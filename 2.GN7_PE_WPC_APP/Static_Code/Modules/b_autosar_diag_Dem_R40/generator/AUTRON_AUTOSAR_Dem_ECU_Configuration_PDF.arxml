AUTOSAR XML (schema 4-0-3)
# (C) 2013 HYUNDAI AUTRON Co., Ltd.
# Confidential Proprietary Information. Distribution Limited.
# Do Not Copy Without Prior Permission
package /AUTRON
  ecuc definition collection ParameterDefinition_Dem: module=Dem
  module definition Dem: refined-module-def=Dem, variants pre-compile  # Configuration of the Dem (Diagnostic Event Manager) module.
    container DemConfigSet  # This container contains the configuration parameters and sub containers of the Dem module supporting multiple configuration sets. This container is a MultipleConfigurationContainer, i.e. this container and its sub-containers exist once per configuration set.
      container DemDTCClass [0..65535]  # This container contains the configuration (parameters) for DTCClass.
        integer DemDTCFunctionalUnit [0..1]: 0..255, set at pre-compile  # DTCFunctionalUnit is a 1-byte value which identifies the corresponding basic vehicle / system function which reports the DTC. This parameter is necessary for the report of severity informations.
        enumeration DemDTCSeverity [0..1]: {DEM_DTC_SEV_CHECK_AT_NEXT_HALT, DEM_DTC_SEV_IMMEDIATELY, DEM_DTC_SEV_MAINTENANCE_ONLY, DEM_DTC_SEV_NO_SEVERITY}, set at pre-compile  # DTC severity | This parameter depends on automotive manufacturer and is optional. DEM_DTC_SEV_CHECK_AT_NEXT_HALT: Check at next halt DEM_DTC_SEV_IMMEDIATELY: Check immediately DEM_DTC_SEV_MAINTENANCE_ONLY: Maintenance required DEM_DTC_SEV_NO_SEVERITY: No severity information available
        boolean DemImmediateNvStorage: set at pre-compile, default-value=false  # Switch to enable immediate storage triggering of an according event memory entry persistently to NVRAM. | true: immediate non-volatile storage triggering enabled false: immediate non-volatile storage triggering disabled
        integer DemObdDTC [0..1]: 1..65535, set at pre-compile  # Unique Diagnostic Trouble Code value for OBD
        integer DemUdsDTC [0..1]: 1..16777214, set at pre-compile  # Unique Diagnostic Trouble Code value for UDS | (Range: 0x000000 and 0xFFFFFF are reserved for DTC groups by ISO 14229-1)
        integer DemJ1939DTCValue [0..1]: 1..16777214, set at pre-compile, origin=AUTRON_v1.0.0  # Unique Diagnostic Trouble Code value for J1939 (consiting of SPN andFMI) | (Range: 0x000000 and 0xFFFFFF are reserved for DTC groups by ISO 14229-1)
        integer DemUdsStatusAvailabilityMask [0..1]: 1..255, set at pre-compile, origin=AUTRON_v1.0.0  # Mask for the supported DTC status bits by the Dem. This mask is used by UDS service 0x19. This is used as DTC Status but not DTCStatusAvailabilityMask in the response message. Also, this is a subset of the mask.
        boolean DemJ1939DM1ActiveConditionConfirmedDTC [0..1]: set at pre-compile, origin=AUTRON_v1.0.0, default-value=true  # Switch to include the ComfirmedDTC bit with the match fillter of J1939 DM1 or not | true: the match filter - TestFailed bit0 == 1 and ComfirmedDTC bit3 == 1 false: the match filter - TestFailed bit0 == 1
        integer DemObdDTCValue3Byte [0..1]: 256..16777214, set at pre-compile  # Unique Diagnostic Trouble Code value for OBD
        enumeration DemWWHOBDDTCClass [0..1]: {DEM_DTC_WWHOBD_CLASS_A, DEM_DTC_WWHOBD_CLASS_B1, DEM_DTC_WWHOBD_CLASS_B2, DEM_DTC_WWHOBD_CLASS_C, DEM_DTC_WWHOBD_CLASS_NOCLASS}, scope=ECU, multiplicity set at pre-compile, set at pre-compile  # DTC Class according to ISO 14229-1 [2013 version]. This parameter depends on the automotive manufacturer. | If it is not configured, the value is marked as 'unclassified'. If this parameter is configured for no DTC, the Dem provides no DTC WWHOBD class information.
      container DemEventParameter [1..65535]  # This container contains the configuration (parameters) for events. | Note that this container definition does not explicitly define a symbolic name parameter. Instead, the short name of the container will be used in the Ecu Configuration Description to specify the symbolic name of the diagnostic event.
        integer DemEventId: 1..65535, set at pre-compile, symbolic-name-value=true  # Unique identifier of a diagnostic event. | This parameter should not be changeable by user, because the Id should be generated by Dem itself to prevent gaps and multiple use of an Id. The events should be sequentially ordered beginning with 1 and no gaps in between.
        enumeration DemEventKind: {DEM_EVENT_KIND_BSW, DEM_EVENT_KIND_SWC}, set at pre-compile  # This parameter is used to distinguish between SW-C and BSW events. SW-C events are reported by Dem_SetEventStatus API and BSW events are reported by Dem_ReportErrorStatus API. | DEM_EVENT_KIND_BSW:The event is a assigned to a BSW module DEM_EVENT_KIND_SWC: The event is a assigned to a SW-C
        integer DemMaxNumberFreezeFrameRecords [0..1]: 0..255, set at pre-compile  # This parameter defines the number of according freeze frame records, which can maximal be stored for this event. Therefore all these freeze frame records have the same freeze frame class. | This parameter is only required for calculated record numeration (refer to DemTypeOfFreezeFrameRecordNumeration).
        boolean DemEventStatusBitStorageTestFailed [0..1]: set at pre-compile, origin=AUTRON_v1.0.0, default-value=false  # Activate/Deactivate the permanent storage of the "TestFailed" status bits.In case DemEventStatusBitStorageTestFailed is not present, the DemStatusBitStorageTestFailed is used instead. | true: If event is stored in the event memory entry then storage activated false: storage deactivated. Clears TestFailed bit, if the respective operation cycle starts
        enumeration DemEventStatusBitResetWarningIndicatorRequested [0..1]: {DEM_WIR_RESET_ON_OPERATIONCYCLE_END, DEM_WIR_RESET_ON_OPERATIONCYCLE_START}, set at pre-compile  # Activate/Deactivate the permanent storage of the "WarningIndicatorRequested" status bit. | DEM_WIR_RESET_ON_OPERATIONCYCLE_END: storage deactivated. Clears "WarningIndicatorRequested" bit, if the respective operation cycle ends . DEM_WIR_RESET_ON_OPERATIONCYCLE_START: storage deactivated. Clears "WarningIndicatorRequested" bit, if the respective operation cycle starts.
        boolean DemResetEventStatus [0..1]: set at pre-compile, origin=AUTRON_v1.0.0  # Activate/Deactivate Clear Event which does not allocate the event memory entry.
        reference DemDTCClassRef [0..1]: set at pre-compile, destination=DemDTCClass  # This parameter defines the DTC configuration associated with the diagnostic event. | It is allowed to have events without a DTC (e.g. for ECU-internal events triggering safety reactions without being reported via diagnostic communication). The same DemDTCClass can be used from several events, to combine these (refer to chapter "Combination of diagonstic event").
        reference DemExtendedDataClassRef [0..1]: set at pre-compile, destination=DemExtendedDataClass  # This reference defines the link to an extended data class sampler.
        reference DemFreezeFrameClassRef [0..1]: set at pre-compile, destination=DemFreezeFrameClass  # These references define the links to a freeze frame class sampler.
        reference DemFreezeFrameRecNumClassRef [0..1]: set at pre-compile, destination=DemFreezeFrameRecNumClass  # This parameter defines the list of dedicated freeze frame record numbers associated with the diagnostic event. These record numbers are assigned to the freeze frame records (instead of calculated record numbers). | This parameter is only required for configured record numeration (refer to DemTypeOfFreezeFrameRecordNumeration).
        reference DemJ1939FreezeFrameClassRef [0..1]: set at pre-compile, destination=DemJ1939FreezeFrameClass  # These references define the links to a J1939 freeze frame class sampler.
        reference DemJ1939ExpandedFreezeFrameClassRef [0..1]: set at pre-compile, destination=DemJ1939FreezeFrameClass  # These references define the links to a J1939 freeze frame class sampler.
        container DemCallbackClearEventAllowed [0..1]  # The presence of this container indicates that the Dem has access to a "ClearEventAllowed" callback. | In case there is a DemCallbackClearEventAllowedFnc, this parameter defines the name of the function that the Dem will call. In case there is no DemCallbackClearEventAllowedFnc, the Dem will have an R-Port requiring the interface CallbackClearEventAllowed whose name is generated by using the unique callback-prefix followed by the event name.
          function name DemCallbackClearEventAllowedFnc [0..1]: set at pre-compile  # Function name of prototype "ClearEventAllowed".
        container DemCallbackEventDataChanged [0..1]  # The presence of this container indicates that the Dem has access to an "EventDataChanged" callback. | In case there is a DemCallbackEventDataChangedFnc, this parameter defines the name of the function that the Dem will call. In case there is no DemCallbackEventDataChangedFnc, the Dem will have an R-Port requiring the interface CallbackEventDataChanged whose name is generated by using the unique callback-prefix followed by the event name.
          function name DemCallbackEventDataChangedFnc [0..1]: set at pre-compile  # Function name of prototype "EventDataChanged"
        container DemCallbackEventStatusChanged [0..*]  # The presence of this container indicates, that the Dem has access to an "EventStatusChanged" callback, which the Dem will call to notify other components about the change in the status of an event. | In case there is a DemCallbackEvenStatusChangedFnc, this parameter defines the name of the function that the Dem will call. In case there is no DemCallbackEvenStatusChangedFnc, the Dem will have an R-Port requiring the interface CallbackEventStatusChanged, whose name is generated by using the unique callback-prefix followed by the event name.
          function name DemCallbackEventStatusChangedFnc [0..1]: set at pre-compile  # Function name of prototype "EventStatusChanged"
        container DemCallbackInitMForE [0..1]  # The presence of this container indicates, that the Dem has access to an "InitMonitorForEvent" callback, which the Dem will call to initialize a monitor. | In case the container has a DemCallbackInitMForEFnc, this parameter defines the name of the function that the Dem will call. In case there is no DemCallbackInitMForEFnc, the Dem will have an R-Port requiring the interface CallbackInitMonitorForEvent, whose name is generated by using the unique callback-prefix followed by the event name.
          function name DemCallbackInitMForEFnc [0..1]: set at pre-compile  # Function name of prototype "InitMonitorForEvent".
        container DemEventClass  # This container contains the configuration (parameters) for EventClass
          boolean DemAgingAllowed: set at pre-compile, default-value=false  # Switch to allow aging/unlearning of the event or not. | true: aging allowed false: aging not allowed
          integer DemAgingCycleCounterThreshold [0..1]: 1..256, set at pre-compile  # Number of aging cycles needed to unlearn/delete the event. if this parameter is blank, a diagnostic event is removed immediately from event memory when a diagnostic event qulified as passed.
          boolean DemConsiderPtoStatus: set at pre-compile, default-value=false  # This parameter is TRUE, when the event is affected by the Dem PTO handling. | true: Event is affected by PTO handling false: Event is not affected by PTO handling
          enumeration DemEventDestination [0..4]: {DEM_DTC_ORIGIN_PRIMARY_MEMORY, DEM_DTC_ORIGIN_SECONDARY_MEMORY}, set at pre-compile  # The event destination assigns events to none, one or multiple origins. | If no event destination is assigned to a specific event, the event is handled internally and is not visible externally to the Dcm. If more than one event destination is assigned to a specific event, the event can be present in the corresponding origins. DEM_DTC_ORIGIN_MIRROR_MEMORY: Event information located in the mirror memory. DEM_DTC_ORIGIN_PRIMARY_MEMORY: Event information located in the primary memory. DEM_DTC_ORIGIN_SECONDARY_MEMORY: Event information located in the secondary memory.
          integer DemEventFailureCycleCounterThreshold [0..1]: 1..256, set at pre-compile, default-value=1  # Defines the number of failure cycles for the event based fault confirmation. Example) DemEventFailureCycleCounterThreshold = 1 if (TestFailed && TestFailedThisOperation 0 to 1) FailureCycleCounter++ if (FailureCycleCounter >= DemEventFailureCycleCounterThreshold ) set ConfirmedDTC bit = 1
          enumeration DemEventOBDReadinessGroup [0..1]: {DEM_OBD_RDY_AC, DEM_OBD_RDY_BOOSTPR, DEM_OBD_RDY_CAT, DEM_OBD_RDY_CMPRCMPT, DEM_OBD_RDY_EGSENS, DEM_OBD_RDY_EGR, DEM_OBD_RDY_EVAP, DEM_OBD_RDY_FLSYS, DEM_OBD_RDY_HCCAT, DEM_OBD_RDY_HTCAT, DEM_OBD_RDY_MISF, DEM_OBD_RDY_NONE, DEM_OBD_RDY_NOXCAT, DEM_OBD_RDY_O2SENS, DEM_OBD_RDY_O2SENSHT, DEM_OBD_RDY_PMFLT, DEM_OBD_RDY_SECAIR}, set at pre-compile, default-value=DEM_OBD_RDY_NONE  # This parameter specifies the Event OBD Readiness group for PID $01 and PID $41 computation. | This parameter is only applicable for emission-related ECUs. DEM_OBD_RDY_AC: A/C system component - spark DEM_OBD_RDY_BOOSTPR: Boost Pressure System - compr. DEM_OBD_RDY_CAT: Catalyst - spark DEM_OBD_RDY_CMPRCMPT: Comprehensive component - spark, compr. DEM_OBD_RDY_EGSENS: Exhaust Gas Sensor - compr. DEM_OBD_RDY_EGR: EGR system - spark, compr. DEM_OBD_RDY_EVAP: Evaporative system - spark DEM_OBD_RDY_FLSYS: Fuel system - spark, compr. DEM_OBD_RDY_HCCAT: Non-Methan HC Catalyst - compr. DEM_OBD_RDY_HTCAT: Heated catalyst - spark DEM_OBD_RDY_MISF: Misfire - spark, compr. DEM_OBD_RDY_NONE: None - spark, compr. DEM_OBD_RDY_NOXCAT: NOx Catalyst - compr. DEM_OBD_RDY_O2SENS: Oxygen sensor - spark DEM_OBD_RDY_O2SENSHT: Oxygen sensor heater - spark DEM_OBD_RDY_PMFLT: Particle Matters Filter - compr. DEM_OBD_RDY_SECAIR: Secondary air system - spark
          integer DemEventPriority: 1..256, set at pre-compile  # Priority of the event, in view of full event buffer.
          enumeration DemEventSignificance [0..1]: {DEM_EVENT_SIGNIFICANCE_FAULT, DEM_EVENT_SIGNIFICANCE_OCCURRENCE}, set at pre-compile  # Significance of the event, which indicates additional information concerning fault classification and resolution. | It can be mapped as Dem-internal data element. It shall be configured, if it is a part of event related data. DEM_EVENT_SIGNIFICANCE_FAULT: failure, which affects the component/ECU itself DEM_EVENT_SIGNIFICANCE_OCCURRENCE: issue, which indicates additional information concerning insufficient system behavior
          boolean DemFFPrestorageSupported: set at pre-compile, default-value=false  # If this parameter is set to true, then the Prestorage of FreezeFrames is supported by the assigned event. This parameter is useful to calculate the buffer size. | true: Prestorage of FreezeFrames is supported by the assigned event false: Prestorage of FreezeFrames is not supported by the assigned event
          choice reference DemAgingCycleRef [0..1]: set at pre-compile, destination=DemOperationCycle  # Reference to the cycle which is triggering the aging of the event. This can either be the same as the operation cycle of the event, or a separate aging cycle reported via API Dem_SetAgingCycleState. If external aging is configured (refer to DemAgingCycleCounterProcessing), this parameter is not used.
          reference DemEnableConditionGroupRef [0..1]: set at pre-compile, destination=DemEnableConditionGroup  # References an enable condition group.
          reference DemOperationCycleRef: set at pre-compile, destination=DemOperationCycle  # Kind of operation cycle for the event (e.g. power cycle, driving cycle, ...)
          reference DemStorageConditionGroupRef [0..1]: set at pre-compile, destination=DemStorageConditionGroup  # References a storage condition group.
          choice container DemDebounceAlgorithmClass  # Debounce algorithm class: counter based, time based, or monitor internal.
            container DemDebounceCounterBased [0..1]  # This container contains the configuration (parameters) for counter based debouncing.
              integer DemDebounceCounterDecrementStepSize: 1..32768, set at pre-compile  # Defines the step size for decrementation of the internal fault detection counter (PREPASSED).
              integer DemDebounceCounterFailedThreshold: 1..32767, set at pre-compile  # Defines the value of the internal fault detection counter, which indicates the failed status.
              integer DemDebounceCounterIncrementStepSize: 1..32767, set at pre-compile  # Defines the step size for incrementation of the internal fault detection counter (PREFAILED).
              boolean DemDebounceCounterJumpDown: set at pre-compile, default-value=false  # Switch for the activation of Jump-Down. | true: Jump-Down activated false: Jump-Down deactivated
              integer DemDebounceCounterJumpDownValue: -32768..32767, set at pre-compile, default-value=0  # Jump-Down value of the internal fault detection counter.
              boolean DemDebounceCounterJumpUp: set at pre-compile, default-value=false  # Switch for the activation of Jump-Up. | true: Jump-Up activated false: Jump-Up deactivated
              integer DemDebounceCounterJumpUpValue: -32768..32767, set at pre-compile, default-value=0  # Jump-Up value of the internal fault detection counter.
              integer DemDebounceCounterPassedThreshold: -32768..-1, set at pre-compile  # Defines the value of the internal fault detection counter, which indicates the passed status.
            container DemDebounceMonitorInternal [0..1]  # This container contains the configuration (parameters) for monitor internal debouncing.
              container DemCallbackGetFDC  # The presence of this container indicates, that the Dem has access to a "GetFaultDetectionCounter" callback, which the Dem will call to obtain the value of the fault detection counter. | In case the container has a DemCallbackGetFDCFnc, this parameter defines the name of the function that the Dem will call. In case there is no DemCallbackGetFDCFnc, the Dem will have a R-Port requiring the interface CallbackGetFaultDetectionCounter, whose name is generated by using the unique callback-prefix followed by the event name.
                function name DemCallbackGetFDCFnc [0..1]: set at pre-compile  # Function name of prototype "GetFaultDetectionCounter".
            container DemDebounceTimeBase [0..1]  # This container contains the configuration (parameters) for time based debouncing.
              float DemDebounceTimeFailedThreshold: 0.001..3600, set at pre-compile  # Defines the time out duration for "Event Failed" qualification. | The AUTOSAR configuration standard is to use SI units, so this parameter is defined as float value in seconds. Dem configuration tools must convert this float value to the appropriate value format for the use in the software implementation of Dem.
              float DemDebounceTimePassedThreshold: 0.001..3600, set at pre-compile  # Defines the time out duration for "Event Passed" qualification. | The AUTOSAR configuration standard is to use SI units, so this parameter is defined as float value in seconds. Dem configuration tools must convert this float value to the appropriate value format for the use in the software implementation of Dem.
          container DemIndicatorAttribute [0..255]  # This container contains the event specific configuration of Indicators.
            enumeration DemIndicatorBehaviour: {DEM_INDICATOR_BLINKING, DEM_INDICATOR_BLINK_CONT, DEM_INDICATOR_CONTINUOUS, DEM_INDICATOR_FAST_FLASH, DEM_INDICATOR_SLOW_FLASH}, set at pre-compile  # Behaviour of the linked indicator | DEM_INDICATOR_BLINKING: The indicator blinks when the event has status FAILED DEM_INDICATOR_BLINK_CONT: The indicator is active and blinkswhen the event has status FAILED DEM_INDICATOR_CONTINUOUS: The indicator is active when the even has status FAILED DEM_INDICATOR_FAST_FLASH: Flash Indicator Lamp should be set to ’Fast Flash’ DEM_INDICATOR_SLOW_FLASH: Flash Indicator Lamp should be set to ’Slow Flash’
            integer DemIndicatorFailureCycleCounterThreshold [0..1]: 0..255, set at pre-compile  # Defines the number of failure cycles for the WarningIndicatorOnCriteria.
            integer DemIndicatorHealingCycleCounterThreshold: 0..255, set at pre-compile  # Defines the number of healing cycles for the WarningIndicatorOffCriteria.
            reference DemIndicatorRef: set at pre-compile, destination=DemIndicator  # Reference to the used indicator.
      container DemPidClass [0..255]  # This container contains the different PIDs for the single global OBD relevant freeze frame class. It is assembled out of one or several data elements.
        integer DemPidIdentifier: 0..255, set at pre-compile  # identifier of the PID
        container DemPidDataElement [1..255]  # This container contains the different data elements contained in the specific PID.
          choice reference DemPidDataElementClassRef: set at pre-compile, destination=[DemExternalCSDataElementClass, DemExternalSRDataElementClass, DemInternalDataElementClass]  # This reference contains the link to a data element class.
      container DemDtrs [0..1]  # This container holds the configuration of DTRs collection.
        container DemDtr [0..65535]  # This container holds the configuration of one individual DTR.
          float DemDtrCompuDenominator0: scope=ECU, set at pre-compile  # Part of the conversion between the binary representation and the physical meaning analogous to the SW-C Template conversion CompuRationalCoeffs with 2 numerator coefficients and 1 denominator coefficient in the direction compuInternalToPhys. | This is the only one supported denominator value, a constant divisor. The value 0 is not allowed.
          float DemDtrCompuNumerator0: scope=ECU, set at pre-compile  # Part of the conversion between the binary representation and the physical meaning analogous to the SW-C Template conversion CompuRationalCoeffs with 2 numerator coefficients and 1 denominator coefficient in the direction compuInternalToPhys. | This is the first numerator value, which is multiplied with x^0, i.e., the offset.
          float DemDtrCompuNumerator1: scope=ECU, set at pre-compile  # Part of the conversion between the binary representation and the physical meaning analogous to the SW-C Template conversion CompuRationalCoeffs with 2 numerator coefficients and 1 denominator coefficient in the direction compuInternalToPhys. | This is the second numerator value, which is multiplied with x^1, i.e., the factor.
          enumeration DemDtrUpdateKind: {DEM_DTR_UPDATE_ALWAYS, DEM_DTR_UPDATE_STEADY}, multiplicity set at pre-compile, set at pre-compile, default-value=DEM_DTR_UPDATE_ALWAYS  # Update conditions applied by the Dem to reports of DTR values. Only supported if a related Event is configured
          integer DemDtrTid: 0..255, scope=ECU, multiplicity set at post-build in variant post-build / pre-compile in variant pre-compile, post-build-variant-multiplicity=true, post-build-variant-value=true, set at post-build in variant post-build / pre-compile in variant pre-compile  # The OBDTID of the DTR.
          integer DemDtrId: 0..65535, scope=ECU, set at pre-compile, symbolic-name-value=true  # The index identifier value assigned to this DTR. The value is generated during the Dem configuration process.
          integer DemDtrUasid: 0..255, scope=ECU, multiplicity set at post-build in variant post-build / pre-compile in variant pre-compile, post-build-variant-multiplicity=true, post-build-variant-value=true, set at post-build in variant post-build / pre-compile in variant pre-compile  # The UaSId the DTR data shall be scaled to, and reported together with the rescaled DTR data.
          integer DemDtrMid: 0..255, scope=ECU, multiplicity set at post-build in variant post-build / pre-compile in variant pre-compile, post-build-variant-multiplicity=true, post-build-variant-value=true, set at post-build in variant post-build / pre-compile in variant pre-compile  # The OBDMID of the DTR. | The values 0x00, 0x20, 0x40, 0x60, 0x80, 0xA0, 0xC0, 0xE0 are reserved.
          reference DemDtrEventRef [0..1]: scope=ECU, multiplicity set at pre-compile, set at pre-compile, destination=DemEventParameter  # Reference to the DemEventParameter this DTR is related to. If the related event is not configured, the Dem cannot ensure consistency between the DTR and the event.
    container DemGeneral  # This container contains the configuration (parameters) of the BSW Dem
      enumeration DemAgingCycleCounterProcessing: {DEM_PROCESS_AGINGCTR_EXTERN, DEM_PROCESS_AGINGCTR_INTERN}, category=FIXED, set at pre-compile, default-value=DEM_PROCESS_AGINGCTR_INTERN  # This configuration switch defines, whether the aging counter is calculated Dem-internally or provided via Dem_SetAgingCycleCounterValue. | DEM_PROCESS_AGINGCTR_EXTERN: based on API Dem_SetAgingCycleCounterValue DEM_PROCESS_AGINGCTR_INTERN: based on reported cycle states
      integer DemBswErrorBufferSize: 0..255, set at pre-compile  # Maximum number of elements in buffer for handling of BSW errors (ref. to Dem107).
      enumeration DemClearDTCBehavior: {DEM_CLRRESP_NONVOLATILE_FINISH, DEM_CLRRESP_NONVOLATILE_TRIGGER, DEM_CLRRESP_VOLATILE}, set at pre-compile  # Defines the clearing process of diagnostic information for volatile and non-volatile memory and the positive response handling for the Dcm module. | DEM_CLRRESP_NONVOLATILE_FINISH: Return DEM_CLEAR_OK after volatile and non-volatile event memory data cleared. DEM_CLRRESP_NONVOLATILE_TRIGGER: Return DEM_CLEAR_OK after volatile event memory data cleared and non-volatile event memory clearing is triggered DEM_CLRRESP_VOLATILE: Return DEM_CLEAR_OK after volatile event memory data cleared
      boolean DemDTCSuppressionSupport: set at pre-compile, default-value=false  # This configuration switch defines, whether support for DTC suppression is enabled or not. | true: DTC suppression support is enabled false: DTC suppression support is disabled
      boolean DemDebounceCounterBasedSupport: set at pre-compile, default-value=false  # This configuration switch defines, whether support for counter based debouncing is enabled or not. | true: counter based debouncing support is enabled false: counter based debouncing support is disabled
      boolean DemDebounceTimeBasedSupport: set at pre-compile, default-value=false  # This configuration switch defines, whether support for time based debouncing is enabled or not. | true: time based debouncing support is enabled false: time based debouncing support is disabled
      boolean DemDevErrorDetect: set at pre-compile, default-value=true  # Activate/Deactivate the Development Error Detection and Notification. | true: Development Error Detection and Notification activated false: Development Error Detection and Notification deactivated
      integer DemDtcStatusAvailabilityMask: 0..255, set at pre-compile  # Mask for the supported DTC status bits by the Dem. This mask is used by UDS service 0x19.
      boolean DemEnableConditionSupport: set at pre-compile, default-value=false  # This configuration switch defines, whether support for enable conditions is enabled or not. | true: support for enable conditions is enabled false: support for enable conditions is disabled
      enumeration DemEventCombinationSupport: {DEM_EVCOMB_DISABLED, DEM_EVCOMB_TYPE1}, set at pre-compile  # This parameter defines the type of event combination supported by the Dem. | DEM_EVCOMB_DISABLED: No event combination supported DEM_EVCOMB_TYPE1: Event combination Type 1 enabled DEM_EVCOMB_TYPE2: Event combination Type 2 enabled
      boolean DemEventDisplacementSupport: set at pre-compile, default-value=false  # This configuration switch defines, whether support for event displacement is enabled or not. | true: event displacement support is enabled false: event displacement support is disabled
      enumeration DemExtendedDataCapture [0..1]: {DEM_TRIGGER_TESTFAILED}, set at pre-compile  # This parameter defines the point in time, when the extended data collection is done for the initial event memory entry. | DEM_TRIGGER_EVENT_MEMORY_STORAGE: Triggers the collection of extended data if the event is stored in fault memory. DEM_TRIGGER_TESTFAILED: Triggers the collection of extended data if the UDS DTC status bit 0 (TestedFailed) changes from 0 to 1.
      enumeration DemFreezeFrameCapture [0..1]: {DEM_TRIGGER_TESTFAILED}, set at pre-compile  # This parameter defines the point in time, when the freeze frame data collection is done for the initial event memory entry. | DEM_TRIGGER_EVENT_MEMORY_STORAGE: Triggers the collection of freeze frame data if the event is stored in fault memory. DEM_TRIGGER_TESTFAILED: Triggers the collection of freeze frame data if the UDS DTC status bit 0 (TestedFailed) changes from 0 to 1.
      string DemHeaderFileInclusion [0..*]: set at pre-compile, regular-expression=[a-zA-Z0-9_]([a-zA-Z0-9\._])*  # Name of the header file(s) to be included by the Dem module containing the used C-callback declarations.
      integer DemImmediateNvStorageLimit [0..1]: 1..255, set at pre-compile  # This parameter defines the maximum number of occurrences, a specific event memory entry is allowed, to be stored in NVRAM immediately (refer to DemImmediateNvStorage).
      integer DemMaxNumberEventEntryMirror: 0..255, category=NOT_SUPPORTED, set at pre-compile, default-value=0  # Maximum number of events which can be stored in the mirror memory
      integer DemMaxNumberEventEntryPermanent: 0..255, set at pre-compile, default-value=0  # Maximum number of events which can be stored in the permanent memory. | The assignment of an event to this memory type is dynamic and used for emission-related events only.
      integer DemMaxNumberEventEntryPrimary: 1..255, set at pre-compile  # Maximum number of events which can be stored in the primary memory
      integer DemMaxNumberEventEntrySecondary: 0..255, set at pre-compile, default-value=0  # Maximum number of events which can be stored in the secondary memory
      integer DemMaxNumberPrestoredFF: 0..255, set at pre-compile  # Defines the maximum number for prestored freeze frames. | If set to 0, then freeze frame prestorage is not supported by the ECU.
      boolean DemOBDSupport [0..1]: set at pre-compile, default-value=false  # This configuration switch defines whether OBD is supported or not | true: OBD is supported false: OBD is not supported
      enumeration DemOccurrenceCounterProcessing: {DEM_PROCESS_OCCCTR_CDTC, DEM_PROCESS_OCCCTR_TF}, set at pre-compile  # This configuration switch defines the consideration of the fault confirmation process for the occurrence counter. For OBD and mixed systems (OBD/non OBD, refer to DemOBDSupport) the fault confirmation process must not be considered. | DEM_PROCESS_OCCCTR_CDTC: the occurrence counter is triggered by the TestFailed bit only, but the fault confirmation is not considered DEM_PROCESS_OCCCTR_TF: the occurrence counter is triggered after the fault confirmation was successfull
      boolean DemOperationCycleStatusStorage: set at pre-compile, default-value=true  # Defines if the operation cycle state is available over the power cycle (stored non-volatile) or not. | true: the operation cycle state is stored non-volatile false: the operation cycle state is only stored volatile
      boolean DemPTOSupport: set at pre-compile, default-value=false  # This configuration switch defines, whether PTO support (and therefore PID $1E support) is enabled or not. | true: PTO support is enabled false: PTO support is disabled
      enumeration DemStatusBitHandlingTestFailedSinceLastClear: {DEM_STATUS_BIT_AGING_AND_DISPLACEMENT, DEM_STATUS_BIT_NORMAL}, set at pre-compile, default-value=DEM_STATUS_BIT_NORMAL  # This configuration switch defines, whether the aging and displacement mechanism shall be applied to the "TestFailedSinceLastClear" status bits. | DEM_STATUS_BIT_AGING_AND_DISPLACEMENT: the "TestFailedSinceLastClear" status bits are reset to 0, if aging or displacement applies (like done for the "ConfirmedDTC" status bits) DEM_STATUS_BIT_NORMAL: aging and displacement has no impact on the "TestFailedSinceLastClear" status bits
      boolean DemStatusBitStorageTestFailed: set at pre-compile, default-value=false  # Activate/Deactivate the permanent storage of the "TestFailed" status bits. | true: storage activated false: storage deactivated
      boolean DemStorageConditionSupport: set at pre-compile, default-value=false  # This configuration switch defines, whether support for storage conditions is enabled or not. | true: support for storage conditions is enabled false: support for storage conditions is disabled
      float DemTaskTime: 0..0.1, set at pre-compile  # Allow to configure the time for the periodic cyclic task. Please note: This configuration value shall be equal to the value in the Basic Software Scheduler configuration of the RTE module. | The AUTOSAR configuration standard is to use SI units, so this parameter is defined as float value in seconds. Dem configuration tools must convert this float value to the appropriate value format for the use in the software implementation of Dem. min: A negative value is not allowed. max: After event status was reported, processing shall be completed within 100ms in order to have the fault entry status information updated as soon as possible (e.g. for PID $01). upperMultiplicity: Exactly one TaskTime must be specified per configuration. lowerMultiplicity: Exactly one TaskTime must be specified per configuration.
      boolean DemTriggerDcmReports: category=NOT_SUPPORTED, set at pre-compile, default-value=false  # Activate/Deactivate the notification to the Diagnostic Communication Manager for ROE processing. | true: Dcm ROE notification activated false: Dcm ROE notification deactivated
      boolean DemTriggerDltReports: category=NOT_SUPPORTED, set at pre-compile, default-value=false  # Activate/Deactivate the notification to the Diagnostic Log and Trace. | true: Dlt notification activated false: Dlt notification deactivated
      boolean DemTriggerFiMReports: set at pre-compile, default-value=false  # Activate/Deactivate the notification to the Function Inhibition Manager. | true: FiM notification activated false: FiM notification deactivated
      boolean DemTriggerMonitorInitBeforeClearOk: set at pre-compile, default-value=false  # Defines if the monitor re-initialization has to be triggered before or after the Dem module returns DEM_CLEAR_OK. | true: trigger re-initialization before DEM_CLEAR_OK false: trigger re-initialization after DEM_CLEAR_OK
      enumeration DemTypeOfDTCSupported: {DEM_DTC_TRANSLATION_ISO11992_4, DEM_DTC_TRANSLATION_ISO14229_1, DEM_DTC_TRANSLATION_ISO15031_6, DEM_DTC_TRANSLATION_SAEJ1939_73, DEM_DTC_TRANSLATION_J2012DA_FORMAT_04}, set at pre-compile, default-value=DEM_DTC_TRANSLATION_ISO15031_6  # This parameter defines the format returned by Dem_GetTranslationType and does not relate to/influence the supported Dem functionality. DEM_DTC_TRANSLATION_ISO11992_4: ISO11992-4 DTC format DEM_DTC_TRANSLATION_ISO14229_1: ISO14229-1 DTC format (3 byte format) DEM_DTC_TRANSLATION_ISO15031_6: ISO15031-6 DTC format (2 byte format) DEM_DTC_TRANSLATION_SAEJ1939_73: SAEJ1939-73 DTC format DEM_DTC_TRANSLATION_J2012DA_FORMAT_04: SAE_J2012-DA_DTCFormat_00 (3 byte format)
      enumeration DemTypeOfFreezeFrameRecordNumeration: {DEM_FF_RECNUM_CALCULATED, DEM_FF_RECNUM_CONFIGURED}, set at pre-compile  # This parameter defines the type of assigning freeze frame record numbers for event-specific freeze frame records. | DEM_FF_RECNUM_CALCULATED: freeze frame records will be numbered consecutive starting by 1 in their chronological order DEM_FF_RECNUM_CONFIGURED: freeze frame records will be numbered based on the given configuration in their chronological order
      boolean DemVersionInfoApi: set at pre-compile, default-value=false  # Activate/Deactivate the version information API. | true: version information activated false: version information deactivated
      enumeration DemEngineType [0..1]: {DEM_ENGINE_SPARK, DEM_ENGINE_COMPRESSION}, set at pre-compile, origin=AUTRON_v1.0.0  # This parameter defines the type of the ECU engine. | DEM_ENGINE_SPARK: Spark Ignition Engine DEM_ENGINE_COMPRESSION: Compression Ignition Engine
      enumeration DemObdCompliance [0..1]: {DEM_OBDII_CALIFORNIAARB, DEM_OBD_US_FEDERALEPA, DEM_OBD_and_OBDII, DEM_OBDI_CERTIFIEDTOCALIFORNIA, DEM_NOT_OBD_COMPLIANT, DEM_EOBD, DEM_EOBD_and_OBDII, DEM_EOBD_and_OBD, DEM_EOBD_OBD_and_OBDII, DEM_JOBD, DEM_JOBD_and_OBDII, DEM_JOBD_and_EOBD, DEM_JOBD_EOBD_and_OBDII, DEM_EMD, DEM_EMDPLUS, DEM_HD_OBD_C, DEM_HD_OBD, DEM_WWH_OBD, DEM_HD_EOBD_I, DEM_HD_EOBD_I_N, DEM_HD_EOBD_II, DEM_HD_EOBD_II_N, DEM_OBDBR_1, DEM_OBDBR_2}, set at pre-compile, origin=AUTRON_v1.0.0  # This parameter defines the OBD requirements to which vehicle or engine is certified. | DEM_OBDII_CALIFORNIAARB : California-only (including other "green" states) OBD II certified systems. "Certified to California OBDII" should only be included if the actual test group DEM_OBD_US_FEDERALEPA : US Federal only OBD-certified (including vehicles using US Federal allowance to certify to California OBDII but then turn off/disable 0.020" evap leak detection DEM_OBD_and_OBDII : US 50-state certified or non-California vehicles certified to California OBDII requirements (including 0.020" evap leak detection) in lieu of US Federal OBD. DEM_OBDI_CERTIFIEDTOCALIFORNIA : Certified to California OBDI requirements (pre-1996 model year California certified vehicles) DEM_NOT_OBD_COMPLIANT : Not certified to any OBD requirements (e.g., US Federal pre-1996 model year, Canadian pre-1997 model year, non-street legal applications, US Federal 8500-14000 vehicles not in phase-ins of 2004-2008 US Federal OBD) DEM_EOBD : Euro OBD DEM_EOBD_and_OBDII : Euro OBD and OBDII DEM_EOBD_and_OBD : EOBD and OBD DEM_EOBD_OBD_and_OBDII : EOBD, OBD and OBD II DEM_JOBD : Japan OBD DEM_JOBD_and_OBDII : JOBD and OBD II DEM_JOBD_and_EOBD : JOBD and EOBD DEM_JOBD_EOBD_and_OBDII : JOBD, EOBD, and OBD II DEM_EMD : Engine Manufacturer Diagnostics (EMD)-Heavy-duty vehicles (>14,000) certified to EMD under title 13, CCR section 1971 (e.g., 2007-2009 model year diesel and gasoline engines) DEM_EMDPLUS : Engine Manufacturer Diagnostics Enhanced(EMD+)-Heavy-duty vehicles (>14,000) certified to EMD+ under title 13, CCR section 1971.1 (e.g., 2010-2012 model year diesel and gasoline enginesnot certified to HD OBD, 2013-2019 model year alternate fuel engines) DEM_HD_OBD_C : Heavy Duty On-Board Diagnostics (Child/Partial) - Heavy-duty engines (>14,000)certified to HDOBD as an extrapolated/child rating under title 13, CCR section 1971.1(d)(7.1.2) or (7.2.3) (e.g., 2010-2015 model year diesel and gasoline engines that are subject to HDOBD but are not the full OBD/parent rating) DEM_HD_OBD : Heavy Duty On-Board Diagnostics - Heavyduty engines (>14,000) certified to HDOBD as a full OBD/parent rating under title 13, CCR section 1971.1(d)(7.1.1) or (7.2.2) (e.g., 2010 and beyond model year diesel and gasoline engines that are subject to full HDOBD) DEM_WWH_OBD : World Wide Harmonized OBD DEM_HD_EOBD_I : Heavy Duty Euro OBD Stage I without NOx control DEM_HD_EOBD_I_N : Heavy Duty Euro OBD Stage I with NOx control DEM_HD_EOBD_II : Heavy Duty Euro OBD Stage II without NOx control DEM_HD_EOBD_II_N : Heavy Duty Euro OBD Stage II with NOx control DEM_OBDBR_1 : Brazil OBD Phase 1 DEM_OBDBR_2 : Brazil OBD Phase 2
      boolean DemAgingRequieresTestedCycle: set at pre-compile, origin=AUTOSAR_ECUC_v422, default-value=true  # Defines if the aging cycle counter is processed every aging cycles or if only tested aging cycle are considered. | true: only tested aging cycle are considered for aging cycle counter false: aging cycle counter is processed every aging cycle
      boolean DemHealingRequieresTestedCycle: set at pre-compile, origin=AUTRON_v1.0.0, default-value=true  # Defines if the healing cycle counter is processed every event operation cycles or if only tested event operation cycle are considered. | true: only tested event operation cycle are considered for healing cycle counter false: healing cycle counter is processed every event operation cycle
      boolean DemNvRamBlockAccessOptimizationSupport [0..1]: set at pre-compile, origin=AUTRON_v1.0.0, default-value=false  # This configuration switch defines, whether support for nvm access optimization is enabled or not. | true: support for nvm access optimization is enabled false:support for nvm access optimization is disabled
      boolean DemFimIntegrated [0..1]: set at pre-compile, origin=AUTRON_v1.0.0, default-value=false  # This configuration switch defines, whether FiM is integrated | true: FiM is integrated false: FiM is not integrated
      boolean DemEventClearSupport [0..1]: set at pre-compile, origin=AUTRON_v1.0.0, default-value=false  # Activate/Deactivate Clear Event which does not allocate the event memory entry.
      reference DemMILIndicatorRef [0..1]: set at pre-compile, destination=DemIndicator  # This parameter defines the indicator representing the MIL. | This parameter is mandatory for ECUs supporting OBD (refer to DemOBDSupport).
      container DemCallbackDTCStatusChanged [0..*]  # The presence of this container indicates, that the Dem has access to a "DTCStatusChanged" callback, which the Dem will call to notify other components about the change in the status of a DTC. | In case there is a DemCallbackDTCStatusChangedFnc, this parameter defines the name of the function that the Dem will call. In case there is no DemCallbackDTCStatusChangedFnc, the Dem will have an R-Port requiring the interface CallbackDTCStatusChanged whose name is generated by using the unique callback-prefix followed by the event name.
        function name DemCallbackDTCStatusChangedFnc [0..1]: set at pre-compile  # Function name of prototype "DTCStatusChanged". | Note: If the parameter DemTriggerDcmReports is enabled, this parameter shall not be "Dcm_DemTriggerOnDTCStatus".
      choice container DemDataElementClass [0..255]  # This container contains the configuration (parameters) for an internal/external data element class.
        container DemExternalCSDataElementClass [0..1]  # This container contains the configuration (parameters) for an external client/server based data element class. | It defines, how the Dem can obtain the value of the data element from either a SW-C or another BSW module. Whether a client/server port or a C function-call is used, is defined by DemDataElementUsePort.
          integer DemDataElementDataSize: 1..255, set at pre-compile  # Defines the size of the data element in bytes.
          function name DemDataElementReadFnc [0..1]: set at pre-compile  # In case of DemDataElementUsePort is false, this parameter defines the prototype of the C function "ReadDataElement" used to get the according value.
          boolean DemDataElementUsePort: set at pre-compile, default-value=false  # If the parameter is set to True, a R-Port is generated, to obtain the data element (interface DataServices_<SyncDataElement>). | If the parameter is set to False, the information is obtained by C function-call on another BSW module specified by the parameter DemDataElementReadFnc.
        container DemExternalSRDataElementClass [0..0]: category=NOT_SUPPORTED  # This container contains the configuration (parameters) for an external sender/receiver based data element class. It defines, how the Dem can obtain the value of the data element from a SW-C, by using a sender/receiver port.
          integer DemDataElementDataSize: 1..255, category=NOT_SUPPORTED, set at pre-compile  # Defines the size of the data element in bits.
          instance reference DemDataElementInstanceRef: category=NOT_SUPPORTED, set at pre-compile, destination-context=ROOT-SW-COMPOSITION-PROTOTYP SW-COMPONENT-PROTOTYPE+ PORT-PROTOTYPE, destination-type=VARIABLE-DATA-PROTOTYPE  # Instance Reference to the actual OperationPrototype which shall be traced.
        container DemInternalDataElementClass [0..1]  # This container contains the configuration (parameters) for an internal data element class.
          integer DemDataElementDataSize: 1..255, set at pre-compile  # Defines the size of the data element in bytes.
          enumeration DemInternalDataElement: {DEM_AGINGCTR, DEM_OCCCTR, DEM_OVFLIND, DEM_SIGNIFICANCE, DEM_DTR, DEM_IUMPR, DEM_MONITOR_ACTIVITY_DATA}, set at pre-compile  # This parameter defines the Dem-internal data value, which is mapped to the data element. | DEM_AGINGCTR: map Dem-internal aging counter DEM_OCCCTR: map Dem-internal occurrence counter DEM_OVFLIND: map Dem-internal overflow indication DEM_SIGNIFICANCE: map (static) Dem-internal event significance (refer to DemEventSignificance)
      container DemDidClass [0..255]  # This container contains the configuration (parameters) for a data Id class. It is assembled out of one or several data elements.
        integer DemDidIdentifier: 0..65535, set at pre-compile  # Identifier of the Data ID.
        choice reference DemDidDataElementClassRef [1..255]: set at pre-compile, destination=[DemExternalCSDataElementClass, DemExternalSRDataElementClass, DemInternalDataElementClass]  # This reference contains the link to a data element class.
      container DemEnableCondition [0..255]  # This container contains the configuration (parameters) for enable conditions.
        integer DemEnableConditionId: 0..255, set at pre-compile, symbolic-name-value=true  # Defines a unique enable condition Id. | This parameter should not be changeable by user, because the Id should be generated by Dem itself to prevent gaps and multiple use of an Id. The enable conditions should be sequentially ordered beginning with 0 and no gaps in between.
        boolean DemEnableConditionStatus: set at pre-compile, default-value=false  # Defines the initial status for enable or disable of acceptance of event reports of a diagnostic event. | The value is the initialization after power up (before this condition is reported the first time). true: acceptance of a diagnostic event enabled false: acceptance of a diagnostic event disabled
      container DemEnableConditionGroup [0..255]  # This container contains the configuration (parameters) for enable condition groups.
        reference DemEnableConditionRef [1..255]: set at pre-compile, destination=DemEnableCondition  # References an enable condition.
      container DemExtendedDataClass [0..253]  # This class contains the combinations of extended data records for an extended data class.
        reference DemExtendedDataRecordClassRef [1..253]: set at pre-compile, destination=DemExtendedDataRecordClass  # This reference contains the link to an extended data class record.
      container DemExtendedDataRecordClass [0..255]  # This container contains the configuration (parameters) for an extended data record class. | It is assembled out of one or several data elements.
        integer DemExtendedDataRecordNumber: 0..253, set at pre-compile  # This configuration parameter specifies an unique identifier for an extended data record. | One or more extended data records can be assigned to one diagnostic event/DTC. 0xFF and 0xFE are reserved by ISO (therefore the maximal value equals 253).
        enumeration DemExtendedDataRecordUpdate [0..1]: {DEM_UPDATE_RECORD_NO, DEM_UPDATE_RECORD_YES}, set at pre-compile  # This parameter defines the case, when the extended data record is stored/updated. | DEM_UPDATE_RECORD_NO: This extended data record is only captured for new event memory entries. DEM_UPDATE_RECORD_YES: This extended data record is captured every time.
        choice reference DemDataElementClassRef [1..255]: set at pre-compile, destination=[DemExternalCSDataElementClass, DemExternalSRDataElementClass, DemInternalDataElementClass]  # This reference contains the link to a data element class.
      container DemFreezeFrameClass [0..255]  # This container contains the combinations of DIDs for a non OBD relevant freeze frame class.
        reference DemDidClassRef [1..255]: set at pre-compile, destination=DemDidClass  # For OBD relevant data | Multiple PIDs can be relevant per freeze frame.
      container DemFreezeFrameRecNumClass [0..255]  # This container contains a list of dedicated, different freeze frame record numbers assigned to an event. The order of record numbers in this list is assigned to the chronological order of the according freeze frame records. | dependency: DemTypeOfFreezeFrameRecordNumeration
        integer DemFreezeFrameRecordNumber [1..254]: 0..254, set at pre-compile  # This parameter defines a record number for a freeze frame record. This record number is unique per freeze frame record number class. | The range of this value is defined by ISO 14229-1 (0x01 .. 0xFE).
      container DemGeneralOBD [0..1]  # This container contains the general OBD-specific configuration (parameters) of the Dem module.
        boolean DemSupportedObdUdsDtcSeparation [0..1]: set at pre-compile  # If this parameter is set to true, the OBD UDS DTC separation is enabled. If this parameter is set to false, the OBD UDS DTC separation is disabled.
        choice reference DemOBDInputAcceleratorPaddleInformation [0..1]: set at pre-compile, destination=[DemExternalCSDataElementClass, DemExternalSRDataElementClass]  # Input variable for the accelerator paddle information, which is assigned to a specific data element used as interface for the Dem-internal PID calculations.
        choice reference DemOBDInputAmbientPressure [0..1]: set at pre-compile, destination=[DemExternalCSDataElementClass, DemExternalSRDataElementClass]  # Input variable for the ambient pressure, which is assigned to a specific data element used as interface for the Dem-internal PID calculations.
        choice reference DemOBDInputAmbientTemperature [0..1]: set at pre-compile, destination=[DemExternalCSDataElementClass, DemExternalSRDataElementClass]  # Input variable for the ambient temperature, which is assigned to a specific data element used as interface for the Dem-internal PID calculations.
        choice reference DemOBDInputDistanceInformation [0..1]: set at pre-compile, destination=[DemExternalCSDataElementClass, DemExternalSRDataElementClass]  # Input variable for the distance information, which is assigned to a specific data element used as interface for the Dem-internal PID calculations.
        choice reference DemOBDInputEngineSpeed: set at pre-compile, destination=[DemExternalCSDataElementClass, DemExternalSRDataElementClass]  # Input variable for the engine speed, which is assigned to a specific data element used as interface for the Dem-internal PID calculations.
        choice reference DemOBDInputEngineTemperature [0..1]: set at pre-compile, destination=[DemExternalCSDataElementClass, DemExternalSRDataElementClass]  # Input variable for the engine temperature, which is assigned to a specific data element used as interface for the Dem-internal PID calculations.
        choice reference DemOBDInputProgrammingEvent [0..1]: set at pre-compile, destination=[DemExternalCSDataElementClass, DemExternalSRDataElementClass]  # Input variable for the programming event, which is assigned to a specific data element used as interface for the Dem-internal PID calculations.
        choice reference DemOBDInputVehicleSpeed: set at pre-compile, destination=[DemExternalCSDataElementClass, DemExternalSRDataElementClass]  # Input variable for the vehicle speed, which is assigned to a specific data element used as interface for the Dem-internal PID calculations.
        choice reference DemOBDTimeSinceEngineStart: set at pre-compile, destination=[DemExternalCSDataElementClass, DemExternalSRDataElementClass, DemInternalDataElementClass]  # Input variable for the Time Since Engine Start information, which is assigned to a specific data element.
      container DemGeneralJ1939 [0..1]  # This container contains the general J1939-specific configuration (parameters) of the Dem module. If the container exists the J1939 support is enabled.
        boolean DemJ1939ClearDtcSupport: set at pre-compile, default-value=false  # This configuration switch defines whether clearing J1939 DTCs (DM3 und DM11) is supported or not. This switches on and off the API Dem_J1939DcmClearDTC. | true: J1939 Clear DTC support is enabled false: J1939 Clear DTC support is disabled
        boolean DemJ1939Dm31Support: set at pre-compile, default-value=false  # This configuration switch defines whether J1939 DM31 is supported or not. This switches on and off the APIs Dem_J1939DcmFirstDTCwithLampStatus and Dem_J1939DcmGetNextDTCwithLampStatus. | true: J1939 Dm31 support is enabled false: J1939 Dm31 support is disabled
        boolean DemJ1939ExpandedFreezeFrameSupport: set at pre-compile, default-value=false  # true: J1939 expanded freeze frames support is enabled false: J1939 expanded freeze frames support is disabled
        boolean DemJ1939FreezeFrameSupport: set at pre-compile, default-value=false  # This configuration switch defines whether J1939 freeze frames are supported or not. This switches on and off the APIs Dem_J1939DcmSetFreezeFrameFilter and Dem_J1939DcmGetNextFreezeFrame. | true: J1939 freeze frames support is enabled false: J1939 freeze frames support is disabled
        boolean DemJ1939RatioSupport: set at pre-compile, default-value=false  # This configuration switch defines whether J1939 performance ratios are supported or not. This switches on and off the APIs Dem_J1939DcmSetRatioFilter and Dem_J1939DcmGetNextFilteredRatio. | true: J1939 performance ratios support is enabled false: J1939 performance ratios support is disabled
        boolean DemJ1939Readiness{1..3}Support: set at pre-compile, default-value=false  # This configuration switch defines whether J1939 diagnostic readiness {1..3} is supported or not. This switches on and off the API Dem_J1939DcmReadDiagnosticReadiness{1..3}. | true: J1939 diagnostic readiness {1..3} support is enabled false: J1939 diagnostic readiness {1..3} support is disabled
        boolean DemJ1939ReadingDtcSupport: set at pre-compile, default-value=false  # This configuration switch defines whether J1939 DTC readout is supported or not. This switches on and off the APIs Dem_J1939DcmSetDTCFilter, Dem_J1939DcmGetNumberOfFilteredDTC and Dem_J1939DcmGetNextFilteredDTC. | true: J1939 DTC readout support is enabled false: J1939 DTC readout support is disabled
        reference DemAmberWarningLampIndicatorRef [0..1]: set at pre-compile, origin=AUTOSAR_ECUC_422, destination=DemIndicator  # This parameter defines the indicator representing the AmberWarningLamp. | This parameter defines the indicator representing the AmberWarningLamp . This parameter may be used for ECUs supporting J1939.
        reference DemRedStopLampIndicatorRef [0..1]: set at pre-compile, origin=AUTOSAR_ECUC_422, destination=DemIndicator  # This parameter defines the indicator representing the RedStopLamp. | This parameter defines the indicator representing the RedStopLamp. This parameter may be used for ECUs supporting J1939.
        reference DemProtectLampIndicatorRef [0..1]: set at pre-compile, origin=AUTOSAR_ECUC_422, destination=DemIndicator  # This parameter defines the indicator representing the ProtectLamp. | This parameter defines the indicator representing the ProtectLamp. This parameter may be used for ECUs supporting J1939.
        container DemJ1939FreezeFrameClass [0..255]  # This container contains the combinations of SPNs s for a J1939 relevant freeze frame.
          reference DemSPNClassRef [1..255]: set at pre-compile, destination=DemSPNClass  # Reference to an SPN. | This reference defines requiresIndex = true since it represents a ordered list of references where the order describes the order of single SPNs in the J1939 Freeze Frame.
        container DemSPNClass [0..*]  # This container contains the configuration (parameters) for a SPN.
          integer DemSPNId: 0..524287, set at pre-compile  # This container contains the configuration (parameters) for a SPN.
          choice reference DemSPNDataElementClassRef: set at pre-compile, destination=[DemExternalCSDataElementClass, DemExternalSRDataElementClass, DemInternalDataElementClass]  # This reference contains the link to a data element class.
      container DemGroupOfDTC [0..255]: category=FIXED  # This container contains the configuration (parameters) for DTC groups.
        integer DemGroupDTCs: 0..16777214, set at pre-compile, symbolic-name-value=true  # DTC value of the selected group of DTC | (Range: 3 byte, 0x000000 is only available for the emission-related DTC group, 0xFFFFFF is reserved for 'all DTCs', according to ISO14229-1 Annex D.1,) The DTC group 'all DTCs' is always available and will not be configured.
      container DemIndicator [0..255]  # This container contains the configuration (parameters) for Indicators. | Note that this container definition does not explicitly define a symbolic name parameter. Instead, the short name of the container will be used in the Ecu Configuration Description to specify the symbolic name of the INDICATOR_NAME.
        integer DemIndicatorID: 0..255, set at pre-compile, symbolic-name-value=true  # Unique identifier of an indicator.
      container DemNvRamBlockId [0..*]  # This container contains the configuration (parameters) for a non-volatile memory block, which is used from the Dem. If no permanent storage of event memory entries is required, no block needs to be configured. | The number of blocks which are necessary depends on the implementation and configuration (e.g. number of used event memories) of the Dem module.
        container DemManagementBlock [0..1]  # This container contains the configuration (parameters) for a non-volatile memory block, which is used from the Dem. If no permanent storage of event memory entries is required, no block needs to be configured. | The number of blocks which are necessary depends on the implementation and configuration (e.g. number of used event memories) of the Dem module.
          symbolic name reference DemManagementBlockNvBlockIdRef: set at pre-compile, destination=NvMBlockDescriptor  # This reference contains the link to a non-volatile memory block. For post build time configurations worst case scenario shall be used.
        container DemEventStatusNvRamBlock [0..1]  # This container contains the configuration (parameters) for a non-volatile memory block, which is used from the Dem. If no permanent storage of event memory entries is required, no block needs to be configured. | The number of blocks which are necessary depends on the implementation and configuration (e.g. number of used event memories) of the Dem module.
          symbolic name reference DemEventStatusNvRamBlockIdRef: set at pre-compile, destination=NvMBlockDescriptor  # This reference contains the link to a non-volatile memory block. For post build time configurations worst case scenario shall be used.
        container DemPrimaryEventMemory [0..255]  # This container contains the configuration (parameters) for a non-volatile memory block, which is used from the Dem. If no permanent storage of event memory entries is required, no block needs to be configured. | The number of blocks which are necessary depends on the implementation and configuration (e.g. number of used event memories) of the Dem module.
          symbolic name reference DemPrimaryEventMemoryNvBlockIdRef: set at pre-compile, destination=NvMBlockDescriptor  # This reference contains the link to a non-volatile memory block. For post build time configurations worst case scenario shall be used.
        container DemSecondaryEventMemory [0..255]  # This container contains the configuration (parameters) for a non-volatile memory block, which is used from the Dem. If no permanent storage of event memory entries is required, no block needs to be configured. | The number of blocks which are necessary depends on the implementation and configuration (e.g. number of used event memories) of the Dem module.
          symbolic name reference DemSecondaryEventMemoryNvBlockIdRef: set at pre-compile, destination=NvMBlockDescriptor  # This reference contains the link to a non-volatile memory block. For post build time configurations worst case scenario shall be used.
        container DemPermanentEventMemory [0..255]  # This container contains the configuration (parameters) for a non-volatile memory block, which is used from the Dem. If no permanent storage of event memory entries is required, no block needs to be configured. | The number of blocks which are necessary depends on the implementation and configuration (e.g. number of used event memories) of the Dem module.
          symbolic name reference DemPermanentEventMemoryNvBlockIdRef [0..255]: set at pre-compile, destination=NvMBlockDescriptor  # This reference contains the link to a non-volatile memory block. For post build time configurations worst case scenario shall be used.
      container DemOperationCycle [1..256]  # Note that this container definition does not explicitly define a symbolic name parameter. Instead, the short name of the container will be used in the Ecu Configuration Description to specify the symbolic name of the operation cycle name.
        enumeration DemOperationCycleType: {DEM_OPCYC_IGNITION, DEM_OPCYC_OBD_DCY, DEM_OPCYC_OTHER, DEM_OPCYC_POWER, DEM_OPCYC_TIME, DEM_OPCYC_WARMUP, EcucEnumerationLiteralDef6}, set at pre-compile  # Operation cycles types for the Dem to be supported by cycle-state APIs. | Further cycle types can be specified as part of the Dem delivery. DEM_OPCYC_IGNITION: Ignition ON / OFF cycle DEM_OPCYC_OBD_DCY: OBD Driving cycle DEM_OPCYC_OTHER: further operation cycle DEM_OPCYC_POWER: Power ON / OFF cycle DEM_OPCYC_TIME: Time based operation cycle DEM_OPCYC_WARMUP: OBD Warm up cycle
      container DemRatioId [0..65535]  # This container contains the OBD specific ratio Id configuration. It is related to a specific event, a FID, and an IUMPR group. | Note that this container definition does not explicitly define a symbolic name parameter. Instead, the short name of the container will be used in the Ecu Configuration Description to specify the symbolic name of the ratio Id name.
        enumeration DemIUMPRGroup: {DEM_IUMPR_BOOSTPRS, DEM_IUMPR_CAT1, DEM_IUMPR_CAT2, DEM_IUMPR_EGR, DEM_IUMPR_EGSENSOR, DEM_IUMPR_EVAP, DEM_IUMPR_NMHCCAT, DEM_IUMPR_NOXADSORB, DEM_IUMPR_NOXCAT, DEM_IUMPR_OXS1, DEM_IUMPR_OXS2, DEM_IUMPR_PMFILTER, DEM_IUMPR_PRIVATE, DEM_IUMPR_SAIR, DEM_IUMPR_SECOXS1, DEM_IUMPR_SECOXS2}, set at pre-compile  # This parameter specifies the assigned IUMPR group of the ratio Id.
        enumeration DemRatioIdType: {DEM_RATIO_API, DEM_RATIO_OBSERVER}, set at pre-compile  # This parameter defines whether the ratio Id will be calculated API or observer based. | DEM_RATIO_API: API based ratio Id DEM_RATIO_OBSERVER: Observer based ratio Id
        enumeration DemIUMPRDenGroup: {DEM_IUMPR_DEN_500MILL, DEM_IUMPR_DEN_COLDSTART, DEM_IUMPR_DEN_EVAP, DEM_IUMPR_DEN_NONE, DEM_IUMPR_DEN_PHYS_API}, set at pre-compile  # This parameter specifies the assigned denominator type which is applied in addition to the DEM_IUMPR_GENERAL_INDIVIDUAL_DENOMINATOR conditions.
        reference DemDiagnosticEventRef: set at pre-compile, destination=DemEventParameter  # This reference contains the link to a diagnostic event.
        symbolic name reference DemFunctionIdRef: set at pre-compile, destination=FiMFID  # This reference contains the link to a function identifier within the FiM which is used as a primary FID.
        symbolic name reference DemSecondaryFunctionIdRef [0..*]: set at pre-compile, destination=FiMFID  # This reference contains the link to a function identifier within the FiM which is used as a secondary FID. | The "primary" and all "secondary" FID inhibitions are combined by "OR".
      container DemStorageCondition [0..255]  # This container contains the configuration (parameters) for storage conditions.
        integer DemStorageConditionId: 0..255, set at pre-compile, symbolic-name-value=true  # Defines a unique storage condition Id. This parameter should not be changeable by user, because the Id should be generated by Dem itself to prevent gaps and multiple use of an Id. The storage conditions should be sequentially ordered beginning with 0 and no gaps in between.
        boolean DemStorageConditionStatus: set at pre-compile, default-value=false  # Defines the initial status for enable or disable of storage of a diagnostic event. | The value is the initialization after power up (before this condition is reported the first time). true: storage of a diagnostic event enabled false: storage of a diagnostic event disabled
      container DemStorageConditionGroup [0..255]  # This container contains the configuration (parameters) for storage condition groups.
        reference DemStorageConditionRef [1..255]: set at pre-compile, destination=DemStorageCondition  # References an enable condition.
