AUTOSAR XML (schema 4-0-3)
# (C) 2018 HYUNDAI AUTRON Co., Ltd.
# Confidential Proprietary Information. Distribution Limited.
# Do Not Copy Without Prior Permission
package /AUTRON
  ecuc definition collection ParameterDefinition_CDD_Router: module=Cdd
  module definition Cdd [0..*]: api-service-prefix=Cdd_Router  # The CDD module describes the minimal requirements that are necessary for the configuration of a CDD with respect to the surrounding standardized BSW modules.
    container CddComStackContribution [0..1]  # Contribution of COM Stack modules.
      container CddComIfUpperLayerContribution [0..1]  # Parameters that are necessary for the configuration of a Complex Driver that serves as the UpperLayer of the Com Interface module.
        container CddComIfUpperLayerRxPdu [0..*]  # This container specifies Rx PDUs that are exchanged between the CDD and the standardized BSW module.
          integer CddComIfHandleId [0..1]: 0..65535, symbolic-name-value=true  # ECU wide unique, symbolic handle for the Pdu.
          reference CddComIfPduRef: destination=Pdu  # Reference to the "global" Pdu structure to allow harmonization of handle IDs in the COM-Stack.
        container CddComIfUpperLayerTxPdu [0..*]  # This container specifies Tx PDUs that are exchanged between the CDD and the standardized BSW module.
          integer CddComIfHandleId [0..1]: 0..65535, symbolic-name-value=true  # ECU wide unique, symbolic handle for the Pdu.
          reference CddComIfPduRef: destination=Pdu  # Reference to the "global" Pdu structure to allow harmonization of handle IDs in the COM-Stack.
      container CddSoAdUpperLayerContribution [0..1]  # Parameters that are necessary for the configuration of a Complex Driver that serves as the UpperLayer of the SoAd module.
        container CddSoAdUpperLayerRxPdu [0..*]  # This container specifies Rx PDUs that are exchanged between the CDD and the standardized BSW module.
          enumeration CddPduRApiType [0..1]: {IF, TP}  # This parameter configures the type of the CDD interface (IF/TP)
          integer CddSoAdUpperLayerHandleId: 0..65535, symbolic-name-value=true  # ECU wide unique, symbolic handle for the Pdu.
          reference CddSoAdUpperLayerPduRef: destination=Pdu  # Reference to the "global" Pdu structure to allow harmonization of handle IDs in the COM-Stack.
        container CddSoAdUpperLayerTxPdu [0..*]  # This container specifies Tx PDUs that are exchanged between the CDD and the standardized BSW module.
          enumeration CddPduRApiType [0..1]: {IF, TP}  # This parameter configures the type of the CDD interface (IF/TP)
          integer CddSoAdUpperLayerHandleId [0..1]: 0..65535, symbolic-name-value=true  # ECU wide unique, symbolic handle for the Pdu.
          reference CddSoAdUpperLayerPduRef: destination=Pdu  # Reference to the "global" Pdu structure to allow harmonization of handle IDs in the COM-Stack.
      container CddPduRLowerLayerContribution [0..1]  # Parameters that are necessary for the configuration of a Complex Driver that serves as the LowerLayer of the Pdu Router module.
        container CddPduRLowerLayerRxPdu [0..*]  # This container specifies Rx PDUs that are exchanged between the CDD and the standardized BSW module.
          enumeration CddPduRApiType [0..1]: {IF, TP}  # This parameter configures the type of the CDD interface (IF/TP)
          integer CddPduRLowerLayerHandleId [0..1]: 0..65535, symbolic-name-value=true  # ECU wide unique, symbolic handle for the Pdu.
          integer CddTargetAddressId: 0..536870911, set at link in variant link-time / post-build in variant post-build / pre-compile in variant pre-compile, origin=AUTRON  # CAN Identifier of Receive CAN L-PDUs used by the CAN Interface. Exa: Software Filtering. This parameter is used if exactly one Can Identifier is assigned to the Pdu. | Range: 11 Bit For Standard CAN Identifier or 29 Bit For Extended CAN Identifier
          reference CddPduRLowerLayerPduRef: destination=Pdu  # Reference to the "global" Pdu structure to allow harmonization of handle IDs in the COM-Stack.
        container CddPduRLowerLayerTxPdu [0..*]  # This container specifies Tx PDUs that are exchanged between the CDD and the standardized BSW module.
          enumeration CddPduRApiType [0..1]: {IF, TP}  # This parameter configures the type of the CDD interface (IF/TP)
          integer CddPduRLowerLayerHandleId [0..1]: 0..65535, symbolic-name-value=true  # ECU wide unique, symbolic handle for the Pdu.
          integer CddTargetAddressId: 0..536870911, set at link in variant link-time / post-build in variant post-build / pre-compile in variant pre-compile, origin=AUTRON  # CAN Identifier of Receive CAN L-PDUs used by the CAN Interface. Exa: Software Filtering. This parameter is used if exactly one Can Identifier is assigned to the Pdu. | Range: 11 Bit For Standard CAN Identifier or 29 Bit For Extended CAN Identifier
          reference CddPduRLowerLayerPduRef: destination=Pdu  # Reference to the "global" Pdu structure to allow harmonization of handle IDs in the COM-Stack.
          reference CddIfUpperLayerPduRef [0..1]: destination=Pdu  # Reference to the "global" Pdu structure to allow harmonization of handle IDs in the COM-Stack.
      container CddCanTpLowerLayerContribution [0..1]  # Parameters that are necessary for the configuration of a Complex Driver that serves as the LowerLayer of the CanTp module.
        container CddCanTpLowerLayerRxPdu [0..*]  # This container specifies Rx PDUs that are exchanged between the CDD and the standardized BSW module.
          integer CddCanTpLowerLayerHandleId: 0..65535, symbolic-name-value=true  # ECU wide unique, symbolic handle for the Pdu.
          reference CddCanTpLowerLayerPduRef: origin=AUTOEVER, destination=Pdu  # Reference to the "global" Pdu structure to allow harmonization of handle IDs in the COM-Stack.
        container CddCanTpLowerLayerTxPdu [0..*]  # This container specifies Tx PDUs that are exchanged between the CDD and the standardized BSW module.
          integer CddCanTpLowerLayerHandleId: 0..65535, symbolic-name-value=true  # ECU wide unique, symbolic handle for the Pdu.
          reference CddCanTpLowerLayerPduRef: destination=Pdu  # Reference to the "global" Pdu structure to allow harmonization of handle IDs in the COM-Stack.
          reference CddIfUpperLayerPduRef [0..1]: destination=Pdu  # Reference to the "global" Pdu structure to allow harmonization of handle IDs in the COM-Stack.
    container CddEcucPartitionInteraction [0..1]  # This optional container holds the partition interaction configuration.
      function name CddPartitionStoppedFunctionName  # Function name to be called when the partition which is triggering the complex driver is stopped.
      reference CddEcucPartitionRef: destination=EcucPartition  # Reference to the "EcucPartition" which executes the software which triggers the CDD.
