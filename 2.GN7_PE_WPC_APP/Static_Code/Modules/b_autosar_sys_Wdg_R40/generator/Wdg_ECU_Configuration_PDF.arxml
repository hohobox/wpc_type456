AUTOSAR XML (schema 4-0-3)
# (C) 2016 HYUNDAI AUTRON Co., Ltd.
# Confidential Proprietary Information. Distribution Limited.
# Do Not Copy Without Prior Permission
package /AUTRON
  module definition Wdg: refined-module-def=Wdg, variants pre-compile  # Configuration of the Wdg (Watchdog Driver) module.
    container WdgDemEventParameterRefs [0..1]  # Container for the references to DemEventParameter elementswhich shall be invoked using the API Dem_ReportErrorStatus in case the corresponding error occurs. The EventId is taken from the referenced DemEventParameter's DemEventId value. The standardized errors are provided in the container and can be extended by vendor-specific error references.
      reference WDG_E_DISABLE_REJECTED [0..1]: set at pre-compile, destination=DemEventParameter  # Reference to the DemEventParameter which shall be issued when the error "Initialization or mode switch failed because it would disable the watchdog" has occurred.
      reference WDG_E_MODE_FAILED [0..1]: set at pre-compile, destination=DemEventParameter  # Reference to the DemEventParameter which shall be issued when the error "Setting a watchdog mode failed (during initialization or mode switch)" has occurred.
    container WdgGeneral  # All general parameters of the watchdog driver are collected here.
      boolean WdgDevErrorDetect: set at pre-compile, default-value=false  # Compile switch to enable / disable development error detection for this module. True: Development error detection enabled False: Development error detection disabled
      boolean WdgDisableAllowed: set at pre-compile, default-value=false  # Compile switch to allow / forbid disabling the watchdog driver during runtime. True: Disabling the watchdog driver at runtimeis allowed. False: Disabling the watchdog driver at runtime is not allowed.
      integer WdgIndex: 0..255, set at pre-compile, default-value=0  # Represents the watchdog driver's ID so that it can be referenced by the watchdog interface.
      float WdgInitialTimeout: 0..65.535, set at pre-compile, default-value=0.2  # The initial timeout (sec) for the trigger condition to be initialized during Init function. It shall be not larger than WdgMaxTimeout.
      float WdgMaxTimeout: 0..65.535, set at pre-compile, default-value=1.0  # The maximum timeout (sec) to which the watchdog trigger condition can be initialized.
      enumeration WdgRunArea: category=NOT_SUPPORTED, set at pre-compile, default-value=ROM
        RAM  # Watchdog driver to be executed out of RAM area
        ROM  # Watchdog driver to be executed out of ROM area
      function name WdgTriggerLocation: category=NOT_SUPPORTED, set at pre-compile  # Location (memory address) of the watchdog trigger routine.
      boolean WdgVersionInfoApi: set at pre-compile, default-value=false  # Compile switch to enable / disable the version information API * True: API enabled * False: API disabled
      enumeration WdgVendorMcalVersion: {INFINEON_TC2XX, INFINEON_TC3XX, FREESCALE, RENESAS, ST, NXP, CYPRESS_Traveo2}, origin=AUTRON
    container WdgSettingsConfig: multiple-configuration-container=true  # Configuration items for the different watchdog settings, including those for external watchdog hardware. Note: All postbuild parameters are handled via this container.
      enumeration WdgDefaultMode: set at pre-compile, default-value=WDGIF_SLOW_MODE  # Default mode for watchdog driver initialization. ImplementationType: WdgIf_ModeType
        WDGIF_OFF_MODE  # Default watchdog mode is "off"
        WDGIF_SLOW_MODE  # Default watchdog mode is "slow"
        WDGIF_FAST_MODE  # Default watchdog mode is "fast"
      string WdgGptChannelPrefix: origin=AUTRON
      string WdgDioChannelPrefix: origin=AUTRON
      container WdgSettingsOff  # Hardware dependent settings for the watchdog driver's "off" mode.
      container WdgSettingsSlow  # Hardware dependent settings for the watchdog driver's "slow" mode.
        float WdgPeriod: 0.001..65.535, origin=AUTRON, default-value=0.05  # A period of time to send output signals in seconds.
      container WdgSettingsFast  # Hardware dependent settings for the watchdog driver's "fast" mode.
        float WdgPeriod: 0.001..65.535, origin=AUTRON, default-value=0.02  # A period of time to send output signals in seconds.
      container WdgExternalConfiguration [0..1]  # Configuration items for an external watchdog hardware
        choice reference WdgExternalContainerRef [0..1]: category=NOT_SUPPORTED, set at pre-compile, destination=[DioChannelGroup, SpiSequence]  # Reference to either - a DioChannelGroup container in case the hardware watchdog is connected via DIO pins - an SpiSequenceConfiguration container in case the watchdog hardware is accessed via SPI
        reference WdgGptChannelRef: set at pre-compile, origin=AUTRON, destination=GptChannelConfiguration
        choice container WdgExternalDevice
          container WdgDioTrigger
            integer WdgDioTriggerDuty: 1..99, origin=AUTRON, default-value=10  # Duty of the output signals in percent.
            reference WdgDioTriggerChannelRef: origin=AUTRON, destination=DioChannel  # Reference to a DioChannel container in case the hardware watchdog is connected via a DIO pin
          container WdgArisuCan
            enumeration WdgArisuCanTimerPeriod: {WD_TIMER_10MS, WD_TIMER_20MS, WD_TIMER_50MS, WD_TIMER_100MS, WD_TIMER_200MS, WD_TIMER_500MS, WD_TIMER_1000MS}, origin=AUTRON, default-value=WD_TIMER_100MS  # Watchdog Timer Period
            enumeration WdgArisuCanType: {WD_TYPE_TIMEOUT, WD_TYPE_WINDOW}, origin=AUTRON, default-value=WD_TYPE_TIMEOUT  # Watchdog Type Selection WD_TYPE_TIMEOUT : Watchdog works as a Time-Out watchdog WD_TYPE_WINDOW : Watchdog works as a Window watchdog WD_TYPE_WINDOW is not supported.
            boolean WdgArisuCanDeactivationInStopMode: origin=AUTRON, default-value=false  # Watchdog Deactivation during Stop Mode false : Watchdog is active in Stop Mode true : Watchdog is deactivated in Stop Mode
            boolean WdgArisuCanEnableAfterBusWake: origin=AUTRON, default-value=false  # Watchdog Enable after Bus (CANx) Wake in SBC Stop Mode false : Watchdog will not start after a CANx wake true : Watchdog starts with a long open window after CANx Wake
            boolean WdgArisuCanMax3Reset: origin=AUTRON, default-value=false  # Limit number of resets due to a Watchdog failure false : Always generate a reset in case of WD fail true : After 3 consecutive resets due to WD fail, no further reset is generated (only valid in config 1 & 3)
          container WdgMPQ6411
            float WdgMPQ6411InitailOffSet: 0..65.535, origin=AUTRON, default-value=0.010  # Initial Offset period(sec) for watchdog hardware initialization. MPQ6411 is need to PowerOnDelay. If the OK purse is occur before PowerOnDelay finish that will be cause the external watchdog reset.
            integer WdgMPQ6411TriggerDuty: 1..99, origin=AUTRON, default-value=10  # Duty of the output signals in percent. MPQ6411 is need for Out signals width above 10us and below 5ms. Should be config the duty percentage of Slow/Fast period is match for MPQ6411 out signals constraint.
            reference WdgMPQ6411DioTriggerChannelRef: origin=AUTRON, destination=DioChannel  # Reference to a DioChannel container in case the hardware watchdog is connected via a DIO pin
            reference WdgMPQ6411DioModeChannelRef: origin=AUTRON, destination=DioChannel  # Reference to a DioChannel container in case the hardware watchdog is connected via a DIO pin
    container WdgPublishedInformation  # Container holding all Wdg specific published information parameters
      enumeration WdgTriggerMode: {WDG_BOTH, WDG_TOGGLE, WDG_WINDOW}, category=FIXED, set at published-information, default-value=WDG_TOGGLE  # Watchdog trigger mode (toggle/window/both)
  ecuc definition collection ParameterDefinition_Wdg: module=Wdg
