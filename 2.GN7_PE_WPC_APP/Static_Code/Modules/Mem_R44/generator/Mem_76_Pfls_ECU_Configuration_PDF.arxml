AUTOSAR XML (schema 00047)
package /AUTRON
  module definition Mem [0..*]: refined-module-def=Mem, variants pre-compile  # Configuration of the Mem driver (internal or external memory driver) module. Tags: atp.Status=draft | Its multiplicity describes the actual number of Mem drivers. There will be one container for each Mem driver.
    container MemGeneral  # Container for general configuration parameters of the Mem driver. These parameters are always pre-compile. Tags: atp.Status=draft
      boolean MemDevErrorDetect: set at pre-compile  # Switches the development error detection and notification on or off. Tags: atp.Status=draft
      boolean MemDisableEccTrap [0..1]: set at pre-compile  # Disable Ecc Trap of Memory Program Flash. Tags: atp.Status=draft
      float MemMainfunctionPeriod: 0..Inf, origin=AUTRON  # MainFunction period [s]
      string MemUserIncludeFiles [1..255]: origin=AUTRON  # User include files
      enumeration MemProcessorSeries: {CYT2B6X, CYT2B7X, CYT2B9X, CYT2BLX_CYT3BX_CYT4BBX, CYT4BFX, CYT6BJX}, scope=ECU, multiplicity set at pre-compile, origin=AUTRON, set at pre-compile, default-value=CYTXXX  # Processor name is designated by this parameter.
      function name WdgTriggerCalloutFunction [0..1]
      boolean MemUseNvm: set at pre-compile  # Switches the development error detection and notification on or off. Tags: atp.Status=draft
      boolean MemUseRamCode: set at pre-compile  # Enable run flash operation in ram. Tags: atp.Status=draft | False: Dual MMU type. True: Single type or Dual NonMMU type
    container MemInstance [1..65535]: multiplicity set at pre-compile  # This container includes the Mem driver instance specific configuration parameters. Tags: atp.Status=draft | Its multiplicity describes the number of Mem driver instances of this Mem driver. There will be one container for each Mem driver instance.
      integer MemInstanceId: 0..65535, set at pre-compile, default-value=0  # This value specifies the unique numeric identifier which is used to reference a Mem driver instance in case multiple devices of the same type shall be addressed by one Mem driver. This value will be assigned to the symbolic name derived of the MemInstance container short name. Tags: atp.Status=draft
      container UserPreCalloutFunction [0..255]
        function name UserPreCalloutFunction [0..1]
      container MemSectorBatch [1..*]: multiplicity set at pre-compile  # Configuration description of a programmable sector or sector batch. Sector batch means that homogenous and coherent sectors can be configured as one MemSector element. Tags: atp.Status=draft | It is recommended to group as many identical sectors as possible together.
        integer MemEraseSectorSize: 1..4294967295, set at pre-compile  # Size of this sector in bytes. Tags: atp.Status=draft | A sector is the smallest erasable unit.
        integer MemNumberOfSectors: 1..65535, set at pre-compile, default-value=1  # Number of contiguous sectors with identical values for MemSectorSize and MemPageSize. Tags: atp.Status=draft | If this parameter is configured to be greater than 1, the sectors are grouped in a sector batch.
        integer MemReadPageSize: 1..4294967295, set at pre-compile  # Size of a read page of this sector in bytes. Tags: atp.Status=draft | A read page is the smallest readable unit.
        integer MemSpecifiedEraseCycles: 0..4294967295, set at pre-compile  # Number of erase cycles specified for the memory device (usually given in the device data sheet). Tags: atp.Status=draft
        integer MemStartAddress: 0..18446744073709551615, set at pre-compile  # Physical start address of the sector (batch). Tags: atp.Status=draft | In case of a sector batch, the physical start address is the address of the first sector. The physical start address of the other sectors can be calculated by the MemSectorSize parameter.
        integer MemAltStartAddress [0..1]: 0..18446744073709551615, set at pre-compile  # Alternative start address of the sector (batch). Tags: atp.Status=draft | In case of a sector batch, the alternative start address is the address of the inactive first sector.
        integer MemWritePageSize: 1..4294967295, set at pre-compile  # Size of a write page of this sector in bytes. Tags: atp.Status=draft | A write page is the smallest writeable unit.
        container MemBurstSettings [0..1]: multiplicity set at pre-compile  # Container for burst setting configuration parameters of the Mem driver. Tags: atp.Status=draft | A sector burst can be used for improved performance.
          integer MemEraseBurstSize: 0..4294967295, set at pre-compile  # Size of sector erase burst in bytes. A sector burst can be used for improved performance and is typically (a subset of) a sector batch. Tags: atp.Status=draft | To make use of the sector erase burst feature, the physical start address of the sector batch must be aligned to the sector erase burst size.
          integer MemReadBurstSize: 0..4294967295, set at pre-compile  # This value specifies the maximum number of bytes the MemAcc module requests within one Mem read request. Tags: atp.Status=draft
          integer MemWriteBurstSize: 0..4294967295, set at pre-compile  # Size of page write/program burst in bytes. A sector burst can be used for improved performance and is typically (a subset of) a sector batch. Tags: atp.Status=draft | To make use of the write burst feature, the physical start address must be aligned to the write burst size.
      container UserPostCalloutFunction [0..255]
        function name UserPostCalloutFunction [0..1]
    container MemPublishedInformation  # Additional published parameters not covered by CommonPublishedInformation container. Tags: atp.Status=draft | Note that these parameters do not have any configuration class setting, since they are published information.
      integer MemErasedValue: 0..4294967295, set at pre-compile  # The contents of an erased memory cell. Tags: atp.Status=draft
  ecuc definition collection ParameterDefinition_Mem: module=Mem
