AUTOSAR XML (schema 4-0-3)
# (C) 2021 HYUNDAI AUTOEVER Corp.
# Confidential Proprietary Information. Distribution Limited.
# Do Not Copy Without Prior Permission
package /AUTRON
  ecuc definition collection AUTRON_ParameterDefinition_IoHwAb: module=IoHwAb
  module definition IoHwAb: variants pre-compile  # Configuration of the AUTOSAR IoHwAb module.
    container IoHwAbGeneral  # Contains the general configuration parameters of the module.
      boolean IoHwAbDevErrorDetect: set at pre-compile, default-value=false  # Active/Deactivate the detection of development errors, for production code this parameter has to be False.
      boolean IoHwAbVersionInfoApi: set at pre-compile, default-value=false  # Active/Deactivate the version information API.
      enumeration IoHwAbMcalVendorVersion: {INFINEON_TC21X, INFINEON_TC22X, INFINEON_TC23X, INFINEON_TC26X, INFINEON_TC27X, INFINEON_TC29X, INFINEON_TC38X, INFINEON_TC39X, FREESCALE_MPC560XB, FREESCALE_MPC560XB_HF11, FREESCALE_MPC560XB_101HF5, FREESCALE_MPC574XR, RENESAS_RH850F1L, RENESAS_RH850F1L_413, RENESAS_RH850F1K, RENESAS_RH850F1KM, CYPRESS_S6J32XX, CYPRESS_S6J33XX, CYPRESS_CYT2B9XX, CYPRESS_CYT4BBXX, ST_SPC58XCX, ST_SPC58XHX, NXP_S32K14X, NXP_S32G2X, TI_TDA4X}, origin=AUTRON
      container IoHwAbPortPinChs [0..1]
        container IoHwAbPortPinCh [0..*]
          enumeration IoHwAbPolarity: {HighActive, LowActive}, origin=AUTRON, default-value=HighActive  # The polarity describes if a pin is active high or active low. The values possible are HighActive or LowActive.
          reference IoHwAbHwDioChRef: origin=AUTRON, destination=DioChannel
          reference IoHwAbHwPortPinRef: origin=AUTRON, destination=PortPin
      container IoHwAbAdcSetting [0..1]
        integer IoHwAbAdcReadDirectMaxDelay: 0..65535, origin=AUTRON
        container IoHwAbAdcGroups
          container IoHwAbAdcGroup [0..*]
            reference IoHwAbHwAdcGroupRef: origin=AUTRON, destination=AdcGroup
        container IoHwAbAdcAllGroups
          reference IoHwAbHwAdcAllGroupRef [0..*]: origin=AUTRON, destination=AdcGroup
          container IoHwAbAdcGroupInAll [0..*]
            reference IoHwAbHwAdcGroupRef: origin=AUTRON, destination=AdcGroup
      container IoHwAbMux [0..1]
        container IoHwAbMC33972 [0..8]
          integer IoHwAbInputScanPeriodInLp: 0..7, origin=AUTRON  # This parameter set the scan period in LP to get the input status in all input channels. Scan Period = 2^(IoHwAbInputScanPeriodInLp - 1) (where 0 is "No Scan")
          boolean IoHwAbMC33972CallbackViaRte: origin=AUTRON
          reference IoHwAbSpiChRef: destination=SpiChannel
          reference IoHwAbSpiSeqRef: destination=SpiSequence
          reference IoHwAbSpiExtDevice: origin=AUTRON, destination=SpiExternalDevice
          reference IoHwAbSpiCsGPIO [0..1]: origin=AUTRON, destination=DioChannel
          reference IoHwAbExtIntChRef [0..1]: destination=IcuChannel
          container IoHwAbMC33972Pin [22..22]
            enumeration IoHwAbPinGroup: {SP, SG}, origin=AUTRON
            integer IoHwAbPinBitCarrier: 0..13, origin=AUTRON  # It contains the number of the bit in the data byte that corresponds to this pin.
            enumeration IoHwAbPolarity: {HighActive, LowActive}, origin=AUTRON  # The polarity describes if a pin is active high or active low. The values possible are HighActive or LowActive.
            enumeration IoHwAbWakeUpInLp: {Enable, Disable}, origin=AUTRON  # This attribute specifies the wake up functionality in LP mode is enabled or not. If this is set with "Enable" and the input status is changed in LP, mc33972 mux outputs signal via wake up and interrupt pin.
            enumeration IoHwAbWettingCurrentTimer: {Enable, Disable}, origin=AUTRON  # Enable switch input has a designated 20ms timer for wetting current control.
            enumeration IoHwAbWettingCurrentReg: {WetCur_2mA, WetCur_16mA}, origin=AUTRON  # Configure the metallic control for wetting currnet is used to set the switch contact current level.
      container IoHwAbDemux [0..1]
        container IoHwAbL9826 [0..8]
          boolean IoHwAbUseDiag: origin=AUTRON, default-value=false
          reference IoHwAbSpiChRef: destination=SpiChannel
          reference IoHwAbSpiSeqRef: destination=SpiSequence
          reference IoHwAbSpiExtDevice: origin=AUTRON, destination=SpiExternalDevice
          reference IoHwAbSpiCsGPIO [0..1]: origin=AUTRON, destination=DioChannel
          reference IoHwAbResetChRef: destination=DioChannel
          container IoHwAbL9826Pin [8..8]
            integer IoHwAbPinBitCarrier: 0..7, origin=AUTRON  # It contains the number of the bit in the data byte that corresponds to this pin.
            boolean IoHwAbParallelMode [0..1]: origin=AUTRON, default-value=false
        container IoHwAbL99MC6 [0..8]
          enumeration IoHwAbChargePumpControl: {Disable, Enable}, origin=AUTRON, default-value=Disable  # This parameter can set the state of Charge pump in L99MC6 output driver.
          reference IoHwAbSpiChRef: destination=SpiChannel
          reference IoHwAbSpiSeqRef: destination=SpiSequence
          reference IoHwAbSpiExtDevice: origin=AUTRON, destination=SpiExternalDevice
          reference IoHwAbSpiCsGPIO [0..1]: origin=AUTRON, destination=DioChannel
          container IoHwAbL99MC6Pin [6..6]
            integer IoHwAbPinBitCarrier: 0..5, origin=AUTRON  # It contains the number of the bit in the data byte that corresponds to this pin.
            enumeration IoHwAbOverCurrentRecovery: {Disable, Enable}, origin=AUTRON, default-value=Disable  # This attribute is used to enable the over current recovery functionality in L99MC6 Demultiplexer for each pin output.
        container IoHwAbTLE7240SL [0..8]
          enumeration IoHwAbDiagnosis: {Disable, Enable}, set at   # This parameter can set the state of Charge pump in L99MC6 output driver.
          reference IoHwAbSpiChRef: destination=SpiChannel
          reference IoHwAbSpiSeqRef: destination=SpiSequence
          reference IoHwAbSpiExtDevice: origin=AUTRON, destination=SpiExternalDevice
          reference IoHwAbSpiCsGPIO [0..1]: origin=AUTRON, destination=DioChannel
          reference IoHwAbResetChRef: destination=DioChannel
          container IoHwAbTLE7240SLPin [8..8]
            integer IoHwAbPinBitCarrier: 0..7, origin=AUTRON  # It contains the number of the bit in the data byte that corresponds to this pin.
            enumeration IoHwAbInputMode: {Disable, Enable}, origin=AUTRON, default-value=Disable  # This attribute is used to enable the over current recovery functionality in L99MC6 Demultiplexer for each pin output.
      container IoHwAbPrefixConfig
        enumeration IoHwAbCustomPortPinPrefix: {UNUSED, CUSTOM, CUSTOM_WITHOUT_CONTAINER}, origin=AUTRON
        string IoHwAbPortPinPrefix [0..1]: origin=AUTRON
        enumeration IoHwAbCustomSpiSequencePrefix: {UNUSED, CUSTOM}, origin=AUTRON
        string IoHwAbSpiSequencePrefix [0..1]: origin=AUTRON
        enumeration IoHwAbCustomDioChannelPrefix: {UNUSED, CUSTOM}, origin=AUTRON
        string IoHwAbDioChannelPrefix [0..1]: origin=AUTRON
        enumeration IoHwAbCustomOcuChannelPrefix: {UNUSED, CUSTOM}, origin=AUTRON
        string IoHwAbOcuChannelPrefix [0..1]: origin=AUTRON
        enumeration IoHwAbCustomAdcGroupPrefix: {UNUSED, CUSTOM}, origin=AUTRON
        string IoHwAbAdcGroupPrefix [0..1]: origin=AUTRON
        enumeration IoHwAbCustomSpiChannelPrefix: {UNUSED, CUSTOM}, origin=AUTRON
        string IoHwAbSpiChannelPrefix [0..1]: origin=AUTRON
        enumeration IoHwAbCustomGptChannelPrefix: {UNUSED, CUSTOM}, origin=AUTRON
        string IoHwAbGptChannelPrefix [0..1]: origin=AUTRON
        enumeration IoHwAbCustomPwmChannelPrefix: {UNUSED, CUSTOM}, origin=AUTRON
        string IoHwAbPwmChannelPrefix [0..1]: origin=AUTRON
        enumeration IoHwAbCustomIcuChannelPrefix: {UNUSED, CUSTOM}, origin=AUTRON
        string IoHwAbIcuChannelPrefix [0..1]: origin=AUTRON
    container IoHwAbConfig  # This container contains the configuration parameters and sub containers of the AUTOSAR IoHwAb module. This container is a MultipleConfigurationContainer, i.e. this container and its sub-containers exist once per configuration set.
      boolean IoHwAbUseDigitalDirect: origin=AUTRON, default-value=false
      boolean IoHwAbUseAnalogInputDirect: origin=AUTRON, default-value=false
      boolean IoHwAbUsePwm: origin=AUTRON, default-value=false
      boolean IoHwAbUseGpt: origin=AUTRON, default-value=false
      boolean IoHwAbUseIcu: origin=AUTRON, default-value=false
      boolean IoHwAbUseIOManager: origin=AUTRON, default-value=false
      boolean IoHwAbUseOcu: origin=AUTRON, default-value=false
      container IoHwAbDigitalDirect [0..1]
        container IoHwAbDigitalDirectLogical [0..*]
          reference IoHwAbPortPinChRef: origin=AUTRON, destination=IoHwAbPortPinCh
      container IoHwAbAnalogInputDirect [0..1]
        container IoHwAbAnalogInputDirectLogical [0..*]
          reference IoHwAbAdcGroupRef: origin=AUTRON, destination=IoHwAbAdcGroup
      container IoHwAbPwm [0..1]
        container IoHwAbPwmLogical [0..*]
          boolean IoHwAbPwmCallbackViaRte: origin=AUTRON
          reference IoHwAbHwPwmChRef: origin=AUTRON, destination=PwmChannel
      container IoHwAbGpt [0..1]
        container IoHwAbGptLogical [0..*]
          boolean IoHwAbGptCallbackViaRte: origin=AUTRON
          reference IoHwAbHwGptChRef: origin=AUTRON, destination=GptChannelConfiguration
      container IoHwAbIcu [0..1]
        container IoHwAbIcuLogical [0..*]
          boolean IoHwAbIcuCallbackViaRte: origin=AUTRON
          reference IoHwAbHwIcuChRef: origin=AUTRON, destination=IcuChannel
      container IoHwAbIOManager [0..1]
        boolean IoHwAbUseLowPowerFlag: origin=AUTRON, default-value=true
        boolean IoHwAbUsePmModule: origin=AUTRON, default-value=true
        boolean IoHwAbUseAnalogInput: origin=AUTRON, default-value=false
        boolean IoHwAbUseDigitalInput: origin=AUTRON, default-value=false
        boolean IoHwAbUseDigitalOutput: origin=AUTRON, default-value=false
        boolean IoHwAbUseInputSupplySwitch: origin=AUTRON, default-value=false
        boolean IoHwAbUseVoltageMonitoring: origin=AUTRON, default-value=false
        integer IoHwAbMultipleActivationDelay: 0..65535, origin=AUTRON
        reference IoHwAbTaskFG1Ref: origin=AUTRON, destination=OsTask
        reference IoHwAbTaskFG2Ref: origin=AUTRON, destination=OsTask
        container IoHwAbIOMTimer
          reference IoHwAbFastTimerRef [0..1]: origin=AUTRON, destination=CoSvAbFastTimer
          reference IoHwAbGptChRef [0..1]: origin=AUTRON, destination=GptChannelConfiguration
        container IoHwAbAnalogInput [0..1]
          container IoHwAbAnalogInputLogical [0..*]
            boolean IoHwAbDirectAccess: origin=AUTRON, default-value=false
            integer IoHwAbDefaultValue: 0..1023, origin=AUTRON, default-value=0  # This attribute specifies the default value of this logical analog input. The possible values are between 0-1023.
            integer IoHwAbFilterConstant: 0..255, default-value=0  # This attribute specifies the filter constant for this logical analog input. The possible values are between 0-255.
            reference IoHwAbAdcGroupRef [0..1]: origin=AUTRON, destination=IoHwAbAdcGroupInAll
        container IoHwAbDigitalInput [0..1]
          container IoHwAbDigitalInputLogical [0..*]
            boolean IoHwAbDirectAccess [0..1]: origin=AUTRON, default-value=false
            boolean IoHwAbLowPower [0..1]: origin=AUTRON, default-value=false  # This attribute specifies if this logical digital input must also be sampled in low power.
            enumeration IoHwAbSamplePeriod: {Slow, Fast}, origin=AUTRON, default-value=Slow  # This attribute specifies the period of the sampling for this logical digital input. The possible values are Fast and Slow (the value Fast is only available for the non-multiplexed pins not on switched battery).
            integer IoHwAbDebounceH2L: 1..16, origin=AUTRON, default-value=3  # This attribute specifies the debounce constant for a high to low transition. The possible values are between 1-16 (1 means that the input is only sampled).
            integer IoHwAbDebounceL2H: 1..16, origin=AUTRON, default-value=3  # This attribute specifies the debounce constant for a low to high transition. The possible values are between 1-16 (1 means that the input is only sampled).
            reference IoHwAbPortPinChRef [0..1]: origin=AUTRON, destination=IoHwAbPortPinCh
            reference IoHwAbMC33972PinRef [0..1]: origin=AUTRON, destination=IoHwAbMC33972Pin
        container IoHwAbDigitalOutput [0..1]
          container IoHwAbDigitalOutputLogical [0..*]
            boolean IoHwAbDirectAccess [0..1]: origin=AUTRON, default-value=false  # This attribute specifies if the logical digital output configured on this pin has direct access possibilities or not (only available for non-multiplexed pins).
            enumeration IoHwAbDefaultValue: {Active, Inactive}, origin=AUTRON, default-value=Active  # This macro specifies the logical default value after reset for this logical digital output. The possible values are Active or Inactive.
            reference IoHwAbPortPinChRef [0..1]: origin=AUTRON, destination=IoHwAbPortPinCh
            reference IoHwAbL9826PinRef [0..1]: origin=AUTRON, destination=IoHwAbL9826Pin
            reference IoHwAbL99MC6PinRef [0..1]: origin=AUTRON, destination=IoHwAbL99MC6Pin
            reference IoHwAbTLE7240SLPinRef [0..1]: origin=AUTRON, destination=IoHwAbTLE7240SLPin
        container IoHwAbInputSupplySwitch [0..1]
          boolean IoHwAbUseDigitalSupplySwitch: origin=AUTRON, default-value=false
          boolean IoHwAbUseAnalogSupplySwitch: origin=AUTRON, default-value=false
          container IoHwAbDigitalSupplySwitch [0..1]
            boolean IoHwAbUseDigitalSupplySwitchLP: origin=AUTRON, default-value=false
            integer IoHwAbDigitalSupplySwitchDelay: 0..65535, origin=AUTRON
            container IoHwAbDigitalSupplySwitchPin [0..*]
              boolean IoHwAbUseDigitalSupplySwitchControlInApp: origin=AUTRON, default-value=false
              enumeration IoHwAbDigitalSupplySwitchInitMode [0..1]: {SW_OFF, SW_ON}, origin=AUTRON
              reference IoHwAbDigitalSupplySwitchPortPinChRef: origin=AUTRON, destination=IoHwAbPortPinCh
          container IoHwAbAnalogSupplySwitch [0..1]
            integer IoHwAbAnalogSupplySwitchDelay: 0..65535, origin=AUTRON
            container IoHwAbAnalogSupplySwitchPin [0..*]
              reference IoHwAbAnalogSupplySwitchPortPinChRef: origin=AUTRON, destination=IoHwAbPortPinCh
        container IoHwAbVoltageMonitoring [0..1]
          integer IoHwAbVoltageMonHysteresis: 0..4095, origin=AUTRON  # This attribute specifies the hysteresis value used by the battery monitoring manager. 10bit resolution : possible values are between 0-1023. 12bit resolution : possible values are between 0-4095.
          integer IoHwAbVoltageMonDefaultValue: 0..4095, origin=AUTRON  # This attribute specifies the default value of the battery used by the voltage monitoring manager. 10bit resolution : possible values are between 0-1023. 12bit resolution : possible values are between 0-4095.
          integer IoHwAbVoltageMonFilter: 0..255, origin=AUTRON  # This attribute specifies the value of the filter constant used by the battery monitoring manager. The possible values are between 0-255.
          reference IoHwAbVoltageMonAdcGroupRef: origin=AUTRON, destination=IoHwAbAdcGroup
          container IoHwAbVoltageMonThreshold [0..8]
            integer IoHwAbVoltageMonThresholdValue: 0..4095, origin=AUTRON  # This attribute specifies the value of the threshold. 10bit resolution : possible values are between 0-1023. 12bit resolution : possible values are between 0-4095.
      container IoHwAbDemEventParameterRefs [0..1]  # Container for the references to DemEventParameter elements which shall be invoked using the API Dem_ReportErrorStatus API in case the corresponding error occurs. The EventId is taken from the referenced DemEventParameter's DemEventId value. The standardized errors are provided in the container and can be extended by vendor specific error references.
        symbolic name reference IOHWAB_E_WRONG_STATE [0..1]: set at pre-compile, origin=AUTRON, destination=DemEventParameter  # Reference to the DemEventParameter which shall be issued when the defensive behavior checks have detected an improper caller.
        symbolic name reference IOHWAB_E_WRONG_SETTING [0..1]: set at pre-compile, origin=AUTRON, destination=DemEventParameter  # Reference to the DemEventParameter which shall be issued when the defensive behavior checks have detected an improper caller.
        symbolic name reference IOHWAB_E_WRONG_PARAM [0..1]: set at pre-compile, origin=AUTRON, destination=DemEventParameter  # Reference to the DemEventParameter which shall be issued when the defensive behavior checks have detected an improper caller.
        symbolic name reference IOHWAB_E_SETUP_FAIL [0..1]: set at pre-compile, origin=AUTRON, destination=DemEventParameter  # Reference to the DemEventParameter which shall be issued when the defensive behavior checks have detected an improper caller.
        symbolic name reference IOHWAB_E_PROC_FAIL [0..1]: set at pre-compile, origin=AUTRON, destination=DemEventParameter  # Reference to the DemEventParameter which shall be issued when the defensive behavior checks have detected an improper caller.
        symbolic name reference IOHWAB_E_BUSY [0..1]: set at pre-compile, origin=AUTRON, destination=DemEventParameter  # Reference to the DemEventParameter which shall be issued when the defensive behavior checks have detected an improper caller.
      container IoHwAbOcu [0..1]
        container IoHwAbOcuLogical [0..*]
          boolean IoHwAbOcuCallbackViaRte: origin=AUTRON
          reference IoHwAbHwOcuChRef: origin=AUTRON, destination=OcuChannel
