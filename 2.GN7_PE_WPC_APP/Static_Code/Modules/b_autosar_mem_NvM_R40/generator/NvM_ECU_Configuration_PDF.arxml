AUTOSAR XML (schema 4-0-3)
# (C) 2021 HYUNDAI AUTOEVER Corp.
package /AUTRON
  ecuc definition collection ParameterDefinition_NvM: module=NvM
  module definition NvM: refined-module-def=NvM, variants pre-compile  # Configuration of the NvM (NvRam Manager) module.
    container NvMBlockDescriptor [1..65536]  # Container for a management structure to configure the composition of a given NVRAM Block Management Type. Its multiplicity describes the number of configured NVRAM blocks, one block is required to be configured. The NVRAM block descriptors are condensed in the NVRAM block descriptor table.
      enumeration NvMBlockCrcType [0..1]: {NVM_CRC16, NVM_CRC32, NVM_CRC8}, set at pre-compile  # Defines CRC data width for the NVRAM block. Default: NVM_CRC16, i.e. CRC16 will be used if NVM_BLOCK_USE_CRC==true
      integer NvMBlockJobPriority: 0..255, set at pre-compile, default-value=1  # Defines the job priority for a NVRAM block (0 = Immediate priority).
      enumeration NvMBlockManagementType: {NVM_BLOCK_DATASET, NVM_BLOCK_NATIVE, NVM_BLOCK_REDUNDANT}, set at pre-compile  # Defines the block management type for the NVRAM block.[NVM137]
      boolean NvMBlockUseCrc: set at pre-compile, default-value=false  # Defines CRC usage for the NVRAM block, i.e. memory space for CRC is reserved in RAM and NV memory. | true: CRC will be used for this NVRAM block. false: CRC will not be used for this NVRAM block.
      boolean NvMBlockUseSyncMechanism: category=NOT_SUPPORTED, set at pre-compile, default-value=false  # Defines whether an explicit synchronization mechanism with a RAM mirror and callback routiness for transferring data to and from NvM module's RAM mirror is used for NV block. | true: If synchronization mechanism is used. false: If synchronization mechanism is not used.
      boolean NvMBlockWriteProt: set at pre-compile, default-value=false  # Defines an initial write protection of the NV block | true: Initial block write protection is enabled. false: Initial block write protection is disabled.
      boolean NvMBswMBlockStatusInformation: set at pre-compile, default-value=false  # This parameter specifies whether BswM is informed about the current status of the specified block. | true: Call BswM_NvM_CurrentBlockMode on changes. false: Don't inform BswM at all.
      boolean NvMCalcRamBlockCrc: set at pre-compile, default-value=false  # Defines CRC (re)calculation for the permanent RAM block | true: CRC will be (re)calculated for this permanent RAM block. false: CRC will not be (re)calculated for this permanent RAM block.
      function name NvMInitBlockCallback [0..1]: set at pre-compile  # Entry address of a block specific callback routine which shall be called if no ROM data is available for initialization of the NVRAM block. | If not configured, no specific callback routine shall be called for initialization of the NVRAM block with default data.
      integer NvMMaxNumOfReadRetries: 0..7, set at pre-compile, default-value=0  # Defines the maximum number of read retries.
      integer NvMMaxNumOfWriteRetries: 0..7, set at pre-compile, default-value=0  # Defines the maximum number of write retries for a NVRAM block with [NVM061_Conf]. Regardless of configuration a consistency check (and maybe write retries) are always forced for each block which is processed by the request NvM_WriteAll and NvM_WriteBlock.
      integer NvMNvBlockBaseNumber: 1..65534, set at pre-compile  # Configuration parameter to perform the link between the NVM_NVRAM_BLOCK_IDENTIFIER used by the SW-Cs and the FEE_BLOCK_NUMBER expected by the memory abstraction modules. The parameter value equals the FEE_BLOCK_NUMBER or EA_BLOCK_NUMBER shifted to the right by NvMDatasetSelectionBits bits. (ref. to chapter 7.1.2.1). | Calculation Formula: value = TargetBlockReference.[Ea/Fee]BlockConfiguration.[Ea/Fee]BlockNumber >> NvMDatasetSelectionBits
      integer NvMNvBlockLength: 1..65535, set at pre-compile  # Defines the NV block data length in bytes. | Note: The implementer can add the attribute 'withAuto' to the parameter definition which indicates that the length can be calculated by the generator automatically (e.g. by using the sizeof operator). When 'withAuto' is set to 'true' for this parameter definition the 'isAutoValue' can be set to 'true'. If 'isAutoValue' is set to 'true' the actual value will not be considered during ECU Configuration but will be (re-)calculated by the code generator and stored in the value attribute afterwards.
      integer NvMNvBlockNum: 1..255, set at pre-compile  # Defines the number of multiple NV blocks in a contiguous area according to the given block management type. | 1-255 For NVRAM blocks to be configured of block management type NVM_BLOCK_DATASET. The actual range is limited according to NVM444. 1 For NVRAM blocks to be configured of block management type NVM_BLOCK_NATIVE 2 For NVRAM blocks to be configured of block management type NVM_BLOCK_REDUNDANT
      integer NvMNvramBlockIdentifier: 1..65535, set at pre-compile, symbolic-name-value=true  # Identification of a NVRAM block via a unique block identifier. | Implementation Type: NvM_BlockIdType. min = 2 max = 2^(16- NVM_DATASET_SELECTION_BITS)-1 Reserved NVRAM block IDs: 0 -> to derive multi block request results via NvM_GetErrorStatus 1 -> redundant NVRAM block which holds the configuration ID
      integer NvMNvramDeviceId: 0..254, set at pre-compile, default-value=0  # Defines the NVRAM device ID where the NVRAM block is located. | Calculation Formula: value = TargetBlockReference.[Ea/Fee]BlockConfiguration.[Ea/Fee]DeviceIndex
      string NvMRamBlockDataAddress [0..1]: set at pre-compile  # Defines the start address of the RAM block data. | If this is not configured, no permanent RAM data block is available for the selected block management type.
      function name NvMReadRamBlockFromNvCallback [0..1]: category=NOT_SUPPORTED, set at pre-compile  # Entry address of a block specific callback routine which shall be called in order to let the application copy data from the NvM module's mirror to RAM block. | Implementation type: Std_ReturnType E_OK: copy was successful E_NOT_OK: copy was not successful, callback routine to be called again
      boolean NvMResistantToChangedSw: set at pre-compile, default-value=false  # Defines whether a NVRAM block shall be treated resistant to configuration changes or not. If there is no default data available at configuration time then the application shall be responsible for providing the default initialization data. In this case the application has to use NvM_GetErrorStatus()to be able to distinguish between first initialization and corrupted data. | true: NVRAM block is resistant to changed software. false: NVRAM block is not resistant to changed software.
      string NvMRomBlockDataAddress [0..1]: set at pre-compile  # Defines the start address of the ROM block data. | If not configured, no ROM block is available for the selected block management type.
      integer NvMRomBlockNum: 0..255, set at pre-compile  # Defines the number of multiple ROM blocks in a contiguous area according to the given block management type. | 0-255 For NVRAM blocks to be configured of block management type NVM_BLOCK_DATASET. The actual range is limited according to NVM444. 0-1 For NVRAM blocks to be configured of block management type NVM_BLOCK_NATIVE 0-1 For NVRAM blocks to be configured of block management type NVM_BLOCK_REDUNDANT
      boolean NvMSelectBlockForReadAll: set at pre-compile, default-value=false  # NVM117: Defines whether a NVRAM block shall be processed during NvM_ReadAll or not. This configuration parameter has only influence on those NVRAM blocks which are configured to have a permanent RAM block. | true: NVRAM block shall be processed by NvM_ReadAll false: NVRAM block shall not be processed by NvM_ReadAll
      boolean NvMSelectBlockForWriteAll: set at pre-compile, default-value=false  # Defines whether a NVRAM block shall be processed during NvM_WriteAll or not. This configuration parameter has only influence on those NVRAM blocks which are configured to have a permanent RAM block. | true: NVRAM block shall be processed by NvM_WriteAll false: NVRAM block shall not be processed by NvM_WriteAll
      function name NvMSingleBlockCallback [0..1]: set at pre-compile  # Entry address of the block specific callback routine which shall be invoked on termination of each asynchronous single block request [NVM113].
      boolean NvMStaticBlockIDCheck: set at pre-compile, default-value=false  # Defines if the Static Block ID check is enabled. | false: Static Block ID check is disabled. true: Static Block ID check is enabled.
      boolean NvMWriteBlockOnce: set at pre-compile, default-value=false  # Defines write protection after first write. The NVRAM manager sets the write protection bit after the NV block was written the first time. This means that some of the NV blocks in the NVRAM should never be erased nor be replaced with the default ROM data after first initialization. [NVM276]. | true: Defines write protection after first write is enabled. false: Defines write protection after first write is disabled.
      function name NvMWriteRamBlockToNvCallback [0..1]: category=NOT_SUPPORTED, set at pre-compile  # Entry address of a block specific callback routine which shall be called in order to let the application copy data from RAM block to NvM module's mirror. | Implementation type: Std_ReturnType E_OK: copy was successful E_NOT_OK: copy was not successful, callback routine to be called again
      boolean NvMWriteVerification: set at pre-compile, default-value=false  # Defines if Write Verification is enabled. | false: Write verification is disabled. true: Write Verification is enabled.
      integer NvMWriteVerificationDataSize: 1..65536, set at pre-compile, default-value=1  # Defines the number of bytes to compare in each step when comparing the content of a RAM Block and a block read back.
      boolean NvMDefaultROMCRCEnabled: category=NOT_SUPPORTED, set at pre-compile, origin=AUTRON, default-value=false  # Defines if Default ROMCRC is Enabled. | false: Default ROMCRC is disabled. true: Default ROMCRC is enabled.
      integer NvMReadAllOrder: 1..65535, set at pre-compile, symbolic-name-value=true  # Reading order when executing ReadAll function. If NvMNvramBlockIdentifier of this block is "1" or NvMRomBlockDataAddress of this block is "Ea_GaaNvData", NvMOrderOfWriteAll should be blank.
      integer NvMWriteAllOrder: 1..65535, set at pre-compile, symbolic-name-value=true  # Writing order when executing WriteAll function. If NvMNvramBlockIdentifier of this block is "1" or NvMRomBlockDataAddress of this block is "Ea_GaaNvData", NvMOrderOfWriteAll should be blank.
      choice container NvMTargetBlockReference  # This parameter is just a container for the parameters for EA and FEE
        container NvMEaRef [0..1]  # EEPROM Abstraction
          symbolic name reference NvMNameOfEaBlock: set at pre-compile, destination=EaBlockConfiguration  # reference to EaBlock
        container NvMFeeRef [0..1]  # Flash EEPROM Emulation
          symbolic name reference NvMNameOfFeeBlock: set at pre-compile, destination=FeeBlockConfiguration  # reference to FeeBlock
    container NvMCommon  # Container for common configuration options.
      enumeration NvMApiConfigClass: {NVM_API_CONFIG_CLASS_2, NVM_API_CONFIG_CLASS_3}, set at pre-compile  # Preprocessor switch to enable some API calls which are related to NVM API configuration classes.
      boolean NvMBswMMultiBlockJobStatusInformation: category=FIXED, set at pre-compile, default-value=true  # This parameter specifies whether BswM is informed about the current status of the multiblock job. | true: call BswM_NvM_CurrentJobMode if ReadAll and WriteAll are started, finished, canceled false: do not inform BswM at all
      integer NvMCompiledConfigId: 0..65535, set at pre-compile, default-value=20  # Configuration ID regarding the NV memory layout. This configuration ID shall be published as e.g. a SW-C shall have the possibility to write it to NV memory.
      integer NvMCrcNumOfBytes: 1..65535, category=NOT_SUPPORTED, set at pre-compile, default-value=4  # If CRC is configured for at least one NVRAM block, this parameter defines the maximum number of bytes which shall be processed within one cycle of job processing.
      integer NvMDatasetSelectionBits: 0..8, set at pre-compile  # Defines the number of least significant bits which shall be used to address a certain dataset of a NVRAM block within the interface to the memory hardware abstraction. | 0..8: Number of bits which are used for dataset or redundant block addressing. 0: No dataset or redundant NVRAM blocks are configured at all, no selection bits required. 1: In case of redundant NVRAM blocks are configured, but no dataset NVRAM blocks.
      boolean NvMDevErrorDetect: set at pre-compile  # Pre-processor switch to enable and disable development error detection. | true: Development error detection enabled. false: Development error detection disabled.
      boolean NvMDrvModeSwitch: category=FIXED, set at pre-compile, default-value=false  # Preprocessor switch to enable switching memory drivers to fast mode during performing NvM_ReadAll and NvM_WriteAll | true: Fast mode enabled. false: Fast mode disabled.
      boolean NvMDynamicConfiguration: set at pre-compile, default-value=false  # Preprocessor switch to enable the dynamic configuration management handling by the NvM_ReadAll request. | true: Dynamic configuration management handling enabled. false: Dynamic configuration management handling disabled.
      boolean NvMJobPrioritization: set at pre-compile, default-value=false  # Preprocessor switch to enable job prioritization handling | true: Job prioritization handling enabled. false: Job prioritization handling disabled.
      function name NvMMultiBlockCallback [0..1]: set at pre-compile  # Entry address of the common callback routine which shall be invoked on termination of each asynchronous multi block request
      boolean NvMPollingMode: category=NOT_SUPPORTED, set at pre-compile, default-value=false  # Preprocessor switch to enable/disable the polling mode in the NVRAM Manager and at the same time disable/enable the callback functions usable by lower layers | true: Polling mode enabled, callback function usage disabled. false: Polling mode disabled, callback function usage enabled.
      integer NvMRepeatMirrorOperations: 0..7, category=NOT_SUPPORTED, set at pre-compile, default-value=0  # Defines the number of retries to let the application copy data to or from the NvM module's mirror before postponing the current job.
      boolean NvMSetRamBlockStatusApi: set at pre-compile, default-value=false  # Preprocessor switch to enable the API NvM_SetRamBlockStatus. | true: API NvM_SetRamBlockStatus enabled. false: API NvM_SetRamBlockStatus disabled.
      integer NvMSizeImmediateJobQueue [0..1]: 1..255, set at pre-compile  # Defines the number of queue entries for the immediate priority job queue. If NVM_JOB_PRIORITIZATION is switched OFF this parameter shall be out of scope.
      integer NvMSizeStandardJobQueue: 1..255, set at pre-compile  # Defines the number of queue entries for the standard job queue.
      float NvMMainFunctionCallCycle [0..1]: 0..1, category=NOT_SUPPORTED, set at pre-compile, origin=AUTRON, default-value=0.005  # Call cycle time of the NvM main function. Unit: [s]
      boolean NvMVersionInfoApi: set at pre-compile, default-value=true  # Pre-processor switch to enable / disable the API to read out the modules version information [NVM285], [NVM286]. | true: Version info API enabled. false: Version info API disabled.
      function name NvMUserWdgToggleFunction [0..1]: set at pre-compile, origin=AUTRON  # This parameter specifies the function name without parameters. The function is used to triggered External Watchdog.
      function name NvMUserJobFunction [0..1]: set at pre-compile, origin=AUTRON  # This parameter specifies the function name without parameters. The parameters are specified during configuration time, and cannot be changed during run time. Any return values passed by the callout will be ignored.
      boolean NvMReadAllOrderSupport [0..1]: set at pre-compile, default-value=false  # Pre-processor switch to enable / disable the support user defined order when using ReadAll functions. | true: Order support enabled. false: Order support disabled.
      boolean NvMWriteAllOrderSupport [0..1]: set at pre-compile, default-value=false  # Pre-processor switch to enable / disable the support user defined order when using WriteAll functions. | true: Order support enabled. false: Order support disabled.
      choice reference NvMMainfunctionTriggerRef [0..1]: set at pre-compile, origin=AUTRON, destination=OsAlarm  # Reference to a OsAlarm for the Memory servicing routine implementation.
      container NvMUserIncludeFiles [0..1]  # Collection of header file names which shall be included by the NvM.
        string NvMUserIncludeFile [1..*]: set at pre-compile, origin=AUTRON  # Header file name which shall be included by the NvM. | The value of this parameter shall be used as h-char-sequence or q-char-sequence according to ISO C90 section 6.10.2 "source file inclusion". The parameter value MUST NOT represent a path, since ISO C90 does not specify how such a path is treated (i.e., this is implementation defined (and additionally depends on the operating system and the underlying file system)).
    container NvMDemEventParameterRefs [0..1]  # Container for the references to DemEventParameter elements which shall be invoked using the API Dem_ReportErrorStatus API in case the corresponding error occurs. The EventId is taken from the referenced DemEventParameter's DemEventId value. The standardized errors are provided in the container and can be extended by vendor specific error references.
      symbolic name reference NVM_E_INTEGRITY_FAILED [0..1]: set at pre-compile, destination=DemEventParameter  # Reference to the DemEventParameter which shall be issued when the error "API request integrity failed" has occurred.
      symbolic name reference NVM_E_LOSS_OF_REDUNDANCY [0..1]: set at pre-compile, destination=DemEventParameter  # Reference to the DemEventParameter which shall be issued when the error "loss of redundancy" has occurred.
      symbolic name reference NVM_E_QUEUE_OVERFLOW [0..1]: set at pre-compile, destination=DemEventParameter  # Reference to the DemEventParameter which shall be issued when the error "NVRAM Managers job queue overflow" has occurred.
      symbolic name reference NVM_E_REQ_FAILED [0..1]: set at pre-compile, destination=DemEventParameter  # Reference to the DemEventParameter which shall be issued when the error "API request failed" has occurred.
      symbolic name reference NVM_E_VERIFY_FAILED [0..1]: set at pre-compile, destination=DemEventParameter  # Reference to the DemEventParameter which shall be issued when the error "Write Verification failed" has occurred.
      symbolic name reference NVM_E_WRITE_PROTECTED [0..1]: set at pre-compile, destination=DemEventParameter  # Reference to the DemEventParameter which shall be issued when the error "write attempt to NVRAM block with write protection" has occurred.
      symbolic name reference NVM_E_WRONG_BLOCK_ID [0..1]: set at pre-compile, destination=DemEventParameter  # Reference to the DemEventParameter which shall be issued when the error "Static Block ID check failed" has occurred.
