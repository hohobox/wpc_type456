AUTOSAR XML (schema 4-0-3)
# (C) 2015 HYUNDAI AUTRON Co., Ltd.
# Confidential Proprietary Information. Distribution Limited.
# Do Not Copy Without Prior Permission
package /AUTRON
  ecuc definition collection ParameterDefinition_CtrRam: module=CtrlRam
  module definition CtrlRam: variants pre-compile  # Configuration of the Controlled RAM module.
    container CtrlRamGeneral  # Container for common configuration options.
      enumeration CtrlRamPlatformArchitecture: {LITTLE_ENDIAN_PLATFORM, BIG_ENDIAN_PLATFORM}, set at pre-compile, origin=AUTRON  # Specifies the platform architecture: - Little Endian Platform - Big Endian Platform
      boolean CtrlRamRecovery: set at pre-compile, origin=AUTRON, default-value=false  # The Controlled RAM Recovery Mechanism. | true: A recovery of the Controlled RAM data will be attempted when a reset occures during data update in this area. false: A recovery of the Controlled RAM data will NOT be attempted when a reset occures during data update in this area.
      boolean CtrlRamVerifyAtInit: set at pre-compile, origin=AUTRON, default-value=false  # Verification of data validity at initialization can be configured to be done or not. | true: controlled RAM area is checked and it is decided, if a reinitialization is needed depending on the data validity. false: controlled RAM area is reinitialized without checking the data validity
      boolean CtrlRamDevErrorDetect: set at pre-compile, origin=AUTRON  # Pre-processor switch to enable and disable development error detection. | true: Development error detection enabled. false: Development error detection disabled.
      container CtrlRamUserIncludeFiles [0..1]  # Collection of header file names which shall be included by the CtrRam.
        string CtrlRamUserIncludeFile [1..*]: set at pre-compile, origin=AUTRON  # Header file name which shall be included by the NvM. | The value of this parameter shall be used as h-char-sequence or q-char-sequence according to ISO C90 section 6.10.2 "source file inclusion". The parameter value MUST NOT represent a path, since ISO C90 does not specify how such a path is treated (i.e., this is implementation defined (and additionally depends on the operating system and the underlying file system)).
    container CtrlRamConfigSet [1..65536]
      integer CtrlRamDataTypeSize: 0..65535, set at pre-compile, origin=AUTRON  # Size of the largest data type defined in the Controlled RAM. [This information will be used in case the Recovery mechanism is enabled.]
      function name CtrlRamCallback [0..1]: set at pre-compile, origin=AUTRON  # Callback routine - called at startup in order to infrom the ASW if the Controlled RAM area was not valid after Reset. The ASW can use this routine to reinitialize the data in the Controlled RAM.Set this to NULL if no callback routine is used.
    container CtrlRamDemEventParameterRefs [0..1]  # Container for the references to DemEventParameter elements which shall be invoked using the API Dem_ReportErrorStatus API in case the corresponding error occurs. The EventId is taken from the referenced DemEventParameter's DemEventId value. The standardized errors are provided in the container and can be extended by vendor specific error references.
      symbolic name reference CTRLRAM_E_WRONG_STATE [0..1]: set at pre-compile, destination=DemEventParameter  # Reference to the DemEventParameter which shall be issued when the error "API request integrity failed" has occurred.
