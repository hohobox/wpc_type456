AUTOSAR XML (schema 4-0-3)
# (C) 2021 HYUNDAI AUTOEVER Corp.
# Confidential Proprietary Information. Distribution Limited.
# Do Not Copy Without Prior Permission
package /AUTRON
  ecuc definition collection ParameterDefinition_CanTrcv: module=CanTrcv
  module definition CanTrcv [1..*]: refined-module-def=CanTrcv, variants pre-compile  # Configuration of the CanTrcv (CAN Transceiver driver) module.
    container CanTrcvConfigSet  # This is the multiple configuration set container for CAN Transceiver.
      container CanTrcvChannel [1..*]  # Container gives CAN transceiver driver information about a single CAN | transceiver (channel).
        integer CanTrcvChannelId: 0..255, set at pre-compile, symbolic-name-value=true  # Unique identifier of the CAN Transceiver Channel.
        boolean CanTrcvChannelUsed: set at pre-compile, default-value=true  # Shall the related CAN transceiver channel be used true:related CAN transceiver channel be used false:related CAN transceiver channel shall not be used
        boolean CanTrcvControlsPowerSupply: category=NOT_SUPPORTED, set at pre-compile, default-value=false  # Is ECU power supply controlled by this transceiver? | TRUE = Controlled by transceiver. FALSE = Not controlled by transceiver.
        boolean CanTrcvHwPnSupport: set at pre-compile, default-value=false  # Indicates whether the HW supports the selective wake-up function | TRUE = Selective wakeup feature is supported by the transceiver FALSE = Selective wakeup functionality is not available in transceiver
        enumeration CanTrcvInitState: {CANTRCV_OP_MODE_SLEEP, CANTRCV_OP_MODE_STANDBY}, set at pre-compile, default-value=CANTRCV_OP_MODE_STANDBY  # State of CAN transceiver after call to CanTrcv_Init. | CANTRCV_OP_MODE_SLEEP = Indicates CAN transceiver is in Sleep mode. CANTRCV_OP_MODE_STANDBY = Indicates CAN transceiver is in Standby mode.
        integer CanTrcvMaxBaudrate: 0..1000, category=NOT_SUPPORTED, set at pre-compile  # Max baudrate for transceiver hardware type. Only used for validation purposes. Value shall be configured by configuration tool based on | transceiver hardware type.
        boolean CanTrcvWakeupByBusUsed [0..1]: category=NOT_SUPPORTED, set at pre-compile, default-value=false  # Is wake up by bus supported? If CAN transceiver hardware does not support wake up by bus value is always FALSE. If CAN transceiver hardware supports wake up by bus value is TRUE or FALSE depending whether it is used or not. | TRUE = Is used. FALSE = Is not used.
        enumeration CanTrcvHwDevName: {TJA1041A, TJA1042, TJA1043, TJA1050, TJA1051, TJA1054, TJA1055, TLE6251DS, TLE6250G, TLE6251G, TLE6254G, TLE7250G, TJA1044, NCV7342, TJA1059, TJA1145, TCAN1043A, TCAN1044, TCAN1057, ARISU_CAN0, ARISU_CAN1, ARISU_CAN2, ARISU_CAN3, TJA1463, TCAN1145}, set at pre-compile, origin=AUTOEVER  # Device Name of CAN transceiver.
        boolean CanTrcvSleepModeUsed [0..1]: set at pre-compile, default-value=false  # If you check this, you should use SleepMode instead of StandByMode. | TRUE = SleepMode used. FALSE = StandByMode used.
        reference CanTrcvWakeupSourceRef [0..1]: category=NOT_SUPPORTED, set at pre-compile, destination=EcuMWakeupSource  # Reference to a wakeup source in the EcuM configuration. | This reference is only needed if CanTrcvWakeupByBusUsed is true.
        choice container CanTrcvAccess: category=FIXED  # Container gives CanTrcv Driver information about access to a single CAN transceiver.
          container CanTrcvDioAccess [0..1]: category=FIXED  # Container gives CAN transceiver driver information about accessing ports and port pins. In addition relation between CAN transceiver hardware pin names and Dio port access information is given. | If a CAN transceiver hardware has no Dio interface, there is no instance of this container.
            container CanTrcvDioChannelAccess [1..*]: category=FIXED  # Container gives DIO channel access by single Can transceiver channel.
              string CanTrcvHardwareInterfaceName: set at pre-compile  # CAN transceiver hardware interface name. It is typically the name of a pin. From a Dio point of view it is either a port, a single channel or a channel group. Depending on this fact either | CANTRCV_DIO_PORT_SYMBOLIC_NAME or CANTRCV_DIO_CHANNEL_SYMBOLIC_NAME or CANTRCV_DIO_CHANNEL_GROUP_SYMBOLIC_NAME shall reference a Dio configuration. The CAN transceiver driver implementation description shall list up this name for the appropriate CAN transceiver hardware.
              choice reference CanTrcvDioSymNameRef: set at pre-compile, destination=[DioChannel, DioChannelGroup, DioPort]  # Choice Reference to a DIO Port, DIO Channel or DIO Channel Group. This reference replaces the CANTRCV_DIO_PORT_SYM_NAME, CANTRCV_DIO_CHANNEL_SYM_NAME and CANTRCV_DIO_GROUP_SYM_NAME references in the Can Trcv SWS.
          container CanTrcvSpiSequence [0..*]: category=NOT_SUPPORTED  # Container gives CAN transceiver driver information about one SPI sequence. | One SPI sequence used by CAN transceiver driver is in exclusive use for it. No other driver is allowed to access this sequence. CAN transceiver driver may use one sequence to access n CAN transceiver hardwares chips of the same type or n sequences are used to access one single CAN transceiver hardware chip. If a CAN transceiver hardware has no SPI interface, there is no instance of this container.
            boolean CanTrcvSpiAccessSynchronous [0..1]: set at pre-compile, default-value=true  # This parameter is used to define whether the access to the Spi sequence is synchronous or asynchronous. | true: SPI access is synchronous. false: SPI access is asynchronous.
            enumeration CanTrcvArisucanModeOnNormal: {ARISU_CANTRCV_NORMAL, ARISU_CANTRCV_WAKECAPABLE, ARISU_CANTRCV_OFF}, set at pre-compile, origin=AUTOEVER  # Device Name of CAN transceiver.
            enumeration CanTrcvArisucanModeOnStop: {ARISU_CANTRCV_WAKECAPABLE, ARISU_CANTRCV_OFF}, set at pre-compile, origin=AUTOEVER  # Device Name of CAN transceiver.
            enumeration CanTrcvArisucanModeOnSleep: {ARISU_CANTRCV_WAKECAPABLE, ARISU_CANTRCV_OFF}, set at pre-compile, origin=AUTOEVER  # Device Name of CAN transceiver.
            symbolic name reference CanTrcvSpiSequenceName [1..*]: set at pre-compile, destination=SpiSequence  # Reference to a Spi sequence configuration container.
            choice reference CanTrcvSpiCSGpioNameRef [0..1]: destination=[DioChannel, DioChannelGroup, DioPort]  # Choice Reference to a DIO Port, DIO Channel or DIO Channel Group. This reference replaces the CANTRCV_DIO_PORT_SYM_NAME, CANTRCV_DIO_CHANNEL_SYM_NAME and CANTRCV_DIO_GROUP_SYM_NAME references in the Can Trcv SWS.
        container CanTrcvPartialNetwork [0..1]: category=NOT_SUPPORTED  # Container gives CAN transceiver driver information about the configuration of Partial Networking functionality.
          integer CanTrcvBaudRate: 0..1000, category=NOT_SUPPORTED, set at pre-compile  # Indicates the CAN Bus communication baud rate in kbps.
          boolean CanTrcvBusErrFlag: category=NOT_SUPPORTED, set at pre-compile, default-value=false  # Indicates if the Bus Error (BUSERR) flag is managed by the BSW. This flag is set if a bus failure is detected by the transceiver. | TRUE = Supported by transceiver and managed by BSW. FALSE = Not managed by BSW.
          boolean CanTrcvPnCanIdIsExtended: set at pre-compile, default-value=false  # Indicates whether extended or standard ID is used. | TRUE = Extended Can identifier is used. FALSE = Standard Can identifier is used
          boolean CanTrcvPnEnabled: set at pre-compile, default-value=false  # Indicates whether the selective wake-up function is enabled or disabled in HW. | TRUE = Selective wakeup feature is enabled in the transceiver hardware FALSE = Selective wakeup feature is disabled in the transceiver hardware
          integer CanTrcvPnFrameCanId: 0..4294967295, set at pre-compile  # CAN ID of the Wake-up Frame (WUF).
          integer CanTrcvPnFrameCanIdMask: 0..4294967295, set at pre-compile  # ID Mask for the selective activation of the transceiver. It is used to enableFrame Wake-up (WUF) on a group of IDs.
          integer CanTrcvPnFrameDlc: 0..8, set at pre-compile  # Data Length of the Wake-up Frame (WUF).
          boolean CanTrcvPowerOnFlag: set at pre-compile, default-value=false  # Description: Indicates if the Power On Reset (POR) flag is available and is managed by the transceiver. | TRUE = Supported by Hardware. FALSE = Not supported by Hardware
          boolean CanTrcvPnDlcMatchingCondition: set at pre-compile, default-value=false  # .
          container CanTrcvPnFrameDataMaskSpec [0..8]  # Defines data payload mask to be used on the received payload in order to determine if the transceiver must be woken up by the received Wake-up Frame (WUF).
            integer CanTrcvPnFrameDataMask: 0..255, set at pre-compile  # Defines the n byte (Byte0 = LSB) of the data payload mask to be used on the received payload in order to determine if the transceiver must be woken up by the received Wake-up Frame (WUF).
            integer CanTrcvPnFrameDataMaskIndex: 0..7, set at pre-compile  # holds the position n in frame of the mask-part
    container CanTrcvGeneral  # Container gives CAN transceiver driver basic information.
      boolean CanTrcvDevErrorDetect: category=FIXED, set at pre-compile, default-value=true  # Switches development error detection and notification on and off. | True: #define CANTRCV_DEV_ERROR_DETECT ON shall be generated. False: #define CANTRCV_DEV_ERROR _DETECT OFF shall be generated. Define shall be part of file CanTrcv_Cfg.h.
      boolean CanTrcvGetVersionInfo: category=FIXED, set at pre-compile, default-value=true  # Switches version information API on and off. If switched off, function need not be present in compiled code. | True: Switches version information API on. False: Switches version information API off
      integer CanTrcvSPICommRetries: 0..255, category=NOT_SUPPORTED, set at pre-compile, default-value=0  # Indicates the maximal number of communication retries in case of failed SPI communication (applies both to timed out communication and to errors/NACK in the response data). | (0 ... 255 times, 0 means no retry allowed, communication must succeed at first try)
      integer CanTrcvSPICommTimeout: 0..100, category=NOT_SUPPORTED, set at pre-compile, default-value=0  # Indicates the maximal time allowed to the Transceiver in order to reply | (either positively or negatively) to a SPI command. (value in ms, 0ms means no specific timeout is to be used, communication is executed at the best of the SPI HW capacity)
      integer CanTrcvWaitCount: 0..4294967295, set at pre-compile, default-value=0  # Indicates the number of wait states to change the transceiver operation mode. Transceiver hardware may need wait states for some transitions.
      enumeration CanTrcvWakeUpSupport: {CANTRCV_WAKEUP_BY_POLLING, CANTRCV_WAKEUP_NOT_SUPPORTED}, category=FIXED, set at pre-compile, default-value=CANTRCV_WAKEUP_NOT_SUPPORTED  # Informs whether wake up is supported by polling or not supported. In case no | wake up is supported by the hardware, setting has to be NOT_SUPPORTED. Only in the case of wake up supported by polling, function CanTrcv_MainFunction has to be present and to be invoked by the scheduler. CANTRCV_WAKEUP_BY_POLLING:wake ups generated by CAN transceiver driver causes CAN channel wake ups. CANTRCV_WAKEUP_NOT_SUPPORTED: no wake ups are generated by CAN transceiver driver
      boolean ArisuCanPwmAutoSupport [0..1]: set at pre-compile, origin=AUTOEVER, default-value=false  # ARISU-CAN PWM AUTO Function on and off. | True: #define ARISU-CAN PWM_AUTO On. False: #define ARISU-CAN PWM_AUTO Off.
      boolean CanTrcvSupportAR42 [0..1]: set at pre-compile, origin=AUTOEVER, default-value=false  # CanTrcv Support SPI MCAL AR4.2 or higher Version. | True: Support SPI MCAL AR4.2 or Higher Version False: Support SPI MCAL AR4.0 Version.
      integer CanTrcvTCAN1043AWaitCount [0..1]: 0..4294967295, set at pre-compile, origin=AUTOEVER, default-value=0  # Indicates the number of wait states to change the transceiver operation mode for TCAN1043A. This Parameter should be at least 20 microseconds from CPU Clock.( TCAN1043AWaitCount >= CPU Clock(Mhz) * 20). | This Parameter is only needed if HwDevName is TCAN1043A
