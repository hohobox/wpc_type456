AUTOSAR XML (schema 4-3-0)
# (C) 2018 HYUNDAI AUTRON Co., Ltd.
# Confidential Proprietary Information. Distribution Limited.
# Do Not Copy Without Prior Permission
package /AUTRON_ComXf/EcucDefs
  ecuc definition collection AUTOSARParameterDefinition: module=Xfrm
  module definition Xfrm [0..*]: api-service-prefix=ComXf, post-build-variant-support=true, refined-module-def=Xfrm, variants link-time/post-build/pre-compile
    container XfrmGeneral  # Contains the general configuration parameters of the module.
      boolean XfrmDevErrorDetect: set at pre-compile, default-value=false  # Switches the development error detection and notification on or off. | * true: detection and notification is enabled. * false: detection and notification is disabled.
      boolean XfrmVersionInfoApi: category=FIXED, set at pre-compile, default-value=false  # Activate/Deactivate the version information API. | * true: version information API activated * false: version information API deactivated
      boolean XfrmUnusedArea: category=FIXED, origin=AUTRON, set at pre-compile, default-value=false  # XfrmUnusedArea will be used for filling of unused area in buffer. | * true: Buffer filled with COM unused area parameter value. * false: Buffer will not be filled with COM unused area parameter value. That means garbage value might be present.
      enumeration XfrmCpuEndianness: {BIG_ENDIAN, LITTLE_ENDIAN}, origin=AUTRON, post-build-variant-value=true, set at pre-compile, default-value=LITTLE_ENDIAN  # Defines the endianness of the CPU.
      enumeration XfrmBufferLengthType [0..1]: {uint16, uint32}, category=FIXED, origin=AUTRON, post-build-variant-value=true, set at pre-compile, default-value=uint32  # Defines the size of the BufferLength. Default it is uint32.
    container XfrmImplementationMapping [1..*]  # For each transformer (TransformationTechnology) in a transformer chain (DataTransformation) which is applied to an ISignal it is necessary to specify the BswModuleEntry which implements it. This is the container to hold these mappings.
      foreign reference XfrmInvTransformerBswModuleEntryRef [0..1]: multiplicity set at pre-compile, set at pre-compile, destination-type=BSW-MODULE-ENTRY  # Reference to the BswModuleEntry which implements the referenced inverse transformer on the receiving/called side.
      foreign reference XfrmTransformationTechnologyRef: set at pre-compile, destination-type=TRANSFORMATION-TECHNOLOGY  # Reference to the TransformationTechnology in the DataTransformation of the system description for which the implementation (BswModuleEntry) shall be mapped.
      foreign reference XfrmTransformerBswModuleEntryRef [0..1]: multiplicity set at pre-compile, set at pre-compile, destination-type=BSW-MODULE-ENTRY  # Reference to the BswModuleEntry which implements the referenced transformer on the sending/calling side.
      instance reference XfrmVariableDataPrototypeInstanceRef [0..1]: multiplicity set at pre-compile, set at pre-compile, destination-context=SW-COMPONENT-PROTOTYPE PORT-PROTOTYPE, destination-type=VARIABLE-DATA-PROTOTYPE  # Instance Reference to a VariableDataPrototype in case a dedicated transformer BswModuleEntry is required per VariableDataPrototype access.
      reference XfrmSignalGroupRef: origin=AUTRON, set at link in variant link-time+post-build / pre-compile in variant pre-compile, destination=ComSignalGroup  # Reference to the Com SignalGroup in the ECU configuration
      container XfrmDemEventParameterRefs [0..1]  # Container for the references to DemEventParameter elements which shall be invoked using the API Dem_SetEventStatus in case the corresponding error occurs. The EventId is taken from the referenced DemEventParameter's DemEventId symbolic value. The standardized errors are provided in this container and can be extended by vendor-specific error references.
        symbolic name reference XFRM_E_MALFORMED_MESSAGE [0..1]: multiplicity set at pre-compile, set at pre-compile, destination=DemEventParameter  # Reference to configured DEM event to report if malformed messages were received by the transformer.
      container XfrmSignal [0..1]  # Reference to the signal in the system description that transports the transformed data.
        choice container XfrmSignalChoice  # Choice whether an ISignal or an ISignalGroup shall be referenced.
          container XfrmISignalGroupRefChoice [0..1]  # Reference to the ISignalGroup in the system description that transports the transformed data.
            foreign reference XfrmISignalGroupRef: set at pre-compile, destination-type=I-SIGNAL-GROUP  # Reference to the ISignalGroup in the system description that transports the transformed data.
          container XfrmISignalRefChoice [0..1]  # Reference to the ISignal in the system description that transports the transformed data.
            foreign reference XfrmISignalRef: set at pre-compile, destination-type=I-SIGNAL  # Reference to the ISignal in the system description that transports the transformed data.
