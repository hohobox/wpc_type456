AUTOSAR XML (schema 4-0-3)
# (C) 2013-2019 HYUNDAI AUTRON Co., Ltd.
# Confidential Proprietary Information. Distribution Limited.
# Do Not Copy Without Prior Permission
package /AUTRON
  ecuc definition collection ParameterDefinition_EcuM: module=EcuM
  module definition EcuM: refined-module-def=EcuM, variants post-build  # Configuration of the EcuM (ECU State Manager) module.
    container EcuMConfiguration [0..1]: multiple-configuration-container=true  # This container contains the configuration (parameters) of the ECU State Manager.
      string EcuMPrefixSleepMode [0..1]: multiplicity set at pre-compile, origin=AUTRON, set at pre-compile  # The prefix of the generated symbolic name for 'EcuMSleepMode' container
      string EcuMPrefixWakeupSource [0..1]: multiplicity set at pre-compile, origin=AUTRON, set at pre-compile  # The prefix of the generated symbolic name for 'EcuMWakeupSource' container
      string EcuMPrefixAlarmClock [0..1]: multiplicity set at pre-compile, origin=AUTRON, set at pre-compile  # The prefix of the generated symbolic name for 'EcuMAlarmClock' container
      string EcuMPrefixFlexUserConfig [0..1]: multiplicity set at pre-compile, origin=AUTRON, set at pre-compile  # The prefix of the generated symbolic name for 'EcuMFlexUserConfig' container
      string EcuMPrefixResetMode [0..1]: multiplicity set at pre-compile, origin=AUTRON, set at pre-compile  # The prefix of the generated symbolic name for 'EcuMShutdownCause' container
      string EcuMPrefixShutdownCause [0..1]: multiplicity set at pre-compile, origin=AUTRON, set at pre-compile  # The prefix of the generated symbolic name for 'EcuMWakeupSource' container
      container EcuMCommonConfiguration [0..1]  # This container contains the common configuration (parameters) of the ECU State Manager.
        integer EcuMConfigConsistencyHash: 0..18446744073709551615, set at link  # A hash value generated across all pre-compile and link-time parameters of all BSW modules. This hash value is compared against a field in the EcuM_ConfigType and hence allows checking the consistency of the entire configuration.
        reference EcuMDefaultAppMode: set at post-build, destination=OsAppMode  # The default application mode loaded when the ECU comes out of reset.
        reference EcuMOSResource [1..*]: set at pre-compile, destination=OsResource  # This parameter is a reference to a OS resource which is used to bring the ECU into sleep mode. | In case of multi core each core shall have an own OsResource.
        reference EcuMOsTaskRef [0..1]: set at pre-compile, origin=AUTRON, destination=OsTask  # This parameter contains reference to container OsTask where BswM_MainFunction will be executed. This parameter is used for invoking for shutdown synchronization in multi core.
        reference EcuMOsEventRef [0..*]: set at pre-compile, origin=AUTRON, destination=OsEvent  # This parameter is a reference to OS events which is used for multicore synchronized shutdown. | In case of multi core each core shall have an own OsEvent.
        reference EcuMOsSpinlockRef [0..1]: set at post-build, origin=AUTRON, destination=OsSpinlock  # This parameter is a reference to a OS spin lock which is used to protect a shared resource from Multi-Core. | In case of multi core each core shall have an own OsResource.
        container EcuMDefaultShutdownTarget [0..1]  # This container describes the default shutdown target to be selected by EcuM. The actual shutdown target may be overridden by the EcuM_SelectShutdownTarget service.
          enumeration EcuMDefaultState: {EcuMStateOff, EcuMStateReset, EcuMStateSleep}, set at post-build  # This parameter describes the state part of the default shutdown target selected when the ECU comes out of reset. If EcuMStateSleep is selected, the parameter EcuMDefaultSleepModeRef selects the specific sleep mode. EcuMStateOff: Corresponds to ECUM_STATE_OFF in EcuM_StateType. EcuMStateReset: Corresponds to ECUM_STATE_RESET in EcuM_StateType. This literal is only be applicable for EcuMFlex. EcuMStateSleep: Corresponds to ECUM_STATE_SLEEP in EcuM_StateType.
          symbolic name reference EcuMDefaultResetModeRef [0..1]: set at post-build, destination=EcuMResetMode  # If EcuMDefaultShutdownTarget is EcuMStateReset, this parameter selects the default reset mode. Otherwise this parameter may be ignored.
          symbolic name reference EcuMDefaultSleepModeRef [0..1]: set at post-build, destination=EcuMSleepMode  # If EcuMDefaultShutdownTarget is EcuMStateSleep, this parameter selects the default sleep mode. Otherwise this parameter may be ignored.
        container EcuMDemEventParameterRefs [0..1]  # Container for the references to DemEventParameter elements which shall be invoked using the API Dem_ReportErrorStatus in case the corresponding error occurs. The EventId is taken from the referenced DemEventParameter's DemEventId value. | The standardized errors are provided in this container and can be extended by vendor specific error references.
          symbolic name reference ECUM_E_IMPROPER_CALLER [0..1]: set at pre-compile, destination=DemEventParameter  # Reference to the DemEventParameter which shall be issued when the error "ECUM_E_IMPROPER_CALLER" has occured.
          symbolic name reference ECUM_E_CONFIGURATION_DATA_INCONSISTENT [0..1]: set at pre-compile, destination=DemEventParameter  # Reference to the DemEventParameter which shall be issued when the error "ECUM_E_CONFIGURATION_DATA_INCONSISTENT" has occured.
          symbolic name reference ECUM_E_RAM_CHECK_FAILED [0..1]: set at pre-compile, destination=DemEventParameter  # Reference to the DemEventParameter which shall be issued when the error "ECUM_E_RAM_CHECK_FAILED" has occured.
        container EcuMDriverInitListZero [0..1]  # Container for Init Block 0. | This container holds a list of module IDs that will be initialised. Each module in the list will be called for initialisation in the list order. All modules in this list are initilialised before the post-build configuration has been loaded and the OS is initialized. Therefore, these modules may not use post-build configuration.
          container EcuMDriverInitItem [1..*]: requires-index=true  # These containers describe the entries in a driver init list.
            string EcuMModuleID [0..1]: multiplicity set at pre-compile, set at pre-compile  # Short name of the module to be initialized, e.g. Mcu, Gpt etc. | In case EcuMModuleRef is used the EcuMModuleID is optional (in case it is given it shall have the same value as the referenced module configuration).
            enumeration EcuMModuleParameter: {NULL_PTR, POSTBUILD_PTR, VOID}, set at pre-compile  # Definition of the function prototype and the parameter passed to the function.
            string EcuMModuleService [0..1]: multiplicity set at pre-compile, set at pre-compile  # The service to be called to initialize that module, e.g. Init, PreInit, Start etc. If nothing is defined "Init" is taken by default.
            integer EcuMDriverInitItemIndex: 0..65535, set at pre-compile, origin=AUTRON, symbolic-name-value=true  # This index detemines the order of driver init list.
            string EcuMModulePostBuildPtr [0..1]: multiplicity set at pre-compile, origin=AUTRON, set at pre-compile  # The configuration pointer set for Variant-post-build.
            boolean EcuMModuleUsed: set at pre-compile, origin=AUTRON, default-value=true  # This option determines whether the module is initialized or not. | true : This module is initialized. false : This module is not initialized.
            foreign reference EcuMModuleRef [0..1]: multiplicity set at pre-compile, set at pre-compile, destination-type=ECUC-MODULE-CONFIGURATION-VALUES  # Foreign reference to the configuration of a module instance which shall be initialized by EcuM
        container EcuMDriverInitListOne [0..1]  # Container for Init Block I. | This container holds a list of module IDs that will be initialised. Each module in the list will be called for initialisation in the list order. All modules in this list are initilialised before the OS is started and so these modules require no OS support.
          container EcuMDriverInitItem [1..*]: requires-index=true  # These containers describe the entries in a driver init list.
            string EcuMModuleID [0..1]: multiplicity set at pre-compile, set at pre-compile  # Short name of the module to be initialized, e.g. Mcu, Gpt etc. | In case EcuMModuleRef is used the EcuMModuleID is optional (in case it is given it shall have the same value as the referenced module configuration).
            enumeration EcuMModuleParameter: {NULL_PTR, POSTBUILD_PTR, VOID}, set at pre-compile  # Definition of the function prototype and the parameter passed to the function.
            string EcuMModuleService [0..1]: multiplicity set at pre-compile, set at pre-compile  # The service to be called to initialize that module, e.g. Init, PreInit, Start etc. If nothing is defined "Init" is taken by default.
            integer EcuMDriverInitItemIndex: 0..65535, set at pre-compile, origin=AUTRON, symbolic-name-value=true  # This index detemines the order of driver init list.
            string EcuMModulePostBuildPtr [0..1]: multiplicity set at pre-compile, origin=AUTRON, set at pre-compile  # The configuration pointer set for Variant-post-build.
            boolean EcuMModuleUsed: set at pre-compile, origin=AUTRON, default-value=true  # This option determines whether the module is initialized or not. | true : This module is initialized. false : This module is not initialized.
            foreign reference EcuMModuleRef [0..1]: multiplicity set at pre-compile, set at pre-compile, destination-type=ECUC-MODULE-CONFIGURATION-VALUES  # Foreign reference to the configuration of a module instance which shall be initialized by EcuM
        container EcuMDriverRestartList [0..1]  # List of module IDs. | EcuM2719: A configuration tool shall fill the callout EcuM_AL_DriverRestart with initialization calls to the listed drivers in the order in which they occur in the list. EcuM2720: Entries in this list must appear in the same order as in the combined list of EcuM_DriverInitListOne and EcuM_DriverInitListTwo. This list may be a real subset though. In all other cases, the generation tool shall report an error. The included container has the same structure as EcuM_DriverInitItem
          container EcuMDriverInitItem [1..*]: requires-index=true  # These containers describe the entries in a driver init list.
            string EcuMModuleID [0..1]: multiplicity set at pre-compile, set at pre-compile  # Short name of the module to be initialized, e.g. Mcu, Gpt etc. | In case EcuMModuleRef is used the EcuMModuleID is optional (in case it is given it shall have the same value as the referenced module configuration).
            enumeration EcuMModuleParameter: {NULL_PTR, POSTBUILD_PTR, VOID}, set at pre-compile  # Definition of the function prototype and the parameter passed to the function.
            string EcuMModuleService [0..1]: multiplicity set at pre-compile, set at pre-compile  # The service to be called to initialize that module, e.g. Init, PreInit, Start etc. If nothing is defined "Init" is taken by default.
            integer EcuMDriverInitItemIndex: 0..65535, set at pre-compile, origin=AUTRON, symbolic-name-value=true  # This index detemines the order of driver init list.
            string EcuMModulePostBuildPtr [0..1]: multiplicity set at pre-compile, origin=AUTRON, set at pre-compile  # The configuration pointer set for Variant-post-build.
            boolean EcuMModuleUsed: set at pre-compile, origin=AUTRON  # This option determines whether the module is initialized or not. | true : This module is initialized. false : This module is not initialized.
            foreign reference EcuMModuleRef [0..1]: multiplicity set at pre-compile, set at pre-compile, destination-type=ECUC-MODULE-CONFIGURATION-VALUES  # Foreign reference to the configuration of a module instance which shall be initialized by EcuM
        container EcuMSleepMode [0..*]  # These containers describe the configured sleep modes. | The names of these containers specify the symbolic names of the different sleep modes.
          integer EcuMSleepModeId: 0..255, set at pre-compile, symbolic-name-value=true  # This ID identifies this sleep mode in services like EcuM_SelectShutdownTarget.
          boolean EcuMSleepModeSuspend: set at pre-compile  # Flag, which is set true, if the CPU is suspended, halted, or powered off in the sleep mode. If the CPU keeps running in this sleep mode, then this flag must be set to false. true: CPU is suspended, halted or powered off in the sleep mode. false: CPU keeps running in sleep mode.
          symbolic name reference EcuMSleepModeMcuModeRef: set at pre-compile, destination=McuModeSettingConf  # This parameter is a reference to the corresponding MCU mode for this sleep mode.
          symbolic name reference EcuMWakeupSourceMask [1..*]: set at pre-compile, destination=EcuMWakeupSource  # These parameters are references to the wakeup sources that shall be enabled for this sleep mode.
        container EcuMWakeupSource [0..*]  # These containers describe the configured wakeup sources.
          float EcuMValidationTimeout [0..1]: 0..65.535, set at pre-compile, default-value=0  # The validation timeout (period for which the ECU State Manager will wait for the validation of a wakeup event) can be defined for each wakeup source independently. The timeout is specified in seconds. | When the timeout is not instantiated, there is no validation routine and the ECU Manager shall not validate the wakeup source.
          integer EcuMWakeupSourceId: 0..31, set at pre-compile, symbolic-name-value=true  # This parameter defines the identifier of this wakeup source. This ID in the range of [0 - 4] should be configured with the short name as below. [0] ECUM_WKSOURCE_POWER [1] ECUM_WKSOURCE_RESET [2] ECUM_WKSOURCE_INTERNAL_RESET [3] ECUM_WKSOURCE_INTERNAL_WDG [4] ECUM_WKSOURCE_EXTERNAL_WDG
          boolean EcuMWakeupSourcePolling: set at pre-compile, default-value=false  # This parameter describes if the wakeup source needs polling. true: Wakeup source needs polling. false: Wakeup source does not need polling.
          symbolic name reference EcuMComMChannelRef [0..1]: set at pre-compile, destination=ComMChannel  # This parameter is a reference to a Network (channel) defined in the Communication Manager. No reference indicates that the wakeup source is not a communication channel.
          symbolic name reference EcuMResetReasonRef: set at pre-compile, destination=McuResetReasonConf  # This parameter describes the mapping of reset reasons detected by the MCU driver into wakeup sources.
        container EcuMCalloutUserIncludeFiles [0..1]  # Collection of header file names which shall be included by the EcuM Callout.
          string EcuMCalloutUserIncludeFile [0..*]: set at pre-compile, origin=AUTRON  # Header file name which shall be included by the EcuM Callout.
      container EcuMFlexConfiguration [0..1]  # This container contains the configuration (parameters) of the EcuMFlex. | Only applicable if EcuMFlex is implemented.
        reference EcuMFlexGptConfigurationRef [0..1]: set at pre-compile, origin=AUTRON, destination=GptChannelConfiguration  # This parameter contains reference to GptChannelConfiguration. This parameter is used for starting the Gpt timer during EcuM Sleep mode for Alarm functionality.
        symbolic name reference EcuMNormalMcuModeRef [0..1]: category=NOT_SUPPORTED, set at pre-compile, destination=McuModeSettingConf  # This parameter is a reference to the normal MCU mode to be restored after a sleep.
        symbolic name reference EcuMNormalMcuClockRef [0..1]: set at pre-compile, origin=AUTRON, destination=McuClockSettingConfig  # This parameter is a reference to the normal MCU clock to be initialized for Mcu_InitClock API.
        reference EcuMPartitionRef [0..*]: set at pre-compile, destination=EcucPartition  # Denotes which "EcucPartition" includes Master EcuM in case of Multi-Core.
        container EcuMAlarmClock [0..*]  # These containers describe the configured alarm clocks. | The name of these conatiners allows giving a symbolic name to one alarm clock.
          integer EcuMAlarmClockId: 0..255, set at pre-compile, symbolic-name-value=true  # This ID identifies this alarmclock.
          float EcuMAlarmClockTimeOut: 0..65.535, set at pre-compile  # This parameter allows to define a timout for this alarm clock.
          symbolic name reference EcuMAlarmClockUser: set at pre-compile, destination=EcuMFlexUserConfig  # This parameter allows an alarm to be assigned to a user.
        container EcuMFlexUserConfig [0..*]  # These containers describe the identifiers that are needed to refer to a software component or another appropriate entity in the system which uses the EcuMFlex Interfaces.
          integer EcuMFlexUser: 0..255, set at pre-compile, symbolic-name-value=true  # Parameter used to identify one user.
          reference EcuMFlexEcucPartitionRef [0..1]: category=NOT_SUPPORTED, set at pre-compile, destination=EcucPartition  # This parameter is not used for the implementation. It denotes in which "EcucPartition" the user of the EcuM is executed.
        container EcuMGoDownAllowedUsers [0..1]  # This container describes the collection of allowed users which are allowed to call the EcuM_GoDown API.
          symbolic name reference EcuMGoDownAllowedUserRef [1..*]: set at pre-compile, destination=EcuMFlexUserConfig  # These parameters describe the references to the users which are allowed to call the EcuM_GoDown API.
        container EcuMResetMode [0..*]  # These containers describe the configured reset modes.
          integer EcuMResetModeId: 0..255, set at pre-compile, symbolic-name-value=true  # This ID identifies this reset mode in services like EcuM_SelectShutdownTarget. This ID in the range of [0 - 2] should be configured with the short name as below. [0] ECUM_RESET_MCU [1] ECUM_RESET_WDG [2] ECUM_RESET_IO
        container EcuMSetClockAllowedUsers [0..1]  # This container describes the collection of allowed users which are allowed to call the EcuM_SetClock API.
          symbolic name reference EcuMSetClockAllowedUserRef [0..*]: set at pre-compile, destination=EcuMFlexUserConfig  # These parameters describe the references to the users which are allowed to call the EcuM_SetClock API.
        container EcuMShutdownCause [0..*]  # These containers describe the configured shutdown or reset causes.
          integer EcuMShutdownCauseId: 0..255, set at pre-compile, symbolic-name-value=true  # This ID identifies this shut down cause. This ID in the range of [0 - 3] should be configured with the short name as below. [0] ECUM_CAUSE_UNKNOWN [1] ECUM_CAUSE_ECU_STATE [2] ECUM_CAUSE_WDGM [3] ECUM_CAUSE_DCM
    container EcuMFlexGeneral [0..1]  # This container holds the general, pre-compile configuration parameters for the EcuMFlex. | Only applicable if EcuMFlex is implemented.
      boolean EcuMAlarmClockPresent: set at pre-compile, default-value=false  # This flag indicates whether the optional AlarmClock feature is present. true: Optional AlarmClock feature is present. false: Optional AlarmClock feature is not present.
      boolean EcuMEnableDefBehaviour [0..1]: set at pre-compile, default-value=false  # Switches the defensive behaviour on or off. true: Defensive behaviour is switched on. false: Defensive behaviour is switched off.
      boolean EcuMResetLoopDetection: set at pre-compile, default-value=false  # If false, no reset loop detection is performed. true: Reset loop detection is performed. false: Reset loop detection is not performed.
      boolean EcuMPmEnabled: set at pre-compile, origin=AUTRON, default-value=false  # This flag indicates whether the Pm module is used in low power mode or not. true: Pm module is used in low power mode. false: Pm module is not used in low power mode.
      boolean EcuMLpTransitionCalloutEnabled: set at pre-compile, origin=AUTRON, default-value=false  # This flag indicates whether the Lp transition callouts are used in low power mode or not. true: Lp callouts are used in low power mode. false: Lp callouts are not used in low power mode.
      integer EcuMLoopCountMax [0..1]: 0..4294967295, set at pre-compile, origin=AUTRON, default-value=2000000  # The maximum number of iterations to prevent an infinite loop. ex) Failsafe for PLL Lock Loop
      symbolic name reference EcuMAlarmWakeupSource [0..1]: set at pre-compile, destination=EcuMWakeupSource  # This parameter describes the reference to the EcuMWakeupSource being used for the EcuM AlarmClock.
    container EcuMGeneral [0..1]  # This container holds the general, pre-compile configuration parameters.
      boolean EcuMDevErrorDetect: set at pre-compile, default-value=false  # If false, no debug artifacts (e.g. calls to DET) shall remain in the executable object. Initialization of DET, however is controlled by configuration of optional BSW modules. true: development error detection and notification shall be generated. false: development error detection and notification shall not be generated.
      boolean EcuMIncludeDet: set at pre-compile, default-value=false  # If defined, the according BSW module will be initialized by the ECU State Manager true: Det will be initialized by the EcuM. false: Det will not be initialized by the EcuM.
      float EcuMMainFunctionPeriod: 0..65.535, set at pre-compile  # This parameter defines the schedule period of EcuM_MainFunction. | Unit: [s]
      boolean EcuMVersionInfoApi: set at pre-compile, default-value=false  # Switches the version info API on or off true: Version Info API is switched on. false: Version Info API is switched off.
