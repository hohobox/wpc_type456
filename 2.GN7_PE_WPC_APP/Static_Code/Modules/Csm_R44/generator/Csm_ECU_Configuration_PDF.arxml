AUTOSAR XML (schema 00047)
# (C) 2021 HYUNDAI AUTOEVER Corp.
package /AUTRON
  module definition Csm [0..1]: variants pre-compile  # Configuration of the Csm (CryptoServiceManager) module.
    container CsmCallbacks [0..1]  # Container for callback function configurations
      container CsmCallback [0..*]: multiplicity set at pre-compile  # Container for configuration of a callback function
        function name CsmCallbackFunc [0..1]: multiplicity set at pre-compile, set at pre-compile  # Callback function to be called if an asynchronous operation has finished. The corresponding job has to be configured to be processed asynchronously.
        integer CsmCallbackId [0..1]: 0..4294967295, multiplicity set at pre-compile, set at pre-compile  # Identifier of the callback function. The set of actually configured identifiers shall be consecutive and gapless.
    container CsmGeneral: multiplicity set at pre-compile  # Container for common configuration options.
      integer CsmAsymPrivateKeyMaxLength [0..1]: 1..4294967295, multiplicity set at pre-compile, set at pre-compile  # Maximum length in bytes of an asymmetric public key for all algorithm
      integer CsmAsymPublicKeyMaxLength [0..1]: 1..4294967295, multiplicity set at pre-compile, set at pre-compile  # Maximum length in bytes of an asymmetric key for all algorithm
      boolean CsmDevErrorDetect: multiplicity set at pre-compile, set at pre-compile, default-value=false  # Switches the development error detection and notification on or off. | * true: detection and notification is enabled. * false: detection and notification is disabled.
      float CsmMainFunctionPeriod [0..1]: 0..Inf, multiplicity set at pre-compile, set at pre-compile  # Specifies the period of main function Csm_MainFunction in seconds.
      boolean CsmUseDeprecated: multiplicity set at pre-compile, set at pre-compile, default-value=false  # Decides if the deprecated interfaces shall be used (Backwards combatibility). | true: use deprecated interfaces. false: use normal interfaces.
      boolean CsmVersionInfoApi: multiplicity set at pre-compile, set at pre-compile, default-value=false  # Pre-processor switch to enable and disable availability of the API Csm_GetVersionInfo(). | True: API Csm_GetVersionInfo() is available. False: API Csm_GetVersionInfo() is not available.
      boolean CsmInputDataNoValidation [0..1]: multiplicity set at pre-compile, origin=AUTOEVER, set at pre-compile, default-value=false  # Pre-processor switch to enable and disable vaidation of input data on API Csm_PrvValidateInputPtr(). | *true: Validation of input data is disable. *false: Validation of input data is enable.
      string CsmUserIncludeFiles [0..*]: set at pre-compile, regular-expression=[a-zA-Z0-9_]([a-zA-Z0-9\._])*  # Name of the header file(s) to be included by the Csm module like header of user custom algorithms. Ex: User_header
    container CsmInOutRedirections [0..1]  # Configuration for CSM redirection configurations
      container CsmInOutRedirection [1..*]  # Container for configuration of a CSM redirection. | A redirection let a CSM job use a specific key element as input or/and output.
        integer CsmInputKeyElementId [0..1]: 0..4294967295, multiplicity set at pre-compile, set at pre-compile  # Identifier of the key element used as input
        integer CsmOutputKeyElementId [0..1]: 0..4294967295, multiplicity set at pre-compile, set at pre-compile  # Identifier of the key element used as output.
        integer CsmSecondaryInputKeyElementId [0..1]: 0..4294967295, multiplicity set at pre-compile, set at pre-compile  # Identifier of the key element used as secondary input.
        integer CsmSecondaryOutputKeyElementId [0..1]: 0..4294967295, multiplicity set at pre-compile, set at pre-compile  # Identifier of the key element used as secondary output.
        integer CsmTertiaryInputKeyElementId [0..1]: 0..4294967295, multiplicity set at pre-compile, set at pre-compile  # Identifier of the key element used as tertiary input.
        reference CsmInputKeyRef [0..1]: multiplicity set at pre-compile, set at pre-compile, destination=CsmKey  # This parameter refers to the key used as input.
        reference CsmOutputKeyRef [0..1]: multiplicity set at pre-compile, set at pre-compile, destination=CsmKey  # This parameter refers to the key used as output.
        reference CsmSecondaryInputKeyRef [0..1]: multiplicity set at pre-compile, set at pre-compile, destination=CsmKey  # This parameter refers to the key used as secondary input.
        reference CsmSecondaryOutputKeyRef [0..1]: multiplicity set at pre-compile, set at pre-compile, destination=CsmKey  # This parameter refers to the key used as secondary output.
        reference CsmTertiaryInputKeyRef [0..1]: multiplicity set at pre-compile, set at pre-compile, destination=CsmKey  # This parameter refers to the key used as tertiary input.
    container CsmJobs [0..1]: multiplicity set at pre-compile  # Container for configuration of CSM jobs.
      container CsmJob [1..*]: multiplicity set at pre-compile  # Container for configuration of CSM job. The container name serves as a symbolic name for the identifier of a job configuration.
        integer CsmJobId: 0..4294967295, multiplicity set at pre-compile, set at pre-compile, symbolic-name-value=true  # Identifier of the CSM job. The set of actually configured identifiers shall be consecutive and gapless.
        enumeration CsmJobInterfaceUsePort: {CRYPTO_USE_FNC, CRYPTO_USE_PORT, CRYPTO_USE_PORT_OPTIMIZED}, set at pre-compile  # Does the job need RTE interfaces?
        boolean CsmJobPrimitiveCallbackUpdateNotification [0..1]: multiplicity set at pre-compile, set at pre-compile, default-value=false  # This parameter indicates, whether the callback function shall be called, if the UPDATE operation has been finished.
        integer CsmJobPriority: 0..4294967295, multiplicity set at pre-compile, set at pre-compile  # Priority of the job. | The higher the value, the higher the job's priority.
        enumeration CsmProcessingMode: {CRYPTO_PROCESSING_ASYNC, CRYPTO_PROCESSING_SYNC}, set at pre-compile  # Determines how the interface shall be used for that job. Synchronous processing returns with the result while asynchronous processing returns without processing the job. The caller will be notified by the corresponding callback.
        reference CsmInOutRedirectionRef [0..1]: multiplicity set at pre-compile, set at pre-compile, destination=CsmInOutRedirection  # This parameter refers to the used redirection.
        reference CsmJobKeyRef: multiplicity set at pre-compile, set at pre-compile, destination=CsmKey  # This parameter refers to the key which shall be used for the CsmPrimitive. It's possible to use a CsmKey for different jobs
        reference CsmJobPrimitiveCallbackRef [0..1]: multiplicity set at pre-compile, set at pre-compile, destination=CsmCallback  # This parameter refers to the used CsmCallback. | The referred CsmCallback is called when the crypto job has been finished.
        choice reference CsmJobPrimitiveRef: multiplicity set at pre-compile, set at pre-compile, destination=[CsmAEADDecrypt, CsmAEADEncrypt, CsmDecrypt, CsmEncrypt, CsmHash, CsmJobKeyDerive, CsmJobKeyExchangeCalcPubVal, CsmJobKeyExchangeCalcSecret, CsmJobKeyGenerate, CsmJobKeySetValid, CsmJobRandomSeed, CsmMacGenerate, CsmMacVerify, CsmRandomGenerate, CsmSignatureGenerate, CsmSignatureVerify]  # This parameter refers to the used CsmPrimitive. | Different jobs may refer to one CsmPrimitive. The referred CsmPrimitive provides detailed information on the actual cryptographic routine.
        reference CsmJobQueueRef: multiplicity set at pre-compile, set at pre-compile, destination=CsmQueue  # This parameter refers to the queue. | The queue is used if the underlying crypto driver object is busy. The queue refers also to the channel which is used.
    container CsmKeys [0..1]  # Container for CSM key configurations.
      container CsmKey [0..*]  # Container for configuration of a CSM key. The container name serves as a symbolic name for the identifier of a key configuration.
        integer CsmKeyId: 0..4294967295, multiplicity set at pre-compile, set at pre-compile, symbolic-name-value=true  # Identifier of the CsmKey. The set of actually configured identifiers shall be consecutive and gapless.
        boolean CsmKeyUsePort: multiplicity set at pre-compile, set at pre-compile  # Does the key need RTE interfaces? | True: RTE interfaces used for this key False: No RTE interfaces used for this key
        reference CsmKeyRef: multiplicity set at pre-compile, set at pre-compile, requires-symbolic-name-value=true, destination=CryIfKey  # This parameter refers to the used CryIfKey. The underlying CryIfKey refers to a specific CryptoKey in the Crypto Driver.
    container CsmPrimitives [0..*]: multiple-configuration-container=true  # Container for configuration of CsmPrimitives
      container CsmAEADDecrypt [0..1]  # Configuration of AEAD decryption primitives
        container CsmAEADDecryptConfig  # Container for configuration of a CSM decryption interface. The container name serves as a symbolic name for the identifier of an decryption interface.
          enumeration CsmAEADDecryptAlgorithmFamily: {CRYPTO_ALGOFAM_3DES, CRYPTO_ALGOFAM_AES, CRYPTO_ALGOFAM_CUSTOM, CRYPTO_ALGOFAM_CHACHA, CRYPTO_ALGOFAM_EEA3}, multiplicity set at pre-compile, set at pre-compile  # Determines the algorithm family used for the crypto service. This parameter defines the most significant part of the algorithm.
          string CsmAEADDecryptAlgorithmFamilyCustom [0..1]: multiplicity set at pre-compile, set at pre-compile  # This is the name of the custom algorithm family, if CRYPTO_ALGOFAM_CUSTOM is used as CsmAEADDecryptAlgorithmFamily.
          integer CsmAEADDecryptAlgorithmKeyLength: 1..4294967295, multiplicity set at pre-compile, set at pre-compile  # Size of the AEAD decryption key in bytes
          enumeration CsmAEADDecryptAlgorithmMode: {CRYPTO_ALGOMODE_20ROUNDS, CRYPTO_ALGOMODE_12ROUNDS, CRYPTO_ALGOMODE_8ROUNDS, CRYPTO_ALGOMODE_GCM, CRYPTO_ALGOMODE_CCM, CRYPTO_ALGOMODE_CUSTOM}, multiplicity set at pre-compile, set at pre-compile  # Determines the algorithm mode used for the crypto service
          string CsmAEADDecryptAlgorithmModeCustom [0..1]: multiplicity set at pre-compile, set at pre-compile  # Name of the custom algorithm mode used for the crypto service
          integer CsmAEADDecryptAssociatedDataMaxLength [0..1]: 1..4294967295, multiplicity set at pre-compile, set at pre-compile  # Max size of the input associated data length in bytes
          integer CsmAEADDecryptCiphertextMaxLength [0..1]: 1..4294967295, multiplicity set at pre-compile, set at pre-compile  # Max size of the input ciphertext in bytes
          integer CsmAEADDecryptPlaintextMaxLength [0..1]: 1..4294967295, multiplicity set at pre-compile, set at pre-compile  # Size of the output plaintext length in bytes
          integer CsmAEADDecryptTagLength: 1..4294967295, multiplicity set at pre-compile, set at pre-compile  # Size of the input Tag length in BITS
          enumeration CsmAEADDecryptAlgorithmSecondaryFamily: {CRYPTO_ALGOFAM_NOT_SET, CRYPTO_ALGOFAM_POLY1305, CRYPTO_ALGOFAM_CUSTOM}, multiplicity set at pre-compile, set at pre-compile, default-value=CRYPTO_ALGOFAM_NOT_SET  # Determines the algorithm family used for the crypto service.
          string CsmAEADDecryptAlgorithmSecondaryFamilyCustom [0..1]: multiplicity set at pre-compile, set at pre-compile  # This is the name of the custom secondary algorithm family, if CRYPTO_ALGOFAM_CUSTOM is used as CsmAEADDecryptAlgorithmFamily.
          reference CsmAEADDecryptKeyRef: multiplicity set at pre-compile, set at pre-compile, destination=CsmKey  # This parameter refers to the key used for that decryption primitive.
          reference CsmAEADDecryptQueueRef: multiplicity set at pre-compile, set at pre-compile, destination=CsmQueue  # This parameter refers to the queue used for that decryption primitive.
      container CsmAEADEncrypt [0..1]  # Configuration of AEAD encryption primitives
        container CsmAEADEncryptConfig  # Container for configuration of a CSM encryption interface. The container name serves as a symbolic name for the identifier of an encryption interface.
          enumeration CsmAEADEncryptAlgorithmFamily: {CRYPTO_ALGOFAM_3DES, CRYPTO_ALGOFAM_AES, CRYPTO_ALGOFAM_CHACHA, CRYPTO_ALGOFAM_CUSTOM, CRYPTO_ALGOFAM_EEA3}, multiplicity set at pre-compile, set at pre-compile  # Determines the algorithm family used for the crypto service. This parameter defines the most significant part of the algorithm.
          string CsmAEADEncryptAlgorithmFamilyCustom [0..1]: multiplicity set at pre-compile, set at pre-compile  # This is the name of the custom algorithm family, if CRYPTO_ALGOFAM_CUSTOM is used as CsmAEADEncryptAlgorithmFamily.
          integer CsmAEADEncryptAlgorithmKeyLength: 1..4294967295, multiplicity set at pre-compile, set at pre-compile  # Size of the AEAD encryption key in bytes
          enumeration CsmAEADEncryptAlgorithmMode: {CRYPTO_ALGOMODE_20ROUNDS, CRYPTO_ALGOMODE_12ROUNDS, CRYPTO_ALGOMODE_8ROUNDS, CRYPTO_ALGOMODE_GCM, CRYPTO_ALGOMODE_CCM, CRYPTO_ALGOMODE_CUSTOM}, multiplicity set at pre-compile, set at pre-compile  # Determines the algorithm mode used for the crypto service
          string CsmAEADEncryptAlgorithmModeCustom [0..1]: multiplicity set at pre-compile, set at pre-compile  # Name of the custom algorithm mode used for the crypto service
          integer CsmAEADEncryptAssociatedDataMaxLength [0..1]: 1..4294967295, multiplicity set at pre-compile, set at pre-compile  # Max size of the input associated data length in bytes
          integer CsmAEADEncryptCiphertextMaxLength [0..1]: 1..4294967295, multiplicity set at pre-compile, set at pre-compile  # Max size of the output ciphertext length in bytes
          integer CsmAEADEncryptPlaintextMaxLength [0..1]: 1..4294967295, multiplicity set at pre-compile, set at pre-compile  # Max size of the input plaintext length in bytes
          integer CsmAEADEncryptTagLength: 1..4294967295, multiplicity set at pre-compile, set at pre-compile  # Size of the output Tag length in bytes
          enumeration CsmAEADEncryptAlgorithmSecondaryFamily: {CRYPTO_ALGOFAM_NOT_SET, CRYPTO_ALGOFAM_POLY1305, CRYPTO_ALGOFAM_CUSTOM}, multiplicity set at pre-compile, set at pre-compile, default-value=CRYPTO_ALGOFAM_NOT_SET  # Defines the secondary family used for the crypto service.
          string CsmAEADEncryptAlgorithmSecondaryFamilyCustom [0..1]: multiplicity set at pre-compile, set at pre-compile  # This is the name of the custom secondary algorithm family, if CRYPTO_ALGOFAM_CUSTOM is used as CsmAEADEncryptAlgorithmFamily.
          reference CsmAEADEncryptKeyRef: multiplicity set at pre-compile, set at pre-compile, destination=CsmKey  # This parameter refers to the key used for that encryption primitive.
          reference CsmAEADEncryptQueueRef: multiplicity set at pre-compile, set at pre-compile, destination=CsmQueue  # This parameter refers to the queue used for that encryption primitive.
      container CsmDecrypt [0..1]  # Configurations of Decryption primitives
        container CsmDecryptConfig  # Container for configuration of a CSM decryption interface. The container name serves as a symbolic name for the identifier of an decryption interface.
          enumeration CsmDecryptAlgorithmFamily: {CRYPTO_ALGOFAM_3DES, CRYPTO_ALGOFAM_AES, CRYPTO_ALGOFAM_CHACHA, CRYPTO_ALGOFAM_CUSTOM, CRYPTO_ALGOFAM_ECIES, CRYPTO_ALGOFAM_RSA}, multiplicity set at pre-compile, set at pre-compile  # Determines the algorithm family used for the crypto service. This parameter defines the most significant part of the algorithm.
          string CsmDecryptAlgorithmFamilyCustom [0..1]: multiplicity set at pre-compile, set at pre-compile  # Name of the custom algorithm family, if CRYPTO_ALGOFAM_CUSTOM is used as CsmDecryptAlgorithmFamily.
          integer CsmDecryptAlgorithmKeyLength: 1..4294967295, multiplicity set at pre-compile, set at pre-compile  # Size of the encryption key in bytes
          enumeration CsmDecryptAlgorithmMode: {CRYPTO_ALGOMODE_12ROUNDS, CRYPTO_ALGOMODE_20ROUNDS, CRYPTO_ALGOMODE_8ROUNDS, CRYPTO_ALGOMODE_CBC, CRYPTO_ALGOMODE_CFB, CRYPTO_ALGOMODE_CTR, CRYPTO_ALGOMODE_CUSTOM, CRYPTO_ALGOMODE_ECB, CRYPTO_ALGOMODE_NOT_SET, CRYPTO_ALGOMODE_OFB, CRYPTO_ALGOMODE_RSAES_OAEP, CRYPTO_ALGOMODE_RSAES_PKCS1_v1_5, CRYPTO_ALGOMODE_XTS}, multiplicity set at pre-compile, set at pre-compile  # Determines the algorithm mode used for the crypto service
          string CsmDecryptAlgorithmModeCustom [0..1]: multiplicity set at pre-compile, set at pre-compile  # Name of the custom algorithm mode used for the crypto service
          enumeration CsmDecryptAlgorithmSecondaryFamily: {CRYPTO_ALGOFAM_CUSTOM, CRYPTO_ALGOFAM_NOT_SET}, multiplicity set at pre-compile, set at pre-compile, default-value=CRYPTO_ALGOFAM_NOT_SET  # Determines the secondary algorithm family used for the crypto service
          string CsmDecryptAlgorithmSecondaryFamilyCustom [0..1]: multiplicity set at pre-compile, set at pre-compile  # Name of the custom secondary algorithm family used for the crypto service
          integer CsmDecryptDataMaxLength [0..1]: 1..4294967295, multiplicity set at pre-compile, set at pre-compile  # Max size of the input ciphertext length in bytes
          integer CsmDecryptResultMaxLength [0..1]: 1..4294967295, multiplicity set at pre-compile, set at pre-compile  # Max size of the output plaintext length in bytes
      container CsmEncrypt [0..1]  # Configurations of Encryption primitives
        container CsmEncryptConfig  # Container for configuration of a CSM encryption interface. The container name serves as a symbolic name for the identifier of an encryption interface.
          enumeration CsmEncryptAlgorithmFamily: {CRYPTO_ALGOFAM_3DES, CRYPTO_ALGOFAM_AES, CRYPTO_ALGOFAM_CHACHA, CRYPTO_ALGOFAM_CUSTOM, CRYPTO_ALGOFAM_ECIES, CRYPTO_ALGOFAM_RSA}, multiplicity set at pre-compile, set at pre-compile  # Determines the algorithm family used for the crypto service. This parameter defines the most significant part of the algorithm.
          string CsmEncryptAlgorithmFamilyCustom [0..1]: multiplicity set at pre-compile, set at pre-compile  # This is the name of the custom algorithm family, if CRYPTO_ALGOFAM_CUSTOM is used as CsmEncryptAlgorithmFamily.
          integer CsmEncryptAlgorithmKeyLength: 1..4294967295, multiplicity set at pre-compile, set at pre-compile  # Size of the encryption key in bytes
          enumeration CsmEncryptAlgorithmMode: {CRYPTO_ALGOMODE_12ROUNDS, CRYPTO_ALGOMODE_20ROUNDS, CRYPTO_ALGOMODE_8ROUNDS, CRYPTO_ALGOMODE_CBC, CRYPTO_ALGOMODE_CFB, CRYPTO_ALGOMODE_CTR, CRYPTO_ALGOMODE_CUSTOM, CRYPTO_ALGOMODE_ECB, CRYPTO_ALGOMODE_NOT_SET, CRYPTO_ALGOMODE_OFB, CRYPTO_ALGOMODE_RSAES_OAEP, CRYPTO_ALGOMODE_RSAES_PKCS1_v1_5, CRYPTO_ALGOMODE_XTS}, multiplicity set at pre-compile, set at pre-compile  # Determines the algorithm mode used for the crypto service
          string CsmEncryptAlgorithmModeCustom [0..1]: multiplicity set at pre-compile, set at pre-compile  # Name of the custom algorithm mode used for the crypto service
          enumeration CsmEncryptAlgorithmSecondaryFamily: {CRYPTO_ALGOFAM_CUSTOM, CRYPTO_ALGOFAM_NOT_SET}, multiplicity set at pre-compile, set at pre-compile, default-value=CRYPTO_ALGOFAM_NOT_SET  # Determines the algorithm family used for the crypto service
          string CsmEncryptAlgorithmSecondaryFamilyCustom [0..1]: multiplicity set at pre-compile, set at pre-compile  # Name of the custom secondary algorithm family used for the crypto service
          integer CsmEncryptDataMaxLength [0..1]: 1..4294967295, multiplicity set at pre-compile, set at pre-compile  # Max size of the input plaintext length in bytes
          integer CsmEncryptResultMaxLength [0..1]: 1..4294967295, multiplicity set at pre-compile, set at pre-compile  # Max size of the output cipher length in bytes
      container CsmHash [0..1]  # Container for Hash Configurations
        container CsmHashConfig  # Container for configuration of a CSM hash. The container name serves as a symbolic name for the identifier of a key configuration.
          enumeration CsmHashAlgorithmFamily: {CRYPTO_ALGOFAM_BLAKE_1_256, CRYPTO_ALGOFAM_BLAKE_1_512, CRYPTO_ALGOFAM_BLAKE_2s_256, CRYPTO_ALGOFAM_BLAKE_2s_512, CRYPTO_ALGOFAM_CUSTOM, CRYPTO_ALGOFAM_RIPEMD160, CRYPTO_ALGOFAM_SHA1, CRYPTO_ALGOFAM_SHA2_224, CRYPTO_ALGOFAM_SHA2_256, CRYPTO_ALGOFAM_SHA2_384, CRYPTO_ALGOFAM_SHA2_512, CRYPTO_ALGOFAM_SHA2_512_224, CRYPTO_ALGOFAM_SHA2_512_256, CRYPTO_ALGOFAM_SHA3_224, CRYPTO_ALGOFAM_SHA3_256, CRYPTO_ALGOFAM_SHA3_384, CRYPTO_ALGOFAM_SHA3_512, CRYPTO_ALGOFAM_SHAKE128, CRYPTO_ALGOFAM_SHAKE256}, multiplicity set at pre-compile, set at pre-compile  # Determines the algorithm family used for the crypto service. This parameter defines the most significant part of the algorithm.
          string CsmHashAlgorithmFamilyCustom [0..1]: multiplicity set at pre-compile, set at pre-compile  # This is the name of the custom algorithm family, if CRYPTO_ALGOFAM_CUSTOM is used as CsmHashAlgorithmFamily.
          enumeration CsmHashAlgorithmMode: {CRYPTO_ALGOMODE_CUSTOM, CRYPTO_ALGOMODE_NOT_SET}, multiplicity set at pre-compile, set at pre-compile, default-value=CRYPTO_ALGOMODE_NOT_SET  # Determines the algorithm mode used for the crypto service
          string CsmHashAlgorithmModeCustom [0..1]: multiplicity set at pre-compile, set at pre-compile  # Name of the custom primitive mode.
          enumeration CsmHashAlgorithmSecondaryFamily: {CRYPTO_ALGOFAM_CUSTOM, CRYPTO_ALGOFAM_NOT_SET}, multiplicity set at pre-compile, set at pre-compile, default-value=CRYPTO_ALGOFAM_NOT_SET  # Determines the algorithm family used for the crypto service
          string CsmHashAlgorithmSecondaryFamilyCustom [0..1]: multiplicity set at pre-compile, set at pre-compile  # This is the second name of the custom algorithm family, if CRYPTO_ALGOFAM_CUSTOM is set as CsmHashAlgorithmSecondaryFamily.
          integer CsmHashDataMaxLength [0..1]: 1..4294967295, multiplicity set at pre-compile, set at pre-compile  # Max size of the input data length in bytes
          integer CsmHashResultLength: 1..4294967295, multiplicity set at pre-compile, set at pre-compile  # Size of the output hash length in bytes
      container CsmJobKeyDerive [0..1]  # Configurations of KeyDerive primitives
        container CsmJobKeyDeriveConfig  # Container for configuration of a CSM key derive operation. The container name serves as a symbolic name for the identifier of a key derive configuration.
          enumeration CsmJobKeyDeriveAlgorithmFamily: {CRYPTO_ALGOFAM_CUSTOM, CRYPTO_ALGOFAM_HKDF, CRYPTO_ALGOFAM_KDFX963, CRYPTO_ALGOFAM_PBKDF2}, set at pre-compile  # Determines the algorithm family used for the crypto service. This parameter defines the most significant part of the algorithm.
          enumeration CsmJobKeyDeriveAlgorithmMode: {CRYPTO_ALGOMODE_CMAC, CRYPTO_ALGOMODE_CTRDRBG, CRYPTO_ALGOMODE_CUSTOM, CRYPTO_ALGOMODE_GMAC, CRYPTO_ALGOMODE_HMAC, CRYPTO_ALGOMODE_NOT_SET, CRYPTO_ALGOMODE_SIPHASH_2_4, CRYPTO_ALGOMODE_SIPHASH_4_8}, set at pre-compile  # Determines the algorithm mode used for the crypto service
          string CsmJobKeyDeriveAlgorithmModeCustom [0..1]: multiplicity set at pre-compile, set at pre-compile  # Name of the custom algorithm mode used for the crypto service.
          enumeration CsmJobKeyDeriveAlgorithmSecondaryFamily: {CRYPTO_ALGOFAM_CUSTOM, CRYPTO_ALGOFAM_NOT_SET}, set at pre-compile, default-value=CRYPTO_ALGOFAM_NOT_SET  # Determines the algorithm family used for the crypto service.
          string CsmJobKeyDeriveAlgorithmFamilyCustom [0..1]: multiplicity set at pre-compile, set at pre-compile  # Name of the custom algorithm mode used for the crypto service.
          string CsmJobKeyDeriveAlgorithmSecondaryFamilyCustom [0..1]: multiplicity set at pre-compile, set at pre-compile  # Name of the custom algorithm mode used for the crypto service.
      container CsmJobKeyExchangeCalcPubVal [0..1]  # Configurations of KeyExchangeCalcPubVal primitives
        container CsmJobKeyExchangeCalcPubValConfig  # Container for configuration of a CSM JobKeyExchangeCalcPubVal. The container name serves as a symbolic name for the identifier of a key configuration.
          enumeration CsmJobKeyExchangeCalcPubValAlgorithmFamily: {CRYPTO_ALGOFAM_CUSTOM, CRYPTO_ALGOFAM_DH, CRYPTO_ALGOFAM_RSA}, set at pre-compile  # Determines the algorithm family used for the crypto service. This parameter defines the most significant part of the algorithm.
          string CsmJobKeyExchangeCalcPubValAlgorithmFamilyCustom [0..1]: multiplicity set at pre-compile, set at pre-compile  # Name of the custom algorithm family used for the crypto service. | This is the name of the custom algorithm family, if CRYPTO_ALGOFAM_CUSTOM is used.
          enumeration CsmJobKeyExchangeCalcPubValAlgorithmMode: {CRYPTO_ALGOMODE_CUSTOM, CRYPTO_ALGOMODE_NOT_SET}, set at pre-compile  # Determines the algorithm mode used for the crypto service
          string CsmJobKeyExchangeCalcPubValAlgorithmModeCustom [0..1]: multiplicity set at pre-compile, set at pre-compile  # Name of the custom primitive mode.
          enumeration CsmJobKeyExchangeCalcPubValAlgorithmSecondaryFamily: {CRYPTO_ALGOFAM_CUSTOM, CRYPTO_ALGOFAM_NOT_SET}, set at pre-compile  # Determines the algorithm family used for the crypto service.
          string CsmJobKeyExchangeCalcPubValAlgorithmSecondaryFamilyCustom [0..1]: multiplicity set at pre-compile, set at pre-compile  # This is the second name of the custom algorithm family, if CRYPTO_ALGOFAM_CUSTOM is used .
      container CsmJobKeyExchangeCalcSecret [0..1]  # Configurations of KeyExchangeCalcSecret primitives
        container CsmJobKeyExchangeCalcSecretConfig  # Container for configuration of a CSM JobKeyExchangeCalcSecret. The container name serves as a symbolic name for the identifier of a JobKeyExchangeCalcSecret configuration.
          enumeration CsmJobKeyExchangeCalcSecretAlgorithmFamily: {CRYPTO_ALGOFAM_CUSTOM, CRYPTO_ALGOFAM_DH, CRYPTO_ALGOFAM_RSA}, set at pre-compile  # Determines the algorithm family used for the crypto service. This parameter defines the most significant part of the algorithm.
          string CsmJobKeyExchangeCalcSecretAlgorithmFamilyCustom [0..1]: multiplicity set at pre-compile, set at pre-compile  # Name of the custom algorithm family used for the crypto service. | This is the name of the custom algorithm family, if CRYPTO_ALGOFAM_CUSTOM is used.
          enumeration CsmJobKeyExchangeCalcSecretAlgorithmMode: {CRYPTO_ALGOMODE_CUSTOM, CRYPTO_ALGOMODE_NOT_SET}, set at pre-compile  # Determines the algorithm mode used for the crypto service
          string CsmJobKeyExchangeCalcSecretAlgorithmModeCustom [0..1]: multiplicity set at pre-compile, set at pre-compile  # Name of the custom primitive mode.
          enumeration CsmJobKeyExchangeCalcSecretAlgorithmSecondaryFamily: {CRYPTO_ALGOFAM_CUSTOM, CRYPTO_ALGOFAM_NOT_SET}, set at pre-compile  # Determines the algorithm family used for the crypto service.
          string CsmJobKeyExchangeCalcSecretAlgorithmSecondaryFamilyCustom [0..1]: multiplicity set at pre-compile, set at pre-compile  # This is the second name of the custom algorithm family, if CRYPTO_ALGOFAM_CUSTOM is used.
      container CsmJobKeyGenerate [0..1]  # Configurations of KeyGenerate primitives
        container CsmJobKeyGenerateConfig  # Container for configuration of a CSM key generate operation. The container name serves as a symbolic name for the identifier of a key generate configuration.
          enumeration CsmJobKeyGenerateAlgorithmFamily: {CRYPTO_ALGOFAM_X448, CRYPTO_ALGOFAM_ED448, CRYPTO_ALGOFAM_CUSTOM, CRYPTO_ALGOFAM_ECCANSI, CRYPTO_ALGOFAM_ECCNIST, CRYPTO_ALGOFAM_ECCSEC, CRYPTO_ALGOFAM_ECDH, CRYPTO_ALGOFAM_ED25519, CRYPTO_ALGOFAM_X25519}, set at pre-compile  # Determines the algorithm family used for the crypto service. This parameter defines the most significant part of the algorithm. Below are vendor specific defines: CRYPTO_ALGOFAM_ED448(0xEE) : Curve448 public key that is used for signature verifying. CRYPTO_ALGOFAM_X448(0xEF) : Curve448 public key that is used for Key Exchange.
          enumeration CsmJobKeyGenerateAlgorithmMode: {CRYPTO_ALGOMODE_CUSTOM, CRYPTO_ALGOMODE_NOT_SET}, set at pre-compile, default-value=CRYPTO_ALGOMODE_NOT_SET  # Determines the algorithm mode used for the crypto service
          string CsmJobKeyGenerateAlgorithmModeCustom [0..1]: multiplicity set at pre-compile, set at pre-compile  # Name of the custom algorithm mode used for the crypto service.
          enumeration CsmJobKeyGenerateAlgorithmSecondaryFamily: {CRYPTO_ALGOFAM_CUSTOM, CRYPTO_ALGOFAM_NOT_SET}, set at pre-compile, default-value=CRYPTO_ALGOFAM_NOT_SET  # Determines the algorithm family used for the crypto service.
          string CsmJobKeyGenerateAlgorithmFamilyCustom [0..1]: multiplicity set at pre-compile, set at pre-compile  # Name of the custom algorithm family used for the crypto service.
          string CsmJobKeyGenerateAlgorithmSecondaryFamilyCustom [0..1]: multiplicity set at pre-compile, set at pre-compile  # Name of the custom secondary algorithm family used for the crypto service.
      container CsmJobKeySetValid [0..1]  # Configurations of KeySetValid primitives
        container CsmJobKeySetValidConfig  # Container for configuration of a CSM key set valid operation. The container name serves as a symbolic name for the identifier of a key configuration.
          string CsmJobKeySetValidAlgorithmModeCustom [0..1]: multiplicity set at pre-compile, set at pre-compile  # Name of the custom algorithm mode used for the crypto service.
          string CsmJobKeySetValidAlgorithmSecondaryFamilyCustom [0..1]: multiplicity set at pre-compile, set at pre-compile  # Name of the custom secondary algorithm family used for the crypto service.
          string CsmJobKeySetValidAlgorithmFamilyCustom [0..1]: multiplicity set at pre-compile, set at pre-compile  # Name of the custom algorithm family used for the crypto service.
          enumeration CsmJobKeySetValidAlgorithmMode: {CRYPTO_ALGOMODE_CUSTOM, CRYPTO_ALGOMODE_NOT_SET}, set at pre-compile, default-value=CRYPTO_ALGOMODE_NOT_SET  # Determines the algorithm mode used for the crypto service
          enumeration CsmJobKeySetValidAlgorithmFamily: {CRYPTO_ALGOFAM_NOT_SET, CRYPTO_ALGOFAM_CUSTOM}, set at pre-compile, default-value=CRYPTO_ALGOFAM_NOT_SET  # Determines the algorithm family used for the crypto service.
          enumeration CsmJobKeySetValidAlgorithmSecondaryFamily: {CRYPTO_ALGOFAM_CUSTOM, CRYPTO_ALGOFAM_NOT_SET}, set at pre-compile, default-value=CRYPTO_ALGOFAM_NOT_SET  # Determines the algorithm family used for the crypto service.
      container CsmJobRandomSeed [0..1]  # Configurations of RandomSeed primitives
        container CsmJobRandomSeedConfig  # Container for configuration of a CSM random seed operation. The container name serves as a symbolic name for the identifier of a random seed configuration.
          string CsmJobRandomSeedAlgorithmFamilyCustom [0..1]: multiplicity set at pre-compile, set at pre-compile  # Name of the custom algorithm family used for the crypto service. This is the name of the custom algorithm family, if CRYPTO_ALGOFAM_CUSTOM is used.
          enumeration CsmJobRandomSeedAlgorithmMode: {CRYPTO_ALGOMODE_CMAC, CRYPTO_ALGOMODE_CTRDRBG, CRYPTO_ALGOMODE_CUSTOM, CRYPTO_ALGOMODE_GMAC, CRYPTO_ALGOMODE_HMAC, CRYPTO_ALGOMODE_NOT_SET, CRYPTO_ALGOMODE_SIPHASH_2_4, CRYPTO_ALGOMODE_SIPHASH_4_8}, set at pre-compile  # Determines the algorithm mode used for the crypto service
          string CsmJobRandomSeedAlgorithmModeCustom [0..1]: multiplicity set at pre-compile, set at pre-compile  # Name of the custom algorithm mode used for the crypto service. This is the name of the custom algorithm family, if CRYPTO_ALGOFAM_CUSTOM is used.
          enumeration CsmJobRandomSeedAlgorithmSecondaryFamily: {CRYPTO_ALGOFAM_CUSTOM, CRYPTO_ALGOFAM_NOT_SET}, set at pre-compile  # Determines the algorithm family used for the crypto service.
          string CsmJobRandomSeedAlgorithmSecondaryFamilyCustom [0..1]: multiplicity set at pre-compile, set at pre-compile  # Name of the custom secondary algorithm family used for the crypto service. This is the second name of the custom algorithm family, if CRYPTO_ALGOFAM_CUSTOM is used.
          enumeration CsmRandomSeedAlgorithmFamily: {CRYPTO_ALGOFAM_3DES, CRYPTO_ALGOFAM_AES, CRYPTO_ALGOFAM_BLAKE_1_256, CRYPTO_ALGOFAM_BLAKE_1_512, CRYPTO_ALGOFAM_BLAKE_2s_256, CRYPTO_ALGOFAM_BLAKE_2s_512, CRYPTO_ALGOFAM_CHACHA, CRYPTO_ALGOFAM_CUSTOM, CRYPTO_ALGOFAM_RIPEMD160, CRYPTO_ALGOFAM_RNG, CRYPTO_ALGOFAM_SHA1, CRYPTO_ALGOFAM_SHA2_224, CRYPTO_ALGOFAM_SHA2_256, CRYPTO_ALGOFAM_SHA2_384, CRYPTO_ALGOFAM_SHA2_512, CRYPTO_ALGOFAM_SHA2_512_224, CRYPTO_ALGOFAM_SHA2_512_256, CRYPTO_ALGOFAM_SHA3_224, CRYPTO_ALGOFAM_SHA3_256, CRYPTO_ALGOFAM_SHA3_384, CRYPTO_ALGOFAM_SHA3_512, CRYPTO_ALGOFAM_SHAKE128, CRYPTO_ALGOFAM_SHAKE256}, set at pre-compile  # Determines the algorithm family used for the crypto service. This parameter defines the most significant part of the algorithm.
      container CsmMacGenerate [0..1]  # Configurations of MacGenerate primitives
        container CsmMacGenerateConfig  # Container for configuration of a CSM mac generation interface. The container name serves as a symbolic name for the identifier of a MAC generation interface.
          enumeration CsmMacGenerateAlgorithmFamily: {CRYPTO_ALGOFAM_3DES, CRYPTO_ALGOFAM_AES, CRYPTO_ALGOFAM_BLAKE_1_256, CRYPTO_ALGOFAM_BLAKE_1_512, CRYPTO_ALGOFAM_BLAKE_2s_256, CRYPTO_ALGOFAM_BLAKE_2s_512, CRYPTO_ALGOFAM_CHACHA, CRYPTO_ALGOFAM_CUSTOM, CRYPTO_ALGOFAM_RIPEMD160, CRYPTO_ALGOFAM_RNG, CRYPTO_ALGOFAM_SHA1, CRYPTO_ALGOFAM_SHA2_224, CRYPTO_ALGOFAM_SHA2_256, CRYPTO_ALGOFAM_SHA2_384, CRYPTO_ALGOFAM_SHA2_512, CRYPTO_ALGOFAM_SHA2_512_224, CRYPTO_ALGOFAM_SHA2_512_256, CRYPTO_ALGOFAM_SHA3_224, CRYPTO_ALGOFAM_SHA3_256, CRYPTO_ALGOFAM_SHA3_384, CRYPTO_ALGOFAM_SHA3_512, CRYPTO_ALGOFAM_SHAKE128, CRYPTO_ALGOFAM_SHAKE256, CRYPTO_ALGOFAM_SIPHASH}, multiplicity set at pre-compile, set at pre-compile  # Determines the algorithm family used for the crypto service. This parameter defines the most significant part of the algorithm.
          string CsmMacGenerateAlgorithmFamilyCustom [0..1]: multiplicity set at pre-compile, set at pre-compile  # This is the name of the custom algorithm family, | if CRYPTO_ALGOFAM_CUSTOM is used as CsmMacGenerateAlgorithmFamily
          integer CsmMacGenerateAlgorithmKeyLength: 1..4294967295, multiplicity set at pre-compile, set at pre-compile  # Size of the MAC key in bytes
          enumeration CsmMacGenerateAlgorithmMode: {CRYPTO_ALGOMODE_CMAC, CRYPTO_ALGOMODE_CTRDRBG, CRYPTO_ALGOMODE_CUSTOM, CRYPTO_ALGOMODE_GMAC, CRYPTO_ALGOMODE_HMAC, CRYPTO_ALGOMODE_NOT_SET, CRYPTO_ALGOMODE_SIPHASH_2_4, CRYPTO_ALGOMODE_SIPHASH_4_8}, multiplicity set at pre-compile, set at pre-compile  # Determines the algorithm mode used for the crypto service
          string CsmMacGenerateAlgorithmModeCustom [0..1]: multiplicity set at pre-compile, set at pre-compile  # Name of the custom algorithm mode used for the crypto service
          enumeration CsmMacGenerateAlgorithmSecondaryFamily: {CRYPTO_ALGOFAM_NOT_SET, CRYPTO_ALGOMODE_CUSTOM}, multiplicity set at pre-compile, set at pre-compile, default-value=CRYPTO_ALGOFAM_NOT_SET  # Determines the secondary algorithm family used for the crypto service
          string CsmMacGenerateAlgorithmSecondaryFamilyCustom [0..1]: multiplicity set at pre-compile, set at pre-compile  # This is the second name of the custom algorithm family, if CRYPTO_ALGOFAM_CUSTOM is set as CsmHashAlgorithmSecondaryFamilyCustom.
          integer CsmMacGenerateDataMaxLength [0..1]: 1..4294967295, multiplicity set at pre-compile, set at pre-compile  # Max size of the input data length in bytes
          integer CsmMacGenerateResultLength: 1..4294967295, multiplicity set at pre-compile, set at pre-compile  # Size of the output MAC length in bytes
      container CsmMacVerify [0..1]  # Configurations of MacVerify primitives
        container CsmMacVerifyConfig  # Container for configuration of a CSM MAC verification interface. The container name serves as a symbolic name for the identifier of a MAC generation interface
          enumeration CsmMacVerifyAlgorithmFamily: {CRYPTO_ALGOFAM_3DES, CRYPTO_ALGOFAM_AES, CRYPTO_ALGOFAM_BLAKE_1_256, CRYPTO_ALGOFAM_BLAKE_1_512, CRYPTO_ALGOFAM_BLAKE_2s_256, CRYPTO_ALGOFAM_BLAKE_2s_512, CRYPTO_ALGOFAM_CHACHA, CRYPTO_ALGOFAM_RIPEMD160, CRYPTO_ALGOFAM_RNG, CRYPTO_ALGOFAM_SHA1, CRYPTO_ALGOFAM_SHA2_224, CRYPTO_ALGOFAM_SHA2_256, CRYPTO_ALGOFAM_SHA2_384, CRYPTO_ALGOFAM_SHA2_512, CRYPTO_ALGOFAM_SHA2_512_224, CRYPTO_ALGOFAM_SHA2_512_256, CRYPTO_ALGOFAM_SHA3_224, CRYPTO_ALGOFAM_SHA3_256, CRYPTO_ALGOFAM_SHA3_384, CRYPTO_ALGOFAM_SHA3_512, CRYPTO_ALGOFAM_SHAKE128, CRYPTO_ALGOFAM_SHAKE256, CRYPTO_ALGOFAM_SIPHASH, CRYPTO_ALGOMODE_CUSTOM}, multiplicity set at pre-compile, set at pre-compile  # Determines the algorithm family used for the crypto service. This parameter defines the most significant part of the algorithm.
          string CsmMacVerifyAlgorithmFamilyCustom [0..1]: multiplicity set at pre-compile, set at pre-compile  # Name of the custom algorithm family used for the crypto service
          integer CsmMacVerifyAlgorithmKeyLength: 1..4294967295, multiplicity set at pre-compile, set at pre-compile  # Size of the MAC key in bytes
          enumeration CsmMacVerifyAlgorithmMode: {CRYPTO_ALGOMODE_CMAC, CRYPTO_ALGOMODE_CTRDRBG, CRYPTO_ALGOMODE_CUSTOM, CRYPTO_ALGOMODE_GMAC, CRYPTO_ALGOMODE_HMAC, CRYPTO_ALGOMODE_NOT_SET, CRYPTO_ALGOMODE_SIPHASH_2_4, CRYPTO_ALGOMODE_SIPHASH_4_8}, multiplicity set at pre-compile, set at pre-compile  # Determines the algorithm mode used for the crypto service
          string CsmMacVerifyAlgorithmModeCustom [0..1]: multiplicity set at pre-compile, set at pre-compile  # Name of the custom algorithm mode used for the crypto service
          enumeration CsmMacVerifyAlgorithmSecondaryFamily: {CRYPTO_ALGOFAM_CUSTOM, CRYPTO_ALGOFAM_NOT_SET}, multiplicity set at pre-compile, set at pre-compile, default-value=CRYPTO_ALGOFAM_NOT_SET  # Determines the secondary algorithm family used for the crypto service
          string CsmMacVerifyAlgorithmSecondaryFamilyCustom [0..1]: multiplicity set at pre-compile, set at pre-compile  # This is the second the name of the custom algorithm, if CRYPTO_ALGOFAM_CUSTOM is set as CsmMacVerifyAlgorithmSecondaryFamily
          integer CsmMacVerifyCompareLength: 1..4294967295, multiplicity set at pre-compile, set at pre-compile  # Size of the input MAC length, that shall be verified, in BITS
          integer CsmMacVerifyDataMaxLength [0..1]: 1..4294967295, multiplicity set at pre-compile, set at pre-compile  # Max size of the input data length, for whichs MAC shall be verified, in bytes
      container CsmRandomGenerate [0..1]  # Configurations of RandomGenerate primitives
        container CsmRandomGenerateConfig  # Container for configuration of a CSM random generator. The container name serves as a symbolic name for the identifier of a random generator configuration.
          enumeration CsmRandomGenerateAlgorithmFamily: {CRYPTO_ALGOFAM_3DES, CRYPTO_ALGOFAM_AES, CRYPTO_ALGOFAM_BLAKE_1_256, CRYPTO_ALGOFAM_BLAKE_1_512, CRYPTO_ALGOFAM_BLAKE_2s_256, CRYPTO_ALGOFAM_BLAKE_2s_512, CRYPTO_ALGOFAM_CHACHA, CRYPTO_ALGOFAM_CUSTOM, CRYPTO_ALGOFAM_RIPEMD160, CRYPTO_ALGOFAM_RNG, CRYPTO_ALGOFAM_SHA1, CRYPTO_ALGOFAM_SHA2_224, CRYPTO_ALGOFAM_SHA2_256, CRYPTO_ALGOFAM_SHA2_384, CRYPTO_ALGOFAM_SHA2_512, CRYPTO_ALGOFAM_SHA2_512_224, CRYPTO_ALGOFAM_SHA2_512_256, CRYPTO_ALGOFAM_SHA3_224, CRYPTO_ALGOFAM_SHA3_256, CRYPTO_ALGOFAM_SHA3_384, CRYPTO_ALGOFAM_SHA3_512, CRYPTO_ALGOFAM_SHAKE128, CRYPTO_ALGOFAM_SHAKE256}, multiplicity set at pre-compile, set at pre-compile  # Determines the algorithm family used for the crypto service. This parameter defines the most significant part of the algorithm.
          string CsmRandomGenerateAlgorithmFamilyCustom [0..1]: multiplicity set at pre-compile, set at pre-compile  # Name of the custom algorithm family used for the crypto service. This is the name of the custom algorithm family, if CRYPTO_ALGOFAM_CUSTOM is used as CsmRandomAlgorithmFamily
          enumeration CsmRandomGenerateAlgorithmMode: {CRYPTO_ALGOMODE_CMAC, CRYPTO_ALGOMODE_CTRDRBG, CRYPTO_ALGOMODE_CUSTOM, CRYPTO_ALGOMODE_GMAC, CRYPTO_ALGOMODE_HMAC, CRYPTO_ALGOMODE_NOT_SET, CRYPTO_ALGOMODE_SIPHASH_2_4, CRYPTO_ALGOMODE_SIPHASH_4_8}, multiplicity set at pre-compile, set at pre-compile  # Determines the algorithm mode used for the crypto service
          string CsmRandomGenerateAlgorithmModeCustom [0..1]: multiplicity set at pre-compile, set at pre-compile  # Name of the custom algorithm mode used for the crypto service. This is the name of the custom algorithm family, if CRYPTO_ALGOFAM_CUSTOM is used as CsmRandomGenerateAlgorithmFamily.
          enumeration CsmRandomGenerateAlgorithmSecondaryFamily: {CRYPTO_ALGOFAM_CUSTOM, CRYPTO_ALGOFAM_NOT_SET}, multiplicity set at pre-compile, set at pre-compile  # Determines the algorithm family used for the crypto service
          string CsmRandomGenerateAlgorithmSecondaryFamilyCustom [0..1]: multiplicity set at pre-compile, set at pre-compile  # Name of the custom secondary algorithm family used for the crypto service. This is the second name of the custom algorithm family, if CRYPTO_ALGOFAM_CUSTOM is set as Csm RandomAlgorithmSecondaryFamily.
          integer CsmRandomGenerateResultLength: 1..4294967295, multiplicity set at pre-compile, set at pre-compile  # Size of the random generate key in bytes
      container CsmSignatureGenerate [0..1]  # Configurations of SignatureGenerate primitives
        container CsmSignatureGenerateConfig  # Container for configuration of a CSM signature generation interface. The container name serves as a symbolic name for the identifier of signature generation interface.
          enumeration CsmSignatureGenerateAlgorithmFamily: {CRYPTO_ALGOFAM_BRAINPOOL, CRYPTO_ALGOFAM_CUSTOM, CRYPTO_ALGOFAM_ECCNIST, CRYPTO_ALGOFAM_ED25519, CRYPTO_ALGOFAM_RSA, CRYPTO_ALGOFAM_ED448}, multiplicity set at pre-compile, set at pre-compile  # Determines the algorithm family used for the crypto service. This parameter defines the most significant part of the algorithm. Below is vendor specific define: CRYPTO_ALGOFAM_ED448(0xEE) : DSA with Curve448
          string CsmSignatureGenerateAlgorithmFamilyCustom [0..1]: multiplicity set at pre-compile, set at pre-compile  # Name of the custom algorithm family used for the crypto service. | This is the name of the custom algorithm family, if CRYPTO_ALGOFAM_CUSTOM is used as CsmSignatureGenerateAlgorithmFamily.
          enumeration CsmSignatureGenerateAlgorithmMode: {CRYPTO_ALGOMODE_CUSTOM, CRYPTO_ALGOMODE_NOT_SET, CRYPTO_ALGOMODE_RSASSA_PKCS1_v1_5, CRYPTO_ALGOMODE_RSASSA_PSS}, multiplicity set at pre-compile, set at pre-compile  # Determines the algorithm mode used for the crypto service
          string CsmSignatureGenerateAlgorithmModeCustom [0..1]: multiplicity set at pre-compile, set at pre-compile  # Name of the custom algorithm mode used for the crypto service
          enumeration CsmSignatureGenerateAlgorithmSecondaryFamily: {CRYPTO_ALGOFAM_BLAKE_1_256, CRYPTO_ALGOFAM_BLAKE_1_512, CRYPTO_ALGOFAM_BLAKE_2s_256, CRYPTO_ALGOFAM_BLAKE_2s_512, CRYPTO_ALGOFAM_CUSTOM, CRYPTO_ALGOFAM_NOT_SET, CRYPTO_ALGOFAM_RIPEMD160, CRYPTO_ALGOFAM_SHA1, CRYPTO_ALGOFAM_SHA2_224, CRYPTO_ALGOFAM_SHA2_256, CRYPTO_ALGOFAM_SHA2_384, CRYPTO_ALGOFAM_SHA2_512, CRYPTO_ALGOFAM_SHA2_512_224, CRYPTO_ALGOFAM_SHA2_512_256, CRYPTO_ALGOFAM_SHA3_224, CRYPTO_ALGOFAM_SHA3_256, CRYPTO_ALGOFAM_SHA3_384, CRYPTO_ALGOFAM_SHA3_512, CRYPTO_ALGOFAM_SHAKE128, CRYPTO_ALGOFAM_SHAKE256}, multiplicity set at pre-compile, set at pre-compile, default-value=CRYPTO_ALGOFAM_NOT_SET  # Determines the algorithm mode used for the crypto service
          string CsmSignatureGenerateAlgorithmSecondaryFamilyCustom [0..1]: multiplicity set at pre-compile, set at pre-compile  # Name of the custom secondary algorithm family used for the crypto service. This is the second name of the custom algorithm family, if CRYPTO_ALGOFAM_CUSTOM is set as CsmSignatureGenerateAlgorithmSecondaryFamily.
          integer CsmSignatureGenerateDataMaxLength [0..1]: 1..4294967295, multiplicity set at pre-compile, set at pre-compile  # Size of the input data length in bytes
          integer CsmSignatureGenerateKeyLength: 1..4294967295, multiplicity set at pre-compile, set at pre-compile  # Size of the signature generate key in bytes
          integer CsmSignatureGenerateResultLength: 1..4294967295, multiplicity set at pre-compile, set at pre-compile  # Size of the output signature length in bytes
      container CsmSignatureVerify [0..1]  # Configurations of SignatureVerify primitives
        container CsmSignatureVerifyConfig  # Container for configuration of a CSM signature verification interface. The container name serves as a symbolic name for the identifier of signature verification interface.
          enumeration CsmSignatureVerifyAlgorithmFamily: {CRYPTO_ALGOFAM_BRAINPOOL, CRYPTO_ALGOFAM_CUSTOM, CRYPTO_ALGOFAM_ECCNIST, CRYPTO_ALGOFAM_ED25519, CRYPTO_ALGOFAM_RSA, CRYPTO_ALGOFAM_ED448}, multiplicity set at pre-compile, set at pre-compile  # Determines the algorithm family used for the crypto service. This parameter defines the most significant part of the algorithm. Below is vendor specific define: CRYPTO_ALGOFAM_ED448(0xEE) : Verify signature with Curve448
          string CsmSignatureVerifyAlgorithmFamilyCustom [0..1]: multiplicity set at pre-compile, set at pre-compile  # Name of the custom algorithm family used for the crypto service. This is the name of the custom algorithm family, if CRYPTO_ALGOFAM_CUSTOM is used as CsmSignatureVerifyAlgorithmFamily.
          enumeration CsmSignatureVerifyAlgorithmMode: {CRYPTO_ALGOMODE_CUSTOM, CRYPTO_ALGOMODE_NOT_SET, CRYPTO_ALGOMODE_RSASSA_PKCS1_v1_5, CRYPTO_ALGOMODE_RSASSA_PSS}, multiplicity set at pre-compile, set at pre-compile  # Determines the algorithm mode used for the crypto service
          string CsmSignatureVerifyAlgorithmModeCustom [0..1]: multiplicity set at pre-compile, set at pre-compile  # Name of the custom algorithm mode used for the crypto service
          enumeration CsmSignatureVerifyAlgorithmSecondaryFamily: {CRYPTO_ALGOFAM_BLAKE_1_256, CRYPTO_ALGOFAM_BLAKE_1_512, CRYPTO_ALGOFAM_BLAKE_2s_256, CRYPTO_ALGOFAM_BLAKE_2s_512, CRYPTO_ALGOFAM_CUSTOM, CRYPTO_ALGOFAM_NOT_SET, CRYPTO_ALGOFAM_RIPEMD160, CRYPTO_ALGOFAM_SHA1, CRYPTO_ALGOFAM_SHA2_224, CRYPTO_ALGOFAM_SHA2_256, CRYPTO_ALGOFAM_SHA2_384, CRYPTO_ALGOFAM_SHA2_512, CRYPTO_ALGOFAM_SHA2_512_224, CRYPTO_ALGOFAM_SHA2_512_256, CRYPTO_ALGOFAM_SHA3_224, CRYPTO_ALGOFAM_SHA3_256, CRYPTO_ALGOFAM_SHA3_384, CRYPTO_ALGOFAM_SHA3_512, CRYPTO_ALGOFAM_SHAKE128, CRYPTO_ALGOFAM_SHAKE256}, multiplicity set at pre-compile, set at pre-compile  # Determines the algorithm family used for the crypto service. This parameter defines the most significant part of the algorithm.
          string CsmSignatureVerifyAlgorithmSecondaryFamilyCustom [0..1]: multiplicity set at pre-compile, set at pre-compile  # Name of the custom secondary algorithm family used for the crypto service. This is the name of the custom algorithm family, if CRYPTO_ALGOFAM_CUSTOM is used as CsmSignatureVerifyAlgorithmFamily.
          integer CsmSignatureVerifyCompareLength: 1..4294967295, multiplicity set at pre-compile, set at pre-compile  # Number of the least significant bytes of the signature, for which the verification shall be calculated.
          integer CsmSignatureVerifyDataMaxLength [0..1]: 1..4294967295, multiplicity set at pre-compile, set at pre-compile  # Max size of the input data, for which the signature shall be verified, in bytes.
          integer CsmSignatureVerifyKeyLength: 1..4294967295, multiplicity set at pre-compile, set at pre-compile  # Size of the signature verify key in bytes
    container CsmQueues [0..1]  # Container for CSM queue configurations
      container CsmQueue [1..*]  # Container for configuration of a CSM queue. | A queue has two tasks: 1. queue jobs which cannot be processed since the underlying hardware is busy and 2. refer to channel which shall be used
        integer CsmQueueSize: 1..4294967295, multiplicity set at pre-compile, set at pre-compile  # Size of the CsmQueue. If jobs cannot be processed by the underlying hardware since the hardware is busy, the jobs stay in the prioritized queue. If the queue is full, the next job will be rejected.
        reference CsmChannelRef: multiplicity set at pre-compile, set at pre-compile, requires-symbolic-name-value=true, destination=CryIfChannel  # Refers to the underlying Crypto Interface channel.
  ecuc definition collection ParameterDefinition_Csm: module=Csm
