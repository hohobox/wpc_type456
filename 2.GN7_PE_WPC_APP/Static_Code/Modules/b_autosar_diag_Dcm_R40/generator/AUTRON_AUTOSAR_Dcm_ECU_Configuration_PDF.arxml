AUTOSAR XML (schema 4-0-3)
# (C) 2013 HYUNDAI AUTRON Co., Ltd.
# Confidential Proprietary Information. Distribution Limited.
# Do Not Copy Without Prior Permission
package /AUTRON
  ecuc definition collection ParameterDefinition_Dcm: module=Dcm
  module definition Dcm [0..1]: variants pre-compile  # Configuration of the Dcm (Diagnostic Communications Manager) module.
    container DcmConfigSet: multiple-configuration-container=true  # This container contains the configuration parameters and sub containers of the DCM module supporting multiple configuration sets. | This container is a MultipleConfigurationContainer, i.e. this container and its sub-containers exist once per configuration set.
      container DcmDsd  # These parameters apply to Diagnostic Service Dispatcher. All parameters for all service dispatchers are included in this one configuration container. | There must always be one service dispatcher in a DCM.
        container DcmDsdServiceTable [1..256]  # This container contains the configuration (DSD parameters) for Service Identifier Table.
          integer DcmDsdSidTabId: 0..255, set at pre-compile  # Due the fact of using one or more service tables the member of the Service Identifier Table includes a unique id for the Service Identifier Table.
          container DcmDsdService [1..*]  # This container contains the configuration (DSD parameters) for Service.
            integer DcmDsdServiceRole [0..1]: 0..4294967295, scope=ECU, multiplicity set at link in variant link-time / post-build in variant post-build / pre-compile in variant pre-compile, post-build-variant-multiplicity=true, post-build-variant-value=true, set at link in variant link-time / post-build in variant post-build / pre-compile in variant pre-compile, default-value=0xFF  # Bitfield were each bit represents one dedicated role. A diagnostic service is granted access if the bit value is 1. If a bit value is 0, the service is not allowed to be executed for that role.
            function name DcmDsdSidTabFnc [0..1]: set at pre-compile  # Callback function of the ECU Supplier specific component for the particular DcmDsdSidTabServiceId. | This parameter is related to the interface <Module>_<DiagnosticService>. If it is not configured the service is handled Dcm-internally.
            integer DcmDsdSidTabServiceId: 0..255, set at pre-compile  # Id of the Service identifier. | The possible Service identifier are predefined in the ISO 14229-1 and ISO 15031-5 and in Table 4 and Table 5.
            boolean DcmDsdSidTabSubfuncAvail: set at pre-compile  # Information whether the DcmDsdSidTabServiceId includes Sub functions or not. Used for the Handling of "suppressPosRspMsgIndicationBit" ISO14229-1 can be referenced here, as this specification gives fix definition, if an SID includes Subfunction or not. | true = sub-function available false = sub-function not available
            reference DcmDsdSidTabModeRuleRef [0..0]: category=NOT_SUPPORTED, set at pre-compile, destination=DcmModeRule  # Reference to DcmDspModeRule | Mode rule which controls the execution of the DcmDsdService. If there is no reference, no check of the mode rule shall be done.
            reference DcmDsdSidTabSecurityLevelRef [0..*]: set at pre-compile, origin=AUTOSAR_ECUC V1.0.0, destination=DcmDspSecurityRow  # Link to the Security Access Levels needed for execution of the DcmDsdService. | Please refer to the ISO 14229-1, ISO 15031-5 and "Verification of the Security Access levels". Please note, that it shall be provided to configure several DcmDsdSidTabSecurityLevelRef per DcmDsdService. If there is no reference, no check of security level shall be done.
            reference DcmDsdSidTabSessionLevelRef [0..*]: set at pre-compile, origin=AUTOSAR_ECUC V1.0.0, destination=DcmDspSessionRow  # Link to the Session Control needed for execution of the DcmDsdService. Please refer to the ISO 14229-1, ISO 15031-5 and "Verification of the Diagnostic Session". Please note, that it shall be provided to configure several DcmDsdSidTabSessionLevelRef per DcmDsdService. If there is no reference, no check of session level shall be done.
            container DcmDsdSubService [0..*]  # This container contains the configuration (DSD parameters) for SubServices. This configuration is available only for services having Subfunction: this container exists only if parameter DcmDsdSidTabSubfuncAvail, of this service, is set to TRUE and the parameter DcmDsdSidTabFnc is not existing.
              function name DcmDsdSubServiceFnc [0..1]: set at pre-compile  # Callback function of the ECU Supplier specific component. This parameter is related to the interface <Module>_<DiagnosticService>_<SubService>. | If it is not configured the sub-service is handled Dcm-internally.
              integer DcmDsdSubServiceId: 0..255, set at pre-compile  # Id of the SubService identifier. The possible Subfunction parameter value are predefined in the ISO 14229-1 and ISO 15031-5.
              integer DcmDsdSubServiceRole [0..1]: 0..4294967295, scope=ECU, multiplicity set at link in variant link-time / post-build in variant post-build / pre-compile in variant pre-compile, post-build-variant-multiplicity=true, post-build-variant-value=true, set at link in variant link-time / post-build in variant post-build / pre-compile in variant pre-compile, default-value=0xFF  # Bitfield were each bit represents one dedicated role. A sub-function of a diagnostic service is granted access if the bit value is 1. If a bit value is 0, the service is not allowed to be executed for that role.
              reference DcmDsdSubServiceModeRuleRef [0..0]: category=NOT_SUPPORTED, set at pre-compile, destination=DcmModeRule  # Reference to DcmDspModeRule | Mode rule which controls execution of this the DcmDsdSubService. If there is no reference, no check of the mode rule shall be done.
              reference DcmDsdSubServiceSecurityLevelRef [0..*]: set at pre-compile, destination=DcmDspSecurityRow  # Link to the Security Level needed for execution of the DcmDsdSubService. | Please refer to the ISO 14229-1, ISO 15031-5 and "Verification of the Diagnostic Session". Please note, that it shall be provided to configure several DcmDsdSubServiceSecurityLevelRef per DcmDsdSubService. If there is no reference, no check of security level shall be done.
              reference DcmDsdSubServiceSessionLevelRef [0..*]: set at pre-compile, destination=DcmDspSessionRow  # Link to the Session Control needed for execution of the DcmDsdSubService. | Please refer to the ISO 14229-1, ISO 15031-5 and "Verification of the Diagnostic Session". Please note, that it shall be provided to configure several DcmDsdSubServiceSessionLevelRef per DcmDsdSubService. If there is no reference, no check of session level shall be done.
      container DcmDsl  # These parameters apply to a Diagnostic Session Layer. There may be a parameter set (DSL Configuration) per protocol. | upperMultiplicity: Each DCM configuration must have exactly one DSL configuration. lowerMultiplicity: Each DCM configuration must have exactly one DSL configuration.
        container DcmDslBuffer [1..256]  # This container contains the configuration (parameters) for the diagnostic buffer.
          integer DcmDslBufferSize: 8..4294967294, set at pre-compile  # Size of Diagnostic Buffer (in Bytes) | For a linear buffer: size of the buffer shall be as large as the longest message (request or response) For a paged buffer (only Tx possible): size has impacts on the application performance Please note: max. range is the valid range for a CAN network. We assume a FlexRay (or other networks) implementation will work with this range (and the page buffer mechanism) without any problems.
        container DcmDslCallbackDCMRequestService [1..*]  # The name of this container is used to define the name of the R-Port through which the DCM access the interface CallbackDCMRequestServices. | The R-Port is named CallbackDCMRequestServices_<SWC> where _<SWC> is the name of the container DcmDslCallbackDCMRequestService.
        container DcmDslDiagResp  # This container contains the configuration (parameters) for the ResponsePending handling
          integer DcmDslDiagRespMaxNumRespPend: 0..65535, set at pre-compile, origin=AUTOSAR_ECUC V1.0.0  # Maximum number of negative responses with response code 0x78 (requestCorrectlyReceived-ResponsePending) allowed per request. DCM will send a negative response with response code 0x10(generalReject), in case the limit value gets reached. | This container contains the configuration of the automatic requestCorrectlyReceivedResponsePending response management in the Dcm.
          boolean DcmDslDiagRespOnSecondDeclinedRequest: category=FIXED, set at pre-compile, origin=AUTOSAR_ECUC V1.0.0, default-value=false  # Defines the reaction upon a second request (ClientB) that can not be processed (e.g. due to priority assessment). | TRUE: when the second request (Client B) can not be processed, it shall be answered with NRC21 BusyRepeatRequest. FALSE: when the second request (Client B) can not be processed, it shall not be responded.
        container DcmDslProtocol  # This container contains the configuration (parameters) for the protocol configuration (for each protocol) The following parameters needs to be configured per protocol.
          container DcmDslProtocolRow [1..*]  # Definition of a single Row of configuration for the protocol configuration (for each protocol)
            boolean DcmDslProtocolEndiannessConvEnabled: category=NOT_SUPPORTED, set at pre-compile, origin=AUTOSAR_ECUC V1.0.0, default-value=false  # Enables /disables the endianness conversion, per diagnostic | protocol.
            enumeration DcmDslProtocolID: {DCM_OBD_ON_CAN, DCM_OBD_ON_FLEXRAY, DCM_OBD_ON_IP, DCM_PERIODICTRANS_ON_IP, DCM_PERIODIC_ON_CAN, DCM_PERIODIC_ON_FLEXRAY, DCM_ROE_ON_CAN, DCM_ROE_ON_FLEXRAY, DCM_ROE_ON_IP, DCM_SUPPLIER_1, DCM_SUPPLIER_10, DCM_SUPPLIER_11, DCM_SUPPLIER_12, DCM_SUPPLIER_13, DCM_SUPPLIER_14, DCM_SUPPLIER_15, DCM_SUPPLIER_2, DCM_SUPPLIER_3, DCM_SUPPLIER_4, DCM_SUPPLIER_5, DCM_SUPPLIER_6, DCM_SUPPLIER_7, DCM_SUPPLIER_8, DCM_SUPPLIER_9, DCM_UDS_ON_CAN, DCM_UDS_ON_FLEXRAY, DCM_UDS_ON_IP, DCM_OBD_ON_UDS, DCM_ZEV_ON_UDS}, set at pre-compile, symbolic-name-value=true  # The diagnostic protocol type for the DCM DSL protocol that is being configured. | Implementation Type: Dcm_ProtocolType
            boolean DcmDslProtocolIsParallelExecutab: category=NOT_SUPPORTED, set at pre-compile, origin=AUTOSAR_ECUC V1.0.0  # Enables the parallel processing of ROE or Periodic Transmission protocol. Only these both protocols are allowed to run in parallel to normal protocol (UDS, OBD).
            float DcmDslProtocolPreemptTimeout: 0..1000, set at pre-compile  # This is the value for the timeout (in milliseconds) of preempting protocol until protocol needs to be started. | This is defined in the AUTOSAR SWS for DCM as a uint16. The AUTOSAR configuration standard is to use SI units, so this parameter is defined as a float value in seconds. DCM configuration tools must convert this float value to the appropriate value format for the use in the software implementation of DCM. min: A negative value is not allowed. upperMultiplicity: Exactly one DcmDslProtocolPreemptTimeout value per DSL protocol timing structure. lowerMultiplicity: Exactly one DcmDslProtocolPreemptTimeout value per DSL timing structure. origin: Standard AUTOSAR configuration parameter.
            integer DcmDslProtocolPriority: 0..255, set at pre-compile  # The SWS for DCM defines this item as uint8. This is the protocol priority that is used during protocol preemption handling. | 0 = Highest priority (protocol may not be preempted by other protocols) 1, 2, 3... = Reducing priority. Protocol may be preempted by other protocols with lower priority value. upperMultiplicity: Exactly one priority must be provided per Tx Protocol. lowerMultiplicity: Exactly one priority must be provided per Tx Protocol. origin: Standard AUTOSAR configuration parameter.
            enumeration DcmDslProtocolTransType [0..1]: {TYPE1, TYPE2}, category=FIXED, set at pre-compile, origin=AUTOSAR_ECUC V1.0.0  # Selects the transmission type for protocol.
            boolean DcmSendRespPendOnTransToBoot: set at pre-compile, default-value=false  # Parameter specifying if the ECU should send a NRC 0x78 (response pending) before transitioning to the bootloader (parameter set to TRUE) or if the transition shall be initiated without sending NRC 0x78 (parameter set to FALSE).
            float DcmTimStrP2ServerAdjust: 0..1, set at pre-compile, default-value=0.02  # This parameter is used to guarantee that the diagnostic response is available on the bus before reaching P2 by adjusting the current DcmDspSessionP2ServerMax. This parameter mainly represents the software architecture dependent communication delay between the time the transmission is initiated by DCM and the time when the message is actually transmitted to the bus. The parameter value is defined in seconds and must be a multiple of DcmTaskTime. | The AUTOSAR configuration standard is to use SI units, so this parameter is defined as a float value in seconds. DCM configuration tools must convert this float value to the appropriate value format for the use in the software implementation of DCM.
            float DcmTimStrP2StarServerAdjust: 0..5, set at pre-compile, default-value=2.5  # This parameter is used to guarantee that the diagnostic response is available on the bus before reaching P2Star by adjusting the current DcmDspSessionP2StarServerMax. This parameter mainly represents the software architecture dependent communication delay between the time the transmission is initiated by DCM and the time when the message is actually transmitted to the bus. The parameter value is defined in seconds and must be a multiple of DcmTaskTime. | The AUTOSAR configuration standard is to use SI units, so this parameter is defined as a float value in seconds. DCM configuration tools must convert this float value to the appropriate value format for the use in the software implementation of DCM.
            reference DcmDslProtocolRxBufferRef: set at pre-compile, destination=DcmDslBuffer  # Link to buffer configuration (DcmDslBuffer) for configuration of protocol buffer used for Rx actions. | upperMultiplicity / lowerMultiplicity:: Exactly one Rx buffer is required for protocol reception
            reference DcmDslProtocolSIDTable: set at pre-compile, destination=DcmDsdServiceTable  # Link to the used diagnostic service table for this protocol. | upperMultiplicity: Must have exactly one service table for the protocol. lowerMultiplicity: Must have exactly one service table for the protocol.
            reference DcmDslProtocolSessionRef [0..1]: set at pre-compile, destination=DcmDspSession  # Reference to the DcmDspSession table used for this protocol ConfigurationClass.
            reference DcmDslProtocolTxBufferRef: set at pre-compile, destination=DcmDslBuffer  # Link to buffer configuration (DcmDslBuffer) for configuration of protocol buffer used for Tx actions. | upperMultiplicity / lowerMultiplicity:: Exactly one Tx buffer is required for protocol transmission.
            choice container DcmDslConnection [1..*]  # This container contains links between Diagnostic Protocol (=DcmDslProtocolRow) and the according Rx or Tx channel. | Because of the usecase to allow more then one diagnostic tester (using different CAN channels) it is necessary to allow configuration of multiple DcmDslConnections.
              container DcmDslMainConnection [0..1]  # This container contains configuration for Diagnostic Main Connection | (DcmDslProtocolTx, DcmDslProtocolRx). In addition it contains links to the ROE connection (DcmDslROEConnectionRef) and the Periodic Transmission Connection (DcmDslPeriodicTranmissionConRef) relevant for protocols with DcmDslProtocolTransType = TYPE2 or TYPE1.
                integer DcmDslProtocolRxConnectionId: 0..65535, scope=ECU, multiplicity set at pre-compile, set at link in variant link-time / pre-compile in variant post-build+pre-compile, symbolic-name-value=true  # Unique identifier of the tester which uses this connection for diagnostic communication.
                integer DcmDslProtocolRxTesterSourceAddr: 0..65535, set at pre-compile  # Tester source address uniquely describes a client and will be used e.g. within | the jump to Bootloader interfaces.
                integer DcmDslProtocolAuthenticationConnectionId [0..1]: 0..65535, set at pre-compile, symbolic-name-value=true  # Unique identifier of the main connection which uses this connection for Diagnostic Authentication Service.
                reference DcmDslPeriodicTranmissionConRef [0..1]: category=NOT_SUPPORTED, set at pre-compile, origin=AUTOSAR_ECUC V1.0.0, destination=DcmDslPeriodicTransmission  # Configures the link to the connection of PeriodicTransmission protocol for the processing of the PeriodicTransmission events.
                reference DcmDslROEConnectionRef [0..1]: category=NOT_SUPPORTED, set at pre-compile, origin=AUTOSAR_ECUC V1.0.0, destination=DcmDslResponseOnEvent  # Configures the link to the connection of ROE protocol for processing of the ROE events.
                container DcmDslProtocolRx [1..*]  # This container contains the configuration (parameters) for the protocol configuration of RX channel (for each protocol) | The following parameters needs to be configured per protocol. Please keep in mind, that the parameter DcmDslProtocolRxPduId can be given several times per protocol and that the combination from DcmDslProtocolRxPduId and DcmDslProtocolRxAddrType is unique. Only one physical protocol is allowed per connection. upperMultiplicity: More than one receive PDU ID may be configured for reception (e.g. one for func requests, one for phys requests). lowerMultiplicity: At least one receive PDU ID configuration must be provided per protocol.
                  enumeration DcmDslProtocolRxAddrType: {DCM_FUNCTIONAL_TYPE, DCM_PHYSICAL_TYPE}, set at pre-compile  # Declares the communication type of this DCM_PROTOCOL_DCMRXPDUID. | PHYSICAL is used for 1 to 1 communication FUNCTIONAL is used for 1 to n communication
                  integer DcmDslProtocolRxChannelId: 0..255, set at pre-compile  # Channel Identifier associated to the received Pdu.
                  integer DcmDslProtocolRxPduId: 0..65535, set at pre-compile, symbolic-name-value=true  # DcmRxPduId value for reception of requests.
                  reference DcmDslProtocolRxPduRef: set at pre-compile, destination=Pdu  # DcmRxPduId reference for reception of requests / Multiple links shall be allowed. (e.g. one DcmRxPduId to receive func requests, one DcmRxPduId to receive phys requests)
                  symbolic name reference DcmDslProtocolRxComMChannelRef: set at pre-compile, destination=ComMChannel  # Reference to the ComMChannel on which the DcmDslProtocolRxPdu is received.
                container DcmDslProtocolTx  # This container contains the configuration (parameters) for the protocol configuration of TX channel (for each protocol) | The included parameters needs to be configured per protocol.
                  integer DcmDslTxConfirmationPduId: 0..65535, set at pre-compile, symbolic-name-value=true  # Handle Id to be used by the Lower Layer to confirm the transmission of the DcmDsProtocolTxPdu to the LowerLayer.
                  reference DcmDslProtocolTxPduRef: set at pre-compile, destination=Pdu  # DcmTxPduId reference for transmission of responses
              container DcmDslPeriodicTransmission [0..0]: category=NOT_SUPPORTED  # This container contains the configuration (parameters) for Periodic Transmission service. | Hint: Periodic Transmission request comes via DcmDslMainConnection and PeriodicTransmission Event response is given via DcmDslPeriodicTransmission.
                container DcmDslPeriodicConnection [0..*]: category=NOT_SUPPORTED  # Holding the TxPduId configuration for PeriodicTransmission.
                  integer DcmDslPeriodicTxConfirmationPduId: 0..65535, category=NOT_SUPPORTED, set at pre-compile, symbolic-name-value=true  # Handle Id to be used by the Lower Layer to confirm the transmission of the DcmDslPeriodicTxPdu to the LowerLayer.
                  reference DcmDslPeriodicTxPduRef: category=NOT_SUPPORTED, set at pre-compile, destination=Pdu  # This is the reference to the PDU ID to be used by this DCM when sending Periodic Transmissions. It is only needed for Type2 Periodic Transmissions configurations. | upperMultiplicity: one or several DcmDslPeriodicTxPduRef can be defined if Periodic Transmission is enabled and TYPE2 Periodic Transmissions is configured. lowerMultiplicity: DcmDslPeriodicTxPduRef does not need to be defined if Periodic Transmission is not enabled or TYPE1 Periodic Transmissions is configured..
              container DcmDslResponseOnEvent [0..0]: category=NOT_SUPPORTED  # This container contains the configuration (parameters) for ResponseOnEvent service. | Hint: ROE service request is recept via DcmDslMainConnection and that Event response is given via DcmDslResposeOnEvent
                integer DcmDslRoeTxConfirmationPduId [0..1]: 0..65535, category=NOT_SUPPORTED, set at pre-compile, symbolic-name-value=true  # Handle Id to be used by the Lower Layer to confirm the transmission of the DcmDslRoeTxPdu to the LowerLayer.
                reference DcmDslRoeTxPduRef [0..1]: category=NOT_SUPPORTED, set at pre-compile, destination=Pdu  # Reference to the PDU for transmission of ROE response (only needed for ROE Transmission Type is TYPE2) | upperMultiplicity: One PDU required if ROE Transmission Type is TYPE2. lowerMultiplicity: No PDU required if ROE Transmission Type is TYPE1.
        container DcmDslServiceRequestManufacturerNotification [0..*]  # The name of this container is used to define the name of the R-Port through which the DCM accesses the interface ServiceRequestNotification. | The R-Port is named ServiceRequestManufacturerNotification_<SWC>; where <SWC> is the name of the container DcmDslServiceRequestManufacturerNotification. The lowerMultiplicity is 0: If DcmRequestManufacturerNotificationEnabled = false the Indication API is not available.
        container DcmDslServiceRequestSupplierNotification [0..*]  # The name of this container is used to define the name of the R-Port through which the DCM accesses the interface ServiceRequestNotification. | The R-Port is named ServiceRequestSupplierNotification_<SWC> where <SWC> is the name of the container DcmDslServiceRequestSupplierNotification. The lowerMultiplicity is 0: If DcmRequestSupplierNotification = false the Indication API is not available.
      container DcmDsp [0..1]  # These parameters apply to Diagnostic Service Processing. There will always be one set of these parameters per DCM.
        integer DcmDspMaxDidToRead [0..1]: 1..65535, set at pre-compile  # Indicates the maximum allowed DIDs in a single "ReadDataByIdentifier" request.
        integer DcmDspPowerDownTime [0..1]: 0..255, set at pre-compile  # This parameter indicates to the client the minimum time of the stand-by sequence the server will remain in the power-down sequence. | The resolution of this parameter is one second per count. The following values are valid: 00 - FE hex: 0 - 254 s powerDownTime; FF hex: indicates a failure or time not available.
        integer DcmDspMaxPeriodicDidScheduler: 1..255, category=NOT_SUPPORTED, set at pre-compile, origin=AUTRON_v4.0.3  # Defines the size of the periodic scheduler. | If set to 0, then no limitation is applied.
        integer DcmDspMaxPeriodicDidToRead [0..1]: 1..65535, category=NOT_SUPPORTED, set at pre-compile, origin=AUTRON_v4.0.3  # Indicates the maximum allowed periodicDIDs which can be read in a single "ReadDataByPeriodicIdentifier" request. | If set to 0, then no limitation is applied.
        boolean DcmDspDDDIDcheckPerSourceDID: category=NOT_SUPPORTED, set at pre-compile, origin=AUTRON_v4.0.3  # TRUE: DCM module shall check the session, security and mode dependencies per source DIDs with a ReadDataByIdentifier (0x22) with DID in the range 0xF200 to 0xF3FF FALSE:DCM module shall not check the session, security and mode dependencies per source DIDs with a ReadDataByIdentifier (0x22) with DID in the range 0xF200 to 0xF3FF
        container DcmDspAuthentication [0..1]  # This container contains the configuration for the UDS service Authentication (0x29).
          integer DcmDspAuthenticationDeauthenticatedRole: 1..4294967295, scope=ECU, set at pre-compile  # Role used for service authentication verification in the deauthenticated state.
          integer DcmDspAuthenticationDataBufferLength [0..1]: 1..65535, scope=ECU, set at link in variant link-time / pre-compile in variant post-build+pre-compile  # The buffer length to get data from KeyM and Csm. This parameter should be configured when the paramter DcmDspAuthenticationESUsed set to true
          float DcmDspAuthenticationDefaultSessionTimeOut [0..1]: 0.., scope=ECU, multiplicity set at pre-compile, set at pre-compile  # Defines the number of seconds after which the Dcm makes a transition to deauthenticated state, in case of no active communication.
          float DcmDspAuthenticationAsyncTimeOut [0..1]: 0..1, scope=ECU, multiplicity set at pre-compile, set at pre-compile  # Defines the number of seconds waiting time after Dcm call a asynchronous function.
          integer DcmDspAuthenticationGeneralNRC [0..0]: 0..255, scope=ECU, set at pre-compile  # Defines the NRC that shall be send as replacement of all ISO 14229-1 defined NRCs in case of invalid certificate or content.
          integer DcmDspAuthenticationRoleSize: 1..4, scope=ECU, set at pre-compile  # Defines the size in bytes for the role element within a certificate.
          integer DcmDspAuthenticationWhiteListDIDMaxSize [0..1]: 1..255, scope=ECU, set at pre-compile  # Defines the maximum size in bytes for the white list element within a certificate. If this parameter configured, white list for DID will be supported.
          integer DcmDspAuthenticationWhiteListMemorySelectionMaxSize [0..1]: 1..255, scope=ECU, set at pre-compile  # Defines the maximum size in bytes for the white list element within a certificate. If this parameter configured, white list for Memory Selection will be supported.
          integer DcmDspAuthenticationWhiteListRIDMaxSize [0..1]: 1..255, scope=ECU, set at pre-compile  # Defines the maximum size in bytes for the white list element within a certificate. If this parameter configured, white list for DID will be supported.
          integer DcmDspAuthenticationWhiteListServicesMaxSize [0..1]: 1..255, scope=ECU, set at pre-compile  # Defines the maximum size in bytes for the white list element within a certificate.
          reference DcmDspAuthenticationGeneralNRCModeRuleRef [0..0]: scope=ECU, multiplicity set at pre-compile, set at pre-compile, destination=DcmModeRule  # Mode rule that defines if the general NRC shall be send for all failures due to invalid certificate or content.
          reference DcmDspAuthenticationPersistStateModeRuleRef [0..0]: scope=ECU, multiplicity set at pre-compile, set at pre-compile, destination=DcmModeRule  # References a mode rule that defines if the authentication state shall be persisted in non-volatile memory.
          reference DcmDspAuthenticationPersitStateNvMBlockIdRef [0..0]: scope=ECU, multiplicity set at pre-compile, set at pre-compile, destination=NvMBlockDescriptor  # References a NvM Block Id that persist authentication state in non-volatile memory.
          container DcmDspAuthenticationConnection [0..*]  # This container contains the authentication configuration use for a dsl connection.
            reference DcmDspAuthenticationCertificatePublicKeyStoreJobRef: scope=ECU, multiplicity set at pre-compile, set at pre-compile, destination=CsmJob  # Reference to a CsmJob used to store the public key within the Csm.
            reference DcmDspAuthenticationClientCertificateRef: scope=ECU, multiplicity set at pre-compile, set at pre-compile, destination=KeyMCertificate  # Reference to a KeyMCertificate used to handle the client certificate for this connection.
            reference DcmDspAuthenticationClientChallengeSignJobRef: scope=ECU, multiplicity set at pre-compile, set at pre-compile, destination=CsmJob  # Reference to a job used to sign the client challenge.
            reference DcmDspAuthenticationConnectionCertificateRef: scope=ECU, multiplicity set at pre-compile, set at pre-compile, destination=KeyMCertificate  # Reference to a KeyMCertificate used to store the certificate within the KeyM.
            reference DcmDspAuthenticationConnectionMainConnectionRef: scope=ECU, multiplicity set at pre-compile, set at pre-compile, destination=DcmDslMainConnection  # Reference to the dsl diagnostic connection that uses this authentication configuration.
            reference DcmDspAuthenticationECUCertificateKeyElementRef [0..1]: scope=ECU, multiplicity set at pre-compile, set at pre-compile, destination=CryptoKeyElement  # Reference to a CryptoKeyElement used as server certificate during bi-directional authentication.
            reference DcmDspAuthenticationECUCertificateRef [0..1]: scope=ECU, multiplicity set at pre-compile, set at pre-compile, destination=CsmKey  # Reference to a KeyMCertificate with the server certificate for bi-directional authentication.
            reference DcmDspAuthenticationPublicKeyElementRef: scope=ECU, multiplicity set at pre-compile, set at pre-compile, destination=KeyMCertificateElement  # Reference to a certificate data element with the public key in the certificate.
            reference DcmDspAuthenticationRandomJobRef: scope=ECU, multiplicity set at pre-compile, set at pre-compile, destination=CsmJob  # Reference to a certificate parse job used to parse the authentication certificate.
            reference DcmDspAuthenticationRoleElementRef: scope=ECU, multiplicity set at pre-compile, set at pre-compile, destination=KeyMCertificateElement  # Reference to a certificate data element with the role in the certificate.
            reference DcmDspAuthenticationTargetIdentificationModeRuleRef [0..1]: scope=ECU, multiplicity set at pre-compile, set at pre-compile, destination=DcmModeRule  # Reference to a mode rule that is used to evaluate the target identification.
            reference DcmDspAuthenticationVerifyProofOfOwnerShipClientJobRef: scope=ECU, multiplicity set at pre-compile, set at pre-compile, destination=CsmJob  # Reference to a CsmJob used to verify the proof of ownership client in the Csm.
            reference DcmDspAuthenticationWhiteListDIDElementRef [0..1]: scope=ECU, multiplicity set at pre-compile, set at pre-compile, destination=KeyMCertificateElement  # Reference to a certificate data element with the white list for data identifiers in the certificate.
            reference DcmDspAuthenticationWhiteListMemorySelectionElementRef [0..1]: scope=ECU, multiplicity set at pre-compile, set at pre-compile, destination=KeyMCertificateElement  # Reference to a certificate data element with the white list for user defined memory selection in the certificate.
            reference DcmDspAuthenticationWhiteListRIDElementRef [0..1]: scope=ECU, multiplicity set at pre-compile, set at pre-compile, destination=KeyMCertificateElement  # Reference to a certificate data element with the white list for routine identifiers in the certificate.
            reference DcmDspAuthenticationWhiteListServicesElementRef: scope=ECU, multiplicity set at pre-compile, set at pre-compile, destination=KeyMCertificateElement  # Reference to a certificate data element with the white list in the certificate.
          container DcmDspAuthenticationConnectionES [0..*]  # This container contains the authentication configuration use for a dsl connection, when using ES specification for Authentication service
            integer DcmDspAuthenticationAuthenticatedRole: 1..4294967295, scope=ECU, set at pre-compile  # Role used for service authentication verification in the Authenticated state.
            string DcmDspAuthenticationWLServicesWithoutSubfunction: set at pre-compile, default-value=0  # Value of the white list services data which has no subfunction (hex number). example: 34 35 36
            string DcmDspAuthenticationWLServicesWithSubfunction: set at pre-compile, default-value=0  # Value of the white list services data which has subfunction (hex number). example: 19 01 19 02 11 01 11 02
            string DcmDspAuthenticationWLDID [0..1]: set at pre-compile, default-value=0  # Value of the white list DIDs data (hex number). example: F1 90 03 31 F4 01 - DID 0xF190 : read and write - DID 0x32F4: only read
            string DcmDspAuthenticationWLRID [0..1]: set at pre-compile, default-value=0  # Value of the white list DIDs data (hex number). example: 1A 90 03 02 8A 01 - RID 0x1A90 : startRoutine and stopRoutine - DID 0x32F4: only startRoutine
            string DcmDspAuthenticationWLMemorySelection [0..1]: set at pre-compile, default-value=0
            function name DcmDspAuthenticationUniDirectionalFunc: scope=ECU
            function name DcmDspAuthenticationProofOfOwnerShipClientFunc: scope=ECU
            integer DcmDspAuthenticationCertificateClientSize: 1..4294967295  # Size of the ClientCertificate used in subfunction UniDirectional (in bytes)
            integer DcmDspAuthenticationProofOfOwnerShipClientSize: 1..4294967295  # Size of the ProofOfOwnerShipClient used in subfunction ProofOfOwnerShip (in bytes)
            integer DcmDspAuthenticationChallengeServerSize: 1..4294967295  # Size of the return data ChallengeServer used in subfunction UniDirectional (in bytes)
            function name DcmDspAuthenticationSettingAccessRightsFailedFunc [0..1]: set at pre-compile  # Function name for request to Authentication NRC 5A: Setting Access Rights Failed Fnc
            function name DcmDspAuthenticationDeauthenticationFailedFunc [0..1]: set at pre-compile  # Function name for request to GetCompare Fnc.
            enumeration DcmDspAuthenticationUsePort [0..1]: {USE_ASYNCH_CLIENT_SERVER, USE_ASYNCH_FNC, USE_SYNCH_CLIENT_SERVER, USE_SYNCH_FNC}, set at pre-compile  # This parameter defines which kind of interface shall be used for Authentication NRC.
            reference DcmDspAuthenticationConnectionMainConnectionRef: scope=ECU, multiplicity set at pre-compile, set at pre-compile, destination=DcmDslMainConnection  # Reference to the dsl diagnostic connection that uses this authentication configuration.
        container DcmDspPeriodicTransmission [0..0]: category=NOT_SUPPORTED
          float DcmDspPeriodicTransmissionSlowRate [0..1]: 0..65.535, set at pre-compile, origin=AUTRON_v4.0.3  # This parameter give the transmission rate of the requested periodicDataIdentifiers to be used if the parameter transmissionMode given in the ReadDataByPeriodicID request is equal to 0x01 ("sendAtSlowRate"). This parameter value in seconds have to be configured as a multiple of DcmTaskTime. | The AUTOSAR configuration standard is to use SI units, so this parameter is defined as a float value in seconds. DCM configuration tools must convert this float value to the appropriate value format for the use in the software implementation of DCM.
          float DcmDspPeriodicTransmissionMediumRate [0..1]: 0..65.535, set at pre-compile, origin=AUTRON_v4.0.3  # This parameter give the transmission rate of the requested periodicDataIdentifiers to be used if the parameter transmissionMode given in the ReadDataByPeriodicID request is equal to 0x02 ("sendAtMediumRate"). This parameter value in seconds have to be configured as a multiple of DcmTaskTime. | The AUTOSAR configuration standard is to use SI units, so this parameter is defined as a float value in seconds. DCM configuration tools must convert this float value to the appropriate value format for the use in the software implementation of DCM.
          float DcmDspPeriodicTransmissionFastRate [0..1]: 0..65.535, set at pre-compile, origin=AUTRON_v4.0.3  # This parameter give the transmission rate of the requested periodicDataIdentifiers to be used if the parameter transmissionMode given in the ReadDataByPeriodicID request is equal to 0x03 ("sendAtFastRate"). This parameter value in seconds have to be configured as a multiple of DcmTaskTime. | The AUTOSAR configuration standard is to use SI units, so this parameter is defined as a float value in seconds. DCM configuration tools must convert this float value to the appropriate value format for the use in the software implementation of DCM.
        container DcmDspComControl [0..1]
          container DcmDspComControlAllChannel [0..*]  # Collection of ComM channels which shall be controlled if all networks are addressed.
            symbolic name reference DcmDspAllComMChannelRef: set at pre-compile, destination=ComMChannel  # Reference to ComM channel.
          container DcmDspComControlSetting [0..0]: category=NOT_SUPPORTED  # Provide the configuration of the Communication control.
            reference DcmDspComControlCommunicationReEnableModeRuleRef [0..1]: category=NOT_SUPPORTED, set at pre-compile, destination=DcmModeRule  # Reference to DcmDspModeRule Mode rule which controls re-enabling | of communication by DCM. The DCM module shall call BswM_Dcm_CommunicationMode_CurrentState(DCM_ENABLE_RX_TX_NORM_NM)) in case that the referenced mode rule is not fulfilled anymore.
          container DcmDspComControlSpecificChannel [0..*]  # Assigns subnet number to ComM channel which will be controlled.
            integer DcmDspSubnetNumber: 1..14, set at pre-compile  # Subnet Number which controls the specific ComMChannel.
            symbolic name reference DcmDspSpecificComMChannelRef: set at pre-compile, destination=ComMChannel  # Reference to ComM channel.
        container DcmDspControlDTCSetting [0..0]: category=NOT_SUPPORTED  # Provide the configuration of the ControlDTCSetting mechanism.
          reference DcmDspControlDTCSettingReEnableModeRuleRef [0..1]: set at pre-compile, destination=DcmModeRule  # Reference to DcmDspModeRule | Mode rule which controls re-enabling of controlDTCsetting by DCM. The DCM module shall execute a ControlDTCSetting.Off (call Dem_EnableDTCSetting()) in case that the referenced mode rule is not fulfilled anymore.
        container DcmDspData [0..*]  # This container contains the configuration (parameters) of a Data belonging to a DID
          function name DcmDspDataConditionCheckReadFnc [0..1]: set at pre-compile  # Function name to demand application if the conditions (e.g. System state) to read the DID are correct. (ConditionCheckRead-function). | Multiplicity shall be equal to parameter DcmDspDataReadFnc. Only relevant if DcmDspDataUsePort=="USE_DATA_SYNCH_FNC or DcmDspDataUsePort==USE_DATA_ASYNCH_FNC". This parameter is related to the interface Xxx_ConditionCheckRead.
          function name DcmDspDataEcuSignal [0..1]: category=NOT_SUPPORTED, set at pre-compile  # Function name to control the access to a certain ECU Signal by the DCM. (IoHwAb_Dcm_<EcuSignalName>-function). | Only relevant if DcmDspDataUsePort==USE_ECU_SIGNAL.
          function name DcmDspDataFreezeCurrentStateFnc [0..1]: set at pre-compile  # Function name to request to application to freeze the current state of an IOControl. (FreezeCurrentState-function). | Only relevant if DcmDspDataUsePort=="USE_DATA_SYNCH_FNC or DcmDspDataUsePort==USE_DATA_ASYNCH_FNC". This parameter is related to the interface Xxx_FreezeCurrentState.
          function name DcmDspDataGetScalingInfoFnc [0..1]: category=NOT_SUPPORTED, set at pre-compile  # Function name to request to application the scaling information of the DID. (GetScalingInformation-function). | Only relevant if DcmDspDataUsePort=="USE_DATA_SYNCH_FNC or DcmDspDataUsePort==USE_DATA_ASYNCH_FNC". This parameter is related to the interface Xxxx_GetScalingInformation.
          function name DcmDspDataReadDataLengthFnc [0..1]: set at pre-compile  # Function name to request from application the data length of a DID. (ReadDataLength-function). | Only relevant if DcmDspDataUsePort=="USE_DATA_SYNCH_FNC or DcmDspDataUsePort==USE_DATA_ASYNCH_FNC". This parameter is related to the interface Xxx_ReadDataLength.
          function name DcmDspDataReadEcuSignal [0..1]: set at pre-compile  # Function name for read access to a certain ECU Signal by the DCM. (IoHwAb_Dcm_Read<EcuSignalName>-function). | Only relevant if DcmDspDataUsePort==USE_ECU_SIGNAL.
          function name DcmDspDataReadFnc [0..1]: set at pre-compile  # Function name to request from application the data value of a DID. (ReadData-function). | Multiplicity shall be equal to parameter DcmDspDataConditionCheckReadFnc. Only relevant if DcmDspDataUsePort=="USE_DATA_SYNCH_FNC or DcmDspDataUsePort==USE_DATA_ASYNCH_FNC". This parameter is related to the interface Xxx_ReadData.
          function name DcmDspDataResetToDefaultFnc [0..1]: set at pre-compile  # Function name to request to application to reset an IOControl to default value. (ResetToDefault-function). | Only relevant if DcmDspDataUsePort=="USE_DATA_SYNCH_FNC or DcmDspDataUsePort==USE_DATA_ASYNCH_FNC". This parameter is related to the interface Xxx_ResetToDefault.
          function name DcmDspDataReturnControlToEcuFnc [0..1]: set at pre-compile  # Function name to request to application to return control to ECU of an IOControl. (ReturnControlToECU-function). | Only relevant if DcmDspDataUsePort=="USE_DATA_SYNCH_FNC or DcmDspDataUsePort==USE_DATA_ASYNCH_FNC". This parameter is related to the interface Xxx_ReturnControlToECU.
          function name DcmDspDataShortTermAdjustmentFnc [0..1]: set at pre-compile  # Function name to request to application to adjuste the IO signal. (ShortTermAdjustment-function). | Only relevant if DcmDspDataUsePort=="USE_DATA_SYNCH_FNC or DcmDspDataUsePort==USE_DATA_ASYNCH_FNC". This parameter is related to the interface Xxx_ShortTermAdjustment.
          integer DcmDspDataSize: 0..65535, set at pre-compile  # Length of data in bits associated to the Data. If Data has variable datalength, that corresponds to the maximum datalength.
          enumeration DcmDspDataType [0..1]: {SINT16, SINT32, SINT8, UINT16, UINT32, UINT8}, set at pre-compile  # Provide the data type of Data belonging to a DID.
          enumeration DcmDspDataUsePort: {USE_BLOCK_ID, USE_DATA_ASYNCH_CLIENT_SERVER, USE_DATA_ASYNCH_FNC, USE_DATA_SYNCH_CLIENT_SERVER, USE_DATA_SYNCH_FNC, USE_ECU_SIGNAL}, set at pre-compile  # Define wich interface shall be used to access the data.
          function name DcmDspDataWriteFnc [0..1]: set at pre-compile  # Function name to request application to write the data value of a DID. (WriteData-function). | Only relevant if DcmDspDataUsePort=="USE_DATA_SYNCH_FNC or DcmDspDataUsePort==USE_DATA_ASYNCH_FNC". This parameter is related to the interface Xxx_WriteData.
          reference DcmDspDataInfoRef: set at pre-compile, destination=DcmDspDataInfo  # Reference to 1 DcmDspDataInfo
          symbolic name reference DcmDspDataBlockIdRef [0..1]: set at pre-compile, origin=AUTOSAR_ECUC V1.0.0, destination=NvMBlockDescriptor  # NRAM blockId to access the data. | Only relevant if DcmDspDataUsePort==USE_BLOCK_ID.
        container DcmDspDataInfo [0..*]  # This container contains the configuration (parameters) of a Data
          boolean DcmDspDataFixedLength: set at pre-compile  # Indicates if the datalength of the Data is fixed | true = datalength of the Data is fixed false = datalength of the Data is variable
          integer DcmDspDataScalingInfoSize [0..1]: 0..4294967295, set at pre-compile  # If Scaling information service is available for this Data, it provides the size of the scaling information.
        container DcmDspDid [0..*]  # This container contains the configuration (parameters) of the DID.
          integer DcmDspDidIdentifier: 0..65535, set at pre-compile  # 2 byte Identifier of the DID
          boolean DcmDspDidPreConfigured [0..1]: category=NOT_SUPPORTED, set at pre-compile, origin=AUTRON_v1.0.1  # This parameter specifies about Preconfigured Did for ResponseOnEvent. | true = Preconfigured Did false = Did not preconfigured
          boolean DcmDspDidRoeQueueEnabled [0..1]: category=NOT_SUPPORTED, set at pre-compile  # If set to TRUE, the ROE queue mechanism will be used in case of ROE OnChangeOfDataIdentifier on this DID. | If set to FALSE, the ROE event will be sent without queuing.
          boolean DcmDspDidUsed: set at pre-compile  # Allow to activate or deactivate the usage of a DID, for multi purpose ECUs | true = DID available false = DID not available
          reference DcmDspDidInfoRef: set at pre-compile, destination=DcmDspDidInfo  # Reference to DcmDspDidInfo containing information on this DID.
          reference DcmDspDidRef [0..*]: set at pre-compile, destination=DcmDspDid  # Reference to DcmDspDid in case this DID refer to one or serveral other DID's
          container DcmDspDidExtRoe [0..1]: category=NOT_SUPPORTED  # Provide information to manage a responseOnEvent request on this DID externally. If this container doesn't exist, an ROE event on this DID will be managed internally.
            function name DcmDspDidRoeActivateFnc [0..1]: set at pre-compile  # Function name to activate/deactivate an ROE event managed externally. Only relevant if DcmDspDataUsePort== USE_DATA_SYNCH_FNC or USE_DATA_ASYNCH_FNC. This parameter is related to the interface xxx_ActivateEvent.
            integer DcmDspDidRoeEventId: 0..255, set at pre-compile  # EventId to be used within Apis Dcm_TriggerOnEvent() and xxx_ActivateEvent()
          container DcmDspDidSignal [0..*]  # This container defines the reference to 1 DcmDspData container and position relevant for this DID.
            integer DcmDspDidDataPos: 0..65535, set at pre-compile  # Defines the position of the data defined by DcmDspDidDataRef reference to DcmDspData container in the DID. | The position is defined in bits.
            boolean DcmDspDidSignalEndianness [0..1]: category=NOT_SUPPORTED, set at pre-compile, default-value=false  # This parameter explains about Signal Endianness. | true: BIG_ENDIAN. false: LITTLE_ENDIAN.
            reference DcmDspDidDataRef: set at pre-compile, destination=DcmDspData  # Reference to 1 DcmDspData container relevant for this DID.
        container DcmDspDidInfo [0..*]  # This container contains the configuration (parameters) of the DID's Info
          boolean DcmDspDidDynamicallyDefined: set at pre-compile  # Indicates if this DID can be dynamically defined | true = DID can be dynamically defined false = DID can not be dynamically defined
          container DcmDspDidAccess  # This container contains the configuration (parameters) of the DID access
            container DcmDspDidControl [0..1]  # This container contains the configuration (parameters) of the DID control.
              boolean DcmDspDidFreezeCurrentState [0..1]: set at pre-compile  # This indicates the presence of "FreezeCurrentState".
              boolean DcmDspDidResetToDefault [0..1]: set at pre-compile  # This indicates the presence of "ResetToDefault".
              boolean DcmDspDidReturnControlToEcu [0..1]: set at pre-compile  # This indicates the presence of "ReturnControlToEcu".
              boolean DcmDspDidShortTermAdjustment [0..1]: set at pre-compile  # This indicates the presence of "ShortTermAdjustment".
              integer DcmDspDidControlRole [0..1]: 0..4294967295, scope=ECU, multiplicity set at link in variant link-time / post-build in variant post-build / pre-compile in variant pre-compile, post-build-variant-multiplicity=true, post-build-variant-value=true, set at link in variant link-time / post-build in variant post-build / pre-compile in variant pre-compile  # Bitfield were each bit represents one dedicated role. A DID is granted IOcontrol access if the bit value is 1. If a bit value is 0, the DID is not allowed to be controlled for that role.
              reference DcmDspDidControlModeRuleRef [0..0]: category=NOT_SUPPORTED, set at pre-compile, destination=DcmModeRule  # Reference to DcmDspModeRule | Mode rule which controls this DID. If there is no reference, no check of the mode rule shall be done.
              reference DcmDspDidControlSecurityLevelRef [0..*]: set at pre-compile, destination=DcmDspSecurityRow  # Reference to DcmDspSecurityRow | Security levels allowed to control this DID. If there is no reference, no check of security level shall be done.
              reference DcmDspDidControlSessionRef [0..*]: set at pre-compile, destination=DcmDspSessionRow  # Reference to DcmDspSessionRow | Sessions allowed to control this DID. If there is no reference, no check of session level shall be done.
            container DcmDspDidRead [0..1]  # This container contains the configuration (parameters) of the DID read.
              integer DcmDspDDDIDMaxElements [0..1]: 1..255, category=NOT_SUPPORTED, set at pre-compile, origin=AUTRON_v4.0.3  # On reception of the UDS Service DynamicallyDefineDataIdentifier (0x2C),the DCM module shall check if the DDDID will not exceed the configured DcmDspDDDIDMaxElements. Otherwise (in case the number of elements will be exceeded) the DCM module shall send a NRC 0x31.
              integer DcmDspDidReadRole [0..1]: 0..4294967295, scope=ECU, multiplicity set at link in variant link-time / post-build in variant post-build / pre-compile in variant pre-compile, post-build-variant-multiplicity=true, post-build-variant-value=true, set at link in variant link-time / post-build in variant post-build / pre-compile in variant pre-compile  # Bitfield were each bit represents one dedicated role. A DID is granted read access if the bit value is 1. If a bit value is 0, the DID is not allowed to be read for that role. | Reading DIDs is possible by different UDS services. This setting applies to all possible DID read operations.
              reference DcmDspDidReadModeRuleRef [0..0]: category=NOT_SUPPORTED, set at pre-compile, destination=DcmModeRule  # Reference to DcmDspModeRule | Mode rule which controls to read this DID. If there is no reference, no check of the mode rule shall be done.
              reference DcmDspDidReadSecurityLevelRef [0..*]: set at pre-compile, destination=DcmDspSecurityRow  # Reference to DcmDspSecurityRow | Security levels allowed to read this DID. If there is no reference, no check of security level shall be done.
              reference DcmDspDidReadSessionRef [0..*]: set at pre-compile, destination=DcmDspSessionRow  # Reference to DcmDspSessionRow | Sessions allowed to read this DID. If there is no reference, no check of session level shall be done.
            container DcmDspDidWrite [0..1]  # This container contains the configuration (parameters) of the DID write.
              integer DcmDspDidWriteRole [0..1]: 0..4294967295, scope=ECU, multiplicity set at link in variant link-time / post-build in variant post-build / pre-compile in variant pre-compile, post-build-variant-multiplicity=true, post-build-variant-value=true, set at link in variant link-time / post-build in variant post-build / pre-compile in variant pre-compile  # Bitfield were each bit represents one dedicated role. A DID is granted write access if the bit value is 1. If a bit value is 0, the DID is not allowed to be written for that role.
              reference DcmDspDidWriteModeRuleRef [0..0]: category=NOT_SUPPORTED, set at pre-compile, destination=DcmModeRule  # Reference to DcmDspModeRule | Mode rule which controls to write this DID. If there is no reference, no check of the mode rule shall be done.
              reference DcmDspDidWriteSecurityLevelRef [0..*]: set at pre-compile, destination=DcmDspSecurityRow  # Reference to DcmDspSecurityRow | Security levels allowed to write this DID. If there is no reference, no check of security level shall be done.
              reference DcmDspDidWriteSessionRef [0..*]: set at pre-compile, destination=DcmDspSessionRow  # Reference to DcmDspSessionRow | Sessions allowed to write this DID. If there is no reference, no check of session level shall be done.
        container DcmDspDidRange [0..*]  # This container defines the DID Range
          boolean DcmDspDidRangeHasGaps: set at pre-compile  # Parameter specifying if there are gaps in the DID range (parameter set to TRUE) or not (parameter set to FALSE)
          integer DcmDspDidRangeIdentifierLowerLimit: 0..65535, set at pre-compile  # Lower limit of DID range.
          integer DcmDspDidRangeIdentifierUpperLimit: 0..65535, set at pre-compile  # Upper limit of DID range.
          function name DcmDspDidRangeIsDidAvailableFnc [0..1]: set at pre-compile  # Function name to request from application if a specific DID is available within the range or not. | Only relevant if DcmDspDidRangeUsePort is set to false. This parameter is related to the interface Xxx_IsDidAvailable.
          integer DcmDspDidRangeMaxDataLength: 0..65535, set at pre-compile  # Maximum data length in bytes
          function name DcmDspDidRangeReadDidFnc [0..1]: set at pre-compile  # Function name to request from application the data range value of a DID.(ReadData-function). | Only relevant if DcmDspDidRangeUsePort is set to false. This parameter is related to the interface Xxx_ReadDidData.
          boolean DcmDspDidRangeUsePort: set at pre-compile  # When the parameter DcmDspDidRangeUsePort is set to true the DCM will access the Data using an R-Port requiring a PortInteface DataServices_DIDRange. In that case, DcmDspDidRangeIsDidAvailableFnc, DcmDspDidRangeReadDidFnc and DcmDspDidRangeWriteDidFnc are ignored and the RTE APIs are used. When the parameter DcmDspDidRangeUsePort is false, the DCM calls the functions defined in DcmDspDidRangeIsDidAvailableFnc, DcmDspDidRangeReadDidFnc and DcmDspDidRangeWriteDidFnc.
          function name DcmDspDidRangeWriteDidFnc [0..1]: set at pre-compile  # Function name to request application to write the data range value of a DID.(WriteData-function). | Only relevant if DcmDspDidRangeUsePort is set to false. This parameter is related to the interface Xxx_WriteDidData.
          reference DcmDspDidRangeInfoRef: set at pre-compile, destination=DcmDspDidInfo  # Reference to DcmDspDidInfo containing information on this DID Range.
        container DcmDspMemory [0..1]  # This container contains the configuration of the memory access.
          boolean DcmDspUseMemoryId: category=NOT_SUPPORTED, set at pre-compile  # If this parameter is set to false, the DCM will not use MemoryIdentifier parameter. | The Dcm_WriteMemory and Dcm_ReadMemory callouts shall be called without the MemoryIdentifier parameter. If this parameter is set to true, the DCM will use MemoryIdentifier parameter to select the memory device to use. The Dcm_WriteMemory and Dcm_ReadMemory callouts shall be called with the MemoryIdentifier parameter.
          container DcmDspAddressAndLengthFormatIdentifier [0..*]  # Provides the value of memory identifier used to select the desired memory device | This container contains the configuration of the memory access requested through diagnostic services : ReadMemoryByAddress, WriteMemoryByAddress, RequestDownload, RequestUpload
            integer DcmDspSupportedAddressAndLengthFormatIdentifier: 0..255, set at pre-compile  # This parameter defines the supported AddressAndLengthFormatIdentifier of the request message.
          container DcmDspMemoryIdInfo [1..*]  # Provides the value of memory identifier used to select the desired memory device | This container contains the configuration of the memory access requested through diagnostic services : ReadMemoryByAddress, WriteMemoryByAddress, RequestDownload, RequestUpload
            integer DcmDspMemoryIdValue [0..1]: 0..255, category=NOT_SUPPORTED, set at pre-compile  # Value of the memory device identifer used. This parameter is only relevant if the memory Id parameter use is enabled. (DcmDspUseMemoryId = TRUE)
            container DcmDspReadMemoryRangeInfo [0..*]  # Provides the range of memory address allowed for reading
              integer DcmDspReadMemoryRangeHigh: 0..4294967294, set at pre-compile  # High memory address of a range allowed for reading
              integer DcmDspReadMemoryRangeLow: 0..4294967294, set at pre-compile  # Low memory address of a range allowed for reading
              reference DcmDspReadMemoryRangeModeRuleRef [0..1]: category=NOT_SUPPORTED, set at pre-compile, destination=DcmModeRule  # Reference to DcmDspModeRule | Mode rule which controls read access on this memory address. If there is no reference, no check of the mode rule shall be done.
              reference DcmDspReadMemoryRangeSecurityLevelRef [0..*]: set at pre-compile, destination=DcmDspSecurityRow  # Link to the Security Access Levels needed for read access on this memory address. If there is no reference, no check of security level shall be done.
            container DcmDspWriteMemoryRangeInfo [0..*]  # Provides the range of memory address allowed for writting.
              integer DcmDspWriteMemoryRangeHigh: 0..4294967294, set at pre-compile  # High memory address of a range allowed for writting.
              integer DcmDspWriteMemoryRangeLow: 0..4294967294, set at pre-compile  # Low memory address of a range allowed for writting
              reference DcmDspWriteMemoryRangeModeRuleRef [0..1]: category=NOT_SUPPORTED, set at pre-compile, destination=DcmModeRule  # Reference to DcmDspModeRule | Mode rule which controls write access on this memory address. If there is no reference, no check of the mode rule shall be done.
              reference DcmDspWriteMemoryRangeSecurityLevelRef [0..*]: set at pre-compile, destination=DcmDspSecurityRow  # Link to the Security Access Levels needed for write access on this memory address. If there is no reference, no check of security level shall be done.
        container DcmDspPid [0..*]  # This container defines the availability of a PID to the DCM.
          integer DcmDspPidIdentifier: 0..255, set at pre-compile  # 1 byte Identifier of the PID
          enumeration DcmDspPidService: {DCM_SERVICE_01, DCM_SERVICE_01_02, DCM_SERVICE_02}, set at pre-compile  # Allow to indicate if this PID is used for service $01 or/and $02.
          integer DcmDspPidSize: 0..255, set at pre-compile  # Length of the PID in byte.
          boolean DcmDspPidUsed: set at pre-compile  # Allow to activate or deactivate the usage of a PID, for multi purpose ECUs | true = PID available false = PID not available
          container DcmDspPidData [1..*]  # This container defines the parameter for a Signal in the PID.
            integer DcmDspPidDataPos: 0..2040, set at pre-compile  # This is the position in bit of the PID structure and will not start at position 0 in case a support information is availabe (for bit-mapped PIDs).
            integer DcmDspPidDataSize: 0..2040, set at pre-compile  # Length of data associated to the PID in bit.
            enumeration DcmDspPidDataType [0..1]: {BOOLEAN, SINT16, SINT32, SINT8, UINT16, UINT32, UINT8}, set at pre-compile  # Provide the data type of Data belonging to a PID.
            boolean DcmDspPidSignalEndianness [0..1]: set at pre-compile, default-value=false  # This parameter explains about Signal Endianness. | true: BIG_ENDIAN. false: LITTLE_ENDIAN.
            container DcmDspPidDataSupportInfo [0..1]  # This container defines the supported information.
              integer DcmDspPidDataSupportInfoBit: 0..255, set at pre-compile  # referenced Bit of the SupportInfo
              reference DcmDspPidDataSupportInfoRef: set at pre-compile, destination=DcmDspPidSupportInfo  # Reference to DcmDspPidSupportInfo
            container DcmDspPidService01 [0..1]  # Contains specific configuration parameter of PID for service $01. This container exists only if DcmDspPidService is set to DCM_SERVICE_01 or DCM_SERVICE_01_02.
              function name DcmDspPidDataReadFnc [0..1]: set at pre-compile  # Function name for reading PID data value. | This is only relevant if DcmDspPidDataUsePort==USE_DATA_SYNCH_FNC. This parameter is related to the interface Xxx_ReadData.
              enumeration DcmDspPidDataUsePort: {USE_DATA_SENDER_RECEIVER, USE_DATA_SYNCH_CLIENT_SERVER, USE_DATA_SYNCH_FNC}, set at pre-compile  # If this parameter is set to USE_DATA_SYNCH_FNC, the DCM will use the function defined in DcmDspPidDataReadFnc to get the PID data value. | If this parameter is set to USE_DATA_SYNCH_CLIENT_SERVER, the DCM will have an R-Port requiring the interface DataServices_<Data>. If this parameter is set to USE_DATA_SENDER_RECEIVER, the DCM will have an R-Port requiring a SenderReceiverInterface The R-Port is named DataServices_<Data> where <Data> is the name of the container DcmDspPidData.
            container DcmDspPidService02 [0..1]  # Contains specific configuration parameter of PID for service $02. This container exists only if DcmDspPidService is set to DCM_SERVICE_02 or DCM_SERVICE_01_02.
              reference DcmDspPidDataDemRef [0..1]: set at pre-compile, destination=DemPidDataElement  # Reference to DemPidDataElement in DEM configuration. Allows to link the DCM PID and DEM PID configuration for Mode $02.
          container DcmDspPidSupportInfo [0..*]  # This container defines the support information (typically byte A) to declare the usability of the data bytes within the so-called bit-mapped PIDs (e.g. PID$68).
            integer DcmDspPidSupportInfoLen: 0..255, set at pre-compile  # Length of the supported information in bytes.
            integer DcmDspPidSupportInfoPos: 0..255, set at pre-compile  # Position of the supported information in bytes.
        container DcmDspRequestControl [0..*]  # This container contains the configuration (parameters) of the "Request control of on-board system, test or component" service (Service $08). | The DCM will request the control using an R-Port requiring a PortInteface RequestControlServices_<TID> The R-Port is named RequestControlServices_<TID> where <TID> is the name of the container DcmDspRequestControl.
          integer DcmDspRequestControlInBufferSize: 0..4294967295, set at pre-compile
          integer DcmDspRequestControlOutBufferSize: 0..4294967295, set at pre-compile
          integer DcmDspRequestControlTestId: 0..255, set at pre-compile  # Test Id for Service $08
        container DcmDspRoe [0..0]: category=NOT_SUPPORTED  # Provide the configuration of the ResponseOnEvent mechanism.
          integer DcmDspRoeBufSize [0..1]: 0..65535, set at pre-compile  # Size of the buffer used to managed internally the subservice OnChangeOfDataIdentifier of ResponseOnEvent Service.
          function name DcmDspRoeInitFnc [0..1]: set at pre-compile  # Function name to initialize an ROE event managed externally.
          boolean DcmDspRoeInitOnDSC: set at pre-compile  # If set to TRUE the ROE functionality is re-initialized on reception of service DiagnosticSessionControl.
          float DcmDspRoeInterMessageTime: 0..5000, set at pre-compile  # Provide the minimum time in ms between two transmissions of ROE event. It is used for the delay between two different consecutive Roe transmissions and between two transmissions of the retry mechanism. | The AUTOSAR configuration standard is to use SI units, so this parameter is defined as float value in seconds. DCM configuration tools must convert this float value to the appropriate value format for the use in the software implementation of DCM. min: A negative value is not allowed.
          integer DcmDspRoeMaxEventLength [0..1]: 1..65535, set at pre-compile  # Provide the max size in byte of an ROE message that will be stored in the ROE transmission queue.
          integer DcmDspRoeMaxNumberOfRetry: 0..255, set at pre-compile  # Provide the max number of re-transmission of an ROE event in case of transmission failure. | If set to 0, no retry mechanism will be managed
          integer DcmDspRoeMaxQueueLength [0..1]: 1..65535, set at pre-compile  # Provide the max number of element in the ROE transmission queue.
          boolean DcmDspRoeQueueEnabled: set at pre-compile  # If set to TRUE, the ROE queue mechanism is enabled on DCM. | If set to FALSE, the ROE event will be sent without queuing.
          function name DcmDspRoeStopFnc [0..1]: set at pre-compile  # Function name to stop an ROE event managed externally.
          symbolic name reference DcmDspRoeBlockIdRef [0..1]: set at pre-compile, origin=AUTRON_v4.0.3, destination=NvMBlockDescriptor  # NRAM blockId to access the data.
        container DcmDspRoutine [0..*]  # This container contains the configuration (parameters) for Routines
          function name DcmDspRequestResultsRoutineFnc [0..1]: set at pre-compile  # Function name for request to application the results of a routine. (Routine_RequestResults-function) | This parameter is related to the interface Xxx_RequestResults.
          boolean DcmDspRequestResultsRoutineSupported: set at pre-compile  # Indicates if the optional requestRoutineResults in the RoutineControl is supported | true = requestRoutineResults is supported false = requestRoutineResults is not supported
          boolean DcmDspRoutineFixedLength: set at pre-compile  # Indicates if the datalength of the optional record in the RoutineControl request and response is fixed. | true = datalength of the optional record is fixed false = datalength of the optional record is variable In case DcmDspRoutineFixedLength is set to FALSE, the DcmDspRoutineSignalLength for the last signal is the maximum length (in bits) of the optional record.
          integer DcmDspRoutineIdentifier: 0..65535, set at pre-compile  # 2 bytes Identifier of the RID
          boolean DcmDspRoutineUsePort: set at pre-compile  # If this parameter is set to true, the DCM uses a port requiring a PortInterface RoutineServices_<ROUTINENAME>. | The R-Port is named RoutineServices_<ROUTINENAME> where <ROUTINENAME> is the name of the container DcmDspRoutine In that case, the configuration must not provide function names in DcmDspStartRoutineFnc, DcmDspStopRoutineFnc or DcmDspRequestResultsRoutineFnc. If this is false, the DCM expects to find the names of the functions to be used in DcmDspStartRoutineFnc, DcmDspStopRoutineFnc or DcmDspRequestResultsRoutineFnc.
          boolean DcmDspRoutineUsed: set at pre-compile  # Allow to activate or deactivate the usage of a Routine, for multi purpose ECUs | true = Routine available false = Routine not available
          function name DcmDspStartRoutineFnc [0..1]: set at pre-compile  # Function name for request to application to start a routine. (Routine_Start-function) | This parameter is related to the interface Xxx_Start.
          function name DcmDspStopRoutineFnc [0..1]: set at pre-compile  # Function name for request to application to stop a routine. (Routine_Stop-function) | This parameter is related to the interface Xxx_Stop.
          boolean DcmDspStopRoutineSupported: set at pre-compile  # Indicates if the optional stopRoutine in the RoutineControl is supported | true = stopRoutine is supported false = stopRoutine is not supported
          reference DcmDspRoutineInfoRef: set at pre-compile, destination=DcmDspRoutineInfo  # Reference to DcmDspRoutineInfo containing information on this routine.
        container DcmDspRoutineInfo [0..*]  # This container contains the configuration (parameters) for Routine's Info.
          container DcmDspRoutineAuthorization [0..1]  # This container contains the configuration (parameters) for the Routine Authorization.
            reference DcmDspRoutineModeRuleRef [0..0]: category=NOT_SUPPORTED, set at pre-compile, destination=DcmModeRule  # Reference to DcmDspModeRule | Mode rule which controls this RID. If there is no reference, no check of the mode rule shall be done.
            reference DcmDspRoutineSecurityLevelRef [0..*]: set at pre-compile, destination=DcmDspSecurityRow  # Reference to DcmDspSecurityRow | Security levels allowed to control this RID. If there is no reference, no check of security level shall be done.
            reference DcmDspRoutineSessionRef [0..*]: set at pre-compile, destination=DcmDspSessionRow  # Reference to DcmDspSessionRow | Sessions allowed to control this RID. If there is no reference, no check of session level shall be done.
          container DcmDspRoutineRequestResIn [0..1]  # Provide description of input parameter of RequestResult subservice for RoutineControl service.
            container DcmDspRoutineRequestResInSignal [1..*]  # Provide description of a routine signal used in RoutineControl service.
              enumeration DcmDspRoutineSignalType: {UINT16, UINT32, UINT8, VARIABLE_LENGTH}, set at pre-compile  # Provide the type of the signal in the RoutineControl request/response.
              integer DcmDspRoutineSignalLength: 0..65535, set at pre-compile  # Provide the length in bits of the signal in the RoutineControl request/response
              integer DcmDspRoutineSignalPos: 0..65535, set at pre-compile  # Provide the position of the signal in the RoutineControl request/response. | The position is defined in bits.
              boolean DcmDspRoutineResInEndianness: category=NOT_SUPPORTED, set at pre-compile, default-value=false  # Allow to activate or deactivate endianness | true = BIG_ENDIAN Supported false = LITTLE_ENDIAN Supported.
          container DcmDspRoutineRequestResOut [0..1]  # Provide description of output parameter of RequestResult subservice for RoutineControl service.
            container DcmDspRoutineRequestResOutSignal [1..*]  # Provide description of a routine signal used in RoutineControl service.
              integer DcmDspRoutineSignalLength: 0..65535, set at pre-compile  # Provide the length in bits of the signal in the RoutineControl request/response
              integer DcmDspRoutineSignalPos: 0..65535, set at pre-compile  # Provide the position of the signal in the RoutineControl request/response. | The position is defined in bits.
              enumeration DcmDspRoutineSignalType: {UINT16, UINT32, UINT8, VARIABLE_LENGTH}, set at pre-compile  # Provide the type of the signal in the RoutineControl request/response.
              boolean DcmDspRoutineRequestEndianness: category=NOT_SUPPORTED, set at pre-compile, default-value=false  # Allow to activate or deactivate endianness | true = BIG_ENDIAN Supported false = LITTLE_ENDIAN Supported.
              integer DcmDspRequestRoutineResultsRole [0..1]: 0..4294967295, scope=ECU, multiplicity set at link in variant link-time / post-build in variant post-build / pre-compile in variant pre-compile, post-build-variant-multiplicity=true, post-build-variant-value=true, set at link in variant link-time / post-build in variant post-build / pre-compile in variant pre-compile  # Bitfield were each bit represents one dedicated role. A RoutineControl with sub-function requestResults is granted access if the bit value is 1. If a bit value is 0, the routine is not allowed for that role.
          container DcmDspRoutineStopIn [0..1]  # Provide description of input parameter of Stop subservice for RoutineControl service.
            container DcmDspRoutineStopInSignal [1..*]  # Provide description of a routine signal used in RoutineControl service.
              integer DcmDspRoutineSignalLength: 0..65535, set at pre-compile  # Provide the length in bits of the signal in the RoutineControl request/response
              integer DcmDspRoutineSignalPos: 0..65535, set at pre-compile  # Provide the position of the signal in the RoutineControl request/response. | The position is defined in bits.
              enumeration DcmDspRoutineSignalType: {UINT16, UINT32, UINT8, VARIABLE_LENGTH}, set at pre-compile  # Provide the type of the signal in the RoutineControl request/response.
              boolean DcmDspRoutineStopInEndianness: category=NOT_SUPPORTED, set at pre-compile, default-value=false  # Allow to activate or deactivate endianness | true = BIG_ENDIAN Supported false = LITTLE_ENDIAN Supported.
          container DcmDspRoutineStopOut [0..1]  # Provide description of output parameter of Stop subservice for RoutineControl service.
            container DcmDspRoutineStopOutSignal [1..*]  # Provide description of a routine signal used in RoutineControl service.
              integer DcmDspRoutineSignalLength: 0..65535, set at pre-compile  # Provide the length in bits of the signal in the RoutineControl request/response
              integer DcmDspRoutineSignalPos: 0..65535, set at pre-compile  # Provide the position of the signal in the RoutineControl request/response. | The position is defined in bits.
              enumeration DcmDspRoutineSignalType: {UINT16, UINT32, UINT8, VARIABLE_LENGTH}, set at pre-compile  # Provide the type of the signal in the RoutineControl request/response.
              boolean DcmDspRoutineStopOutEndianness: category=NOT_SUPPORTED, set at pre-compile, default-value=false  # Allow to activate or deactivate endianness | true = BIG_ENDIAN Supported false = LITTLE_ENDIAN Supported.
              integer DcmDspStopRoutineRole [0..1]: 0..4294967295, scope=ECU, multiplicity set at link in variant link-time / post-build in variant post-build / pre-compile in variant pre-compile, post-build-variant-multiplicity=true, post-build-variant-value=true, set at link in variant link-time / post-build in variant post-build / pre-compile in variant pre-compile  # Bitfield were each bit represents one dedicated role. A RoutineControl with sub-function stopRoutine is granted access if the bit value is 1. If a bit value is 0, the routine is not allowed for that role.
          container DcmDspStartRoutineIn [0..1]  # Provide description of input parameter of Start subservice for RoutineControl service
            container DcmDspStartRoutineInSignal [1..*]  # Provide description of a routine signal used in RoutineControl service.
              integer DcmDspRoutineSignalLength: 0..65535, set at pre-compile  # Provide the length in bits of the signal in the RoutineControl request/response
              integer DcmDspRoutineSignalPos: 0..65535, set at pre-compile  # Provide the position of the signal in the RoutineControl request/response. | The position is defined in bits.
              enumeration DcmDspRoutineSignalType: {UINT16, UINT32, UINT8, VARIABLE_LENGTH}, set at pre-compile  # Provide the type of the signal in the RoutineControl request/response.
              boolean DcmDspRoutineStartInEndianness: category=NOT_SUPPORTED, set at pre-compile, default-value=false  # Allow to activate or deactivate endianness | true = BIG_ENDIAN Supported false = LITTLE_ENDIAN Supported.
          container DcmDspStartRoutineOut [0..1]  # Provide description of output parameter of Start subservice for RoutineControl service.
            container DcmDspStartRoutineOutSignal [1..*]  # Provide description of a routine signal used in RoutineControl service.
              integer DcmDspRoutineSignalLength: 0..65535, set at pre-compile  # Provide the length in bits of the signal in the RoutineControl request/response.
              integer DcmDspRoutineSignalPos: 0..65535, set at pre-compile  # Provide the position of the signal in the RoutineControl request/response. | The position is defined in bits.
              enumeration DcmDspRoutineSignalType: {UINT16, UINT32, UINT8, VARIABLE_LENGTH}, set at pre-compile  # Provide the type of the signal in the RoutineControl request/response.
              boolean DcmDspRoutineStartOutEndianness: category=NOT_SUPPORTED, set at pre-compile, default-value=false  # Allow to activate or deactivate endianness | true = BIG_ENDIAN Supported false = LITTLE_ENDIAN Supported.
              integer DcmDspStartRoutineRole [0..1]: 0..4294967295, scope=ECU, multiplicity set at link in variant link-time / post-build in variant post-build / pre-compile in variant pre-compile, post-build-variant-multiplicity=true, post-build-variant-value=true, set at link in variant link-time / post-build in variant post-build / pre-compile in variant pre-compile  # Bitfield were each bit represents one dedicated role. A RoutineControl with sub-function startRoutine is granted access if the bit value is 1. If a bit value is 0, the routine is not allowed for that role.
        container DcmDspSecurity  # This container contains the configuration ( DSP parameter) for security level configuration (per security level) | Description This container contains Rows of DcmDspSecurityRow
          float DcmDspSecurityMaxAttemptCounterReadoutTime: 0..65535, set at link in variant link-time / pre-compile in variant pre-compile+post-build  # Delay, in seconds, from startup (measured from the first call of the Dcm_MainFunction()), allowed for all AttemptCounter values to be obtained from the Application. | Must be a multiple of the DcmTaskTime. min: A value equal to the DcmTaskTime.
          container DcmDspSecurityRow [0..31]  # Definition of a single Row of configuration for security level configuration (per security level) | The name of this container is used to define the name of the R-Port through which the DCM accesses the interface SecurityAccess_<LEVEL>. The R-Port is named SecurityAccess_<LEVEL> where _<LEVEL> is the name of the container DcmDspSecurityRow. If there is no reference, no check of security level shall be done.
            integer DcmDspSecurityADRSize [0..1]: 1..4294967295, set at pre-compile  # Size of the AccessDataRecord used in GetSeed
            float DcmDspSecurityDelayTime: 0..20000, set at pre-compile, default-value=180.0  # Delay time after failed security access (in ms). This is started after DcmDspSecurityNumAttDelay number of failed security accesses. | The AUTOSAR configuration standard is to use SI units, so this parameter is defined as float value in seconds. DCM configuration tools must convert this float value to the appropriate value format for the use in the software implementation of DCM. min: A negative value is not allowed. upperMultiplicity: Exactly one delay time must be specified per security levbel configuration. lowerMultiplicity: Exactly one delay time must be specified per security levbel configuration. origin: Standard AUTOSAR configuration parameter.
            float DcmDspSecurityDelayTimeOnBoot: 0..20000, category=NOT_SUPPORTED, set at pre-compile, origin=AUTOSAR_ECUC V1.0.0, default-value=0.0  # Start delay timer on power on (in ms) | The AUTOSAR configuration standard is to use SI units, so this parameter is defined as float value in seconds. DCM configuration tools must convert this float value to the appropriate value format for the use in the software implementation of DCM. min: A negative value is not allowed. upperMultiplicity: Exactly one delay time must be specified per security level configuration. lowerMultiplicity: Exactly one delay time must be specified per security level configuration.
            integer DcmDspSecurityKeySize: 1..4294967295, set at pre-compile, default-value=4  # size of the security key (in Bytes).
            integer DcmDspSecurityLevel: 1..63, category=FIXED, set at pre-compile, symbolic-name-value=true, default-value=1  # Value of Security level. | Level 1 is the highest security level. The locked state cannot be configured explicitly. 1,2,3...63: configuration dependent - Conversion formula to calculate SecurityLevel out of tester requested SecurityAccessType parameter: SecurityLevel = (SecurityAccessType + 1) / 2 Type: Dcm_SecLevelType
            integer DcmDspSecurityNumAttDelay: 1..255, set at pre-compile, default-value=3  # Number of failed security accesses after which the delay time is activated
            integer DcmDspSecuritySeedSize: 1..4294967295, set at pre-compile, default-value=4  # size of the security seed (in Bytes).
            function name DcmDspSecurityGetSeedFnc [0..1]: set at pre-compile, origin=AUTRON_v4.0.0  # Function name for request to GetSeed Fnc.
            function name DcmDspSecurityGetCompareFnc [0..1]: set at pre-compile, origin=AUTRON_v4.0.0  # Function name for request to GetCompare Fnc.
            enumeration DcmDspSecurityUsePort: {USE_ASYNCH_CLIENT_SERVER, USE_ASYNCH_FNC, USE_SYNCH_CLIENT_SERVER, USE_SYNCH_FNC}, set at pre-compile, origin=AUTOSAR_ECUC V1.0.0  # This parameter defines which kind of interface shall be used for security access.
            boolean DcmDspSecurityAttemptCounterEnabled: scope=ECU, set at link in variant link-time / pre-compile in variant pre-compile+post-build  # This configuration parameter controls the existence of the APIs to set / get the attempt counter values towards application (Xxx_SetSecurityAttemptCounter() / Xxx_GetSecurityAttemptCounter()). | In case of enabled, the security attempt counter values are passed to application, whenever there is a change in the value. This allows storing the values in nonvolatile RAM and restoring them at ECU startup.
            function name DcmDspSecurityGetAttemptCounterFnc [0..1]: multiplicity set at link in variant link-time / pre-compile in variant pre-compile+post-build, set at link in variant link-time / pre-compile in variant pre-compile+post-build  # Function name to request the value of an attempt counter. | This parameter is related to the interface Xxx_ GetSecurityAttemptCounter.
            function name DcmDspSecuritySetAttemptCounterFnc [0..1]: multiplicity set at link in variant link-time / pre-compile in variant pre-compile+post-build, set at link in variant link-time / pre-compile in variant pre-compile+post-build  # Function name to set the value of an attempt counter. | This parameter is related to the interface Xxx_SetSecurityAttemptCounter.
            reference DcmDspSecureAccessCryptoRef [0..1]: set at pre-compile, destination=DcmDspSecurityInfoRow  # Reference to DcmDspSecurityInfoRow | If there is reference, Security Access works with Ref Id.
        container DcmDspSecurityInfo  # This container contains the configuration ( DSP parameter) for security level configuration (per security level) | Description This container contains Rows of DcmDspSecurityRow
          container DcmDspSecurityInfoRow [0..31]  # Definition of a single Row of configuration for security level configuration (per security level) | The name of this container is used to define the name of the R-Port through which the DCM accesses the interface SecurityAccess_<LEVEL>. The R-Port is named SecurityAccess_<LEVEL> where _<LEVEL> is the name of the container DcmDspSecurityRow. If there is no reference, no check of security level shall be done.
            enumeration DcmDspCryptoVersion: {CRYPTO_R40, CRYPTO_R44}, set at pre-compile  # This parameter defines Security Access is used Crypto R40/R44.
            boolean DcmDspSecurityInfoCnrUsedSha1 [0..1]: multiplicity set at pre-compile, set at pre-compile  # This parameter determines if CnR Logic used SHA1 or not.
            reference DcmDspSecureAccessPublicKeyRef [0..1]: scope=ECU, multiplicity set at pre-compile, set at pre-compile, destination=CsmKey  # Reference to a CsmKey used to store the public key within the Csm. This configuation should set when Crypto Version is CRYPTO_R44.
            reference DcmDspSecureAccessCertVerifyJobRef [0..1]: scope=ECU, multiplicity set at pre-compile, set at pre-compile, destination=CsmJob  # Reference to a CsmJob used to verify certificate signature. This configuation should set when Crypto Version is CRYPTO_R44.
            reference DcmDspSecureAccessCrlVerifyJobRef [0..1]: scope=ECU, multiplicity set at pre-compile, set at pre-compile, destination=CsmJob  # Reference to a CsmJob used to verify CRL signature. This configuation should set when Crypto Version is CRYPTO_R44.
            reference DcmDspSecureAccessCrlHashJobRef [0..1]: scope=ECU, multiplicity set at pre-compile, set at pre-compile, destination=CsmJob  # Reference to a CsmJob used to hash CRL signature. This configuation should set when Crypto Version is CRYPTO_R44.
            reference DcmDspSecureAccessRandomSeedKeyRef [0..1]: scope=ECU, multiplicity set at pre-compile, set at pre-compile, destination=CsmKey  # Reference to a CsmKey used to store the Random Seed key within the Csm. This configuation should set when Crypto Version is CRYPTO_R44.
            reference DcmDspSecureAccessRandomGenJobRef [0..1]: scope=ECU, multiplicity set at pre-compile, set at pre-compile, destination=CsmJob  # Reference to a CsmJob used to generate random number. This configuation should set when Crypto Version is CRYPTO_R44.
            reference DcmDspSecureAccessCnrPublicKeyRef [0..1]: scope=ECU, multiplicity set at pre-compile, set at pre-compile, destination=CsmKey  # Reference to a CsmJob used to store the CnR public key within the Csm. This configuation should set when Crypto Version is CRYPTO_R44.
            reference DcmDspSecureAccessCnrVerifyJobRef [0..1]: scope=ECU, multiplicity set at pre-compile, set at pre-compile, destination=CsmJob  # Reference to a CsmJob used to verify CnR signature.
            reference DcmDspSecureAccessRandomSeedJobRef [0..1]: scope=ECU, multiplicity set at pre-compile, set at pre-compile, destination=CsmJob  # Reference to a CsmJob used to get random seed. This configuation should set when Crypto Version is CRYPTO_R44.
        container DcmDspSession [1..*]  # This container contains the configuration ( DSP parameter) session control configuration (per session control) | This container contains Rows of DcmDspSessionRow
          container DcmDspSessionRow [0..31]: category=FIXED  # Definition of a single Row of session control configuration (per session control)
            enumeration DcmDspSessionForBoot: {DCM_NO_BOOT, DCM_OEM_BOOT, DCM_SYS_BOOT}, set at pre-compile, origin=AUTOSAR_ECUC V1.0.0  # This parameter defines whether this diagnostic session allows to jump to Bootloader (OEM Bootloader or System Supplier Bootloader). If this diagnostic session doesn't allow to jump to Bootloader the value DCM_NO_BOOT shall be chosen.
            integer DcmDspSessionLevel: 0..255, category=FIXED, set at pre-compile, symbolic-name-value=true  # Value of the Session control. The symbolicName represents the Name of the Session | SWS defines the Dcm_SesCtrlType: 1 DEFAULT_SESSION 2 PROGRAMMING_SESSION 3 EXTENDED_DIAGNOSTIC_SESSION 4 SAFETY_SYSTEM_DIAGNOSTIC_SESSION 5...63 Reserved by Document 64...126 <configuration dependent (according "diagnosticSessionType" parameter DiagnosticSessionControl request> 127...254 Reserved by Document 255 ALL_SESSION_LEVEL
            float DcmDspSessionP2ServerMax: 0..1, category=FIXED, set at pre-compile, default-value=0.05  # This is the session value for P2ServerMax in milliseconds (per Session Control). | This is defined in the AUTOSAR SWS for DCM as a uint16. The AUTOSAR configuration standard is to use SI units, so this parameter is defined as a float value in seconds. DCM configuration tools must convert this float value to the appropriate value format for the use in the software implementation of DCM.
            float DcmDspSessionP2StarServerMax: 0..100, category=FIXED, set at pre-compile, default-value=5.0  # This is the session value for P2*ServerMax in milliseconds (per Session Control). | This is defined in the AUTOSAR SWS for DCM as a uint16. The AUTOSAR configuration standard is to use SI units, so this parameter is defined as a float value in seconds. DCM configuration tools must convert this float value to the appropriate value format for the use in the software implementation of DCM.
        container DcmDspTestResultByObdmid [0..1]  # This container contains the configuration (parameters) of the "Request on-board monitoring test results" service (Service $06).
          container DcmDspTestResultObdmidTid [1..*]  # This container contains the configuration (parameters) of a OBDMID and the assigned TIDs for the "Request on-board monitoring test results" service (Service $06).
            integer DcmDspTestResultObdmid: 0..255, set at pre-compile  # OBDMID for Service $06
            container DcmDspTestResultObdmidTids [1..*]  # This container contains the configuration (parameters) of the TIDs belonging to the OBDMID for the "Request on-board monitoring test results" service (Service $06).
              integer DcmDspTestResultObdmidTidUaSid: 0..255, set at pre-compile  # Unit And Scaling ID for Service $06
              reference DcmDspTestResultObdmidTidRef [1..*]: set at pre-compile, destination=DcmDspTestResultTid  # Link to reported TIDs of this OBDMID | upperMultiplicity / lowerMultiplicity:: At least one TID must be reported for an OBDMID
          container DcmDspTestResultTid [1..*]  # This container contains the configuration (parameters) of a single TID for the "Request on-board monitoring test results" service (Service $06). | The DCM will access the Data using an R-Port requiring a PortInterface DTRServices. The R-Port is named DtrServices_<OBDMID>_<TID> where <TID> is the name of the container DcmDspTestResultTid and <OBDMID> is the name of the container DcmDspTestResultObdmidTid.
            integer DcmDspTestResultTestId: 0..255, set at pre-compile  # Test Id for Service $06
        container DcmDspVehInfo [0..*]  # This container contains the configuration (parameters) of the "Request vehicle information service" (service $09).
          integer DcmDspVehInfoInfoType: 0..255, set at pre-compile  # value of InfoType.
          boolean DcmDspVehInfoNODIProvResp [0..1]: set at pre-compile, default-value=false  # Indicate the Dcm, which side is responsible to fill the number of data items (NODI), Dcm or the provider of the InfoType data. In case the responsibility is on provider side, only one DcmDspVehInfoData container is allowed. | * true: Provider is responsible for providing the number of data items parameter * false or not existing: Dcm is responsible for providing the number of data items parameter
          container DcmDspVehInfoData [1..*]  # Data Item of an InfoType; post-fix of the port interface name.
            integer DcmDspVehInfoDataOrder: 0..255, set at pre-compile  # Defines the order of the data item in the InfoType; values: 0..255; first data item having the order number 0; the next 1 and so on. | The configuration of order needs to be unique per InfoType.
            function name DcmDspVehInfoDataReadFnc [0..1]: set at pre-compile  # Function name for reading InfoType data item.
            integer DcmDspVehInfoDataSize: 0..255, set at pre-compile  # Size in bytes of the InfoType data item.
            boolean DcmDspVehInfoDataUsePort: set at pre-compile  # When the parameter DcmDspVehInfoUsePort is set to true the DCM will access the Data using an R-Port requiring a PortInteface InfotypeServices_<VEHINFODATA>. The R-Port is named | InfotypeServices_<VEHINFODATA>. where <VEHINFODATA> is the name of the container DcmDspVehInfoData. In that case, the DcmDspVehInfoDataReadFnc is ignored and the RTE APIs are used. When the parameter DcmDspVehInfoDataUsePort is false, the DCM calls the function defined in DcmDspVehInfoDataReadFnc.
        container DcmDspCallbackPresentDate [0..1]  # The name of this container is used to define the name of the R-Port through which the DCM access the interface CallbackDCMPresentDate. | The R-Port is named CallbackDCMPresentDate_<SWC> where _<SWC> is the name of the container DcmDspCallbackPresentDate
        container DcmDspReadDTCInformation [0..1]  # Provides further configuration for the UDS service ReadDTCInformation processing.
          boolean DcmDspReadDTCInformationSupportedObdUdsDtcSeparation [0..1]: set at pre-compile  # If this parameter is set to true, the OBD UDS DTC separation is enabled. If this parameter is not configured or set to false, the OBD UDS DTC separation is disabled.
        container DcmDspRequestFileTransfer [0..1]  # This container contains the configuration for RequestFileTransfer. | This container only exists if RequestFileTransfer is configured.
          integer DcmRequestFileTransferFileSizeOrDirInfoParameterLength: 1..4, scope=ECU, set at pre-compile, default-value=4  # Defines the length (number of bytes, i.e. the value of fileSizeOrDirInfoParameterLength) of the fileSizeUncompressedOrDirInfoLength and fileSizeCompressed in the response of RequestFileTransfer.
          integer DcmRequestFileTransferLengthFormatIdentifier: 1..4, scope=ECU, set at pre-compile, default-value=4  # Defines the length (number of bytes) of the maxNumberOfBlockLength parameter in the response of RequestFileTransfer.
          integer DcmRequestFileTransferMaxFileAndDirName [0..1]: 1..65535, scope=ECU, set at pre-compile, default-value=1  # Defines the maximum size allowed for the FileAndDirName parameter with RTE interfaces used for RequestFileTransfer.
          boolean DcmRequestFileTransferUsePort: scope=ECU, set at pre-compile, default-value=false  # Defines if a C/S or C function call shall be used for RequestFileTransfer processing.
        container DcmDspMemoryTransfer [0..1]  # This container contains the configuration of the memory transfer.
          function name DcmDspMemoryTransferFnc [0..1]: scope=ECU, multiplicity set at pre-compile, set at pre-compile  # Function name for memory transfer services. | Only relevant if DcmDspMemoryTransferUsePort is set to false.
          boolean DcmDspMemoryTransferUsePort: scope=ECU, set at pre-compile, default-value=false  # If this parameter is set to true, the Dcm uses a port requiring a PortInterface UploadDownload. | If the parameter is false, the DCM uses the according C-API callouts.
          container DcmDspAddressAndLengthFormatIdentifier [0..1]  # This container contains the configuration of the supported AddressAndLengthFormatIdentifiers for memory access.
            integer DcmDspSupportedAddressAndLengthFormatIdentifier [1..*]: 0..255, scope=ECU, multiplicity set at link in variant link-time / pre-compile in variant post-build+pre-compile, set at link in variant link-time / pre-compile in variant post-build+pre-compile  # This parameter defines the supported AddressAndLengthFormatIdentifier of the request message.
          container DcmDspMemoryTransferIdInfo [1..*]  # Provides the value of memory identifier used to select the desired memory device | This container contains the configuration of the memory access requested through diagnostic services : RequestDownload, RequestUpload, TransferData, RequestTransferExit
            integer DcmDspMemoryIdValue [0..1]: 0..255, scope=ECU, multiplicity set at link in variant link-time / pre-compile in variant post-build+pre-compile, set at link in variant link-time / pre-compile in variant post-build+pre-compile  # Value of the memory device identifier used. | Each DcmDspMemoryIdInfo should have a unique ID. The MemoryIdValue is retrieved from the request messages (RMBA,WMBA,RD,RU,DDDI) according to ISO-14229-1 with the most significant byte of the request parameter memoryAddress.
        container DcmDspRoutineRequestResIn [0..1]  # Provide description of input parameter of Stop subservice for RoutineControl service.
          container DcmDspRoutineRequestResInSignal [1..*]  # Provide description of a routine signal used in RoutineControl service.
            enumeration DcmDspRoutineSignalType: {UINT16, UINT32, UINT8, VARIABLE_LENGTH}, set at pre-compile  # Provide the type of the signal in the RoutineControl request/response.
            integer DcmDspRoutineSignalLength: 0..65535, set at pre-compile  # Provide the length in bits of the signal in the RoutineControl request/response
            integer DcmDspRoutineSignalPos: 0..65535, set at pre-compile  # Provide the position of the signal in the RoutineControl request/response. | The position is defined in bits.
            boolean DcmDspRoutineResInEndianness: category=NOT_SUPPORTED, set at pre-compile, default-value=false  # Allow to activate or deactivate endianness | true = BIG_ENDIAN Supported false = LITTLE_ENDIAN Supported.
      container DcmGeneral  # This container contains the configuration (parameters) for Component wide parameters
        boolean DcmDevErrorDetect: set at pre-compile  # Preprocessor switch to enable or disable the Development Error Detection (DET) mechanism.
        boolean DemIntegrated: set at pre-compile, symbolic-name-value=true, default-value=True  # this is the vendor specific option. if the dem module is not integrated, than check this value to false.
        boolean DcmNvmIntegrated: set at pre-compile, symbolic-name-value=true, default-value=True  # if the nvm module is not integrated, check this value to false.
        boolean DcmRequestManufacturerNotificationEnabled: set at pre-compile, default-value=false  # Allows to enable or disable the requested notification mechanism for the Manufacturer.
        boolean DcmRequestSupplierNotificationEnabled: set at pre-compile, default-value=false  # Allows to enable or disable the requested notification mechanism for the Supplier.
        boolean DcmRespondAllRequest: category=FIXED, set at pre-compile  # If set to FALSE the DCM will not respond to diagnostic request that contains a service ID which is in the range from 0x40 to 0x7F or in the range from 0xC0 to 0xFF (Response IDs).
        float DcmTaskTime: 0.0001..0.1, category=FIXED, set at pre-compile  # Allow to configure the time for the periodic cyclic task. Please note: This configuration value shall be equal to the value in the ScheduleManager module. | The AUTOSAR configuration standard is to use SI units, so this parameter is defined as float value in seconds. DCM configuration tools must convert this float value to the appropriate value format for the use in the software implementation of DCM. min: A negative value is not allowed. upperMultiplicity: Exactly one TaskTime must be specified per configuration. lowerMultiplicity: Exactly one TaskTime must be specified per configuration.
        boolean DcmVersionInfoApi: set at pre-compile  # Preprocessor switch to enable or disable the output Version info of the functionality.
        enumeration DcmStandardSupport: {DCM_ISO14229_SUPPORT, DCM_ES95486_SUPPORT, DCM_ES96590_SUPPORT, DCM_ES95486_02_SUPPORT, DCM_ES95486_50_SUPPORT, DCM_QZN04_SUPPORT}, set at pre-compile  # Defines the standard behavior of Dcm module. | DCM_ISO14229_SUPPORT : The behavior of DCM complies with ISO14229. DCM_ES95486_SUPPORT : The behavior of DCM complies with ES95486. DCM_ES96590_SUPPORT : The behavior of DCM complies with ES96590. DCM_ES95486_02_SUPPORT : The behavior of DCM complies with ES95486_02. DCM_ES95486_50_SUPPORT : The behavior of DCM complies with ES95486_50. DCM_QZN04_SUPPORT : The behavior of DCM complies with QZN04.
        string DcmHeaderFileInclusion [0..*]: set at pre-compile, regular-expression=[a-zA-Z0-9_]([a-zA-Z0-9\._])*  # Name of the header file(s) to be included by the Dem module containing the used C-callback declarations.
        boolean DcmRemainUnlockCondition [0..1]: set at pre-compile, origin=AUTRON_v4.0.3, symbolic-name-value=true, default-value=false  # When the CGW (ICU, ESU, CCU) transitions from the extendedDiagnosticSession to the non-default session, the security right should not be initialized. | true = Remain unlock condition. false = Change unlock condition.
        boolean DcmForcedEcuReset [0..1]: category=NOT_SUPPORTED, set at pre-compile, origin=AUTRON_v4.0.3, symbolic-name-value=true, default-value=false  # If a server is received ECUReset(0x11) message with suppressPosRspMsgIndicationBit=treu, then the active service shall be aborted. After a successful server reset the server shall activate the defaultSession. | true = Forced Ecu Reset. false = No Forced Ecu Reset.
        enumeration DcmFblUsedType [0..1]: {DCM_AUTOEVER_FBL_UNUSED, DCM_AUTOEVER_FBL_USED_RXCONNECTION_ID_UNUSED, DCM_AUTOEVER_FBL_USED_RXCONNECTION_ID_USED}, set at pre-compile  # This parameter determines which to use the fbl type. | DCM_AUTOEVER_FBL_UNUSED : Not use the AUTOEVER FBL. DCM_AUTOEVER_FBL_USED_RXCONNECTION_ID_UNUSED : Use the AUTOEVER FBL and do not use the DcmDslProtocolRxConnectionId. DCM_AUTOEVER_FBL_USED_RXCONNECTION_ID_USED : Use the AUTOEVER FBL and use the DcmDslProtocolRxConnectionId.
        reference DcmVinRef [0..1]: set at pre-compile, destination=DcmDspDid  # Reference to the Did containing the VIN Information. This parameter is needed for DoIP module.
      container DcmPageBufferCfg  # This container contains the configuration (parameters) for Page Buffer handling
        boolean DcmPagedBufferEnabled: set at pre-compile, default-value=false  # Allow to enable or disable the Page buffer mechanism. | true = Page buffer handling enabled false = Page Buffer handling disabled
        float DcmPagedBufferTimeout [0..1]: 0..1, set at pre-compile  # Allow to configure the Timeout (in ms) towards the application for filling the next page. | This parameter is only relevant if the Page Buffer handling is enabled. (DcmPagedBufferEnabled = TRUE) Defined in the DCM SWS as uint16, this parameter contains a value in milliseconds. The AUTOSAR configuration standard is to use SI units, so this parameter is defined as float value in seconds. DCM configuration tools must convert this float value to the appropriate value format for the use in the software implementation of DCM. min: A negative value is not allowed. upperMultiplicity: Exactly one Timeout must be specified per configuration. lowerMultiplicity: Exactly one Timeout must be specified per configuration. This value should be set to more than twice the DcmTaskTime.
      container DcmProcessingConditions [0..0]: category=NOT_SUPPORTED  # This container contains the configuration ( DSP parameter) for mode arbitration functionality of the Dcm
        container DcmModeCondition [1..*]  # This container contains the configuration of a mode condition which can be used as argument in DcmModeRules. | One DcmModeCondition shall contain either one DcmSwcModeRef or one DcmBswModeRef. Please note that the Dcm acts as well as mode manager. Therefore the references DcmSwcModeRef or one DcmBswModeRef. might point to provided ModeDeclarationGroupPrototypes of the Dcm itself as well as to provided ModeDeclarationGroupPrototypes of other Bsw Modules or software components.
          enumeration DcmConditionType: {DCM_EQUALS, DCM_EQUALS_NOT}, set at pre-compile  # This parameter specifies what kind of comparison that is made for the evaluation of the mode condition.
          foreign reference DcmBswModeRef [0..1]: set at pre-compile, origin=AUTRON_v4.0.1, destination-type=MODE-DECLARATION  # This parameter references a mode of a ModeDeclarationGroupPrototype provided by a Basic Software Module used for the condition. | Please note that such ModeDeclarationGroupPrototype are owned by a Basic Software Module Description in the role providedModeGroup.
          foreign reference DcmSwcModeRef [0..1]: set at pre-compile, origin=AUTRON_v4.0.1, destination-type=MODE-DECLARATION  # This parameter references a mode in a particular mode request port of a software component that is used for the condition.
        container DcmModeRule [1..*]  # This container contains the configuration of a mode rule which represents a logical expression with DcmModeCondistions or other DcmModeRules as arguments. | All arguments are processed with the operator defined by DcmLogicalOperator, for instance: Argument_A AND Argument_B AND Argument_C
          enumeration DcmLogicalOperator [0..1]: {DCM_AND, DCM_OR}, set at pre-compile  # This parameter specifies the logical operator to be used in the logical expression. If the expression only consists of a single condition this parameter shall not be used.
          integer DcmModeRuleNrcValue [0..1]: 0..255, set at pre-compile  # Optional parameter which defines the NRC to be sent in case the mode rule condition is not valid.
          choice reference DcmArgumentRef [1..*]: set at pre-compile, destination=[DcmModeCondition, DcmModeRule]  # This is a choice reference either to a mode condition or a an other mode rule serving as sub-expression.
