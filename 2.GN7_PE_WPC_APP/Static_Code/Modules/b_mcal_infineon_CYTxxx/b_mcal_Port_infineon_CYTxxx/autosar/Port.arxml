AUTOSAR XML (schema 4-2-2)
package /TS_T40D13M1I0R0
  ecuc definition collection PORT_EcuParameterDefinition: module=Port
  module definition Port [0..1]: post-build-variant-support=true, refined-module-def=Port, variants post-build  # Configuration of the Port module.
    container PortConfigSet  # This container contains the configuration parameters and sub containers of the AUTOSAR Port module.
      reference PortTriggerReference: origin=Cypress, set at post-build, destination=PortTriggerConfigSet  # Reference to PortTriggerConfigSet.
      container PortContainer [1..*]: multiplicity set at post-build, post-build-variant-multiplicity=true  # Container collecting the PortPins.
        integer PortNumberOfPortPins: 1..65535, set at pre-compile, default-value=1  # The number of specified PortPins in this PortContainer.
        integer PortId: 0..255, origin=Cypress, set at pre-compile, default-value=0  # Port Id of the port.
        enumeration PortSmartioClockSource: {PORT_SMART_CLK_SRC_IO0, PORT_SMART_CLK_SRC_IO1, PORT_SMART_CLK_SRC_IO2, PORT_SMART_CLK_SRC_IO3, PORT_SMART_CLK_SRC_IO4, PORT_SMART_CLK_SRC_IO5, PORT_SMART_CLK_SRC_IO6, PORT_SMART_CLK_SRC_IO7, PORT_SMART_CLK_SRC_CHIP0, PORT_SMART_CLK_SRC_CHIP1, PORT_SMART_CLK_SRC_CHIP2, PORT_SMART_CLK_SRC_CHIP3, PORT_SMART_CLK_SRC_CHIP4, PORT_SMART_CLK_SRC_CHIP5, PORT_SMART_CLK_SRC_CHIP6, PORT_SMART_CLK_SRC_CHIP7, PORT_SMART_CLK_SRC_CLK_SM_RST_ACT, PORT_SMART_CLK_SRC_CLK_SM_RST_DS, PORT_SMART_CLK_SRC_CLK_SM_RST_DS_HIB, PORT_SMART_CLK_SRC_CLK_LF_RST_LF_DS, PORT_SMART_CLK_SRC_CONST0, PORT_SMART_CLK_SRC_ASYNC}, origin=Cypress, set at post-build, default-value=PORT_SMART_CLK_SRC_CONST0  # Clock ("clk_fabric") and reset ("rst_fabric_n") source selection.
        boolean PortSmartioHoldOverrideEnable: origin=Cypress, set at post-build, default-value=false  # IO cell hold override functionality. true: The SMARTIO controls the IO cell hold override functionality false: The HSIOM controls the IO cell hold override functionality
        boolean PortSmartioPipelineEnable: origin=Cypress, set at post-build, default-value=true  # Enable for pipeline register. true: Enabled false: Disabled (register is bypassed)
        boolean PortSmartioEnable: origin=Cypress, set at post-build, default-value=false  # Enable for programmable IO. true: Enabled false: Disabled
        enumeration PortSmartioDataUnitTr{0..2}Source: {PORT_SMART_DU_TR_CONST0, PORT_SMART_DU_TR_CONST1, PORT_SMART_DU_TR_DU, PORT_SMART_DU_TR_LUT0, PORT_SMART_DU_TR_LUT1, PORT_SMART_DU_TR_LUT2, PORT_SMART_DU_TR_LUT3, PORT_SMART_DU_TR_LUT4, PORT_SMART_DU_TR_LUT5, PORT_SMART_DU_TR_LUT6, PORT_SMART_DU_TR_LUT7}, origin=Cypress, set at post-build, default-value=PORT_SMART_DU_TR_CONST0  # Data unit input signal "tr{0..2}_in" source selection.
        enumeration PortSmartioDataUnitData0Source: {PORT_SMART_DU_DATA_CONST0, PORT_SMART_DU_DATA_CHIP, PORT_SMART_DU_DATA_IO, PORT_SMART_DU_DATA_DATA_REG}, origin=Cypress, set at post-build, default-value=PORT_SMART_DU_DATA_CONST0  # Data unit input data "data0_in" source selection.
        enumeration PortSmartioDataUnitData1Source: {PORT_SMART_DU_DATA_CONST0, PORT_SMART_DU_DATA_CHIP, PORT_SMART_DU_DATA_IO, PORT_SMART_DU_DATA_DATA_REG}, origin=Cypress, set at post-build, default-value=PORT_SMART_DU_DATA_CONST0  # Data unit input data "data1_in" source selection.
        integer PortSmartioDataUnitBitSize: 1..8, origin=Cypress, set at post-build, default-value=1  # Size/width of the data unit data operands (in bits).
        enumeration PortSmartioDataUnitOperation: {PORT_SMART_DU_OPC_INCR, PORT_SMART_DU_OPC_DECR, PORT_SMART_DU_OPC_INCR_WRAP, PORT_SMART_DU_OPC_DECR_WRAP, PORT_SMART_DU_OPC_INCR_DECR, PORT_SMART_DU_OPC_INCR_DECR_WRAP, PORT_SMART_DU_OPC_ROR, PORT_SMART_DU_OPC_SHR, PORT_SMART_DU_OPC_AND_OR, PORT_SMART_DU_OPC_SHR_MAJ3, PORT_SMART_DU_OPC_SHR_EQL}, origin=Cypress, set at post-build, default-value=PORT_SMART_DU_OPC_INCR  # Specifies the data unit operation.
        integer PortSmartioDataUnitSource: 0..255, origin=Cypress, set at post-build, default-value=0  # Data unit input data source.
        container PortPin [1..*]: multiplicity set at post-build, post-build-variant-multiplicity=true  # Configuration of the individual port pins.
          integer PortPinId: 0..65535, set at pre-compile, symbolic-name-value=true, default-value=1  # Pin Id of the port pin. This value will be assigned to the symbolic name derived from the port pin container short name.
          enumeration PortPinName: {P000_0, P000_1, P000_2, P000_3, P000_4, P000_5, P000_6, P000_7, P001_0, P001_1, P001_2, P001_3, P001_4, P001_5, P001_6, P001_7, P002_0, P002_1, P002_2, P002_3, P002_4, P002_5, P002_6, P002_7, P003_0, P003_1, P003_2, P003_3, P003_4, P003_5, P003_6, P003_7, P004_0, P004_1, P004_2, P004_3, P004_4, P004_5, P004_6, P004_7, P005_0, P005_1, P005_2, P005_3, P005_4, P005_5, P005_6, P005_7, P006_0, P006_1, P006_2, P006_3, P006_4, P006_5, P006_6, P006_7, P007_0, P007_1, P007_2, P007_3, P007_4, P007_5, P007_6, P007_7, P008_0, P008_1, P008_2, P008_3, P008_4, P008_5, P008_6, P008_7, P009_0, P009_1, P009_2, P009_3, P009_4, P009_5, P009_6, P009_7, P010_0, P010_1, P010_2, P010_3, P010_4, P010_5, P010_6, P010_7, P011_0, P011_1, P011_2, P011_3, P011_4, P011_5, P011_6, P011_7, P012_0, P012_1, P012_2, P012_3, P012_4, P012_5, P012_6, P012_7, P013_0, P013_1, P013_2, P013_3, P013_4, P013_5, P013_6, P013_7, P014_0, P014_1, P014_2, P014_3, P014_4, P014_5, P014_6, P014_7, P015_0, P015_1, P015_2, P015_3, P015_4, P015_5, P015_6, P015_7, P016_0, P016_1, P016_2, P016_3, P016_4, P016_5, P016_6, P016_7, P017_0, P017_1, P017_2, P017_3, P017_4, P017_5, P017_6, P017_7, P018_0, P018_1, P018_2, P018_3, P018_4, P018_5, P018_6, P018_7, P019_0, P019_1, P019_2, P019_3, P019_4, P019_5, P019_6, P019_7, P020_0, P020_1, P020_2, P020_3, P020_4, P020_5, P020_6, P020_7, P021_0, P021_1, P021_2, P021_3, P021_4, P021_5, P021_6, P021_7, P022_0, P022_1, P022_2, P022_3, P022_4, P022_5, P022_6, P022_7, P023_0, P023_1, P023_2, P023_3, P023_4, P023_5, P023_6, P023_7, P024_0, P024_1, P024_2, P024_3, P024_4, P025_0, P025_1, P025_2, P025_3, P025_4, P025_5, P025_6, P025_7, P026_0, P026_1, P026_2, P026_3, P026_4, P026_5, P026_6, P026_7, P027_0, P027_1, P027_2, P027_3, P027_4, P027_5, P027_6, P027_7, P028_0, P028_1, P028_2, P028_3, P028_4, P028_5, P028_6, P028_7, P029_0, P029_1, P029_2, P029_3, P029_4, P029_5, P029_6, P029_7, P030_0, P030_1, P030_2, P030_3, P031_0, P031_1, P031_2, P032_0, P032_1, P032_2, P032_3, P032_4, P032_5, P032_6, P032_7, P033_0, P033_1, P033_2, P033_3, P033_4, P033_5, P033_6, P033_7, P034_0, P034_1, P034_2, P034_3, P034_4, P034_5, P034_6, P034_7}, origin=Cypress, set at pre-compile, default-value=P000_0  # HW-Pin Id of the hardware port pin.
          enumeration PortPinDirection: {PORT_PIN_IN, PORT_PIN_OUT, PORT_PIN_IN_OUT_DISABLED}, post-build-variant-value=true, set at post-build, default-value=PORT_PIN_IN  # The initial direction of the pin (IN, OUT or IN/OUT disabled). If the direction is not changeable, the value configured here is fixed. The direction must match the pin mode. E.g. A pin used for one of AMUX modes must be configured to be IN/OUT disabled. A pin used for analog port in GPIO mode must be configured PortPinDirection set to OUT, PortPinOutputInBufEnable set to false and PortPinOutputDrive set to HIGHZ. Implementation Type: Port_PinDirectionType
          boolean PortPinDirectionChangeable: post-build-variant-value=true, set at post-build, default-value=false  # Parameter to indicate if the direction is changeable on a port pin during runtime. | true: Port Pin direction changeable enabled. false: Port Pin direction changeable disabled.
          boolean PortPinOutputInBufEnable: origin=Cypress, post-build-variant-value=true, set at post-build, default-value=true  # Enables input buffer for the pin direction PORT_PIN_OUT. | true: Enabling input buffer. The actual output level can be read. false: Disabling input buffer. The level setting on the hardware can be read instead of the actual output.
          enumeration PortPinInitialMode: {GPIO, AMUXA, AMUXB, AMUXA_DSI, AMUXB_DSI, TCPWM_0_LINE_18, TCPWM_0_LINE_COMPL_22, TCPWM_0_TR_ONE_CNT_IN_54, TCPWM_0_TR_ONE_CNT_IN_67, SCB_0_UART_RX, SCB_7_I2C_SDA, LIN_0_LIN_RX_1, SCB_0_SPI_MISO, TCPWM_0_LINE_17, TCPWM_0_LINE_COMPL_18, TCPWM_0_TR_ONE_CNT_IN_51, TCPWM_0_TR_ONE_CNT_IN_55, SCB_0_UART_TX, SCB_7_I2C_SCL, LIN_0_LIN_TX_1, SCB_0_SPI_MOSI, TCPWM_0_LINE_14, TCPWM_0_LINE_COMPL_17, TCPWM_0_TR_ONE_CNT_IN_42, TCPWM_0_TR_ONE_CNT_IN_52, SCB_0_UART_RTS, LIN_0_LIN_EN_1, CANFD_0_TTCAN_TX_1, SCB_0_I2C_SCL, SCB_0_SPI_CLK, TCPWM_0_LINE_13, TCPWM_0_LINE_COMPL_14, TCPWM_0_TR_ONE_CNT_IN_39, TCPWM_0_TR_ONE_CNT_IN_43, SCB_0_UART_CTS, CANFD_0_TTCAN_RX_1, SCB_0_I2C_SDA, SCB_0_SPI_SELECT0, TCPWM_0_LINE_12, TCPWM_0_LINE_COMPL_13, TCPWM_0_TR_ONE_CNT_IN_36, TCPWM_0_TR_ONE_CNT_IN_40, TCPWM_0_LINE_11, TCPWM_0_LINE_COMPL_12, TCPWM_0_TR_ONE_CNT_IN_33, TCPWM_0_TR_ONE_CNT_IN_37, TCPWM_0_LINE_10, TCPWM_0_LINE_COMPL_11, TCPWM_0_TR_ONE_CNT_IN_30, TCPWM_0_TR_ONE_CNT_IN_34, PERI_TR_IO_INPUT_0, TCPWM_0_LINE_8, TCPWM_0_LINE_COMPL_10, TCPWM_0_TR_ONE_CNT_IN_24, TCPWM_0_TR_ONE_CNT_IN_31, PERI_TR_IO_INPUT_1, TCPWM_0_LINE_7, TCPWM_0_LINE_COMPL_8, TCPWM_0_TR_ONE_CNT_IN_21, TCPWM_0_TR_ONE_CNT_IN_25, SCB_7_UART_RX, SCB_7_SPI_MISO, LIN_0_LIN_RX_0, CANFD_0_TTCAN_TX_0, PERI_TR_IO_INPUT_2, CPUSS_SWJ_TRSTN, SCB_0_SPI_SELECT1, TCPWM_0_LINE_6, TCPWM_0_LINE_COMPL_7, TCPWM_0_TR_ONE_CNT_IN_18, TCPWM_0_TR_ONE_CNT_IN_22, SCB_7_UART_TX, SCB_7_SPI_MOSI, LIN_0_LIN_TX_0, CANFD_0_TTCAN_RX_0, PERI_TR_IO_INPUT_3, SCB_0_SPI_SELECT2, TCPWM_0_LINE_5, TCPWM_0_LINE_COMPL_6, TCPWM_0_TR_ONE_CNT_IN_15, TCPWM_0_TR_ONE_CNT_IN_19, SCB_7_UART_RTS, SCB_7_SPI_CLK, LIN_0_LIN_EN_0, PERI_TR_IO_INPUT_4, SCB_0_SPI_SELECT3, TCPWM_0_LINE_4, TCPWM_0_LINE_COMPL_5, TCPWM_0_TR_ONE_CNT_IN_12, TCPWM_0_TR_ONE_CNT_IN_16, SCB_7_UART_CTS, SCB_7_SPI_SELECT0, LIN_0_LIN_RX_5, PERI_TR_IO_INPUT_5, TCPWM_0_LINE_3, TCPWM_0_LINE_COMPL_4, TCPWM_0_TR_ONE_CNT_IN_9, TCPWM_0_TR_ONE_CNT_IN_13, SCB_7_SPI_SELECT1, LIN_0_LIN_TX_5, PERI_TR_IO_INPUT_6, TCPWM_0_LINE_2, TCPWM_0_LINE_COMPL_3, TCPWM_0_TR_ONE_CNT_IN_6, TCPWM_0_TR_ONE_CNT_IN_10, SCB_7_SPI_SELECT2, LIN_0_LIN_EN_5, PERI_TR_IO_INPUT_7, TCPWM_0_LINE_1, TCPWM_0_LINE_COMPL_2, TCPWM_0_TR_ONE_CNT_IN_3, TCPWM_0_TR_ONE_CNT_IN_7, SCB_6_UART_RX, SCB_6_SPI_MISO, PERI_TR_IO_OUTPUT_0, TCPWM_0_LINE_0, TCPWM_0_LINE_COMPL_1, TCPWM_0_TR_ONE_CNT_IN_0, TCPWM_0_TR_ONE_CNT_IN_4, SCB_6_UART_TX, SCB_6_I2C_SDA, SCB_6_SPI_MOSI, PERI_TR_IO_OUTPUT_1, TCPWM_0_LINE_259, TCPWM_0_LINE_COMPL_0, TCPWM_0_TR_ONE_CNT_IN_777, TCPWM_0_TR_ONE_CNT_IN_1, SCB_6_UART_RTS, SCB_6_I2C_SCL, SCB_6_SPI_CLK, TCPWM_0_LINE_258, TCPWM_0_LINE_COMPL_259, TCPWM_0_TR_ONE_CNT_IN_774, TCPWM_0_TR_ONE_CNT_IN_778, SCB_6_UART_CTS, SCB_6_SPI_SELECT0, TCPWM_0_LINE_257, TCPWM_0_LINE_COMPL_258, TCPWM_0_TR_ONE_CNT_IN_771, TCPWM_0_TR_ONE_CNT_IN_775, SCB_6_SPI_SELECT1, TCPWM_0_LINE_256, TCPWM_0_LINE_COMPL_257, TCPWM_0_TR_ONE_CNT_IN_768, TCPWM_0_TR_ONE_CNT_IN_772, SCB_6_SPI_SELECT2, TCPWM_0_LINE_COMPL_256, TCPWM_0_TR_ONE_CNT_IN_769, PASS_0_SAR_EXT_MUX_SEL_0, SCB_5_UART_RX, SCB_5_SPI_MISO, PERI_TR_IO_INPUT_10, PASS_0_SAR_EXT_MUX_SEL_1, SCB_5_UART_TX, SCB_5_I2C_SDA, SCB_5_SPI_MOSI, PERI_TR_IO_INPUT_11, PASS_0_SAR_EXT_MUX_SEL_2, SCB_5_UART_RTS, SCB_5_I2C_SCL, SCB_5_SPI_CLK, PERI_TR_IO_INPUT_12, PASS_0_SAR_EXT_MUX_EN_0, SCB_5_UART_CTS, SCB_5_SPI_SELECT0, PERI_TR_IO_INPUT_13, SCB_5_SPI_SELECT1, TCPWM_0_LINE_9, TCPWM_0_TR_ONE_CNT_IN_27, SCB_5_SPI_SELECT2, LIN_0_LIN_RX_7, TCPWM_0_LINE_COMPL_9, TCPWM_0_TR_ONE_CNT_IN_28, LIN_0_LIN_TX_7, LIN_0_LIN_EN_7, LIN_0_LIN_RX_2, LIN_0_LIN_TX_2, LIN_0_LIN_EN_2, SCB_4_UART_RX, SCB_4_SPI_MISO, LIN_0_LIN_RX_3, SCB_4_UART_TX, SCB_4_I2C_SDA, SCB_4_SPI_MOSI, LIN_0_LIN_TX_3, SCB_4_UART_RTS, SCB_4_I2C_SCL, SCB_4_SPI_CLK, LIN_0_LIN_EN_3, CANFD_0_TTCAN_TX_2, SCB_4_UART_CTS, SCB_4_SPI_SELECT0, LIN_0_LIN_RX_4, CANFD_0_TTCAN_RX_2, CPUSS_CAL_SUP_NZ, SCB_4_SPI_SELECT1, LIN_0_LIN_TX_4, SCB_4_SPI_SELECT2, LIN_0_LIN_EN_4, SCB_4_SPI_SELECT3, PERI_TR_IO_INPUT_8, PERI_TR_IO_INPUT_9, TCPWM_0_LINE_260, TCPWM_0_TR_ONE_CNT_IN_780, TCPWM_0_LINE_15, TCPWM_0_LINE_COMPL_260, TCPWM_0_TR_ONE_CNT_IN_45, TCPWM_0_TR_ONE_CNT_IN_781, TCPWM_0_LINE_261, TCPWM_0_LINE_COMPL_15, TCPWM_0_TR_ONE_CNT_IN_783, TCPWM_0_TR_ONE_CNT_IN_46, TCPWM_0_LINE_16, TCPWM_0_LINE_COMPL_261, TCPWM_0_TR_ONE_CNT_IN_48, TCPWM_0_TR_ONE_CNT_IN_784, TCPWM_0_LINE_262, TCPWM_0_LINE_COMPL_16, TCPWM_0_TR_ONE_CNT_IN_786, TCPWM_0_TR_ONE_CNT_IN_49, TCPWM_0_LINE_COMPL_262, TCPWM_0_TR_ONE_CNT_IN_787, TCPWM_0_LINE_263, TCPWM_0_TR_ONE_CNT_IN_789, PERI_TR_IO_INPUT_16, TCPWM_0_LINE_COMPL_263, TCPWM_0_TR_ONE_CNT_IN_790, PERI_TR_IO_INPUT_17, TCPWM_0_LINE_19, TCPWM_0_TR_ONE_CNT_IN_57, TCPWM_0_LINE_20, TCPWM_0_LINE_COMPL_19, TCPWM_0_TR_ONE_CNT_IN_60, TCPWM_0_TR_ONE_CNT_IN_58, PERI_TR_IO_INPUT_14, TCPWM_0_LINE_21, TCPWM_0_LINE_COMPL_20, TCPWM_0_TR_ONE_CNT_IN_63, TCPWM_0_TR_ONE_CNT_IN_61, PERI_TR_IO_INPUT_15, TCPWM_0_LINE_22, TCPWM_0_LINE_COMPL_21, TCPWM_0_TR_ONE_CNT_IN_66, TCPWM_0_TR_ONE_CNT_IN_64, TCPWM_0_LINE_23, TCPWM_0_TR_ONE_CNT_IN_69, TCPWM_0_LINE_24, TCPWM_0_LINE_COMPL_23, TCPWM_0_TR_ONE_CNT_IN_72, TCPWM_0_TR_ONE_CNT_IN_70, TCPWM_0_LINE_25, TCPWM_0_LINE_COMPL_24, TCPWM_0_TR_ONE_CNT_IN_75, TCPWM_0_TR_ONE_CNT_IN_73, TCPWM_0_LINE_26, TCPWM_0_LINE_COMPL_25, TCPWM_0_TR_ONE_CNT_IN_78, TCPWM_0_TR_ONE_CNT_IN_76, TCPWM_0_LINE_27, TCPWM_0_LINE_COMPL_26, TCPWM_0_TR_ONE_CNT_IN_81, TCPWM_0_TR_ONE_CNT_IN_79, TCPWM_0_LINE_28, TCPWM_0_LINE_COMPL_27, TCPWM_0_TR_ONE_CNT_IN_84, TCPWM_0_TR_ONE_CNT_IN_82, PERI_TR_IO_INPUT_18, TCPWM_0_LINE_29, TCPWM_0_LINE_COMPL_28, TCPWM_0_TR_ONE_CNT_IN_87, TCPWM_0_TR_ONE_CNT_IN_85, PERI_TR_IO_INPUT_19, TCPWM_0_LINE_30, TCPWM_0_LINE_COMPL_29, TCPWM_0_TR_ONE_CNT_IN_90, TCPWM_0_TR_ONE_CNT_IN_88, TCPWM_0_LINE_31, TCPWM_0_LINE_COMPL_30, TCPWM_0_TR_ONE_CNT_IN_93, TCPWM_0_TR_ONE_CNT_IN_91, TCPWM_0_LINE_32, TCPWM_0_LINE_COMPL_31, TCPWM_0_TR_ONE_CNT_IN_96, TCPWM_0_TR_ONE_CNT_IN_94, TCPWM_0_LINE_33, TCPWM_0_LINE_COMPL_32, TCPWM_0_TR_ONE_CNT_IN_99, TCPWM_0_TR_ONE_CNT_IN_97, TCPWM_0_LINE_34, TCPWM_0_LINE_COMPL_33, TCPWM_0_TR_ONE_CNT_IN_102, TCPWM_0_TR_ONE_CNT_IN_100, TCPWM_0_LINE_35, TCPWM_0_LINE_COMPL_34, TCPWM_0_TR_ONE_CNT_IN_105, TCPWM_0_TR_ONE_CNT_IN_103, TCPWM_0_LINE_36, TCPWM_0_LINE_COMPL_35, TCPWM_0_TR_ONE_CNT_IN_108, TCPWM_0_TR_ONE_CNT_IN_106, PERI_TR_IO_INPUT_20, TCPWM_0_LINE_37, TCPWM_0_LINE_COMPL_36, TCPWM_0_TR_ONE_CNT_IN_111, TCPWM_0_TR_ONE_CNT_IN_109, LIN_0_LIN_EN_6, PERI_TR_IO_INPUT_21, TCPWM_0_LINE_38, TCPWM_0_LINE_COMPL_37, TCPWM_0_TR_ONE_CNT_IN_114, TCPWM_0_TR_ONE_CNT_IN_112, PASS_0_SAR_EXT_MUX_EN_1, LIN_0_LIN_RX_6, TCPWM_0_LINE_39, TCPWM_0_LINE_COMPL_38, TCPWM_0_TR_ONE_CNT_IN_117, TCPWM_0_TR_ONE_CNT_IN_115, PASS_0_SAR_EXT_MUX_SEL_3, LIN_0_LIN_TX_6, TCPWM_0_LINE_40, TCPWM_0_LINE_COMPL_39, TCPWM_0_TR_ONE_CNT_IN_120, TCPWM_0_TR_ONE_CNT_IN_118, PASS_0_SAR_EXT_MUX_SEL_4, TCPWM_0_LINE_41, TCPWM_0_LINE_COMPL_40, TCPWM_0_TR_ONE_CNT_IN_123, TCPWM_0_TR_ONE_CNT_IN_121, PASS_0_SAR_EXT_MUX_SEL_5, TCPWM_0_LINE_42, TCPWM_0_LINE_COMPL_41, TCPWM_0_TR_ONE_CNT_IN_126, TCPWM_0_TR_ONE_CNT_IN_124, TCPWM_0_LINE_43, TCPWM_0_LINE_COMPL_42, TCPWM_0_TR_ONE_CNT_IN_129, TCPWM_0_TR_ONE_CNT_IN_127, TCPWM_0_LINE_264, TCPWM_0_LINE_COMPL_43, TCPWM_0_TR_ONE_CNT_IN_792, TCPWM_0_TR_ONE_CNT_IN_130, PASS_0_SAR_EXT_MUX_SEL_6, SCB_3_UART_RX, SCB_3_SPI_MISO, TCPWM_0_LINE_44, TCPWM_0_LINE_COMPL_264, TCPWM_0_TR_ONE_CNT_IN_132, TCPWM_0_TR_ONE_CNT_IN_793, PASS_0_SAR_EXT_MUX_SEL_7, SCB_3_UART_TX, SCB_3_I2C_SDA, SCB_3_SPI_MOSI, TCPWM_0_LINE_265, TCPWM_0_LINE_COMPL_44, TCPWM_0_TR_ONE_CNT_IN_795, TCPWM_0_TR_ONE_CNT_IN_133, PASS_0_SAR_EXT_MUX_SEL_8, SCB_3_UART_RTS, SCB_3_I2C_SCL, SCB_3_SPI_CLK, TCPWM_0_LINE_45, TCPWM_0_LINE_COMPL_265, TCPWM_0_TR_ONE_CNT_IN_135, TCPWM_0_TR_ONE_CNT_IN_796, PASS_0_SAR_EXT_MUX_EN_2, SCB_3_UART_CTS, SCB_3_SPI_SELECT0, TCPWM_0_LINE_266, TCPWM_0_LINE_COMPL_45, TCPWM_0_TR_ONE_CNT_IN_798, TCPWM_0_TR_ONE_CNT_IN_136, SCB_3_SPI_SELECT1, TCPWM_0_LINE_46, TCPWM_0_LINE_COMPL_266, TCPWM_0_TR_ONE_CNT_IN_138, TCPWM_0_TR_ONE_CNT_IN_799, SCB_3_SPI_SELECT2, TCPWM_0_LINE_267, TCPWM_0_LINE_COMPL_46, TCPWM_0_TR_ONE_CNT_IN_801, TCPWM_0_TR_ONE_CNT_IN_139, SCB_3_SPI_SELECT3, PERI_TR_IO_INPUT_22, TCPWM_0_LINE_47, TCPWM_0_LINE_COMPL_267, TCPWM_0_TR_ONE_CNT_IN_141, TCPWM_0_TR_ONE_CNT_IN_802, PERI_TR_IO_INPUT_23, TCPWM_0_LINE_48, TCPWM_0_LINE_COMPL_47, TCPWM_0_TR_ONE_CNT_IN_144, TCPWM_0_TR_ONE_CNT_IN_142, SCB_2_UART_RX, SCB_2_SPI_MISO, CANFD_1_TTCAN_TX_0, TCPWM_0_LINE_49, TCPWM_0_LINE_COMPL_48, TCPWM_0_TR_ONE_CNT_IN_147, TCPWM_0_TR_ONE_CNT_IN_145, SCB_2_UART_TX, SCB_2_I2C_SDA, SCB_2_SPI_MOSI, CANFD_1_TTCAN_RX_0, TCPWM_0_LINE_50, TCPWM_0_LINE_COMPL_49, TCPWM_0_TR_ONE_CNT_IN_150, TCPWM_0_TR_ONE_CNT_IN_148, SCB_2_UART_RTS, SCB_2_I2C_SCL, SCB_2_SPI_CLK, TCPWM_0_LINE_51, TCPWM_0_LINE_COMPL_50, TCPWM_0_TR_ONE_CNT_IN_153, TCPWM_0_TR_ONE_CNT_IN_151, SCB_2_UART_CTS, SCB_2_SPI_SELECT0, TCPWM_0_LINE_52, TCPWM_0_LINE_COMPL_51, TCPWM_0_TR_ONE_CNT_IN_156, TCPWM_0_TR_ONE_CNT_IN_154, SCB_2_SPI_SELECT1, TCPWM_0_LINE_53, TCPWM_0_LINE_COMPL_52, TCPWM_0_TR_ONE_CNT_IN_159, TCPWM_0_TR_ONE_CNT_IN_157, SCB_2_SPI_SELECT2, TCPWM_0_LINE_54, TCPWM_0_LINE_COMPL_53, TCPWM_0_TR_ONE_CNT_IN_162, TCPWM_0_TR_ONE_CNT_IN_160, PERI_TR_IO_INPUT_24, TCPWM_0_LINE_55, TCPWM_0_LINE_COMPL_54, TCPWM_0_TR_ONE_CNT_IN_165, TCPWM_0_TR_ONE_CNT_IN_163, PERI_TR_IO_INPUT_25, TCPWM_0_LINE_56, TCPWM_0_LINE_COMPL_55, TCPWM_0_TR_ONE_CNT_IN_168, TCPWM_0_TR_ONE_CNT_IN_166, TCPWM_0_LINE_57, TCPWM_0_LINE_COMPL_56, TCPWM_0_TR_ONE_CNT_IN_171, TCPWM_0_TR_ONE_CNT_IN_169, TCPWM_0_LINE_58, TCPWM_0_LINE_COMPL_57, TCPWM_0_TR_ONE_CNT_IN_174, TCPWM_0_TR_ONE_CNT_IN_172, TCPWM_0_LINE_59, TCPWM_0_LINE_COMPL_58, TCPWM_0_TR_ONE_CNT_IN_177, TCPWM_0_TR_ONE_CNT_IN_175, TCPWM_0_LINE_60, TCPWM_0_LINE_COMPL_59, TCPWM_0_TR_ONE_CNT_IN_180, TCPWM_0_TR_ONE_CNT_IN_178, TCPWM_0_LINE_512, TCPWM_0_LINE_61, TCPWM_0_LINE_COMPL_60, TCPWM_0_TR_ONE_CNT_IN_183, TCPWM_0_TR_ONE_CNT_IN_181, TCPWM_0_LINE_COMPL_512, TCPWM_0_LINE_62, TCPWM_0_LINE_COMPL_61, TCPWM_0_TR_ONE_CNT_IN_186, TCPWM_0_TR_ONE_CNT_IN_184, TCPWM_0_LINE_513, TCPWM_0_LINE_COMPL_62, TCPWM_0_TR_ONE_CNT_IN_187, TCPWM_0_LINE_COMPL_513, CANFD_1_TTCAN_TX_1, TCPWM_0_LINE_514, CANFD_1_TTCAN_RX_1, TCPWM_0_LINE_COMPL_514, TCPWM_0_LINE_515, PERI_TR_IO_INPUT_26, TCPWM_0_LINE_COMPL_515, PERI_TR_IO_INPUT_27, SCB_1_UART_RX, SCB_1_SPI_MISO, CPUSS_FAULT_OUT_0, SCB_1_UART_TX, SCB_1_I2C_SDA, SCB_1_SPI_MOSI, CPUSS_FAULT_OUT_1, SCB_1_UART_RTS, SCB_1_I2C_SCL, SCB_1_SPI_CLK, SCB_1_UART_CTS, SCB_1_SPI_SELECT0, CPUSS_TRACE_CLOCK, SCB_1_SPI_SELECT1, CPUSS_TRACE_DATA_0, SCB_1_SPI_SELECT2, CPUSS_TRACE_DATA_1, SCB_1_SPI_SELECT3, CANFD_1_TTCAN_TX_2, CPUSS_TRACE_DATA_2, CANFD_1_TTCAN_RX_2, CPUSS_TRACE_DATA_3, TCPWM_0_TR_ONE_CNT_IN_1536, CPUSS_FAULT_OUT_2, TCPWM_0_TR_ONE_CNT_IN_1537, CPUSS_FAULT_OUT_3, TCPWM_0_TR_ONE_CNT_IN_1539, PERI_TR_IO_INPUT_28, TCPWM_0_TR_ONE_CNT_IN_1540, PERI_TR_IO_INPUT_29, TCPWM_0_TR_ONE_CNT_IN_1542, TCPWM_0_TR_ONE_CNT_IN_1543, TCPWM_0_TR_ONE_CNT_IN_1545, TCPWM_0_TR_ONE_CNT_IN_1546, SRSS_EXT_CLK, SRSS_DDFT_PIN_IN_1, CPUSS_CLK_FM_PUMP, SRSS_CAL_WAVE, PERI_TR_IO_INPUT_30, PERI_TR_IO_INPUT_31, CPUSS_SWJ_SWO_TDO, SRSS_DDFT_PIN_IN_0, CPUSS_SWJ_SWCLK_TCLK, CPUSS_SWJ_SWDIO_TMS, CPUSS_SWJ_SWDOE_TDI, TCPWM_0_LINE_516, TCPWM_0_LINE_517, TCPWM_0_LINE_518, TCPWM_0_LINE_519, TCPWM_0_TR_ONE_CNT_IN_1548, TCPWM_0_TR_ONE_CNT_IN_1551, TCPWM_0_TR_ONE_CNT_IN_1554, TCPWM_0_TR_ONE_CNT_IN_1557, TCPWM_0_LINE_COMPL_516, TCPWM_0_LINE_COMPL_517, TCPWM_0_LINE_COMPL_518, TCPWM_0_LINE_COMPL_519, TCPWM_0_TR_ONE_CNT_IN_1549, TCPWM_0_TR_ONE_CNT_IN_1552, TCPWM_0_TR_ONE_CNT_IN_1555, TCPWM_0_TR_ONE_CNT_IN_1558, CXPI_0_CXPI_RX_0, CXPI_0_CXPI_TX_0, CXPI_0_CXPI_EN_0, CXPI_0_CXPI_RX_1, CXPI_0_CXPI_TX_1, CXPI_0_CXPI_EN_1, LIN_0_LIN_RX_9, LIN_0_LIN_TX_9, LIN_0_LIN_EN_9, LIN_0_LIN_RX_8, LIN_0_LIN_TX_8, LIN_0_LIN_EN_8, CXPI_0_CXPI_RX_2, CXPI_0_CXPI_TX_2, CXPI_0_CXPI_EN_2, CANFD_1_TTCAN_TX_3, CANFD_1_TTCAN_RX_3, CANFD_0_TTCAN_TX_3, CANFD_0_TTCAN_RX_3, CXPI_0_CXPI_RX_3, CXPI_0_CXPI_TX_3, CXPI_0_CXPI_EN_3, LIN_0_LIN_RX_10, LIN_0_LIN_TX_10, LIN_0_LIN_EN_10, LIN_0_LIN_RX_11, LIN_0_LIN_TX_11, LIN_0_LIN_EN_11, TCPWM_1_LINE_18, TCPWM_1_LINE_COMPL_22, TCPWM_1_TR_ONE_CNT_IN_54, TCPWM_1_TR_ONE_CNT_IN_67, TCPWM_1_LINE_17, TCPWM_1_LINE_COMPL_18, TCPWM_1_TR_ONE_CNT_IN_51, TCPWM_1_TR_ONE_CNT_IN_55, TCPWM_1_LINE_14, TCPWM_1_LINE_COMPL_17, TCPWM_1_TR_ONE_CNT_IN_42, TCPWM_1_TR_ONE_CNT_IN_52, TCPWM_1_LINE_13, TCPWM_1_LINE_COMPL_14, TCPWM_1_TR_ONE_CNT_IN_39, TCPWM_1_TR_ONE_CNT_IN_43, TCPWM_1_LINE_12, TCPWM_1_LINE_516, TCPWM_1_LINE_COMPL_13, TCPWM_1_TR_ONE_CNT_IN_36, TCPWM_1_TR_ONE_CNT_IN_40, TCPWM_1_LINE_11, TCPWM_1_LINE_517, TCPWM_1_LINE_COMPL_12, TCPWM_1_TR_ONE_CNT_IN_33, TCPWM_1_TR_ONE_CNT_IN_37, TCPWM_1_LINE_10, TCPWM_1_LINE_518, TCPWM_1_LINE_COMPL_11, TCPWM_1_TR_ONE_CNT_IN_30, TCPWM_1_TR_ONE_CNT_IN_34, TCPWM_1_LINE_8, TCPWM_1_LINE_519, TCPWM_1_LINE_COMPL_10, TCPWM_1_TR_ONE_CNT_IN_24, TCPWM_1_TR_ONE_CNT_IN_31, SCB_8_SPI_MISO, SCB_8_UART_RX, TCPWM_1_LINE_71, TCPWM_1_LINE_COMPL_70, TCPWM_1_TR_ONE_CNT_IN_211, TCPWM_1_TR_ONE_CNT_IN_213, SCB_8_I2C_SDA, SCB_8_SPI_MOSI, SCB_8_UART_TX, SCB_8_I2C_SCL, SCB_8_SPI_CLK, SCB_8_UART_RTS, TCPWM_1_LINE_7, TCPWM_1_LINE_COMPL_8, TCPWM_1_TR_ONE_CNT_IN_21, TCPWM_1_TR_ONE_CNT_IN_25, TCPWM_1_TR_ONE_CNT_IN_1548, TCPWM_1_LINE_6, TCPWM_1_LINE_COMPL_7, TCPWM_1_TR_ONE_CNT_IN_18, TCPWM_1_TR_ONE_CNT_IN_22, TCPWM_1_TR_ONE_CNT_IN_1551, ETH_0_RX_ER, TCPWM_1_LINE_5, TCPWM_1_LINE_COMPL_6, TCPWM_1_TR_ONE_CNT_IN_15, TCPWM_1_TR_ONE_CNT_IN_19, TCPWM_1_TR_ONE_CNT_IN_1554, ETH_0_ETH_TSU_TIMER_CMP_VAL, SRSS_IO_CLK_HF_5, TCPWM_1_LINE_4, TCPWM_1_LINE_COMPL_5, TCPWM_1_TR_ONE_CNT_IN_12, TCPWM_1_TR_ONE_CNT_IN_16, TCPWM_1_TR_ONE_CNT_IN_1557, TCPWM_1_LINE_3, TCPWM_1_LINE_COMPL_4, TCPWM_1_LINE_COMPL_516, TCPWM_1_TR_ONE_CNT_IN_9, TCPWM_1_TR_ONE_CNT_IN_13, TCPWM_1_LINE_2, TCPWM_1_LINE_COMPL_3, TCPWM_1_LINE_COMPL_517, TCPWM_1_TR_ONE_CNT_IN_6, TCPWM_1_TR_ONE_CNT_IN_10, SCB_8_SPI_SELECT0, SCB_8_UART_CTS, TCPWM_1_LINE_72, TCPWM_1_LINE_COMPL_71, TCPWM_1_TR_ONE_CNT_IN_214, TCPWM_1_TR_ONE_CNT_IN_216, SCB_8_SPI_SELECT1, TCPWM_1_LINE_73, TCPWM_1_LINE_COMPL_72, TCPWM_1_TR_ONE_CNT_IN_217, TCPWM_1_TR_ONE_CNT_IN_219, ETH_0_MDIO, TCPWM_1_LINE_1, TCPWM_1_LINE_COMPL_2, TCPWM_1_LINE_COMPL_518, TCPWM_1_TR_ONE_CNT_IN_3, TCPWM_1_TR_ONE_CNT_IN_7, ETH_0_MDC, TCPWM_1_LINE_0, TCPWM_1_LINE_COMPL_1, TCPWM_1_LINE_COMPL_519, TCPWM_1_TR_ONE_CNT_IN_0, TCPWM_1_TR_ONE_CNT_IN_4, TCPWM_1_LINE_259, TCPWM_1_LINE_COMPL_0, TCPWM_1_TR_ONE_CNT_IN_1, TCPWM_1_TR_ONE_CNT_IN_777, TCPWM_1_TR_ONE_CNT_IN_1549, TCPWM_1_LINE_258, TCPWM_1_LINE_COMPL_259, TCPWM_1_TR_ONE_CNT_IN_774, TCPWM_1_TR_ONE_CNT_IN_778, TCPWM_1_TR_ONE_CNT_IN_1552, TCPWM_1_LINE_257, TCPWM_1_LINE_COMPL_258, TCPWM_1_TR_ONE_CNT_IN_771, TCPWM_1_TR_ONE_CNT_IN_775, TCPWM_1_TR_ONE_CNT_IN_1555, TCPWM_1_LINE_256, TCPWM_1_LINE_COMPL_257, TCPWM_1_TR_ONE_CNT_IN_768, TCPWM_1_TR_ONE_CNT_IN_772, TCPWM_1_TR_ONE_CNT_IN_1558, SCB_8_SPI_SELECT2, TCPWM_1_LINE_74, TCPWM_1_LINE_COMPL_73, TCPWM_1_TR_ONE_CNT_IN_220, TCPWM_1_TR_ONE_CNT_IN_222, TCPWM_1_LINE_75, TCPWM_1_LINE_COMPL_74, TCPWM_1_TR_ONE_CNT_IN_223, TCPWM_1_TR_ONE_CNT_IN_225, TCPWM_1_LINE_COMPL_256, TCPWM_1_TR_ONE_CNT_IN_769, LIN_0_LIN_RX_15, PERI_TR_IO_INPUT_32, SCB_9_SPI_MISO, SCB_9_UART_RX, PERI_TR_IO_INPUT_33, SCB_9_I2C_SDA, SCB_9_SPI_MOSI, SCB_9_UART_TX, LIN_0_LIN_TX_15, PERI_TR_IO_INPUT_38, TCPWM_1_LINE_9, TCPWM_1_LINE_522, TCPWM_1_TR_ONE_CNT_IN_27, PERI_TR_IO_INPUT_39, SCB_9_SPI_SELECT3, TCPWM_1_LINE_COMPL_9, TCPWM_1_LINE_COMPL_522, TCPWM_1_TR_ONE_CNT_IN_28, TCPWM_1_TR_ONE_CNT_IN_1566, TCPWM_1_TR_ONE_CNT_IN_1567, TCPWM_1_LINE_523, TCPWM_1_LINE_COMPL_523, TCPWM_1_TR_ONE_CNT_IN_1569, TCPWM_1_TR_ONE_CNT_IN_1570, SDHC_0_CARD_MECH_WRITE_PROT, TCPWM_1_LINE_524, SDHC_0_CARD_CMD, SMIF_0_SPIHB_CLK, TCPWM_1_LINE_COMPL_524, SDHC_0_CLK_CARD, SMIF_0_SPIHB_RWDS, TCPWM_1_TR_ONE_CNT_IN_1572, SDHC_0_CARD_DETECT_N, SMIF_0_SPIHB_SELECT0, TCPWM_1_TR_ONE_CNT_IN_1573, SDHC_0_CARD_IF_PWR_EN, SMIF_0_SPIHB_SELECT1, TCPWM_1_LINE_260, TCPWM_1_TR_ONE_CNT_IN_780, SDHC_0_CARD_DAT_3TO0_0, SMIF_0_SPIHB_DATA0, TCPWM_1_LINE_15, TCPWM_1_LINE_COMPL_260, TCPWM_1_TR_ONE_CNT_IN_45, TCPWM_1_TR_ONE_CNT_IN_781, SDHC_0_CARD_DAT_3TO0_1, SMIF_0_SPIHB_DATA1, TCPWM_1_LINE_261, TCPWM_1_LINE_COMPL_15, TCPWM_1_TR_ONE_CNT_IN_46, TCPWM_1_TR_ONE_CNT_IN_783, CANFD_0_TTCAN_TX_4, SDHC_0_CARD_DAT_3TO0_2, SMIF_0_SPIHB_DATA2, TCPWM_1_LINE_16, TCPWM_1_LINE_COMPL_261, TCPWM_1_TR_ONE_CNT_IN_48, TCPWM_1_TR_ONE_CNT_IN_784, CANFD_0_TTCAN_RX_4, SDHC_0_CARD_DAT_3TO0_3, SMIF_0_SPIHB_DATA3, TCPWM_1_LINE_262, TCPWM_1_LINE_COMPL_16, TCPWM_1_TR_ONE_CNT_IN_49, TCPWM_1_TR_ONE_CNT_IN_786, SDHC_0_CARD_DAT_7TO4_0, SMIF_0_SPIHB_DATA4, TCPWM_1_LINE_COMPL_262, TCPWM_1_TR_ONE_CNT_IN_787, TCPWM_1_LINE_263, TCPWM_1_TR_ONE_CNT_IN_789, TCPWM_1_LINE_COMPL_263, TCPWM_1_TR_ONE_CNT_IN_790, SDHC_0_CARD_DAT_7TO4_1, SMIF_0_SPIHB_DATA5, TCPWM_1_LINE_19, TCPWM_1_LINE_520, TCPWM_1_TR_ONE_CNT_IN_57, SDHC_0_CARD_DAT_7TO4_2, SMIF_0_SPIHB_DATA6, TCPWM_1_LINE_20, TCPWM_1_LINE_COMPL_19, TCPWM_1_LINE_COMPL_520, TCPWM_1_TR_ONE_CNT_IN_58, TCPWM_1_TR_ONE_CNT_IN_60, SDHC_0_CARD_DAT_7TO4_3, SMIF_0_SPIHB_DATA7, TCPWM_1_LINE_21, TCPWM_1_LINE_COMPL_20, TCPWM_1_TR_ONE_CNT_IN_61, TCPWM_1_TR_ONE_CNT_IN_63, TCPWM_1_TR_ONE_CNT_IN_1560, LIN_0_LIN_RX_16, TCPWM_1_LINE_22, TCPWM_1_LINE_COMPL_21, TCPWM_1_TR_ONE_CNT_IN_64, TCPWM_1_TR_ONE_CNT_IN_66, TCPWM_1_TR_ONE_CNT_IN_1561, LIN_0_LIN_TX_16, TCPWM_1_LINE_23, TCPWM_1_TR_ONE_CNT_IN_69, LIN_0_LIN_EN_16, TCPWM_1_LINE_24, TCPWM_1_LINE_521, TCPWM_1_LINE_COMPL_23, TCPWM_1_TR_ONE_CNT_IN_70, TCPWM_1_TR_ONE_CNT_IN_72, LIN_0_LIN_RX_12, TCPWM_1_LINE_25, TCPWM_1_LINE_COMPL_24, TCPWM_1_LINE_COMPL_521, TCPWM_1_TR_ONE_CNT_IN_73, TCPWM_1_TR_ONE_CNT_IN_75, LIN_0_LIN_TX_12, TCPWM_1_LINE_26, TCPWM_1_LINE_COMPL_25, TCPWM_1_TR_ONE_CNT_IN_76, TCPWM_1_TR_ONE_CNT_IN_78, TCPWM_1_TR_ONE_CNT_IN_1563, LIN_0_LIN_EN_12, TCPWM_1_LINE_27, TCPWM_1_LINE_COMPL_26, TCPWM_1_TR_ONE_CNT_IN_79, TCPWM_1_TR_ONE_CNT_IN_81, TCPWM_1_TR_ONE_CNT_IN_1564, TCPWM_1_LINE_28, TCPWM_1_LINE_COMPL_27, TCPWM_1_TR_ONE_CNT_IN_82, TCPWM_1_TR_ONE_CNT_IN_84, TCPWM_1_LINE_29, TCPWM_1_LINE_COMPL_28, TCPWM_1_TR_ONE_CNT_IN_85, TCPWM_1_TR_ONE_CNT_IN_87, TCPWM_1_LINE_30, TCPWM_1_LINE_COMPL_29, TCPWM_1_TR_ONE_CNT_IN_88, TCPWM_1_TR_ONE_CNT_IN_90, TCPWM_1_LINE_31, TCPWM_1_LINE_COMPL_30, TCPWM_1_TR_ONE_CNT_IN_91, TCPWM_1_TR_ONE_CNT_IN_93, TCPWM_1_LINE_32, TCPWM_1_LINE_COMPL_31, TCPWM_1_TR_ONE_CNT_IN_94, TCPWM_1_TR_ONE_CNT_IN_96, LIN_0_LIN_RX_13, TCPWM_1_LINE_33, TCPWM_1_LINE_COMPL_32, TCPWM_1_TR_ONE_CNT_IN_97, TCPWM_1_TR_ONE_CNT_IN_99, LIN_0_LIN_TX_13, TCPWM_1_LINE_34, TCPWM_1_LINE_COMPL_33, TCPWM_1_TR_ONE_CNT_IN_100, TCPWM_1_TR_ONE_CNT_IN_102, LIN_0_LIN_EN_13, TCPWM_1_LINE_35, TCPWM_1_LINE_COMPL_34, TCPWM_1_TR_ONE_CNT_IN_103, TCPWM_1_TR_ONE_CNT_IN_105, AUDIOSS_0_MCLK, TCPWM_1_LINE_61, TCPWM_1_LINE_COMPL_62, TCPWM_1_TR_ONE_CNT_IN_183, TCPWM_1_TR_ONE_CNT_IN_187, AUDIOSS_0_TX_SCK, TCPWM_1_LINE_60, TCPWM_1_LINE_COMPL_61, TCPWM_1_TR_ONE_CNT_IN_180, TCPWM_1_TR_ONE_CNT_IN_184, AUDIOSS_0_TX_WS, TCPWM_1_LINE_59, TCPWM_1_LINE_COMPL_60, TCPWM_1_TR_ONE_CNT_IN_177, TCPWM_1_TR_ONE_CNT_IN_181, AUDIOSS_0_TX_SDO, TCPWM_1_LINE_36, TCPWM_1_LINE_COMPL_35, TCPWM_1_TR_ONE_CNT_IN_106, TCPWM_1_TR_ONE_CNT_IN_108, AUDIOSS_0_CLK_I2S_IF, TCPWM_1_LINE_37, TCPWM_1_LINE_COMPL_36, TCPWM_1_TR_ONE_CNT_IN_109, TCPWM_1_TR_ONE_CNT_IN_111, AUDIOSS_0_RX_SCK, TCPWM_1_LINE_38, TCPWM_1_LINE_COMPL_37, TCPWM_1_TR_ONE_CNT_IN_112, TCPWM_1_TR_ONE_CNT_IN_114, AUDIOSS_0_RX_WS, TCPWM_1_LINE_39, TCPWM_1_LINE_COMPL_38, TCPWM_1_TR_ONE_CNT_IN_115, TCPWM_1_TR_ONE_CNT_IN_117, AUDIOSS_0_RX_SDI, TCPWM_1_LINE_40, TCPWM_1_LINE_COMPL_39, TCPWM_1_TR_ONE_CNT_IN_118, TCPWM_1_TR_ONE_CNT_IN_120, TCPWM_1_LINE_41, TCPWM_1_LINE_COMPL_40, TCPWM_1_TR_ONE_CNT_IN_121, TCPWM_1_TR_ONE_CNT_IN_123, TCPWM_1_LINE_42, TCPWM_1_LINE_COMPL_41, TCPWM_1_TR_ONE_CNT_IN_124, TCPWM_1_TR_ONE_CNT_IN_126, TCPWM_1_LINE_43, TCPWM_1_LINE_COMPL_42, TCPWM_1_TR_ONE_CNT_IN_127, TCPWM_1_TR_ONE_CNT_IN_129, AUDIOSS_1_MCLK, TCPWM_1_LINE_264, TCPWM_1_LINE_COMPL_43, TCPWM_1_TR_ONE_CNT_IN_130, TCPWM_1_TR_ONE_CNT_IN_792, AUDIOSS_1_TX_SCK, TCPWM_1_LINE_44, TCPWM_1_LINE_COMPL_264, TCPWM_1_TR_ONE_CNT_IN_132, TCPWM_1_TR_ONE_CNT_IN_793, AUDIOSS_1_TX_WS, TCPWM_1_LINE_265, TCPWM_1_LINE_COMPL_44, TCPWM_1_TR_ONE_CNT_IN_133, TCPWM_1_TR_ONE_CNT_IN_795, AUDIOSS_1_TX_SDO, TCPWM_1_LINE_45, TCPWM_1_LINE_COMPL_265, TCPWM_1_TR_ONE_CNT_IN_135, TCPWM_1_TR_ONE_CNT_IN_796, AUDIOSS_1_CLK_I2S_IF, TCPWM_1_LINE_266, TCPWM_1_LINE_COMPL_45, TCPWM_1_TR_ONE_CNT_IN_136, TCPWM_1_TR_ONE_CNT_IN_798, AUDIOSS_1_RX_SCK, TCPWM_1_LINE_46, TCPWM_1_LINE_COMPL_266, TCPWM_1_TR_ONE_CNT_IN_138, TCPWM_1_TR_ONE_CNT_IN_799, AUDIOSS_1_RX_WS, TCPWM_1_LINE_267, TCPWM_1_LINE_COMPL_46, TCPWM_1_TR_ONE_CNT_IN_139, TCPWM_1_TR_ONE_CNT_IN_801, AUDIOSS_1_RX_SDI, TCPWM_1_LINE_47, TCPWM_1_LINE_COMPL_267, TCPWM_1_TR_ONE_CNT_IN_141, TCPWM_1_TR_ONE_CNT_IN_802, AUDIOSS_2_MCLK, TCPWM_1_LINE_48, TCPWM_1_LINE_COMPL_47, TCPWM_1_TR_ONE_CNT_IN_142, TCPWM_1_TR_ONE_CNT_IN_144, AUDIOSS_2_TX_SCK, TCPWM_1_LINE_49, TCPWM_1_LINE_COMPL_48, TCPWM_1_TR_ONE_CNT_IN_145, TCPWM_1_TR_ONE_CNT_IN_147, TCPWM_1_LINE_50, TCPWM_1_LINE_COMPL_49, TCPWM_1_TR_ONE_CNT_IN_148, TCPWM_1_TR_ONE_CNT_IN_150, TCPWM_1_LINE_51, TCPWM_1_LINE_COMPL_50, TCPWM_1_TR_ONE_CNT_IN_151, TCPWM_1_TR_ONE_CNT_IN_153, AUDIOSS_2_TX_WS, TCPWM_1_LINE_52, TCPWM_1_LINE_COMPL_51, TCPWM_1_TR_ONE_CNT_IN_154, TCPWM_1_TR_ONE_CNT_IN_156, AUDIOSS_2_TX_SDO, LIN_0_LIN_RX_14, TCPWM_1_LINE_53, TCPWM_1_LINE_COMPL_52, TCPWM_1_TR_ONE_CNT_IN_157, TCPWM_1_TR_ONE_CNT_IN_159, LIN_0_LIN_TX_14, TCPWM_1_LINE_54, TCPWM_1_LINE_COMPL_53, TCPWM_1_TR_ONE_CNT_IN_160, TCPWM_1_TR_ONE_CNT_IN_162, LIN_0_LIN_EN_14, TCPWM_1_LINE_55, TCPWM_1_LINE_COMPL_54, TCPWM_1_TR_ONE_CNT_IN_163, TCPWM_1_TR_ONE_CNT_IN_165, AUDIOSS_2_CLK_I2S_IF, TCPWM_1_LINE_56, TCPWM_1_LINE_COMPL_55, TCPWM_1_TR_ONE_CNT_IN_166, TCPWM_1_TR_ONE_CNT_IN_168, AUDIOSS_2_RX_SCK, TCPWM_1_LINE_57, TCPWM_1_LINE_COMPL_56, TCPWM_1_TR_ONE_CNT_IN_169, TCPWM_1_TR_ONE_CNT_IN_171, AUDIOSS_2_RX_WS, SCB_9_I2C_SCL, SCB_9_SPI_CLK, SCB_9_UART_RTS, TCPWM_1_LINE_58, TCPWM_1_LINE_COMPL_57, TCPWM_1_TR_ONE_CNT_IN_172, TCPWM_1_TR_ONE_CNT_IN_174, AUDIOSS_2_RX_SDI, SCB_9_SPI_SELECT0, SCB_9_UART_CTS, TCPWM_1_LINE_COMPL_58, TCPWM_1_TR_ONE_CNT_IN_175, SCB_9_SPI_SELECT1, TCPWM_1_LINE_512, TCPWM_1_LINE_COMPL_59, TCPWM_1_TR_ONE_CNT_IN_178, SCB_9_SPI_SELECT2, TCPWM_1_LINE_COMPL_512, TCPWM_1_LINE_62, TCPWM_1_LINE_513, TCPWM_1_TR_ONE_CNT_IN_186, TCPWM_1_LINE_COMPL_513, TCPWM_1_LINE_68, TCPWM_1_LINE_COMPL_69, TCPWM_1_TR_ONE_CNT_IN_204, TCPWM_1_TR_ONE_CNT_IN_208, TCPWM_1_LINE_67, TCPWM_1_LINE_COMPL_68, TCPWM_1_TR_ONE_CNT_IN_201, TCPWM_1_TR_ONE_CNT_IN_205, TCPWM_1_LINE_66, TCPWM_1_LINE_COMPL_67, TCPWM_1_TR_ONE_CNT_IN_198, TCPWM_1_TR_ONE_CNT_IN_202, TCPWM_1_LINE_65, TCPWM_1_LINE_COMPL_66, TCPWM_1_TR_ONE_CNT_IN_195, TCPWM_1_TR_ONE_CNT_IN_199, TCPWM_1_LINE_515, TCPWM_1_LINE_COMPL_515, TCPWM_1_LINE_514, TCPWM_1_LINE_COMPL_514, LIN_0_LIN_EN_15, ETH_0_REF_CLK, ETH_0_TX_CTL, ETH_0_TX_ER, ETH_0_TX_CLK, ETH_0_TXD_0, ETH_0_TXD_2, ETH_0_TXD_3, ETH_0_RXD_0, TCPWM_1_TR_ONE_CNT_IN_1536, TCPWM_1_TR_ONE_CNT_IN_1537, ETH_0_RXD_2, TCPWM_1_TR_ONE_CNT_IN_1539, ETH_0_RXD_3, TCPWM_1_TR_ONE_CNT_IN_1540, TCPWM_1_TR_ONE_CNT_IN_1542, TCPWM_1_TR_ONE_CNT_IN_1543, TCPWM_1_TR_ONE_CNT_IN_1545, TCPWM_1_TR_ONE_CNT_IN_1546, CANFD_1_TTCAN_TX_4, CANFD_1_TTCAN_RX_4, ETH_0_RX_CTL, ETH_0_RX_CLK, SRSS_DDFT_CLK_DIRECT, ETH_1_TXD_0, ETH_1_TXD_2, ETH_1_TXD_3, ETH_1_RXD_0, ETH_1_RXD_2, ETH_1_RXD_3, SCB_10_SPI_MISO, SCB_10_UART_RX, TCPWM_1_LINE_63, TCPWM_1_LINE_COMPL_65, TCPWM_1_TR_ONE_CNT_IN_189, TCPWM_1_TR_ONE_CNT_IN_196, LIN_0_LIN_RX_17, SCB_10_I2C_SDA, SCB_10_SPI_MOSI, SCB_10_UART_TX, TCPWM_1_LINE_64, TCPWM_1_LINE_COMPL_63, TCPWM_1_TR_ONE_CNT_IN_190, TCPWM_1_TR_ONE_CNT_IN_192, LIN_0_LIN_TX_17, SCB_10_I2C_SCL, SCB_10_SPI_CLK, SCB_10_UART_RTS, TCPWM_1_LINE_COMPL_64, TCPWM_1_TR_ONE_CNT_IN_193, LIN_0_LIN_EN_17, SCB_10_SPI_SELECT0, SCB_10_UART_CTS, LIN_0_LIN_RX_18, SCB_10_SPI_SELECT1, LIN_0_LIN_TX_18, SCB_10_SPI_SELECT2, LIN_0_LIN_EN_18, SCB_10_SPI_SELECT3, TCPWM_1_LINE_69, TCPWM_1_TR_ONE_CNT_IN_207, LIN_0_LIN_RX_19, TCPWM_1_LINE_70, TCPWM_1_TR_ONE_CNT_IN_210, LIN_0_LIN_TX_19, TCPWM_1_LINE_76, TCPWM_1_LINE_COMPL_75, TCPWM_1_TR_ONE_CNT_IN_226, TCPWM_1_TR_ONE_CNT_IN_228, LIN_0_LIN_EN_19, TCPWM_1_LINE_77, TCPWM_1_LINE_COMPL_76, TCPWM_1_TR_ONE_CNT_IN_229, TCPWM_1_TR_ONE_CNT_IN_231, TCPWM_1_LINE_78, TCPWM_1_LINE_COMPL_77, TCPWM_1_TR_ONE_CNT_IN_232, TCPWM_1_TR_ONE_CNT_IN_234, TCPWM_1_LINE_79, TCPWM_1_LINE_COMPL_78, TCPWM_1_TR_ONE_CNT_IN_235, TCPWM_1_TR_ONE_CNT_IN_237, TCPWM_1_LINE_80, TCPWM_1_LINE_COMPL_79, TCPWM_1_TR_ONE_CNT_IN_238, TCPWM_1_TR_ONE_CNT_IN_240, TCPWM_1_LINE_81, TCPWM_1_LINE_COMPL_80, TCPWM_1_TR_ONE_CNT_IN_241, TCPWM_1_TR_ONE_CNT_IN_243, TCPWM_1_LINE_82, TCPWM_1_LINE_COMPL_81, TCPWM_1_TR_ONE_CNT_IN_244, TCPWM_1_TR_ONE_CNT_IN_246, TCPWM_1_LINE_83, TCPWM_1_LINE_COMPL_82, TCPWM_1_TR_ONE_CNT_IN_247, TCPWM_1_TR_ONE_CNT_IN_249, PERI_TR_IO_INPUT_34, TCPWM_1_LINE_COMPL_83, TCPWM_1_TR_ONE_CNT_IN_250, PERI_TR_IO_INPUT_35, PERI_TR_IO_INPUT_36, PERI_TR_IO_INPUT_37, PERI_TR_IO_INPUT_40, PERI_TR_IO_INPUT_41, PERI_TR_IO_INPUT_42, PERI_TR_IO_INPUT_43, PERI_TR_IO_INPUT_44, PERI_TR_IO_INPUT_45, PERI_TR_IO_INPUT_46, PERI_TR_IO_INPUT_47, ETH_1_TXD_4, ETH_1_TXD_5, ETH_1_TXD_6, ETH_1_TXD_7, ETH_1_RXD_4, ETH_1_RXD_5, ETH_1_RXD_6, ETH_1_RXD_7, FLEXRAY_0_RXDA, FLEXRAY_0_TXDA, FLEXRAY_0_TXENA_N, FLEXRAY_0_RXDB, FLEXRAY_0_TXDB, FLEXRAY_0_TXENB_N, ETH_0_TXD_1, ETH_0_RXD_1, ETH_1_REF_CLK, ETH_1_TX_CTL, ETH_1_TX_CLK, ETH_1_TXD_1, ETH_1_RXD_1, ETH_1_RX_CTL, ETH_1_RX_CLK, ETH_1_MDIO, ETH_1_MDC, ETH_1_ETH_TSU_TIMER_CMP_VAL, ETH_1_TX_ER, ETH_1_RX_ER, I2S_0_I2S_RX_MCK_0, I2S_0_I2S_RX_MCK_1, I2S_0_I2S_TX_MCK_1, I2S_0_I2S_RX_SCK_0, I2S_0_I2S_RX_SCK_1, I2S_0_I2S_TX_SCK_1, TCPWM_0_TR_ONE_CNT_IN_20, I2S_0_I2S_RX_WS_0, I2S_0_I2S_RX_WS_1, I2S_0_I2S_TX_WS_1, I2S_0_I2S_RX_SD_0, I2S_0_I2S_RX_SD_1, I2S_0_I2S_TX_SD_1, SCB_11_I2C_SDA, SCB_11_SPI_CLK, SCB_11_UART_RX, SCB_11_I2C_SCL, SCB_11_SPI_MOSI, SCB_11_UART_TX, PWM_0_PWM_LINE2_N_1, TCPWM_0_TR_ONE_CNT_IN_26, VIDEOSS_0_TTL_DSP0_DATA_A1_11, SCB_11_SPI_SELECT1, SCB_11_SPI_MISO, SCB_11_UART_RTS, TCPWM_0_TR_ONE_CNT_IN_23, SCB_11_SPI_SELECT0, SCB_11_UART_CTS, PWM_0_PWM_LINE1_P_0, SG_0_SG_AMPL_0, TDM_0_TDM_RX_MCK_0, TDM_0_TDM_RX_MCK_1, TDM_0_TDM_TX_MCK_1, PWM_0_PWM_LINE1_N_0, SG_0_SG_TONE_0, TDM_0_TDM_RX_SCK_0, TDM_0_TDM_RX_SCK_1, TDM_0_TDM_TX_SCK_1, PWM_0_PWM_LINE2_P_0, SG_0_SG_AMPL_1, TDM_0_TDM_RX_FSYNC_0, TDM_0_TDM_RX_FSYNC_1, TDM_0_TDM_TX_FSYNC_1, PWM_0_PWM_LINE2_N_0, SG_0_SG_TONE_1, TCPWM_0_TR_ONE_CNT_IN_29, TDM_0_TDM_RX_SD_0, TDM_0_TDM_RX_SD_1, TDM_0_TDM_TX_SD_1, I2S_0_I2S_RX_MCK_2, I2S_0_I2S_TX_MCK_2, PWM_0_PWM_LINE1_P_1, SG_0_SG_AMPL_2, TDM_0_TDM_RX_MCK_2, TDM_0_TDM_TX_MCK_2, I2S_0_I2S_RX_SCK_2, I2S_0_I2S_TX_SCK_2, PWM_0_PWM_LINE1_N_1, SG_0_SG_TONE_2, TDM_0_TDM_RX_SCK_2, TDM_0_TDM_TX_SCK_2, I2S_0_I2S_RX_WS_2, I2S_0_I2S_TX_WS_2, PWM_0_PWM_LINE2_P_1, SG_0_SG_AMPL_3, TDM_0_TDM_RX_FSYNC_2, TDM_0_TDM_TX_FSYNC_2, I2S_0_I2S_RX_SD_2, I2S_0_I2S_TX_SD_2, SG_0_SG_TONE_3, TDM_0_TDM_RX_SD_2, TDM_0_TDM_TX_SD_2, TCPWM_0_LINE_524, TCPWM_0_LINE_COMPL_529, TCPWM_0_TR_ONE_CNT_IN_528, VIDEOSS_0_TTL_DSP0_DATA_A0_3, TCPWM_0_LINE_525, TCPWM_0_LINE_COMPL_524, TCPWM_0_TR_ONE_CNT_IN_529, VIDEOSS_0_TTL_DSP0_DATA_A1_3, TCPWM_0_LINE_526, TCPWM_0_LINE_COMPL_525, TCPWM_0_TR_ONE_CNT_IN_524, VIDEOSS_0_TTL_DSP0_DATA_A0_4, TCPWM_0_LINE_527, TCPWM_0_LINE_COMPL_526, TCPWM_0_TR_ONE_CNT_IN_525, VIDEOSS_0_TTL_DSP0_DATA_A1_4, TCPWM_0_LINE_528, TCPWM_0_LINE_COMPL_527, TCPWM_0_TR_ONE_CNT_IN_526, VIDEOSS_0_TTL_DSP0_DATA_A0_5, TCPWM_0_LINE_529, TCPWM_0_LINE_COMPL_528, TCPWM_0_TR_ONE_CNT_IN_527, VIDEOSS_0_TTL_DSP0_DATA_A1_5, VIDEOSS_0_TTL_DSP0_DATA_A0_6, VIDEOSS_0_TTL_DSP0_DATA_A1_6, VIDEOSS_0_TTL_DSP0_DATA_A0_7, VIDEOSS_0_TTL_DSP0_DATA_A1_7, VIDEOSS_0_TTL_DSP0_DATA_A0_8, VIDEOSS_0_TTL_DSP0_DATA_A1_8, VIDEOSS_0_TTL_DSP0_DATA_A0_9, VIDEOSS_0_TTL_DSP0_DATA_A1_9, VIDEOSS_0_TTL_DSP0_DATA_A0_10, VIDEOSS_0_TTL_DSP0_DATA_A1_10, TCPWM_0_TR_ONE_CNT_IN_32, VIDEOSS_0_TTL_DSP0_DATA_A0_11, VIDEOSS_0_TTL_DSP0_CONTROL_0, VIDEOSS_0_TTL_DSP0_CONTROL_1, VIDEOSS_0_TTL_DSP0_CONTROL_2, VIDEOSS_0_TTL_DSP0_CLOCK, I2S_0_I2S_RX_MCK_3, I2S_0_I2S_TX_MCK_3, TCPWM_0_TR_ONE_CNT_IN_530, TDM_0_TDM_RX_MCK_3, TDM_0_TDM_TX_MCK_3, VIDEOSS_0_TTL_CAP0_DATA_8, I2S_0_I2S_RX_SCK_3, I2S_0_I2S_TX_SCK_3, TCPWM_0_TR_ONE_CNT_IN_35, TDM_0_TDM_RX_SCK_3, TDM_0_TDM_TX_SCK_3, VIDEOSS_0_TTL_CAP0_DATA_9, I2S_0_I2S_RX_WS_3, I2S_0_I2S_TX_WS_3, TCPWM_0_TR_ONE_CNT_IN_531, TDM_0_TDM_RX_FSYNC_3, TDM_0_TDM_TX_FSYNC_3, VIDEOSS_0_TTL_CAP0_DATA_10, I2S_0_I2S_RX_SD_3, I2S_0_I2S_TX_SD_3, TDM_0_TDM_RX_SD_3, TDM_0_TDM_TX_SD_3, VIDEOSS_0_TTL_CAP0_DATA_11, I2S_0_I2S_TX_MCK_0, TCPWM_0_TR_ONE_CNT_IN_532, TDM_0_TDM_TX_MCK_0, VIDEOSS_0_TTL_CAP0_DATA_12, I2S_0_I2S_TX_SCK_0, TDM_0_TDM_TX_SCK_0, VIDEOSS_0_TTL_CAP0_DATA_13, I2S_0_I2S_TX_WS_0, SG_0_SG_AMPL_4, TCPWM_0_TR_ONE_CNT_IN_533, TDM_0_TDM_TX_FSYNC_0, VIDEOSS_0_TTL_CAP0_DATA_14, I2S_0_I2S_TX_SD_0, SG_0_SG_TONE_4, TCPWM_0_TR_ONE_CNT_IN_534, TDM_0_TDM_TX_SD_0, VIDEOSS_0_TTL_CAP0_DATA_15, TCPWM_0_TR_ONE_CNT_IN_512, VIDEOSS_0_TTL_CAP0_DATA_16, TCPWM_0_TR_ONE_CNT_IN_513, VIDEOSS_0_TTL_CAP0_DATA_17, TCPWM_0_TR_ONE_CNT_IN_514, VIDEOSS_0_TTL_CAP0_DATA_18, TCPWM_0_TR_ONE_CNT_IN_535, VIDEOSS_0_TTL_CAP0_DATA_19, TCPWM_0_TR_ONE_CNT_IN_515, VIDEOSS_0_TTL_CAP0_DATA_20, TCPWM_0_TR_ONE_CNT_IN_536, VIDEOSS_0_TTL_CAP0_DATA_21, TCPWM_0_TR_ONE_CNT_IN_516, VIDEOSS_0_TTL_CAP0_DATA_22, TCPWM_0_TR_ONE_CNT_IN_537, VIDEOSS_0_TTL_CAP0_DATA_23, TCPWM_0_TR_ONE_CNT_IN_517, VIDEOSS_0_TTL_CAP0_DATA_24, TCPWM_0_TR_ONE_CNT_IN_538, VIDEOSS_0_TTL_CAP0_DATA_25, TCPWM_0_TR_ONE_CNT_IN_518, VIDEOSS_0_TTL_CAP0_DATA_26, TCPWM_0_TR_ONE_CNT_IN_539, TCPWM_0_TR_ONE_CNT_IN_519, VIDEOSS_0_TTL_DSP0_DATA_A0_0, TCPWM_0_TR_ONE_CNT_IN_540, VIDEOSS_0_TTL_DSP0_DATA_A1_0, TCPWM_0_TR_ONE_CNT_IN_520, VIDEOSS_0_TTL_DSP0_DATA_A0_1, TCPWM_0_TR_ONE_CNT_IN_541, VIDEOSS_0_TTL_DSP0_DATA_A1_1, TCPWM_0_TR_ONE_CNT_IN_542, VIDEOSS_0_TTL_DSP0_DATA_A0_2, TCPWM_0_TR_ONE_CNT_IN_543, VIDEOSS_0_TTL_DSP0_DATA_A1_2, TCPWM_0_LINE_521, TCPWM_0_LINE_COMPL_523, TCPWM_0_TR_ONE_CNT_IN_522, TCPWM_0_LINE_522, TCPWM_0_LINE_COMPL_521, TCPWM_0_TR_ONE_CNT_IN_523, TCPWM_0_LINE_523, TCPWM_0_LINE_COMPL_522, TCPWM_0_TR_ONE_CNT_IN_521, SG_0_SG_MCK_0, VIDEOSS_0_TTL_CAP0_CLK, SG_0_SG_MCK_1, VIDEOSS_0_TTL_CAP0_DATA_0, SG_0_SG_MCK_2, VIDEOSS_0_TTL_CAP0_DATA_1, SG_0_SG_MCK_3, VIDEOSS_0_TTL_CAP0_DATA_2, SG_0_SG_MCK_4, VIDEOSS_0_TTL_CAP0_DATA_3, PWM_0_PWM_MCK_0, VIDEOSS_0_TTL_CAP0_DATA_4, PWM_0_PWM_MCK_1, VIDEOSS_0_TTL_CAP0_DATA_5, VIDEOSS_0_TTL_CAP0_DATA_6, VIDEOSS_0_TTL_CAP0_DATA_7, VIDEOSS_0_TTL_DSP1_DATA_A0_0, VIDEOSS_0_TTL_DSP1_DATA_A1_0, VIDEOSS_0_TTL_DSP1_DATA_A0_1, VIDEOSS_0_TTL_DSP1_DATA_A1_1, VIDEOSS_0_TTL_DSP1_DATA_A0_2, VIDEOSS_0_TTL_DSP1_DATA_A1_2, VIDEOSS_0_TTL_DSP1_DATA_A0_3, VIDEOSS_0_TTL_DSP1_DATA_A1_3, VIDEOSS_0_TTL_DSP1_DATA_A0_4, VIDEOSS_0_TTL_DSP1_DATA_A1_4, VIDEOSS_0_TTL_DSP1_DATA_A0_5, VIDEOSS_0_TTL_DSP1_DATA_A1_5, VIDEOSS_0_TTL_DSP1_DATA_A0_6, VIDEOSS_0_TTL_DSP1_DATA_A1_6, VIDEOSS_0_TTL_DSP1_DATA_A0_7, VIDEOSS_0_TTL_DSP1_DATA_A1_7, VIDEOSS_0_TTL_DSP1_DATA_A0_8, VIDEOSS_0_TTL_DSP1_DATA_A1_8, VIDEOSS_0_TTL_DSP1_DATA_A0_9, VIDEOSS_0_TTL_DSP1_DATA_A1_9, VIDEOSS_0_TTL_DSP1_DATA_A0_10, VIDEOSS_0_TTL_DSP1_DATA_A1_10, VIDEOSS_0_TTL_DSP1_DATA_A0_11, VIDEOSS_0_TTL_DSP1_DATA_A1_11, VIDEOSS_0_TTL_DSP1_CONTROL_0, VIDEOSS_0_TTL_DSP1_CONTROL_1, VIDEOSS_0_TTL_DSP1_CONTROL_2, VIDEOSS_0_TTL_DSP1_CLOCK, VIDEOSS_0_FPDLINK_CLKREF_GPIO, SMIF_1_SPIHB_DATA4, SMIF_1_SPIHB_DATA2, SMIF_1_SPIHB_DATA3, SMIF_1_SPIHB_DATA5, SMIF_1_SPIHB_RWDS, SMIF_1_SPIHB_CLK, SMIF_1_SPIHB_DATA0, SMIF_1_SPIHB_DATA6, SMIF_1_SPIHB_SELECT0, SMIF_1_SPIHB_DATA1, SMIF_1_SPIHB_DATA7, SMIF_1_SPIHB_SELECT1, DAC_0_DAC_MCK, TCPWM_0_LINE_520, TCPWM_0_LINE_COMPL_520, TCPWM_0_LINE_COMPL_533, TCPWM_0_LINE_530, TCPWM_0_LINE_COMPL_530, TCPWM_0_LINE_531, TCPWM_0_LINE_COMPL_531, TCPWM_0_LINE_532, TCPWM_0_LINE_COMPL_532, TCPWM_0_LINE_533, VIDEOSS_0_TTL_DSP0_CONTROL_11, VIDEOSS_0_TTL_DSP0_CONTROL_10, VIDEOSS_0_TTL_DSP1_CONTROL_10, VIDEOSS_0_TTL_DSP0_CONTROL_9, VIDEOSS_0_TTL_DSP1_CONTROL_9, VIDEOSS_0_TTL_DSP0_CONTROL_8, VIDEOSS_0_TTL_DSP1_CONTROL_8, VIDEOSS_0_TTL_DSP0_CONTROL_7, VIDEOSS_0_TTL_DSP1_CONTROL_7, VIDEOSS_0_TTL_DSP0_CONTROL_6, VIDEOSS_0_TTL_DSP1_CONTROL_6, VIDEOSS_0_TTL_DSP0_CONTROL_5, VIDEOSS_0_TTL_DSP1_CONTROL_5, VIDEOSS_0_TTL_DSP0_CONTROL_4, VIDEOSS_0_TTL_DSP1_CONTROL_4, VIDEOSS_0_TTL_DSP0_CONTROL_3, VIDEOSS_0_TTL_DSP1_CONTROL_3, TCPWM_0_LINE_534, TCPWM_0_LINE_COMPL_543, TCPWM_0_LINE_535, TCPWM_0_LINE_COMPL_534, TCPWM_0_LINE_536, TCPWM_0_LINE_COMPL_535, TCPWM_0_LINE_537, TCPWM_0_LINE_COMPL_536, TCPWM_0_LINE_538, TCPWM_0_LINE_COMPL_537, TCPWM_0_LINE_539, TCPWM_0_LINE_COMPL_538, TCPWM_0_LINE_540, TCPWM_0_LINE_COMPL_539, TCPWM_0_LINE_541, TCPWM_0_LINE_COMPL_540, TCPWM_0_LINE_542, TCPWM_0_LINE_COMPL_541, TCPWM_0_LINE_543, TCPWM_0_LINE_COMPL_542, VIDEOSS_0_TTL_DSP1_CONTROL_11, CPUSS_TRACE_DATA_4, CPUSS_TRACE_DATA_5, CPUSS_TRACE_DATA_6, CPUSS_TRACE_DATA_7, SMIF_0_SMIF0_SPIHB_DATA4, SMIF_0_SMIF0_SPIHB_DATA2, SMIF_0_SMIF0_SPIHB_DATA3, SMIF_0_SMIF0_SPIHB_DATA5, SMIF_0_SMIF0_SPIHB_RWDS, SMIF_0_SMIF0_SPIHB_CLK, SMIF_0_SMIF0_SPIHB_DATA0, SMIF_0_SMIF0_SPIHB_DATA6, SMIF_0_SMIF0_SPIHB_SELECT0, SMIF_0_SMIF0_SPIHB_DATA1, SMIF_0_SMIF0_SPIHB_DATA7, SMIF_0_SMIF0_SPIHB_SELECT1, SMIF_0_SMIF1_SPIHB_DATA4, SMIF_0_SMIF1_SPIHB_DATA2, SMIF_0_SMIF1_SPIHB_DATA3, SMIF_0_SMIF1_SPIHB_DATA5, SMIF_0_SMIF1_SPIHB_RWDS, SMIF_0_SMIF1_SPIHB_CLK, SMIF_0_SMIF1_SPIHB_DATA0, SMIF_0_SMIF1_SPIHB_DATA6, SMIF_0_SMIF1_SPIHB_SELECT0, SMIF_0_SMIF1_SPIHB_DATA1, SMIF_0_SMIF1_SPIHB_DATA7, SMIF_0_SMIF1_SPIHB_SELECT1, SRSS_IO_CLK_HF_2, LCD_COM_0, LCD_COM_1, LCD_COM_2, LCD_COM_3, LCD_COM_4, LCD_COM_5, LCD_COM_6, LCD_COM_7, LCD_COM_8, LCD_COM_9, LCD_COM_10, LCD_COM_11, LCD_COM_12, LCD_COM_13, LCD_COM_14, LCD_COM_15, LCD_COM_16, LCD_COM_17, LCD_COM_18, LCD_COM_19, LCD_COM_20, LCD_COM_21, LCD_COM_22, LCD_COM_23, LCD_COM_24, LCD_COM_25, LCD_COM_26, LCD_COM_27, LCD_COM_28, LCD_COM_29, LCD_COM_30, LCD_COM_31, LCD_COM_32, LCD_COM_33, LCD_COM_34, LCD_COM_35, LCD_SEG_0, LCD_SEG_1, LCD_SEG_2, LCD_SEG_3, LCD_SEG_4, LCD_SEG_5, LCD_SEG_6, LCD_SEG_7, LCD_SEG_8, LCD_SEG_9, LCD_SEG_10, LCD_SEG_11, LCD_SEG_12, LCD_SEG_13, LCD_SEG_14, LCD_SEG_15, LCD_SEG_16, LCD_SEG_17, LCD_SEG_18, LCD_SEG_19, LCD_SEG_20, LCD_SEG_21, LCD_SEG_22, LCD_SEG_23, LCD_SEG_24, LCD_SEG_25, LCD_SEG_26, LCD_SEG_27, LCD_SEG_28, LCD_SEG_29, LCD_SEG_30, LCD_SEG_31, LCD_SEG_32, LCD_SEG_33, LCD_SEG_34, LCD_SEG_35}, post-build-variant-value=true, set at post-build, default-value=GPIO  # Port pin mode from mode list for use with Port_Init() function.
          boolean PortPinModeChangeable: post-build-variant-value=true, set at post-build, default-value=false  # Parameter to indicate if the mode is changeable on a port pin during runtime. true: Port Pin mode changeable allowed. false: Port Pin mode changeable not permitted.
          enumeration PortPinMode [1..*]: {GPIO, AMUXA, AMUXB, AMUXA_DSI, AMUXB_DSI, TCPWM_0_LINE_18, TCPWM_0_LINE_COMPL_22, TCPWM_0_TR_ONE_CNT_IN_54, TCPWM_0_TR_ONE_CNT_IN_67, SCB_0_UART_RX, SCB_7_I2C_SDA, LIN_0_LIN_RX_1, SCB_0_SPI_MISO, TCPWM_0_LINE_17, TCPWM_0_LINE_COMPL_18, TCPWM_0_TR_ONE_CNT_IN_51, TCPWM_0_TR_ONE_CNT_IN_55, SCB_0_UART_TX, SCB_7_I2C_SCL, LIN_0_LIN_TX_1, SCB_0_SPI_MOSI, TCPWM_0_LINE_14, TCPWM_0_LINE_COMPL_17, TCPWM_0_TR_ONE_CNT_IN_42, TCPWM_0_TR_ONE_CNT_IN_52, SCB_0_UART_RTS, LIN_0_LIN_EN_1, CANFD_0_TTCAN_TX_1, SCB_0_I2C_SCL, SCB_0_SPI_CLK, TCPWM_0_LINE_13, TCPWM_0_LINE_COMPL_14, TCPWM_0_TR_ONE_CNT_IN_39, TCPWM_0_TR_ONE_CNT_IN_43, SCB_0_UART_CTS, CANFD_0_TTCAN_RX_1, SCB_0_I2C_SDA, SCB_0_SPI_SELECT0, TCPWM_0_LINE_12, TCPWM_0_LINE_COMPL_13, TCPWM_0_TR_ONE_CNT_IN_36, TCPWM_0_TR_ONE_CNT_IN_40, TCPWM_0_LINE_11, TCPWM_0_LINE_COMPL_12, TCPWM_0_TR_ONE_CNT_IN_33, TCPWM_0_TR_ONE_CNT_IN_37, TCPWM_0_LINE_10, TCPWM_0_LINE_COMPL_11, TCPWM_0_TR_ONE_CNT_IN_30, TCPWM_0_TR_ONE_CNT_IN_34, PERI_TR_IO_INPUT_0, TCPWM_0_LINE_8, TCPWM_0_LINE_COMPL_10, TCPWM_0_TR_ONE_CNT_IN_24, TCPWM_0_TR_ONE_CNT_IN_31, PERI_TR_IO_INPUT_1, TCPWM_0_LINE_7, TCPWM_0_LINE_COMPL_8, TCPWM_0_TR_ONE_CNT_IN_21, TCPWM_0_TR_ONE_CNT_IN_25, SCB_7_UART_RX, SCB_7_SPI_MISO, LIN_0_LIN_RX_0, CANFD_0_TTCAN_TX_0, PERI_TR_IO_INPUT_2, CPUSS_SWJ_TRSTN, SCB_0_SPI_SELECT1, TCPWM_0_LINE_6, TCPWM_0_LINE_COMPL_7, TCPWM_0_TR_ONE_CNT_IN_18, TCPWM_0_TR_ONE_CNT_IN_22, SCB_7_UART_TX, SCB_7_SPI_MOSI, LIN_0_LIN_TX_0, CANFD_0_TTCAN_RX_0, PERI_TR_IO_INPUT_3, SCB_0_SPI_SELECT2, TCPWM_0_LINE_5, TCPWM_0_LINE_COMPL_6, TCPWM_0_TR_ONE_CNT_IN_15, TCPWM_0_TR_ONE_CNT_IN_19, SCB_7_UART_RTS, SCB_7_SPI_CLK, LIN_0_LIN_EN_0, PERI_TR_IO_INPUT_4, SCB_0_SPI_SELECT3, TCPWM_0_LINE_4, TCPWM_0_LINE_COMPL_5, TCPWM_0_TR_ONE_CNT_IN_12, TCPWM_0_TR_ONE_CNT_IN_16, SCB_7_UART_CTS, SCB_7_SPI_SELECT0, LIN_0_LIN_RX_5, PERI_TR_IO_INPUT_5, TCPWM_0_LINE_3, TCPWM_0_LINE_COMPL_4, TCPWM_0_TR_ONE_CNT_IN_9, TCPWM_0_TR_ONE_CNT_IN_13, SCB_7_SPI_SELECT1, LIN_0_LIN_TX_5, PERI_TR_IO_INPUT_6, TCPWM_0_LINE_2, TCPWM_0_LINE_COMPL_3, TCPWM_0_TR_ONE_CNT_IN_6, TCPWM_0_TR_ONE_CNT_IN_10, SCB_7_SPI_SELECT2, LIN_0_LIN_EN_5, PERI_TR_IO_INPUT_7, TCPWM_0_LINE_1, TCPWM_0_LINE_COMPL_2, TCPWM_0_TR_ONE_CNT_IN_3, TCPWM_0_TR_ONE_CNT_IN_7, SCB_6_UART_RX, SCB_6_SPI_MISO, PERI_TR_IO_OUTPUT_0, TCPWM_0_LINE_0, TCPWM_0_LINE_COMPL_1, TCPWM_0_TR_ONE_CNT_IN_0, TCPWM_0_TR_ONE_CNT_IN_4, SCB_6_UART_TX, SCB_6_I2C_SDA, SCB_6_SPI_MOSI, PERI_TR_IO_OUTPUT_1, TCPWM_0_LINE_259, TCPWM_0_LINE_COMPL_0, TCPWM_0_TR_ONE_CNT_IN_777, TCPWM_0_TR_ONE_CNT_IN_1, SCB_6_UART_RTS, SCB_6_I2C_SCL, SCB_6_SPI_CLK, TCPWM_0_LINE_258, TCPWM_0_LINE_COMPL_259, TCPWM_0_TR_ONE_CNT_IN_774, TCPWM_0_TR_ONE_CNT_IN_778, SCB_6_UART_CTS, SCB_6_SPI_SELECT0, TCPWM_0_LINE_257, TCPWM_0_LINE_COMPL_258, TCPWM_0_TR_ONE_CNT_IN_771, TCPWM_0_TR_ONE_CNT_IN_775, SCB_6_SPI_SELECT1, TCPWM_0_LINE_256, TCPWM_0_LINE_COMPL_257, TCPWM_0_TR_ONE_CNT_IN_768, TCPWM_0_TR_ONE_CNT_IN_772, SCB_6_SPI_SELECT2, TCPWM_0_LINE_COMPL_256, TCPWM_0_TR_ONE_CNT_IN_769, PASS_0_SAR_EXT_MUX_SEL_0, SCB_5_UART_RX, SCB_5_SPI_MISO, PERI_TR_IO_INPUT_10, PASS_0_SAR_EXT_MUX_SEL_1, SCB_5_UART_TX, SCB_5_I2C_SDA, SCB_5_SPI_MOSI, PERI_TR_IO_INPUT_11, PASS_0_SAR_EXT_MUX_SEL_2, SCB_5_UART_RTS, SCB_5_I2C_SCL, SCB_5_SPI_CLK, PERI_TR_IO_INPUT_12, PASS_0_SAR_EXT_MUX_EN_0, SCB_5_UART_CTS, SCB_5_SPI_SELECT0, PERI_TR_IO_INPUT_13, SCB_5_SPI_SELECT1, TCPWM_0_LINE_9, TCPWM_0_TR_ONE_CNT_IN_27, SCB_5_SPI_SELECT2, LIN_0_LIN_RX_7, TCPWM_0_LINE_COMPL_9, TCPWM_0_TR_ONE_CNT_IN_28, LIN_0_LIN_TX_7, LIN_0_LIN_EN_7, LIN_0_LIN_RX_2, LIN_0_LIN_TX_2, LIN_0_LIN_EN_2, SCB_4_UART_RX, SCB_4_SPI_MISO, LIN_0_LIN_RX_3, SCB_4_UART_TX, SCB_4_I2C_SDA, SCB_4_SPI_MOSI, LIN_0_LIN_TX_3, SCB_4_UART_RTS, SCB_4_I2C_SCL, SCB_4_SPI_CLK, LIN_0_LIN_EN_3, CANFD_0_TTCAN_TX_2, SCB_4_UART_CTS, SCB_4_SPI_SELECT0, LIN_0_LIN_RX_4, CANFD_0_TTCAN_RX_2, CPUSS_CAL_SUP_NZ, SCB_4_SPI_SELECT1, LIN_0_LIN_TX_4, SCB_4_SPI_SELECT2, LIN_0_LIN_EN_4, SCB_4_SPI_SELECT3, PERI_TR_IO_INPUT_8, PERI_TR_IO_INPUT_9, TCPWM_0_LINE_260, TCPWM_0_TR_ONE_CNT_IN_780, TCPWM_0_LINE_15, TCPWM_0_LINE_COMPL_260, TCPWM_0_TR_ONE_CNT_IN_45, TCPWM_0_TR_ONE_CNT_IN_781, TCPWM_0_LINE_261, TCPWM_0_LINE_COMPL_15, TCPWM_0_TR_ONE_CNT_IN_783, TCPWM_0_TR_ONE_CNT_IN_46, TCPWM_0_LINE_16, TCPWM_0_LINE_COMPL_261, TCPWM_0_TR_ONE_CNT_IN_48, TCPWM_0_TR_ONE_CNT_IN_784, TCPWM_0_LINE_262, TCPWM_0_LINE_COMPL_16, TCPWM_0_TR_ONE_CNT_IN_786, TCPWM_0_TR_ONE_CNT_IN_49, TCPWM_0_LINE_COMPL_262, TCPWM_0_TR_ONE_CNT_IN_787, TCPWM_0_LINE_263, TCPWM_0_TR_ONE_CNT_IN_789, PERI_TR_IO_INPUT_16, TCPWM_0_LINE_COMPL_263, TCPWM_0_TR_ONE_CNT_IN_790, PERI_TR_IO_INPUT_17, TCPWM_0_LINE_19, TCPWM_0_TR_ONE_CNT_IN_57, TCPWM_0_LINE_20, TCPWM_0_LINE_COMPL_19, TCPWM_0_TR_ONE_CNT_IN_60, TCPWM_0_TR_ONE_CNT_IN_58, PERI_TR_IO_INPUT_14, TCPWM_0_LINE_21, TCPWM_0_LINE_COMPL_20, TCPWM_0_TR_ONE_CNT_IN_63, TCPWM_0_TR_ONE_CNT_IN_61, PERI_TR_IO_INPUT_15, TCPWM_0_LINE_22, TCPWM_0_LINE_COMPL_21, TCPWM_0_TR_ONE_CNT_IN_66, TCPWM_0_TR_ONE_CNT_IN_64, TCPWM_0_LINE_23, TCPWM_0_TR_ONE_CNT_IN_69, TCPWM_0_LINE_24, TCPWM_0_LINE_COMPL_23, TCPWM_0_TR_ONE_CNT_IN_72, TCPWM_0_TR_ONE_CNT_IN_70, TCPWM_0_LINE_25, TCPWM_0_LINE_COMPL_24, TCPWM_0_TR_ONE_CNT_IN_75, TCPWM_0_TR_ONE_CNT_IN_73, TCPWM_0_LINE_26, TCPWM_0_LINE_COMPL_25, TCPWM_0_TR_ONE_CNT_IN_78, TCPWM_0_TR_ONE_CNT_IN_76, TCPWM_0_LINE_27, TCPWM_0_LINE_COMPL_26, TCPWM_0_TR_ONE_CNT_IN_81, TCPWM_0_TR_ONE_CNT_IN_79, TCPWM_0_LINE_28, TCPWM_0_LINE_COMPL_27, TCPWM_0_TR_ONE_CNT_IN_84, TCPWM_0_TR_ONE_CNT_IN_82, PERI_TR_IO_INPUT_18, TCPWM_0_LINE_29, TCPWM_0_LINE_COMPL_28, TCPWM_0_TR_ONE_CNT_IN_87, TCPWM_0_TR_ONE_CNT_IN_85, PERI_TR_IO_INPUT_19, TCPWM_0_LINE_30, TCPWM_0_LINE_COMPL_29, TCPWM_0_TR_ONE_CNT_IN_90, TCPWM_0_TR_ONE_CNT_IN_88, TCPWM_0_LINE_31, TCPWM_0_LINE_COMPL_30, TCPWM_0_TR_ONE_CNT_IN_93, TCPWM_0_TR_ONE_CNT_IN_91, TCPWM_0_LINE_32, TCPWM_0_LINE_COMPL_31, TCPWM_0_TR_ONE_CNT_IN_96, TCPWM_0_TR_ONE_CNT_IN_94, TCPWM_0_LINE_33, TCPWM_0_LINE_COMPL_32, TCPWM_0_TR_ONE_CNT_IN_99, TCPWM_0_TR_ONE_CNT_IN_97, TCPWM_0_LINE_34, TCPWM_0_LINE_COMPL_33, TCPWM_0_TR_ONE_CNT_IN_102, TCPWM_0_TR_ONE_CNT_IN_100, TCPWM_0_LINE_35, TCPWM_0_LINE_COMPL_34, TCPWM_0_TR_ONE_CNT_IN_105, TCPWM_0_TR_ONE_CNT_IN_103, TCPWM_0_LINE_36, TCPWM_0_LINE_COMPL_35, TCPWM_0_TR_ONE_CNT_IN_108, TCPWM_0_TR_ONE_CNT_IN_106, PERI_TR_IO_INPUT_20, TCPWM_0_LINE_37, TCPWM_0_LINE_COMPL_36, TCPWM_0_TR_ONE_CNT_IN_111, TCPWM_0_TR_ONE_CNT_IN_109, LIN_0_LIN_EN_6, PERI_TR_IO_INPUT_21, TCPWM_0_LINE_38, TCPWM_0_LINE_COMPL_37, TCPWM_0_TR_ONE_CNT_IN_114, TCPWM_0_TR_ONE_CNT_IN_112, PASS_0_SAR_EXT_MUX_EN_1, LIN_0_LIN_RX_6, TCPWM_0_LINE_39, TCPWM_0_LINE_COMPL_38, TCPWM_0_TR_ONE_CNT_IN_117, TCPWM_0_TR_ONE_CNT_IN_115, PASS_0_SAR_EXT_MUX_SEL_3, LIN_0_LIN_TX_6, TCPWM_0_LINE_40, TCPWM_0_LINE_COMPL_39, TCPWM_0_TR_ONE_CNT_IN_120, TCPWM_0_TR_ONE_CNT_IN_118, PASS_0_SAR_EXT_MUX_SEL_4, TCPWM_0_LINE_41, TCPWM_0_LINE_COMPL_40, TCPWM_0_TR_ONE_CNT_IN_123, TCPWM_0_TR_ONE_CNT_IN_121, PASS_0_SAR_EXT_MUX_SEL_5, TCPWM_0_LINE_42, TCPWM_0_LINE_COMPL_41, TCPWM_0_TR_ONE_CNT_IN_126, TCPWM_0_TR_ONE_CNT_IN_124, TCPWM_0_LINE_43, TCPWM_0_LINE_COMPL_42, TCPWM_0_TR_ONE_CNT_IN_129, TCPWM_0_TR_ONE_CNT_IN_127, TCPWM_0_LINE_264, TCPWM_0_LINE_COMPL_43, TCPWM_0_TR_ONE_CNT_IN_792, TCPWM_0_TR_ONE_CNT_IN_130, PASS_0_SAR_EXT_MUX_SEL_6, SCB_3_UART_RX, SCB_3_SPI_MISO, TCPWM_0_LINE_44, TCPWM_0_LINE_COMPL_264, TCPWM_0_TR_ONE_CNT_IN_132, TCPWM_0_TR_ONE_CNT_IN_793, PASS_0_SAR_EXT_MUX_SEL_7, SCB_3_UART_TX, SCB_3_I2C_SDA, SCB_3_SPI_MOSI, TCPWM_0_LINE_265, TCPWM_0_LINE_COMPL_44, TCPWM_0_TR_ONE_CNT_IN_795, TCPWM_0_TR_ONE_CNT_IN_133, PASS_0_SAR_EXT_MUX_SEL_8, SCB_3_UART_RTS, SCB_3_I2C_SCL, SCB_3_SPI_CLK, TCPWM_0_LINE_45, TCPWM_0_LINE_COMPL_265, TCPWM_0_TR_ONE_CNT_IN_135, TCPWM_0_TR_ONE_CNT_IN_796, PASS_0_SAR_EXT_MUX_EN_2, SCB_3_UART_CTS, SCB_3_SPI_SELECT0, TCPWM_0_LINE_266, TCPWM_0_LINE_COMPL_45, TCPWM_0_TR_ONE_CNT_IN_798, TCPWM_0_TR_ONE_CNT_IN_136, SCB_3_SPI_SELECT1, TCPWM_0_LINE_46, TCPWM_0_LINE_COMPL_266, TCPWM_0_TR_ONE_CNT_IN_138, TCPWM_0_TR_ONE_CNT_IN_799, SCB_3_SPI_SELECT2, TCPWM_0_LINE_267, TCPWM_0_LINE_COMPL_46, TCPWM_0_TR_ONE_CNT_IN_801, TCPWM_0_TR_ONE_CNT_IN_139, SCB_3_SPI_SELECT3, PERI_TR_IO_INPUT_22, TCPWM_0_LINE_47, TCPWM_0_LINE_COMPL_267, TCPWM_0_TR_ONE_CNT_IN_141, TCPWM_0_TR_ONE_CNT_IN_802, PERI_TR_IO_INPUT_23, TCPWM_0_LINE_48, TCPWM_0_LINE_COMPL_47, TCPWM_0_TR_ONE_CNT_IN_144, TCPWM_0_TR_ONE_CNT_IN_142, SCB_2_UART_RX, SCB_2_SPI_MISO, CANFD_1_TTCAN_TX_0, TCPWM_0_LINE_49, TCPWM_0_LINE_COMPL_48, TCPWM_0_TR_ONE_CNT_IN_147, TCPWM_0_TR_ONE_CNT_IN_145, SCB_2_UART_TX, SCB_2_I2C_SDA, SCB_2_SPI_MOSI, CANFD_1_TTCAN_RX_0, TCPWM_0_LINE_50, TCPWM_0_LINE_COMPL_49, TCPWM_0_TR_ONE_CNT_IN_150, TCPWM_0_TR_ONE_CNT_IN_148, SCB_2_UART_RTS, SCB_2_I2C_SCL, SCB_2_SPI_CLK, TCPWM_0_LINE_51, TCPWM_0_LINE_COMPL_50, TCPWM_0_TR_ONE_CNT_IN_153, TCPWM_0_TR_ONE_CNT_IN_151, SCB_2_UART_CTS, SCB_2_SPI_SELECT0, TCPWM_0_LINE_52, TCPWM_0_LINE_COMPL_51, TCPWM_0_TR_ONE_CNT_IN_156, TCPWM_0_TR_ONE_CNT_IN_154, SCB_2_SPI_SELECT1, TCPWM_0_LINE_53, TCPWM_0_LINE_COMPL_52, TCPWM_0_TR_ONE_CNT_IN_159, TCPWM_0_TR_ONE_CNT_IN_157, SCB_2_SPI_SELECT2, TCPWM_0_LINE_54, TCPWM_0_LINE_COMPL_53, TCPWM_0_TR_ONE_CNT_IN_162, TCPWM_0_TR_ONE_CNT_IN_160, PERI_TR_IO_INPUT_24, TCPWM_0_LINE_55, TCPWM_0_LINE_COMPL_54, TCPWM_0_TR_ONE_CNT_IN_165, TCPWM_0_TR_ONE_CNT_IN_163, PERI_TR_IO_INPUT_25, TCPWM_0_LINE_56, TCPWM_0_LINE_COMPL_55, TCPWM_0_TR_ONE_CNT_IN_168, TCPWM_0_TR_ONE_CNT_IN_166, TCPWM_0_LINE_57, TCPWM_0_LINE_COMPL_56, TCPWM_0_TR_ONE_CNT_IN_171, TCPWM_0_TR_ONE_CNT_IN_169, TCPWM_0_LINE_58, TCPWM_0_LINE_COMPL_57, TCPWM_0_TR_ONE_CNT_IN_174, TCPWM_0_TR_ONE_CNT_IN_172, TCPWM_0_LINE_59, TCPWM_0_LINE_COMPL_58, TCPWM_0_TR_ONE_CNT_IN_177, TCPWM_0_TR_ONE_CNT_IN_175, TCPWM_0_LINE_60, TCPWM_0_LINE_COMPL_59, TCPWM_0_TR_ONE_CNT_IN_180, TCPWM_0_TR_ONE_CNT_IN_178, TCPWM_0_LINE_512, TCPWM_0_LINE_61, TCPWM_0_LINE_COMPL_60, TCPWM_0_TR_ONE_CNT_IN_183, TCPWM_0_TR_ONE_CNT_IN_181, TCPWM_0_LINE_COMPL_512, TCPWM_0_LINE_62, TCPWM_0_LINE_COMPL_61, TCPWM_0_TR_ONE_CNT_IN_186, TCPWM_0_TR_ONE_CNT_IN_184, TCPWM_0_LINE_513, TCPWM_0_LINE_COMPL_62, TCPWM_0_TR_ONE_CNT_IN_187, TCPWM_0_LINE_COMPL_513, CANFD_1_TTCAN_TX_1, TCPWM_0_LINE_514, CANFD_1_TTCAN_RX_1, TCPWM_0_LINE_COMPL_514, TCPWM_0_LINE_515, PERI_TR_IO_INPUT_26, TCPWM_0_LINE_COMPL_515, PERI_TR_IO_INPUT_27, SCB_1_UART_RX, SCB_1_SPI_MISO, CPUSS_FAULT_OUT_0, SCB_1_UART_TX, SCB_1_I2C_SDA, SCB_1_SPI_MOSI, CPUSS_FAULT_OUT_1, SCB_1_UART_RTS, SCB_1_I2C_SCL, SCB_1_SPI_CLK, SCB_1_UART_CTS, SCB_1_SPI_SELECT0, CPUSS_TRACE_CLOCK, SCB_1_SPI_SELECT1, CPUSS_TRACE_DATA_0, SCB_1_SPI_SELECT2, CPUSS_TRACE_DATA_1, SCB_1_SPI_SELECT3, CANFD_1_TTCAN_TX_2, CPUSS_TRACE_DATA_2, CANFD_1_TTCAN_RX_2, CPUSS_TRACE_DATA_3, TCPWM_0_TR_ONE_CNT_IN_1536, CPUSS_FAULT_OUT_2, TCPWM_0_TR_ONE_CNT_IN_1537, CPUSS_FAULT_OUT_3, TCPWM_0_TR_ONE_CNT_IN_1539, PERI_TR_IO_INPUT_28, TCPWM_0_TR_ONE_CNT_IN_1540, PERI_TR_IO_INPUT_29, TCPWM_0_TR_ONE_CNT_IN_1542, TCPWM_0_TR_ONE_CNT_IN_1543, TCPWM_0_TR_ONE_CNT_IN_1545, TCPWM_0_TR_ONE_CNT_IN_1546, SRSS_EXT_CLK, SRSS_DDFT_PIN_IN_1, CPUSS_CLK_FM_PUMP, SRSS_CAL_WAVE, PERI_TR_IO_INPUT_30, PERI_TR_IO_INPUT_31, CPUSS_SWJ_SWO_TDO, SRSS_DDFT_PIN_IN_0, CPUSS_SWJ_SWCLK_TCLK, CPUSS_SWJ_SWDIO_TMS, CPUSS_SWJ_SWDOE_TDI, TCPWM_0_LINE_516, TCPWM_0_LINE_517, TCPWM_0_LINE_518, TCPWM_0_LINE_519, TCPWM_0_TR_ONE_CNT_IN_1548, TCPWM_0_TR_ONE_CNT_IN_1551, TCPWM_0_TR_ONE_CNT_IN_1554, TCPWM_0_TR_ONE_CNT_IN_1557, TCPWM_0_LINE_COMPL_516, TCPWM_0_LINE_COMPL_517, TCPWM_0_LINE_COMPL_518, TCPWM_0_LINE_COMPL_519, TCPWM_0_TR_ONE_CNT_IN_1549, TCPWM_0_TR_ONE_CNT_IN_1552, TCPWM_0_TR_ONE_CNT_IN_1555, TCPWM_0_TR_ONE_CNT_IN_1558, CXPI_0_CXPI_RX_0, CXPI_0_CXPI_TX_0, CXPI_0_CXPI_EN_0, CXPI_0_CXPI_RX_1, CXPI_0_CXPI_TX_1, CXPI_0_CXPI_EN_1, LIN_0_LIN_RX_9, LIN_0_LIN_TX_9, LIN_0_LIN_EN_9, LIN_0_LIN_RX_8, LIN_0_LIN_TX_8, LIN_0_LIN_EN_8, CXPI_0_CXPI_RX_2, CXPI_0_CXPI_TX_2, CXPI_0_CXPI_EN_2, CANFD_1_TTCAN_TX_3, CANFD_1_TTCAN_RX_3, CANFD_0_TTCAN_TX_3, CANFD_0_TTCAN_RX_3, CXPI_0_CXPI_RX_3, CXPI_0_CXPI_TX_3, CXPI_0_CXPI_EN_3, LIN_0_LIN_RX_10, LIN_0_LIN_TX_10, LIN_0_LIN_EN_10, LIN_0_LIN_RX_11, LIN_0_LIN_TX_11, LIN_0_LIN_EN_11, TCPWM_1_LINE_18, TCPWM_1_LINE_COMPL_22, TCPWM_1_TR_ONE_CNT_IN_54, TCPWM_1_TR_ONE_CNT_IN_67, TCPWM_1_LINE_17, TCPWM_1_LINE_COMPL_18, TCPWM_1_TR_ONE_CNT_IN_51, TCPWM_1_TR_ONE_CNT_IN_55, TCPWM_1_LINE_14, TCPWM_1_LINE_COMPL_17, TCPWM_1_TR_ONE_CNT_IN_42, TCPWM_1_TR_ONE_CNT_IN_52, TCPWM_1_LINE_13, TCPWM_1_LINE_COMPL_14, TCPWM_1_TR_ONE_CNT_IN_39, TCPWM_1_TR_ONE_CNT_IN_43, TCPWM_1_LINE_12, TCPWM_1_LINE_516, TCPWM_1_LINE_COMPL_13, TCPWM_1_TR_ONE_CNT_IN_36, TCPWM_1_TR_ONE_CNT_IN_40, TCPWM_1_LINE_11, TCPWM_1_LINE_517, TCPWM_1_LINE_COMPL_12, TCPWM_1_TR_ONE_CNT_IN_33, TCPWM_1_TR_ONE_CNT_IN_37, TCPWM_1_LINE_10, TCPWM_1_LINE_518, TCPWM_1_LINE_COMPL_11, TCPWM_1_TR_ONE_CNT_IN_30, TCPWM_1_TR_ONE_CNT_IN_34, TCPWM_1_LINE_8, TCPWM_1_LINE_519, TCPWM_1_LINE_COMPL_10, TCPWM_1_TR_ONE_CNT_IN_24, TCPWM_1_TR_ONE_CNT_IN_31, SCB_8_SPI_MISO, SCB_8_UART_RX, TCPWM_1_LINE_71, TCPWM_1_LINE_COMPL_70, TCPWM_1_TR_ONE_CNT_IN_211, TCPWM_1_TR_ONE_CNT_IN_213, SCB_8_I2C_SDA, SCB_8_SPI_MOSI, SCB_8_UART_TX, SCB_8_I2C_SCL, SCB_8_SPI_CLK, SCB_8_UART_RTS, TCPWM_1_LINE_7, TCPWM_1_LINE_COMPL_8, TCPWM_1_TR_ONE_CNT_IN_21, TCPWM_1_TR_ONE_CNT_IN_25, TCPWM_1_TR_ONE_CNT_IN_1548, TCPWM_1_LINE_6, TCPWM_1_LINE_COMPL_7, TCPWM_1_TR_ONE_CNT_IN_18, TCPWM_1_TR_ONE_CNT_IN_22, TCPWM_1_TR_ONE_CNT_IN_1551, ETH_0_RX_ER, TCPWM_1_LINE_5, TCPWM_1_LINE_COMPL_6, TCPWM_1_TR_ONE_CNT_IN_15, TCPWM_1_TR_ONE_CNT_IN_19, TCPWM_1_TR_ONE_CNT_IN_1554, ETH_0_ETH_TSU_TIMER_CMP_VAL, SRSS_IO_CLK_HF_5, TCPWM_1_LINE_4, TCPWM_1_LINE_COMPL_5, TCPWM_1_TR_ONE_CNT_IN_12, TCPWM_1_TR_ONE_CNT_IN_16, TCPWM_1_TR_ONE_CNT_IN_1557, TCPWM_1_LINE_3, TCPWM_1_LINE_COMPL_4, TCPWM_1_LINE_COMPL_516, TCPWM_1_TR_ONE_CNT_IN_9, TCPWM_1_TR_ONE_CNT_IN_13, TCPWM_1_LINE_2, TCPWM_1_LINE_COMPL_3, TCPWM_1_LINE_COMPL_517, TCPWM_1_TR_ONE_CNT_IN_6, TCPWM_1_TR_ONE_CNT_IN_10, SCB_8_SPI_SELECT0, SCB_8_UART_CTS, TCPWM_1_LINE_72, TCPWM_1_LINE_COMPL_71, TCPWM_1_TR_ONE_CNT_IN_214, TCPWM_1_TR_ONE_CNT_IN_216, SCB_8_SPI_SELECT1, TCPWM_1_LINE_73, TCPWM_1_LINE_COMPL_72, TCPWM_1_TR_ONE_CNT_IN_217, TCPWM_1_TR_ONE_CNT_IN_219, ETH_0_MDIO, TCPWM_1_LINE_1, TCPWM_1_LINE_COMPL_2, TCPWM_1_LINE_COMPL_518, TCPWM_1_TR_ONE_CNT_IN_3, TCPWM_1_TR_ONE_CNT_IN_7, ETH_0_MDC, TCPWM_1_LINE_0, TCPWM_1_LINE_COMPL_1, TCPWM_1_LINE_COMPL_519, TCPWM_1_TR_ONE_CNT_IN_0, TCPWM_1_TR_ONE_CNT_IN_4, TCPWM_1_LINE_259, TCPWM_1_LINE_COMPL_0, TCPWM_1_TR_ONE_CNT_IN_1, TCPWM_1_TR_ONE_CNT_IN_777, TCPWM_1_TR_ONE_CNT_IN_1549, TCPWM_1_LINE_258, TCPWM_1_LINE_COMPL_259, TCPWM_1_TR_ONE_CNT_IN_774, TCPWM_1_TR_ONE_CNT_IN_778, TCPWM_1_TR_ONE_CNT_IN_1552, TCPWM_1_LINE_257, TCPWM_1_LINE_COMPL_258, TCPWM_1_TR_ONE_CNT_IN_771, TCPWM_1_TR_ONE_CNT_IN_775, TCPWM_1_TR_ONE_CNT_IN_1555, TCPWM_1_LINE_256, TCPWM_1_LINE_COMPL_257, TCPWM_1_TR_ONE_CNT_IN_768, TCPWM_1_TR_ONE_CNT_IN_772, TCPWM_1_TR_ONE_CNT_IN_1558, SCB_8_SPI_SELECT2, TCPWM_1_LINE_74, TCPWM_1_LINE_COMPL_73, TCPWM_1_TR_ONE_CNT_IN_220, TCPWM_1_TR_ONE_CNT_IN_222, TCPWM_1_LINE_75, TCPWM_1_LINE_COMPL_74, TCPWM_1_TR_ONE_CNT_IN_223, TCPWM_1_TR_ONE_CNT_IN_225, TCPWM_1_LINE_COMPL_256, TCPWM_1_TR_ONE_CNT_IN_769, LIN_0_LIN_RX_15, PERI_TR_IO_INPUT_32, SCB_9_SPI_MISO, SCB_9_UART_RX, PERI_TR_IO_INPUT_33, SCB_9_I2C_SDA, SCB_9_SPI_MOSI, SCB_9_UART_TX, LIN_0_LIN_TX_15, PERI_TR_IO_INPUT_38, TCPWM_1_LINE_9, TCPWM_1_LINE_522, TCPWM_1_TR_ONE_CNT_IN_27, PERI_TR_IO_INPUT_39, SCB_9_SPI_SELECT3, TCPWM_1_LINE_COMPL_9, TCPWM_1_LINE_COMPL_522, TCPWM_1_TR_ONE_CNT_IN_28, TCPWM_1_TR_ONE_CNT_IN_1566, TCPWM_1_TR_ONE_CNT_IN_1567, TCPWM_1_LINE_523, TCPWM_1_LINE_COMPL_523, TCPWM_1_TR_ONE_CNT_IN_1569, TCPWM_1_TR_ONE_CNT_IN_1570, SDHC_0_CARD_MECH_WRITE_PROT, TCPWM_1_LINE_524, SDHC_0_CARD_CMD, SMIF_0_SPIHB_CLK, TCPWM_1_LINE_COMPL_524, SDHC_0_CLK_CARD, SMIF_0_SPIHB_RWDS, TCPWM_1_TR_ONE_CNT_IN_1572, SDHC_0_CARD_DETECT_N, SMIF_0_SPIHB_SELECT0, TCPWM_1_TR_ONE_CNT_IN_1573, SDHC_0_CARD_IF_PWR_EN, SMIF_0_SPIHB_SELECT1, TCPWM_1_LINE_260, TCPWM_1_TR_ONE_CNT_IN_780, SDHC_0_CARD_DAT_3TO0_0, SMIF_0_SPIHB_DATA0, TCPWM_1_LINE_15, TCPWM_1_LINE_COMPL_260, TCPWM_1_TR_ONE_CNT_IN_45, TCPWM_1_TR_ONE_CNT_IN_781, SDHC_0_CARD_DAT_3TO0_1, SMIF_0_SPIHB_DATA1, TCPWM_1_LINE_261, TCPWM_1_LINE_COMPL_15, TCPWM_1_TR_ONE_CNT_IN_46, TCPWM_1_TR_ONE_CNT_IN_783, CANFD_0_TTCAN_TX_4, SDHC_0_CARD_DAT_3TO0_2, SMIF_0_SPIHB_DATA2, TCPWM_1_LINE_16, TCPWM_1_LINE_COMPL_261, TCPWM_1_TR_ONE_CNT_IN_48, TCPWM_1_TR_ONE_CNT_IN_784, CANFD_0_TTCAN_RX_4, SDHC_0_CARD_DAT_3TO0_3, SMIF_0_SPIHB_DATA3, TCPWM_1_LINE_262, TCPWM_1_LINE_COMPL_16, TCPWM_1_TR_ONE_CNT_IN_49, TCPWM_1_TR_ONE_CNT_IN_786, SDHC_0_CARD_DAT_7TO4_0, SMIF_0_SPIHB_DATA4, TCPWM_1_LINE_COMPL_262, TCPWM_1_TR_ONE_CNT_IN_787, TCPWM_1_LINE_263, TCPWM_1_TR_ONE_CNT_IN_789, TCPWM_1_LINE_COMPL_263, TCPWM_1_TR_ONE_CNT_IN_790, SDHC_0_CARD_DAT_7TO4_1, SMIF_0_SPIHB_DATA5, TCPWM_1_LINE_19, TCPWM_1_LINE_520, TCPWM_1_TR_ONE_CNT_IN_57, SDHC_0_CARD_DAT_7TO4_2, SMIF_0_SPIHB_DATA6, TCPWM_1_LINE_20, TCPWM_1_LINE_COMPL_19, TCPWM_1_LINE_COMPL_520, TCPWM_1_TR_ONE_CNT_IN_58, TCPWM_1_TR_ONE_CNT_IN_60, SDHC_0_CARD_DAT_7TO4_3, SMIF_0_SPIHB_DATA7, TCPWM_1_LINE_21, TCPWM_1_LINE_COMPL_20, TCPWM_1_TR_ONE_CNT_IN_61, TCPWM_1_TR_ONE_CNT_IN_63, TCPWM_1_TR_ONE_CNT_IN_1560, LIN_0_LIN_RX_16, TCPWM_1_LINE_22, TCPWM_1_LINE_COMPL_21, TCPWM_1_TR_ONE_CNT_IN_64, TCPWM_1_TR_ONE_CNT_IN_66, TCPWM_1_TR_ONE_CNT_IN_1561, LIN_0_LIN_TX_16, TCPWM_1_LINE_23, TCPWM_1_TR_ONE_CNT_IN_69, LIN_0_LIN_EN_16, TCPWM_1_LINE_24, TCPWM_1_LINE_521, TCPWM_1_LINE_COMPL_23, TCPWM_1_TR_ONE_CNT_IN_70, TCPWM_1_TR_ONE_CNT_IN_72, LIN_0_LIN_RX_12, TCPWM_1_LINE_25, TCPWM_1_LINE_COMPL_24, TCPWM_1_LINE_COMPL_521, TCPWM_1_TR_ONE_CNT_IN_73, TCPWM_1_TR_ONE_CNT_IN_75, LIN_0_LIN_TX_12, TCPWM_1_LINE_26, TCPWM_1_LINE_COMPL_25, TCPWM_1_TR_ONE_CNT_IN_76, TCPWM_1_TR_ONE_CNT_IN_78, TCPWM_1_TR_ONE_CNT_IN_1563, LIN_0_LIN_EN_12, TCPWM_1_LINE_27, TCPWM_1_LINE_COMPL_26, TCPWM_1_TR_ONE_CNT_IN_79, TCPWM_1_TR_ONE_CNT_IN_81, TCPWM_1_TR_ONE_CNT_IN_1564, TCPWM_1_LINE_28, TCPWM_1_LINE_COMPL_27, TCPWM_1_TR_ONE_CNT_IN_82, TCPWM_1_TR_ONE_CNT_IN_84, TCPWM_1_LINE_29, TCPWM_1_LINE_COMPL_28, TCPWM_1_TR_ONE_CNT_IN_85, TCPWM_1_TR_ONE_CNT_IN_87, TCPWM_1_LINE_30, TCPWM_1_LINE_COMPL_29, TCPWM_1_TR_ONE_CNT_IN_88, TCPWM_1_TR_ONE_CNT_IN_90, TCPWM_1_LINE_31, TCPWM_1_LINE_COMPL_30, TCPWM_1_TR_ONE_CNT_IN_91, TCPWM_1_TR_ONE_CNT_IN_93, TCPWM_1_LINE_32, TCPWM_1_LINE_COMPL_31, TCPWM_1_TR_ONE_CNT_IN_94, TCPWM_1_TR_ONE_CNT_IN_96, LIN_0_LIN_RX_13, TCPWM_1_LINE_33, TCPWM_1_LINE_COMPL_32, TCPWM_1_TR_ONE_CNT_IN_97, TCPWM_1_TR_ONE_CNT_IN_99, LIN_0_LIN_TX_13, TCPWM_1_LINE_34, TCPWM_1_LINE_COMPL_33, TCPWM_1_TR_ONE_CNT_IN_100, TCPWM_1_TR_ONE_CNT_IN_102, LIN_0_LIN_EN_13, TCPWM_1_LINE_35, TCPWM_1_LINE_COMPL_34, TCPWM_1_TR_ONE_CNT_IN_103, TCPWM_1_TR_ONE_CNT_IN_105, AUDIOSS_0_MCLK, TCPWM_1_LINE_61, TCPWM_1_LINE_COMPL_62, TCPWM_1_TR_ONE_CNT_IN_183, TCPWM_1_TR_ONE_CNT_IN_187, AUDIOSS_0_TX_SCK, TCPWM_1_LINE_60, TCPWM_1_LINE_COMPL_61, TCPWM_1_TR_ONE_CNT_IN_180, TCPWM_1_TR_ONE_CNT_IN_184, AUDIOSS_0_TX_WS, TCPWM_1_LINE_59, TCPWM_1_LINE_COMPL_60, TCPWM_1_TR_ONE_CNT_IN_177, TCPWM_1_TR_ONE_CNT_IN_181, AUDIOSS_0_TX_SDO, TCPWM_1_LINE_36, TCPWM_1_LINE_COMPL_35, TCPWM_1_TR_ONE_CNT_IN_106, TCPWM_1_TR_ONE_CNT_IN_108, AUDIOSS_0_CLK_I2S_IF, TCPWM_1_LINE_37, TCPWM_1_LINE_COMPL_36, TCPWM_1_TR_ONE_CNT_IN_109, TCPWM_1_TR_ONE_CNT_IN_111, AUDIOSS_0_RX_SCK, TCPWM_1_LINE_38, TCPWM_1_LINE_COMPL_37, TCPWM_1_TR_ONE_CNT_IN_112, TCPWM_1_TR_ONE_CNT_IN_114, AUDIOSS_0_RX_WS, TCPWM_1_LINE_39, TCPWM_1_LINE_COMPL_38, TCPWM_1_TR_ONE_CNT_IN_115, TCPWM_1_TR_ONE_CNT_IN_117, AUDIOSS_0_RX_SDI, TCPWM_1_LINE_40, TCPWM_1_LINE_COMPL_39, TCPWM_1_TR_ONE_CNT_IN_118, TCPWM_1_TR_ONE_CNT_IN_120, TCPWM_1_LINE_41, TCPWM_1_LINE_COMPL_40, TCPWM_1_TR_ONE_CNT_IN_121, TCPWM_1_TR_ONE_CNT_IN_123, TCPWM_1_LINE_42, TCPWM_1_LINE_COMPL_41, TCPWM_1_TR_ONE_CNT_IN_124, TCPWM_1_TR_ONE_CNT_IN_126, TCPWM_1_LINE_43, TCPWM_1_LINE_COMPL_42, TCPWM_1_TR_ONE_CNT_IN_127, TCPWM_1_TR_ONE_CNT_IN_129, AUDIOSS_1_MCLK, TCPWM_1_LINE_264, TCPWM_1_LINE_COMPL_43, TCPWM_1_TR_ONE_CNT_IN_130, TCPWM_1_TR_ONE_CNT_IN_792, AUDIOSS_1_TX_SCK, TCPWM_1_LINE_44, TCPWM_1_LINE_COMPL_264, TCPWM_1_TR_ONE_CNT_IN_132, TCPWM_1_TR_ONE_CNT_IN_793, AUDIOSS_1_TX_WS, TCPWM_1_LINE_265, TCPWM_1_LINE_COMPL_44, TCPWM_1_TR_ONE_CNT_IN_133, TCPWM_1_TR_ONE_CNT_IN_795, AUDIOSS_1_TX_SDO, TCPWM_1_LINE_45, TCPWM_1_LINE_COMPL_265, TCPWM_1_TR_ONE_CNT_IN_135, TCPWM_1_TR_ONE_CNT_IN_796, AUDIOSS_1_CLK_I2S_IF, TCPWM_1_LINE_266, TCPWM_1_LINE_COMPL_45, TCPWM_1_TR_ONE_CNT_IN_136, TCPWM_1_TR_ONE_CNT_IN_798, AUDIOSS_1_RX_SCK, TCPWM_1_LINE_46, TCPWM_1_LINE_COMPL_266, TCPWM_1_TR_ONE_CNT_IN_138, TCPWM_1_TR_ONE_CNT_IN_799, AUDIOSS_1_RX_WS, TCPWM_1_LINE_267, TCPWM_1_LINE_COMPL_46, TCPWM_1_TR_ONE_CNT_IN_139, TCPWM_1_TR_ONE_CNT_IN_801, AUDIOSS_1_RX_SDI, TCPWM_1_LINE_47, TCPWM_1_LINE_COMPL_267, TCPWM_1_TR_ONE_CNT_IN_141, TCPWM_1_TR_ONE_CNT_IN_802, AUDIOSS_2_MCLK, TCPWM_1_LINE_48, TCPWM_1_LINE_COMPL_47, TCPWM_1_TR_ONE_CNT_IN_142, TCPWM_1_TR_ONE_CNT_IN_144, AUDIOSS_2_TX_SCK, TCPWM_1_LINE_49, TCPWM_1_LINE_COMPL_48, TCPWM_1_TR_ONE_CNT_IN_145, TCPWM_1_TR_ONE_CNT_IN_147, TCPWM_1_LINE_50, TCPWM_1_LINE_COMPL_49, TCPWM_1_TR_ONE_CNT_IN_148, TCPWM_1_TR_ONE_CNT_IN_150, TCPWM_1_LINE_51, TCPWM_1_LINE_COMPL_50, TCPWM_1_TR_ONE_CNT_IN_151, TCPWM_1_TR_ONE_CNT_IN_153, AUDIOSS_2_TX_WS, TCPWM_1_LINE_52, TCPWM_1_LINE_COMPL_51, TCPWM_1_TR_ONE_CNT_IN_154, TCPWM_1_TR_ONE_CNT_IN_156, AUDIOSS_2_TX_SDO, LIN_0_LIN_RX_14, TCPWM_1_LINE_53, TCPWM_1_LINE_COMPL_52, TCPWM_1_TR_ONE_CNT_IN_157, TCPWM_1_TR_ONE_CNT_IN_159, LIN_0_LIN_TX_14, TCPWM_1_LINE_54, TCPWM_1_LINE_COMPL_53, TCPWM_1_TR_ONE_CNT_IN_160, TCPWM_1_TR_ONE_CNT_IN_162, LIN_0_LIN_EN_14, TCPWM_1_LINE_55, TCPWM_1_LINE_COMPL_54, TCPWM_1_TR_ONE_CNT_IN_163, TCPWM_1_TR_ONE_CNT_IN_165, AUDIOSS_2_CLK_I2S_IF, TCPWM_1_LINE_56, TCPWM_1_LINE_COMPL_55, TCPWM_1_TR_ONE_CNT_IN_166, TCPWM_1_TR_ONE_CNT_IN_168, AUDIOSS_2_RX_SCK, TCPWM_1_LINE_57, TCPWM_1_LINE_COMPL_56, TCPWM_1_TR_ONE_CNT_IN_169, TCPWM_1_TR_ONE_CNT_IN_171, AUDIOSS_2_RX_WS, SCB_9_I2C_SCL, SCB_9_SPI_CLK, SCB_9_UART_RTS, TCPWM_1_LINE_58, TCPWM_1_LINE_COMPL_57, TCPWM_1_TR_ONE_CNT_IN_172, TCPWM_1_TR_ONE_CNT_IN_174, AUDIOSS_2_RX_SDI, SCB_9_SPI_SELECT0, SCB_9_UART_CTS, TCPWM_1_LINE_COMPL_58, TCPWM_1_TR_ONE_CNT_IN_175, SCB_9_SPI_SELECT1, TCPWM_1_LINE_512, TCPWM_1_LINE_COMPL_59, TCPWM_1_TR_ONE_CNT_IN_178, SCB_9_SPI_SELECT2, TCPWM_1_LINE_COMPL_512, TCPWM_1_LINE_62, TCPWM_1_LINE_513, TCPWM_1_TR_ONE_CNT_IN_186, TCPWM_1_LINE_COMPL_513, TCPWM_1_LINE_68, TCPWM_1_LINE_COMPL_69, TCPWM_1_TR_ONE_CNT_IN_204, TCPWM_1_TR_ONE_CNT_IN_208, TCPWM_1_LINE_67, TCPWM_1_LINE_COMPL_68, TCPWM_1_TR_ONE_CNT_IN_201, TCPWM_1_TR_ONE_CNT_IN_205, TCPWM_1_LINE_66, TCPWM_1_LINE_COMPL_67, TCPWM_1_TR_ONE_CNT_IN_198, TCPWM_1_TR_ONE_CNT_IN_202, TCPWM_1_LINE_65, TCPWM_1_LINE_COMPL_66, TCPWM_1_TR_ONE_CNT_IN_195, TCPWM_1_TR_ONE_CNT_IN_199, TCPWM_1_LINE_515, TCPWM_1_LINE_COMPL_515, TCPWM_1_LINE_514, TCPWM_1_LINE_COMPL_514, LIN_0_LIN_EN_15, ETH_0_REF_CLK, ETH_0_TX_CTL, ETH_0_TX_ER, ETH_0_TX_CLK, ETH_0_TXD_0, ETH_0_TXD_2, ETH_0_TXD_3, ETH_0_RXD_0, TCPWM_1_TR_ONE_CNT_IN_1536, TCPWM_1_TR_ONE_CNT_IN_1537, ETH_0_RXD_2, TCPWM_1_TR_ONE_CNT_IN_1539, ETH_0_RXD_3, TCPWM_1_TR_ONE_CNT_IN_1540, TCPWM_1_TR_ONE_CNT_IN_1542, TCPWM_1_TR_ONE_CNT_IN_1543, TCPWM_1_TR_ONE_CNT_IN_1545, TCPWM_1_TR_ONE_CNT_IN_1546, CANFD_1_TTCAN_TX_4, CANFD_1_TTCAN_RX_4, ETH_0_RX_CTL, ETH_0_RX_CLK, SRSS_DDFT_CLK_DIRECT, ETH_1_TXD_0, ETH_1_TXD_2, ETH_1_TXD_3, ETH_1_RXD_0, ETH_1_RXD_2, ETH_1_RXD_3, SCB_10_SPI_MISO, SCB_10_UART_RX, TCPWM_1_LINE_63, TCPWM_1_LINE_COMPL_65, TCPWM_1_TR_ONE_CNT_IN_189, TCPWM_1_TR_ONE_CNT_IN_196, LIN_0_LIN_RX_17, SCB_10_I2C_SDA, SCB_10_SPI_MOSI, SCB_10_UART_TX, TCPWM_1_LINE_64, TCPWM_1_LINE_COMPL_63, TCPWM_1_TR_ONE_CNT_IN_190, TCPWM_1_TR_ONE_CNT_IN_192, LIN_0_LIN_TX_17, SCB_10_I2C_SCL, SCB_10_SPI_CLK, SCB_10_UART_RTS, TCPWM_1_LINE_COMPL_64, TCPWM_1_TR_ONE_CNT_IN_193, LIN_0_LIN_EN_17, SCB_10_SPI_SELECT0, SCB_10_UART_CTS, LIN_0_LIN_RX_18, SCB_10_SPI_SELECT1, LIN_0_LIN_TX_18, SCB_10_SPI_SELECT2, LIN_0_LIN_EN_18, SCB_10_SPI_SELECT3, TCPWM_1_LINE_69, TCPWM_1_TR_ONE_CNT_IN_207, LIN_0_LIN_RX_19, TCPWM_1_LINE_70, TCPWM_1_TR_ONE_CNT_IN_210, LIN_0_LIN_TX_19, TCPWM_1_LINE_76, TCPWM_1_LINE_COMPL_75, TCPWM_1_TR_ONE_CNT_IN_226, TCPWM_1_TR_ONE_CNT_IN_228, LIN_0_LIN_EN_19, TCPWM_1_LINE_77, TCPWM_1_LINE_COMPL_76, TCPWM_1_TR_ONE_CNT_IN_229, TCPWM_1_TR_ONE_CNT_IN_231, TCPWM_1_LINE_78, TCPWM_1_LINE_COMPL_77, TCPWM_1_TR_ONE_CNT_IN_232, TCPWM_1_TR_ONE_CNT_IN_234, TCPWM_1_LINE_79, TCPWM_1_LINE_COMPL_78, TCPWM_1_TR_ONE_CNT_IN_235, TCPWM_1_TR_ONE_CNT_IN_237, TCPWM_1_LINE_80, TCPWM_1_LINE_COMPL_79, TCPWM_1_TR_ONE_CNT_IN_238, TCPWM_1_TR_ONE_CNT_IN_240, TCPWM_1_LINE_81, TCPWM_1_LINE_COMPL_80, TCPWM_1_TR_ONE_CNT_IN_241, TCPWM_1_TR_ONE_CNT_IN_243, TCPWM_1_LINE_82, TCPWM_1_LINE_COMPL_81, TCPWM_1_TR_ONE_CNT_IN_244, TCPWM_1_TR_ONE_CNT_IN_246, TCPWM_1_LINE_83, TCPWM_1_LINE_COMPL_82, TCPWM_1_TR_ONE_CNT_IN_247, TCPWM_1_TR_ONE_CNT_IN_249, PERI_TR_IO_INPUT_34, TCPWM_1_LINE_COMPL_83, TCPWM_1_TR_ONE_CNT_IN_250, PERI_TR_IO_INPUT_35, PERI_TR_IO_INPUT_36, PERI_TR_IO_INPUT_37, PERI_TR_IO_INPUT_40, PERI_TR_IO_INPUT_41, PERI_TR_IO_INPUT_42, PERI_TR_IO_INPUT_43, PERI_TR_IO_INPUT_44, PERI_TR_IO_INPUT_45, PERI_TR_IO_INPUT_46, PERI_TR_IO_INPUT_47, ETH_1_TXD_4, ETH_1_TXD_5, ETH_1_TXD_6, ETH_1_TXD_7, ETH_1_RXD_4, ETH_1_RXD_5, ETH_1_RXD_6, ETH_1_RXD_7, FLEXRAY_0_RXDA, FLEXRAY_0_TXDA, FLEXRAY_0_TXENA_N, FLEXRAY_0_RXDB, FLEXRAY_0_TXDB, FLEXRAY_0_TXENB_N, ETH_0_TXD_1, ETH_0_RXD_1, ETH_1_REF_CLK, ETH_1_TX_CTL, ETH_1_TX_CLK, ETH_1_TXD_1, ETH_1_RXD_1, ETH_1_RX_CTL, ETH_1_RX_CLK, ETH_1_MDIO, ETH_1_MDC, ETH_1_ETH_TSU_TIMER_CMP_VAL, ETH_1_TX_ER, ETH_1_RX_ER, I2S_0_I2S_RX_MCK_0, I2S_0_I2S_RX_MCK_1, I2S_0_I2S_TX_MCK_1, I2S_0_I2S_RX_SCK_0, I2S_0_I2S_RX_SCK_1, I2S_0_I2S_TX_SCK_1, TCPWM_0_TR_ONE_CNT_IN_20, I2S_0_I2S_RX_WS_0, I2S_0_I2S_RX_WS_1, I2S_0_I2S_TX_WS_1, I2S_0_I2S_RX_SD_0, I2S_0_I2S_RX_SD_1, I2S_0_I2S_TX_SD_1, SCB_11_I2C_SDA, SCB_11_SPI_CLK, SCB_11_UART_RX, SCB_11_I2C_SCL, SCB_11_SPI_MOSI, SCB_11_UART_TX, PWM_0_PWM_LINE2_N_1, TCPWM_0_TR_ONE_CNT_IN_26, VIDEOSS_0_TTL_DSP0_DATA_A1_11, SCB_11_SPI_SELECT1, SCB_11_SPI_MISO, SCB_11_UART_RTS, TCPWM_0_TR_ONE_CNT_IN_23, SCB_11_SPI_SELECT0, SCB_11_UART_CTS, PWM_0_PWM_LINE1_P_0, SG_0_SG_AMPL_0, TDM_0_TDM_RX_MCK_0, TDM_0_TDM_RX_MCK_1, TDM_0_TDM_TX_MCK_1, PWM_0_PWM_LINE1_N_0, SG_0_SG_TONE_0, TDM_0_TDM_RX_SCK_0, TDM_0_TDM_RX_SCK_1, TDM_0_TDM_TX_SCK_1, PWM_0_PWM_LINE2_P_0, SG_0_SG_AMPL_1, TDM_0_TDM_RX_FSYNC_0, TDM_0_TDM_RX_FSYNC_1, TDM_0_TDM_TX_FSYNC_1, PWM_0_PWM_LINE2_N_0, SG_0_SG_TONE_1, TCPWM_0_TR_ONE_CNT_IN_29, TDM_0_TDM_RX_SD_0, TDM_0_TDM_RX_SD_1, TDM_0_TDM_TX_SD_1, I2S_0_I2S_RX_MCK_2, I2S_0_I2S_TX_MCK_2, PWM_0_PWM_LINE1_P_1, SG_0_SG_AMPL_2, TDM_0_TDM_RX_MCK_2, TDM_0_TDM_TX_MCK_2, I2S_0_I2S_RX_SCK_2, I2S_0_I2S_TX_SCK_2, PWM_0_PWM_LINE1_N_1, SG_0_SG_TONE_2, TDM_0_TDM_RX_SCK_2, TDM_0_TDM_TX_SCK_2, I2S_0_I2S_RX_WS_2, I2S_0_I2S_TX_WS_2, PWM_0_PWM_LINE2_P_1, SG_0_SG_AMPL_3, TDM_0_TDM_RX_FSYNC_2, TDM_0_TDM_TX_FSYNC_2, I2S_0_I2S_RX_SD_2, I2S_0_I2S_TX_SD_2, SG_0_SG_TONE_3, TDM_0_TDM_RX_SD_2, TDM_0_TDM_TX_SD_2, TCPWM_0_LINE_524, TCPWM_0_LINE_COMPL_529, TCPWM_0_TR_ONE_CNT_IN_528, VIDEOSS_0_TTL_DSP0_DATA_A0_3, TCPWM_0_LINE_525, TCPWM_0_LINE_COMPL_524, TCPWM_0_TR_ONE_CNT_IN_529, VIDEOSS_0_TTL_DSP0_DATA_A1_3, TCPWM_0_LINE_526, TCPWM_0_LINE_COMPL_525, TCPWM_0_TR_ONE_CNT_IN_524, VIDEOSS_0_TTL_DSP0_DATA_A0_4, TCPWM_0_LINE_527, TCPWM_0_LINE_COMPL_526, TCPWM_0_TR_ONE_CNT_IN_525, VIDEOSS_0_TTL_DSP0_DATA_A1_4, TCPWM_0_LINE_528, TCPWM_0_LINE_COMPL_527, TCPWM_0_TR_ONE_CNT_IN_526, VIDEOSS_0_TTL_DSP0_DATA_A0_5, TCPWM_0_LINE_529, TCPWM_0_LINE_COMPL_528, TCPWM_0_TR_ONE_CNT_IN_527, VIDEOSS_0_TTL_DSP0_DATA_A1_5, VIDEOSS_0_TTL_DSP0_DATA_A0_6, VIDEOSS_0_TTL_DSP0_DATA_A1_6, VIDEOSS_0_TTL_DSP0_DATA_A0_7, VIDEOSS_0_TTL_DSP0_DATA_A1_7, VIDEOSS_0_TTL_DSP0_DATA_A0_8, VIDEOSS_0_TTL_DSP0_DATA_A1_8, VIDEOSS_0_TTL_DSP0_DATA_A0_9, VIDEOSS_0_TTL_DSP0_DATA_A1_9, VIDEOSS_0_TTL_DSP0_DATA_A0_10, VIDEOSS_0_TTL_DSP0_DATA_A1_10, TCPWM_0_TR_ONE_CNT_IN_32, VIDEOSS_0_TTL_DSP0_DATA_A0_11, VIDEOSS_0_TTL_DSP0_CONTROL_0, VIDEOSS_0_TTL_DSP0_CONTROL_1, VIDEOSS_0_TTL_DSP0_CONTROL_2, VIDEOSS_0_TTL_DSP0_CLOCK, I2S_0_I2S_RX_MCK_3, I2S_0_I2S_TX_MCK_3, TCPWM_0_TR_ONE_CNT_IN_530, TDM_0_TDM_RX_MCK_3, TDM_0_TDM_TX_MCK_3, VIDEOSS_0_TTL_CAP0_DATA_8, I2S_0_I2S_RX_SCK_3, I2S_0_I2S_TX_SCK_3, TCPWM_0_TR_ONE_CNT_IN_35, TDM_0_TDM_RX_SCK_3, TDM_0_TDM_TX_SCK_3, VIDEOSS_0_TTL_CAP0_DATA_9, I2S_0_I2S_RX_WS_3, I2S_0_I2S_TX_WS_3, TCPWM_0_TR_ONE_CNT_IN_531, TDM_0_TDM_RX_FSYNC_3, TDM_0_TDM_TX_FSYNC_3, VIDEOSS_0_TTL_CAP0_DATA_10, I2S_0_I2S_RX_SD_3, I2S_0_I2S_TX_SD_3, TDM_0_TDM_RX_SD_3, TDM_0_TDM_TX_SD_3, VIDEOSS_0_TTL_CAP0_DATA_11, I2S_0_I2S_TX_MCK_0, TCPWM_0_TR_ONE_CNT_IN_532, TDM_0_TDM_TX_MCK_0, VIDEOSS_0_TTL_CAP0_DATA_12, I2S_0_I2S_TX_SCK_0, TDM_0_TDM_TX_SCK_0, VIDEOSS_0_TTL_CAP0_DATA_13, I2S_0_I2S_TX_WS_0, SG_0_SG_AMPL_4, TCPWM_0_TR_ONE_CNT_IN_533, TDM_0_TDM_TX_FSYNC_0, VIDEOSS_0_TTL_CAP0_DATA_14, I2S_0_I2S_TX_SD_0, SG_0_SG_TONE_4, TCPWM_0_TR_ONE_CNT_IN_534, TDM_0_TDM_TX_SD_0, VIDEOSS_0_TTL_CAP0_DATA_15, TCPWM_0_TR_ONE_CNT_IN_512, VIDEOSS_0_TTL_CAP0_DATA_16, TCPWM_0_TR_ONE_CNT_IN_513, VIDEOSS_0_TTL_CAP0_DATA_17, TCPWM_0_TR_ONE_CNT_IN_514, VIDEOSS_0_TTL_CAP0_DATA_18, TCPWM_0_TR_ONE_CNT_IN_535, VIDEOSS_0_TTL_CAP0_DATA_19, TCPWM_0_TR_ONE_CNT_IN_515, VIDEOSS_0_TTL_CAP0_DATA_20, TCPWM_0_TR_ONE_CNT_IN_536, VIDEOSS_0_TTL_CAP0_DATA_21, TCPWM_0_TR_ONE_CNT_IN_516, VIDEOSS_0_TTL_CAP0_DATA_22, TCPWM_0_TR_ONE_CNT_IN_537, VIDEOSS_0_TTL_CAP0_DATA_23, TCPWM_0_TR_ONE_CNT_IN_517, VIDEOSS_0_TTL_CAP0_DATA_24, TCPWM_0_TR_ONE_CNT_IN_538, VIDEOSS_0_TTL_CAP0_DATA_25, TCPWM_0_TR_ONE_CNT_IN_518, VIDEOSS_0_TTL_CAP0_DATA_26, TCPWM_0_TR_ONE_CNT_IN_539, TCPWM_0_TR_ONE_CNT_IN_519, VIDEOSS_0_TTL_DSP0_DATA_A0_0, TCPWM_0_TR_ONE_CNT_IN_540, VIDEOSS_0_TTL_DSP0_DATA_A1_0, TCPWM_0_TR_ONE_CNT_IN_520, VIDEOSS_0_TTL_DSP0_DATA_A0_1, TCPWM_0_TR_ONE_CNT_IN_541, VIDEOSS_0_TTL_DSP0_DATA_A1_1, TCPWM_0_TR_ONE_CNT_IN_542, VIDEOSS_0_TTL_DSP0_DATA_A0_2, TCPWM_0_TR_ONE_CNT_IN_543, VIDEOSS_0_TTL_DSP0_DATA_A1_2, TCPWM_0_LINE_521, TCPWM_0_LINE_COMPL_523, TCPWM_0_TR_ONE_CNT_IN_522, TCPWM_0_LINE_522, TCPWM_0_LINE_COMPL_521, TCPWM_0_TR_ONE_CNT_IN_523, TCPWM_0_LINE_523, TCPWM_0_LINE_COMPL_522, TCPWM_0_TR_ONE_CNT_IN_521, SG_0_SG_MCK_0, VIDEOSS_0_TTL_CAP0_CLK, SG_0_SG_MCK_1, VIDEOSS_0_TTL_CAP0_DATA_0, SG_0_SG_MCK_2, VIDEOSS_0_TTL_CAP0_DATA_1, SG_0_SG_MCK_3, VIDEOSS_0_TTL_CAP0_DATA_2, SG_0_SG_MCK_4, VIDEOSS_0_TTL_CAP0_DATA_3, PWM_0_PWM_MCK_0, VIDEOSS_0_TTL_CAP0_DATA_4, PWM_0_PWM_MCK_1, VIDEOSS_0_TTL_CAP0_DATA_5, VIDEOSS_0_TTL_CAP0_DATA_6, VIDEOSS_0_TTL_CAP0_DATA_7, VIDEOSS_0_TTL_DSP1_DATA_A0_0, VIDEOSS_0_TTL_DSP1_DATA_A1_0, VIDEOSS_0_TTL_DSP1_DATA_A0_1, VIDEOSS_0_TTL_DSP1_DATA_A1_1, VIDEOSS_0_TTL_DSP1_DATA_A0_2, VIDEOSS_0_TTL_DSP1_DATA_A1_2, VIDEOSS_0_TTL_DSP1_DATA_A0_3, VIDEOSS_0_TTL_DSP1_DATA_A1_3, VIDEOSS_0_TTL_DSP1_DATA_A0_4, VIDEOSS_0_TTL_DSP1_DATA_A1_4, VIDEOSS_0_TTL_DSP1_DATA_A0_5, VIDEOSS_0_TTL_DSP1_DATA_A1_5, VIDEOSS_0_TTL_DSP1_DATA_A0_6, VIDEOSS_0_TTL_DSP1_DATA_A1_6, VIDEOSS_0_TTL_DSP1_DATA_A0_7, VIDEOSS_0_TTL_DSP1_DATA_A1_7, VIDEOSS_0_TTL_DSP1_DATA_A0_8, VIDEOSS_0_TTL_DSP1_DATA_A1_8, VIDEOSS_0_TTL_DSP1_DATA_A0_9, VIDEOSS_0_TTL_DSP1_DATA_A1_9, VIDEOSS_0_TTL_DSP1_DATA_A0_10, VIDEOSS_0_TTL_DSP1_DATA_A1_10, VIDEOSS_0_TTL_DSP1_DATA_A0_11, VIDEOSS_0_TTL_DSP1_DATA_A1_11, VIDEOSS_0_TTL_DSP1_CONTROL_0, VIDEOSS_0_TTL_DSP1_CONTROL_1, VIDEOSS_0_TTL_DSP1_CONTROL_2, VIDEOSS_0_TTL_DSP1_CLOCK, VIDEOSS_0_FPDLINK_CLKREF_GPIO, SMIF_1_SPIHB_DATA4, SMIF_1_SPIHB_DATA2, SMIF_1_SPIHB_DATA3, SMIF_1_SPIHB_DATA5, SMIF_1_SPIHB_RWDS, SMIF_1_SPIHB_CLK, SMIF_1_SPIHB_DATA0, SMIF_1_SPIHB_DATA6, SMIF_1_SPIHB_SELECT0, SMIF_1_SPIHB_DATA1, SMIF_1_SPIHB_DATA7, SMIF_1_SPIHB_SELECT1, DAC_0_DAC_MCK, TCPWM_0_LINE_520, TCPWM_0_LINE_COMPL_520, TCPWM_0_LINE_COMPL_533, TCPWM_0_LINE_530, TCPWM_0_LINE_COMPL_530, TCPWM_0_LINE_531, TCPWM_0_LINE_COMPL_531, TCPWM_0_LINE_532, TCPWM_0_LINE_COMPL_532, TCPWM_0_LINE_533, VIDEOSS_0_TTL_DSP0_CONTROL_11, VIDEOSS_0_TTL_DSP0_CONTROL_10, VIDEOSS_0_TTL_DSP1_CONTROL_10, VIDEOSS_0_TTL_DSP0_CONTROL_9, VIDEOSS_0_TTL_DSP1_CONTROL_9, VIDEOSS_0_TTL_DSP0_CONTROL_8, VIDEOSS_0_TTL_DSP1_CONTROL_8, VIDEOSS_0_TTL_DSP0_CONTROL_7, VIDEOSS_0_TTL_DSP1_CONTROL_7, VIDEOSS_0_TTL_DSP0_CONTROL_6, VIDEOSS_0_TTL_DSP1_CONTROL_6, VIDEOSS_0_TTL_DSP0_CONTROL_5, VIDEOSS_0_TTL_DSP1_CONTROL_5, VIDEOSS_0_TTL_DSP0_CONTROL_4, VIDEOSS_0_TTL_DSP1_CONTROL_4, VIDEOSS_0_TTL_DSP0_CONTROL_3, VIDEOSS_0_TTL_DSP1_CONTROL_3, TCPWM_0_LINE_534, TCPWM_0_LINE_COMPL_543, TCPWM_0_LINE_535, TCPWM_0_LINE_COMPL_534, TCPWM_0_LINE_536, TCPWM_0_LINE_COMPL_535, TCPWM_0_LINE_537, TCPWM_0_LINE_COMPL_536, TCPWM_0_LINE_538, TCPWM_0_LINE_COMPL_537, TCPWM_0_LINE_539, TCPWM_0_LINE_COMPL_538, TCPWM_0_LINE_540, TCPWM_0_LINE_COMPL_539, TCPWM_0_LINE_541, TCPWM_0_LINE_COMPL_540, TCPWM_0_LINE_542, TCPWM_0_LINE_COMPL_541, TCPWM_0_LINE_543, TCPWM_0_LINE_COMPL_542, VIDEOSS_0_TTL_DSP1_CONTROL_11, CPUSS_TRACE_DATA_4, CPUSS_TRACE_DATA_5, CPUSS_TRACE_DATA_6, CPUSS_TRACE_DATA_7, SMIF_0_SMIF0_SPIHB_DATA4, SMIF_0_SMIF0_SPIHB_DATA2, SMIF_0_SMIF0_SPIHB_DATA3, SMIF_0_SMIF0_SPIHB_DATA5, SMIF_0_SMIF0_SPIHB_RWDS, SMIF_0_SMIF0_SPIHB_CLK, SMIF_0_SMIF0_SPIHB_DATA0, SMIF_0_SMIF0_SPIHB_DATA6, SMIF_0_SMIF0_SPIHB_SELECT0, SMIF_0_SMIF0_SPIHB_DATA1, SMIF_0_SMIF0_SPIHB_DATA7, SMIF_0_SMIF0_SPIHB_SELECT1, SMIF_0_SMIF1_SPIHB_DATA4, SMIF_0_SMIF1_SPIHB_DATA2, SMIF_0_SMIF1_SPIHB_DATA3, SMIF_0_SMIF1_SPIHB_DATA5, SMIF_0_SMIF1_SPIHB_RWDS, SMIF_0_SMIF1_SPIHB_CLK, SMIF_0_SMIF1_SPIHB_DATA0, SMIF_0_SMIF1_SPIHB_DATA6, SMIF_0_SMIF1_SPIHB_SELECT0, SMIF_0_SMIF1_SPIHB_DATA1, SMIF_0_SMIF1_SPIHB_DATA7, SMIF_0_SMIF1_SPIHB_SELECT1, SRSS_IO_CLK_HF_2, LCD_COM_0, LCD_COM_1, LCD_COM_2, LCD_COM_3, LCD_COM_4, LCD_COM_5, LCD_COM_6, LCD_COM_7, LCD_COM_8, LCD_COM_9, LCD_COM_10, LCD_COM_11, LCD_COM_12, LCD_COM_13, LCD_COM_14, LCD_COM_15, LCD_COM_16, LCD_COM_17, LCD_COM_18, LCD_COM_19, LCD_COM_20, LCD_COM_21, LCD_COM_22, LCD_COM_23, LCD_COM_24, LCD_COM_25, LCD_COM_26, LCD_COM_27, LCD_COM_28, LCD_COM_29, LCD_COM_30, LCD_COM_31, LCD_COM_32, LCD_COM_33, LCD_COM_34, LCD_COM_35, LCD_SEG_0, LCD_SEG_1, LCD_SEG_2, LCD_SEG_3, LCD_SEG_4, LCD_SEG_5, LCD_SEG_6, LCD_SEG_7, LCD_SEG_8, LCD_SEG_9, LCD_SEG_10, LCD_SEG_11, LCD_SEG_12, LCD_SEG_13, LCD_SEG_14, LCD_SEG_15, LCD_SEG_16, LCD_SEG_17, LCD_SEG_18, LCD_SEG_19, LCD_SEG_20, LCD_SEG_21, LCD_SEG_22, LCD_SEG_23, LCD_SEG_24, LCD_SEG_25, LCD_SEG_26, LCD_SEG_27, LCD_SEG_28, LCD_SEG_29, LCD_SEG_30, LCD_SEG_31, LCD_SEG_32, LCD_SEG_33, LCD_SEG_34, LCD_SEG_35}, multiplicity set at post-build, post-build-variant-multiplicity=true, post-build-variant-value=true, set at post-build, default-value=GPIO  # Port pin mode from mode list. | ATTENTION! This parameter is ignored. Selectable port pin mode is fixed in each sub derivate.
          enumeration PortPinLevelValue: {PORT_PIN_LEVEL_HIGH, PORT_PIN_LEVEL_LOW}, post-build-variant-value=true, set at post-build, default-value=PORT_PIN_LEVEL_LOW  # Port Pin Level value from Port pin list. Note : When the pin mode is set to other than GPIO, the pin output shall be controlled by the peripheral functionality. Therefore, if the initialized pin mode is not GPIO, the configuration parameter PortPinLevelValue is ignored.
          enumeration PortPinOutputDrive: {PORT_PIN_OUT_MODE_HIGHZ, PORT_PIN_OUT_MODE_PULLUP, PORT_PIN_OUT_MODE_PULLDOWN, PORT_PIN_OUT_MODE_OD_LOW, PORT_PIN_OUT_MODE_OD_HIGH, PORT_PIN_OUT_MODE_STRONG, PORT_PIN_OUT_MODE_PULLUP_DOWN}, origin=Cypress, set at post-build, default-value=PORT_PIN_OUT_MODE_HIGHZ  # GPIO output drive mode.
          boolean PortPinSmartioBypassEnable: origin=Cypress, set at post-build, default-value=true  # Bypass of the programmable IO. true: Bypass (programmable SMARTIO fabric is hidden) false: No bypass (programmable SMARTIO fabric is exposed)
          boolean PortPinSmartioSyncIoEnable: origin=Cypress, set at post-build, default-value=false  # Synchronization of the IO pin input signals to "clk_fabric". true: Synchronization false: No synchronization
          boolean PortPinSmartioSyncChipEnable: origin=Cypress, set at post-build, default-value=false  # Synchronization of the chip input signals to "clk_fabric". true: Synchronization false: No synchronization
          enumeration PortPinSmartioLutTr0Source: {PORT_SMART_LUT_TR_DU, PORT_SMART_LUT_TR_LUT1, PORT_SMART_LUT_TR_LUT2, PORT_SMART_LUT_TR_LUT3, PORT_SMART_LUT_TR_LUT4, PORT_SMART_LUT_TR_LUT5, PORT_SMART_LUT_TR_LUT6, PORT_SMART_LUT_TR_LUT7, PORT_SMART_LUT_TR_CHIP04, PORT_SMART_LUT_TR_CHIP15, PORT_SMART_LUT_TR_CHIP26, PORT_SMART_LUT_TR_CHIP37, PORT_SMART_LUT_TR_IO04, PORT_SMART_LUT_TR_IO15, PORT_SMART_LUT_TR_IO26, PORT_SMART_LUT_TR_IO37}, origin=Cypress, set at post-build, default-value=PORT_SMART_LUT_TR_DU  # LUT input signal "tr0_in" source selection.
          enumeration PortPinSmartioLutTr1Source: {PORT_SMART_LUT_TR_LUT0, PORT_SMART_LUT_TR_LUT1, PORT_SMART_LUT_TR_LUT2, PORT_SMART_LUT_TR_LUT3, PORT_SMART_LUT_TR_LUT4, PORT_SMART_LUT_TR_LUT5, PORT_SMART_LUT_TR_LUT6, PORT_SMART_LUT_TR_LUT7, PORT_SMART_LUT_TR_CHIP04, PORT_SMART_LUT_TR_CHIP15, PORT_SMART_LUT_TR_CHIP26, PORT_SMART_LUT_TR_CHIP37, PORT_SMART_LUT_TR_IO04, PORT_SMART_LUT_TR_IO15, PORT_SMART_LUT_TR_IO26, PORT_SMART_LUT_TR_IO37}, origin=Cypress, set at post-build, default-value=PORT_SMART_LUT_TR_LUT0  # LUT input signal "tr1_in" source selection.
          enumeration PortPinSmartioLutTr2Source: {PORT_SMART_LUT_TR_LUT0, PORT_SMART_LUT_TR_LUT1, PORT_SMART_LUT_TR_LUT2, PORT_SMART_LUT_TR_LUT3, PORT_SMART_LUT_TR_LUT4, PORT_SMART_LUT_TR_LUT5, PORT_SMART_LUT_TR_LUT6, PORT_SMART_LUT_TR_LUT7, PORT_SMART_LUT_TR_CHIP04, PORT_SMART_LUT_TR_CHIP15, PORT_SMART_LUT_TR_CHIP26, PORT_SMART_LUT_TR_CHIP37, PORT_SMART_LUT_TR_IO04, PORT_SMART_LUT_TR_IO15, PORT_SMART_LUT_TR_IO26, PORT_SMART_LUT_TR_IO37}, origin=Cypress, set at post-build, default-value=PORT_SMART_LUT_TR_LUT0  # LUT input signal "tr2_in" source selection.
          integer PortPinSmartioLut: 0..255, origin=Cypress, set at post-build, default-value=0  # LUT configuration.
          enumeration PortPinSmartioLutOperation: {PORT_SMART_LUT_OPC_COM_OUT_NO_FB, PORT_SMART_LUT_OPC_COM_OUT_FB, PORT_SMART_LUT_OPC_SEQ_OUT_NO_FB, PORT_SMART_LUT_OPC_REG_ASYNC}, origin=Cypress, set at post-build, default-value=PORT_SMART_LUT_OPC_COM_OUT_NO_FB  # Specifies the LUT operation.
          enumeration PortPinInputBufferMode: {PORT_PIN_IN_MODE_CMOS, PORT_PIN_IN_MODE_TTL}, origin=Cypress, set at post-build, default-value=PORT_PIN_IN_MODE_CMOS  # Input buffer mode (trip points and hysteresis).
          boolean PortPinOutputSlowSlewRateEnable: origin=Cypress, set at post-build, default-value=false  # Enables slow slew rate. true: Slow slew rate false: Fast slew rate
          enumeration PortPinOutputDriveStrength: {PORT_PIN_OUT_STRENGTH_DEFAULT, PORT_PIN_OUT_STRENGTH_FULL, PORT_PIN_OUT_STRENGTH_1_2, PORT_PIN_OUT_STRENGTH_1_4}, origin=Cypress, set at post-build, default-value=PORT_PIN_OUT_STRENGTH_DEFAULT  # Sets the GPIO drive strength. This parameter has different encoding with the cell variant of the pin shown as below. - GPIO_STD/GPIO_ENH: PORT_PIN_OUT_STRENGTH_DEFAULT : GPIO full drive strength. PORT_PIN_OUT_STRENGTH_FULL : Same encoding as PORT_PIN_OUT_STRENGTH_DEFAULT. PORT_PIN_OUT_STRENGTH_1_2 : GPIO 1/2 drive strength. PORT_PIN_OUT_STRENGTH_1_4 : GPIO 1/4 drive strength. - GPIO_SMC/HSIO_STD: PORT_PIN_OUT_STRENGTH_DEFAULT : GPIO_SMC/HSIO default mode. PORT_PIN_OUT_STRENGTH_FULL : GPIO full drive strength. PORT_PIN_OUT_STRENGTH_1_2 : GPIO 1/2 drive strength. PORT_PIN_OUT_STRENGTH_1_4 : GPIO 1/4 drive strength.
          enumeration Port5VPinInputBufferMode: {PORT_PIN_5V_IN_MODE_CMOS_OR_TTL, PORT_PIN_5V_IN_MODE_AUTO}, origin=Cypress, set at post-build, default-value=PORT_PIN_5V_IN_MODE_CMOS_OR_TTL  # Input buffer mode (trip points and hysteresis) for GPIO5V upper bit. This parameter is used along with PortPinInputBufferMode as below: {Port5VPinInputBufferMode, PortPinInputBufferMode}: {CMOS_OR_TTL, CMOS} : CMOS {CMOS_OR_TTL, TTL} : TTL {AUTO, CMOS} : input buffer is compatible with automotive. {AUTO, TTL} : input buffer is compatible with automotive.
          enumeration PortPinOutputDriveSelectTrim: {PORT_PIN_OUT_TRIM_DEFAULT, PORT_PIN_OUT_TRIM_DS_120OHM, PORT_PIN_OUT_TRIM_DS_90OHM, PORT_PIN_OUT_TRIM_DS_60OHM, PORT_PIN_OUT_TRIM_DS_50OHM, PORT_PIN_OUT_TRIM_DS_30OHM, PORT_PIN_OUT_TRIM_DS_20OHM, PORT_PIN_OUT_TRIM_DS_15OHM}, origin=Cypress, set at post-build, default-value=PORT_PIN_OUT_TRIM_DEFAULT  # GPIO output drive select trim.
          enumeration PortPinOutputSlewExt: {PORT_PIN_OUT_SLEW_EXT_FAST, PORT_PIN_OUT_SLEW_EXT_SLOW}, origin=Cypress, set at post-build, default-value=PORT_PIN_OUT_SLEW_EXT_FAST  # GPIO output extra slew rate control. Refer to PortPinOutputDriveExt for the truth table of each enumeration.
          enumeration PortPinOutputDriveExt: {PORT_PIN_OUT_STRENGTH_EXT_0, PORT_PIN_OUT_STRENGTH_EXT_1, PORT_PIN_OUT_STRENGTH_EXT_2, PORT_PIN_OUT_STRENGTH_EXT_3, PORT_PIN_OUT_STRENGTH_EXT_4}, origin=Cypress, set at post-build, default-value=PORT_PIN_OUT_STRENGTH_EXT_0  # Port output extra drive strength control. Here are the truth table of each enumeration. -- PORT_PIN_OUT_STRENGTH_EXT_0 -- When PortPinOutputSlewExt is PORT_PIN_OUT_SLEW_EXT_FAST: 133MHz at 15pF, xSPI-266 mode (default) When PortPinOutputSlewExt is PORT_PIN_OUT_SLEW_EXT_SLOW: 125MHz at 15pF -- PORT_PIN_OUT_STRENGTH_EXT_1 -- When PortPinOutputSlewExt is PORT_PIN_OUT_SLEW_EXT_FAST: 100MHz at 15pF, xSPI-200 mode When PortPinOutputSlewExt is PORT_PIN_OUT_SLEW_EXT_SLOW: 90MHz at 15pF -- PORT_PIN_OUT_STRENGTH_EXT_2 -- When PortPinOutputSlewExt is PORT_PIN_OUT_SLEW_EXT_FAST: 80MHz at 15pF, Graphics When PortPinOutputSlewExt is PORT_PIN_OUT_SLEW_EXT_SLOW: 60MHz at 15pF -- PORT_PIN_OUT_STRENGTH_EXT_3 -- When PortPinOutputSlewExt is PORT_PIN_OUT_SLEW_EXT_FAST: 64MHz at 15pF When PortPinOutputSlewExt is PORT_PIN_OUT_SLEW_EXT_SLOW: 50MHz at 15pF, Ethernet -- PORT_PIN_OUT_STRENGTH_EXT_4 -- 12MHz at 20pF, 25MHz at 10pF, SPI For more detail, please refer device TRM and data sheet.
      container PortAmuxSplitCell [1..*]: multiplicity set at post-build, post-build-variant-multiplicity=true  # Configuration of the individual AMUX splitter cells
        integer PortAmuxSplitCellId: 0..63, origin=Cypress, set at pre-compile, default-value=0  # HW-Cell Id of the hardware Amux Split Cell.
        enumeration PortAmuxBusaSwitchSL: {PORT_AMUX_SWITCH_OPEN, PORT_AMUX_SWITCH_CLOSED}, origin=Cypress, set at post-build, default-value=PORT_AMUX_SWITCH_OPEN  # T-switch control for Left AMUXBUSA switch.
        enumeration PortAmuxBusaSwitchSR: {PORT_AMUX_SWITCH_OPEN, PORT_AMUX_SWITCH_CLOSED}, origin=Cypress, set at post-build, default-value=PORT_AMUX_SWITCH_OPEN  # T-switch control for Right AMUXBUSA switch.
        enumeration PortAmuxBusaSwitchS0: {PORT_AMUX_SWITCH_OPEN, PORT_AMUX_SWITCH_CLOSED}, origin=Cypress, set at post-build, default-value=PORT_AMUX_SWITCH_OPEN  # T-switch control for AMUXBUSA vssa/ground switch.
        enumeration PortAmuxBusbSwitchSL: {PORT_AMUX_SWITCH_OPEN, PORT_AMUX_SWITCH_CLOSED}, origin=Cypress, set at post-build, default-value=PORT_AMUX_SWITCH_OPEN  # T-switch control for Left AMUXBUSB switch.
        enumeration PortAmuxBusbSwitchSR: {PORT_AMUX_SWITCH_OPEN, PORT_AMUX_SWITCH_CLOSED}, origin=Cypress, set at post-build, default-value=PORT_AMUX_SWITCH_OPEN  # T-switch control for Right AMUXBUSB switch.
        enumeration PortAmuxBusbSwitchS0: {PORT_AMUX_SWITCH_OPEN, PORT_AMUX_SWITCH_CLOSED}, origin=Cypress, set at post-build, default-value=PORT_AMUX_SWITCH_OPEN  # T-switch control for AMUXBUSB vssa/ground switch.
    container PortGeneral  # Module wide configuration parameters of the PORT driver.
      boolean PortDevErrorDetect: set at pre-compile, default-value=true  # Switches the Default Error Tracer (Det) detection and notification ON or OFF. | true: enabled (ON). false: disabled (OFF).
      boolean PortSetPinDirectionApi: set at pre-compile, default-value=true  # Pre-processor switch to enable / disable the use of the function Port_SetPinDirection(). | true: Enabled - Function Port_SetPinDirection() is available. false: Disabled - Function Port_SetPinDirection() is not available.
      boolean PortSetPinModeApi: set at pre-compile, default-value=true  # Pre-processor switch to enable / disable the use of the function Port_SetPinMode(). | true: Enabled - Function Port_SetPinMode() is available. false: Disabled - Function Port_SetPinMode() is not available.
      boolean PortVersionInfoApi: set at pre-compile, default-value=true  # Pre-processor switch to enable / disable the API to read out the modules version information. | true: Version info API enabled. false: Version info API disabled.
      boolean PortSafetyFunctionApi: origin=Cypress, set at pre-compile, default-value=true  # Pre-processor switch to enable / disable the use of the functions Port_GetStatus(), Port_GetAmuxSplitCtlStatus() and Port_GetTriggerIdStatus(). true: Enabled - Functions Port_GetStatus(), Port_GetAmuxSplitCtlStatus() and Port_GetTriggerIdStatus() are available. false: Disabled - Functions Port_GetStatus(), Port_GetAmuxSplitCtlStatus() and Port_GetTriggerIdStatus() are not available.
      boolean PortSetToDioAlternateModeApi: origin=Cypress, set at pre-compile, default-value=true  # Pre-processor switch to enable / disable the use of the functions Port_SetToDioMode() and Port_SetToAlternateMode(). true: Enabled - Functions Port_SetToDioMode() and Port_SetToAlternateMode() are available. false: Disabled - Functions Port_SetToDioMode() and Port_SetToAlternateMode() are not available.
      boolean PortSetTriggerApi: origin=Cypress, set at pre-compile, default-value=true  # Pre-processor switch to enable / disable the use of the functions Port_SetTrigger(). true: Enabled - Function Port_SetTrigger() is available. false: Disabled - Function Port_SetTrigger() is not available.
      boolean PortTriggerCommandApi: origin=Cypress, set at pre-compile, default-value=true  # Pre-processor switch to enable / disable the use of the functions Port_ActTrigger(), Port_DeactTrigger() and Port_GetTriggerCmdStatus() . true: Enabled - Functions Port_ActTrigger(), Port_DeactTrigger() and Port_GetTriggerCmdStatus() are available. false: Disabled - Functions Port_ActTrigger(), Port_DeactTrigger() and Port_GetTriggerCmdStatus() are not available.
      function name PortErrorCalloutFunction: origin=Cypress, set at pre-compile, default-value=ErrorCalloutHandler  # Error callout function. Syntax: void ErrorCalloutHandler (uint16 ModuleId, uint8 InstanceId, uint8 ApiId, uint8 ErrorId) The error callout function is called on every error. The ASIL level of this function limits the ASIL level of the Port driver.
      string PortIncludeFile [0..*]: multiplicity set at pre-compile, origin=Cypress, set at pre-compile, default-value=ErrorCalloutHandler.h  # A file that shall be included by Port_Cfg_Include.h. Any application specific symbol that is used by the Port configuration (e.g. Error callout function) should be included by configuring this parameter.
    container PortDefaultConfigSet  # This container contains the default configuration parameters and sub containers of the AUTOSAR Port module.
      container PortDefaultContainer  # Container including default parameters for unconfigured PortPins.
        enumeration PortDefSmartioClockSource: {PORT_SMART_CLK_SRC_IO0, PORT_SMART_CLK_SRC_IO1, PORT_SMART_CLK_SRC_IO2, PORT_SMART_CLK_SRC_IO3, PORT_SMART_CLK_SRC_IO4, PORT_SMART_CLK_SRC_IO5, PORT_SMART_CLK_SRC_IO6, PORT_SMART_CLK_SRC_IO7, PORT_SMART_CLK_SRC_CHIP0, PORT_SMART_CLK_SRC_CHIP1, PORT_SMART_CLK_SRC_CHIP2, PORT_SMART_CLK_SRC_CHIP3, PORT_SMART_CLK_SRC_CHIP4, PORT_SMART_CLK_SRC_CHIP5, PORT_SMART_CLK_SRC_CHIP6, PORT_SMART_CLK_SRC_CHIP7, PORT_SMART_CLK_SRC_CLK_SM_RST_ACT, PORT_SMART_CLK_SRC_CLK_SM_RST_DS, PORT_SMART_CLK_SRC_CLK_SM_RST_DS_HIB, PORT_SMART_CLK_SRC_CLK_LF_RST_LF_DS, PORT_SMART_CLK_SRC_CONST0, PORT_SMART_CLK_SRC_ASYNC}, origin=Cypress, set at post-build, default-value=PORT_SMART_CLK_SRC_CONST0  # Clock ("clk_fabric") and reset ("rst_fabric_n") source selection for unconfigured SMARTIOs.
        boolean PortDefSmartioHoldOverrideEnable: origin=Cypress, set at post-build, default-value=false  # IO cell hold override functionality for unconfigured SMARTIOs.
        boolean PortDefSmartioPipelineEnable: origin=Cypress, set at post-build, default-value=true  # Enable for pipeline register for unconfigured SMARTIOs.
        boolean PortDefSmartioEnable: origin=Cypress, set at post-build, default-value=false  # Enable for programmable IO for unconfigured SMARTIOs.
        enumeration PortDefSmartioDataUnitTr{0..2}Source: {PORT_SMART_DU_TR_CONST0, PORT_SMART_DU_TR_CONST1, PORT_SMART_DU_TR_DU, PORT_SMART_DU_TR_LUT0, PORT_SMART_DU_TR_LUT1, PORT_SMART_DU_TR_LUT2, PORT_SMART_DU_TR_LUT3, PORT_SMART_DU_TR_LUT4, PORT_SMART_DU_TR_LUT5, PORT_SMART_DU_TR_LUT6, PORT_SMART_DU_TR_LUT7}, origin=Cypress, set at post-build, default-value=PORT_SMART_DU_TR_CONST0  # Data unit input signal "tr{0..2}_in" source selection for unconfigured SMARTIOs.
        enumeration PortDefSmartioDataUnitData0Source: {PORT_SMART_DU_DATA_CONST0, PORT_SMART_DU_DATA_CHIP, PORT_SMART_DU_DATA_IO, PORT_SMART_DU_DATA_DATA_REG}, origin=Cypress, set at post-build, default-value=PORT_SMART_DU_DATA_CONST0  # Data unit input data "data0_in" source selection for unconfigured SMARTIOs.
        enumeration PortDefSmartioDataUnitData1Source: {PORT_SMART_DU_DATA_CONST0, PORT_SMART_DU_DATA_CHIP, PORT_SMART_DU_DATA_IO, PORT_SMART_DU_DATA_DATA_REG}, origin=Cypress, set at post-build, default-value=PORT_SMART_DU_DATA_CONST0  # Data unit input data "data1_in" source selection for unconfigured SMARTIOs.
        integer PortDefSmartioDataUnitBitSize: 1..8, origin=Cypress, set at post-build, default-value=1  # Size/width of the data unit data operands (in bits) for unconfigured SMARTIOs.
        enumeration PortDefSmartioDataUnitOperation: {PORT_SMART_DU_OPC_INCR, PORT_SMART_DU_OPC_DECR, PORT_SMART_DU_OPC_INCR_WRAP, PORT_SMART_DU_OPC_DECR_WRAP, PORT_SMART_DU_OPC_INCR_DECR, PORT_SMART_DU_OPC_INCR_DECR_WRAP, PORT_SMART_DU_OPC_ROR, PORT_SMART_DU_OPC_SHR, PORT_SMART_DU_OPC_AND_OR, PORT_SMART_DU_OPC_SHR_MAJ3, PORT_SMART_DU_OPC_SHR_EQL}, origin=Cypress, set at post-build, default-value=PORT_SMART_DU_OPC_INCR  # Specifies the data unit operation for unconfigured SMARTIOs.
        integer PortDefSmartioDataUnitSource: 0..255, origin=Cypress, set at post-build, default-value=0  # Data unit input data source for unconfigured SMARTIOs.
        container PortDefaultPin  # Default configuration of unconfigured port pins.
          enumeration PortDefPinDirection: {PORT_PIN_IN, PORT_PIN_OUT, PORT_PIN_IN_OUT_DISABLED}, origin=Cypress, post-build-variant-value=true, set at post-build, default-value=PORT_PIN_IN  # The initial direction of the pin (IN, OUT or IN/OUT disabled) for unconfigured port pins.
          boolean PortDefPinDirectionChangeable: origin=Cypress, post-build-variant-value=true, set at post-build, default-value=false  # Parameter to indicate if the directions are changeable on unconfigured port pins during runtime.
          boolean PortDefPinOutputInBufEnable: origin=Cypress, post-build-variant-value=true, set at post-build, default-value=true  # Enables input buffer setting for the direction PORT_PIN_OUT for unconfigured port pins.
          enumeration PortDefPinInitialMode: {GPIO, GPIO_DSI, DSI_DSI, DSI_GPIO, AMUXA, AMUXB, AMUXA_DSI, AMUXB_DSI}, origin=Cypress, post-build-variant-value=true, set at post-build, default-value=GPIO  # Port pin mode from mode list for use with Port_Init() function for unconfigured port pins.
          boolean PortDefPinModeChangeable: origin=Cypress, post-build-variant-value=true, set at post-build, default-value=false  # Parameter to indicate if the modes are changeable on unconfigured port pins during runtime.
          enumeration PortDefPinLevelValue: {PORT_PIN_LEVEL_HIGH, PORT_PIN_LEVEL_LOW}, origin=Cypress, post-build-variant-value=true, set at post-build, default-value=PORT_PIN_LEVEL_LOW  # Port Pin Level value from Port pin list for unconfigured port pins.
          enumeration PortDefPinOutputDrive: {PORT_PIN_OUT_MODE_HIGHZ, PORT_PIN_OUT_MODE_PULLUP, PORT_PIN_OUT_MODE_PULLDOWN, PORT_PIN_OUT_MODE_OD_LOW, PORT_PIN_OUT_MODE_OD_HIGH, PORT_PIN_OUT_MODE_STRONG, PORT_PIN_OUT_MODE_PULLUP_DOWN}, origin=Cypress, set at post-build, default-value=PORT_PIN_OUT_MODE_HIGHZ  # GPIO output drive mode for unconfigured port pins.
          boolean PortDefPinSmartioBypassEnable: origin=Cypress, set at post-build, default-value=true  # Bypass of the programmable IO for unconfigured port pins.
          boolean PortDefPinSmartioSyncIoEnable: origin=Cypress, set at post-build, default-value=false  # Synchronization of the IO pin input signals to "clk_fabric" for unconfigured port pins.
          boolean PortDefPinSmartioSyncChipEnable: origin=Cypress, set at post-build, default-value=false  # Synchronization of the chip input signals to "clk_fabric" for unconfigured port pins.
          enumeration PortDefPinSmartioLutTr0Source: {PORT_SMART_LUT_TR_DU, PORT_SMART_LUT_TR_LUT1, PORT_SMART_LUT_TR_LUT2, PORT_SMART_LUT_TR_LUT3, PORT_SMART_LUT_TR_LUT4, PORT_SMART_LUT_TR_LUT5, PORT_SMART_LUT_TR_LUT6, PORT_SMART_LUT_TR_LUT7, PORT_SMART_LUT_TR_CHIP04, PORT_SMART_LUT_TR_CHIP15, PORT_SMART_LUT_TR_CHIP26, PORT_SMART_LUT_TR_CHIP37, PORT_SMART_LUT_TR_IO04, PORT_SMART_LUT_TR_IO15, PORT_SMART_LUT_TR_IO26, PORT_SMART_LUT_TR_IO37}, origin=Cypress, set at post-build, default-value=PORT_SMART_LUT_TR_DU  # LUT input signal "tr0_in" source selection for unconfigured port pins.
          enumeration PortDefPinSmartioLutTr1Source: {PORT_SMART_LUT_TR_LUT0, PORT_SMART_LUT_TR_LUT1, PORT_SMART_LUT_TR_LUT2, PORT_SMART_LUT_TR_LUT3, PORT_SMART_LUT_TR_LUT4, PORT_SMART_LUT_TR_LUT5, PORT_SMART_LUT_TR_LUT6, PORT_SMART_LUT_TR_LUT7, PORT_SMART_LUT_TR_CHIP04, PORT_SMART_LUT_TR_CHIP15, PORT_SMART_LUT_TR_CHIP26, PORT_SMART_LUT_TR_CHIP37, PORT_SMART_LUT_TR_IO04, PORT_SMART_LUT_TR_IO15, PORT_SMART_LUT_TR_IO26, PORT_SMART_LUT_TR_IO37}, origin=Cypress, set at post-build, default-value=PORT_SMART_LUT_TR_LUT0  # LUT input signal "tr1_in" source selection for unconfigured port pins.
          enumeration PortDefPinSmartioLutTr2Source: {PORT_SMART_LUT_TR_LUT0, PORT_SMART_LUT_TR_LUT1, PORT_SMART_LUT_TR_LUT2, PORT_SMART_LUT_TR_LUT3, PORT_SMART_LUT_TR_LUT4, PORT_SMART_LUT_TR_LUT5, PORT_SMART_LUT_TR_LUT6, PORT_SMART_LUT_TR_LUT7, PORT_SMART_LUT_TR_CHIP04, PORT_SMART_LUT_TR_CHIP15, PORT_SMART_LUT_TR_CHIP26, PORT_SMART_LUT_TR_CHIP37, PORT_SMART_LUT_TR_IO04, PORT_SMART_LUT_TR_IO15, PORT_SMART_LUT_TR_IO26, PORT_SMART_LUT_TR_IO37}, origin=Cypress, set at post-build, default-value=PORT_SMART_LUT_TR_LUT0  # LUT input signal "tr2_in" source selection for unconfigured port pins.
          integer PortDefPinSmartioLut: 0..255, origin=Cypress, set at post-build, default-value=0  # LUT configuration for unconfigured port pins.
          enumeration PortDefPinSmartioLutOperation: {PORT_SMART_LUT_OPC_COM_OUT_NO_FB, PORT_SMART_LUT_OPC_COM_OUT_FB, PORT_SMART_LUT_OPC_SEQ_OUT_NO_FB, PORT_SMART_LUT_OPC_REG_ASYNC}, origin=Cypress, set at post-build, default-value=PORT_SMART_LUT_OPC_COM_OUT_NO_FB  # Specifies the LUT operation for unconfigured port pins.
          enumeration PortDefPinInputBufferMode: {PORT_PIN_IN_MODE_CMOS, PORT_PIN_IN_MODE_TTL}, origin=Cypress, set at post-build, default-value=PORT_PIN_IN_MODE_CMOS  # Input buffer mode (trip points and hysteresis) for unconfigured port pins.
          boolean PortDefPinOutputSlowSlewRateEnable: origin=Cypress, set at post-build, default-value=false  # Enables slow slew rate for unconfigured port pins.
          enumeration PortDefPinOutputDriveStrength: {PORT_PIN_OUT_STRENGTH_DEFAULT, PORT_PIN_OUT_STRENGTH_FULL, PORT_PIN_OUT_STRENGTH_1_2, PORT_PIN_OUT_STRENGTH_1_4}, origin=Cypress, set at post-build, default-value=PORT_PIN_OUT_STRENGTH_DEFAULT  # Sets the GPIO drive strength for unconfigured port pins. This parameter has different encoding with the cell variant of the pin shown as below. - GPIO_STD/GPIO_ENH: PORT_PIN_OUT_STRENGTH_DEFAULT : GPIO full drive strength. PORT_PIN_OUT_STRENGTH_FULL : Same encoding as PORT_PIN_OUT_STRENGTH_DEFAULT. PORT_PIN_OUT_STRENGTH_1_2 : GPIO 1/2 drive strength. PORT_PIN_OUT_STRENGTH_1_4 : GPIO 1/4 drive strength. - GPIO_SMC/HSIO_STD: PORT_PIN_OUT_STRENGTH_DEFAULT : GPIO_SMC/HSIO default mode. PORT_PIN_OUT_STRENGTH_FULL : GPIO full drive strength. PORT_PIN_OUT_STRENGTH_1_2 : GPIO 1/2 drive strength. PORT_PIN_OUT_STRENGTH_1_4 : GPIO 1/4 drive strength.
          enumeration PortDef5VPinInputBufferMode: {PORT_PIN_5V_IN_MODE_CMOS_OR_TTL, PORT_PIN_5V_IN_MODE_AUTO}, origin=Cypress, set at post-build, default-value=PORT_PIN_5V_IN_MODE_CMOS_OR_TTL  # Input buffer mode (trip points and hysteresis) for GPIO5V upper bit for unconfigured port pins. This parameter is used along with PortDefPinInputBufferMode as below: {PortDef5VPinInputBufferMode, PortDefPinInputBufferMode}: {CMOS_OR_TTL, CMOS} : CMOS {CMOS_OR_TTL, TTL} : TTL {AUTO, CMOS} : input buffer is compatible with automotive. {AUTO, TTL} : input buffer is compatible with automotive.
          enumeration PortDefPinOutputDriveSelectTrim: {PORT_PIN_OUT_TRIM_DEFAULT, PORT_PIN_OUT_TRIM_DS_120OHM, PORT_PIN_OUT_TRIM_DS_90OHM, PORT_PIN_OUT_TRIM_DS_60OHM, PORT_PIN_OUT_TRIM_DS_50OHM, PORT_PIN_OUT_TRIM_DS_30OHM, PORT_PIN_OUT_TRIM_DS_20OHM, PORT_PIN_OUT_TRIM_DS_15OHM}, origin=Cypress, set at post-build, default-value=PORT_PIN_OUT_TRIM_DEFAULT  # Sets the GPIO drive select trim for unconfigured port pins.
          enumeration PortDefPinOutputSlewExt: {PORT_PIN_OUT_SLEW_EXT_FAST, PORT_PIN_OUT_SLEW_EXT_SLOW}, origin=Cypress, set at post-build, default-value=PORT_PIN_OUT_SLEW_EXT_FAST  # Sets the GPIO extra slew rate for unconfigured port pins.
          enumeration PortDefPinOutputDriveExt: {PORT_PIN_OUT_STRENGTH_EXT_0, PORT_PIN_OUT_STRENGTH_EXT_1, PORT_PIN_OUT_STRENGTH_EXT_2, PORT_PIN_OUT_STRENGTH_EXT_3, PORT_PIN_OUT_STRENGTH_EXT_4}, origin=Cypress, set at post-build, default-value=PORT_PIN_OUT_STRENGTH_EXT_0  # Sets port extra drive strength for unconfigured port pins. Here are the truth table of each enumeration. -- PORT_PIN_OUT_STRENGTH_EXT_0 -- CFG_DRIVE_EXTx.DRIVE_SEL_EXTx[4:0] = 0x00 Mode = xSPI-266 Performance = upto 133MHz Voltage Support = 3.00V-3.60V Package Support = BGA, TQFP -- PORT_PIN_OUT_STRENGTH_EXT_1 -- CFG_DRIVE_EXTx.DRIVE_SEL_EXTx[4:0] = 0x01 Mode = xSPI-200 Performance = upto 100MHz Voltage Support = 3.00V-3.60V Package Support = BGA, TQFP -- PORT_PIN_OUT_STRENGTH_EXT_2 -- CFG_DRIVE_EXTx.DRIVE_SEL_EXTx[4:0] = 0x02 Mode = Graphics Performance = upto 80MHz Voltage Support = 3.00V-3.60V Package Support = BGA -- PORT_PIN_OUT_STRENGTH_EXT_3 -- CFG_DRIVE_EXTx.DRIVE_SEL_EXTx[4:0] = 0x03 Mode = Ethernet-50MHz / Graphics-64MHz Performance = upto 50MHz for Ethernet. upto 64MHz for Graphics Voltage Support = 3.00V-3.60V Package Support = BGA, TQFP for Ethernet. TQFP for Graphics -- PORT_PIN_OUT_STRENGTH_EXT_4 -- CFG_DRIVE_EXTx.DRIVE_SEL_EXTx[4:0] = 0x04 Mode = SPI-12MHz/SPI-25MHz/GPIO Support Performance = upto 25MHz for SPI. upto 20MHz for GPIO Voltage Support = 3.00V-3.60V for SPI. 4.50V-5.60V for GPIO Package Support = BGA, TQFP For more detail, please refer device TRM and data sheet.
      container PortDefaultAmuxSplitCell  # Configuration of unconfigured AMUX splitter cells
        enumeration PortDefAmuxBusaSwitchSL: {PORT_AMUX_SWITCH_OPEN, PORT_AMUX_SWITCH_CLOSED}, origin=Cypress, set at post-build, default-value=PORT_AMUX_SWITCH_OPEN  # T-switch control for Left AMUXBUSA switch for unconfigured AMUX splitter cells.
        enumeration PortDefAmuxBusaSwitchSR: {PORT_AMUX_SWITCH_OPEN, PORT_AMUX_SWITCH_CLOSED}, origin=Cypress, set at post-build, default-value=PORT_AMUX_SWITCH_OPEN  # T-switch control for Right AMUXBUSA switch for unconfigured AMUX splitter cells.
        enumeration PortDefAmuxBusaSwitchS0: {PORT_AMUX_SWITCH_OPEN, PORT_AMUX_SWITCH_CLOSED}, origin=Cypress, set at post-build, default-value=PORT_AMUX_SWITCH_OPEN  # T-switch control for AMUXBUSA vssa/ground switch for unconfigured AMUX splitter cells.
        enumeration PortDefAmuxBusbSwitchSL: {PORT_AMUX_SWITCH_OPEN, PORT_AMUX_SWITCH_CLOSED}, origin=Cypress, set at post-build, default-value=PORT_AMUX_SWITCH_OPEN  # T-switch control for Left AMUXBUSB switch for unconfigured AMUX splitter cells.
        enumeration PortDefAmuxBusbSwitchSR: {PORT_AMUX_SWITCH_OPEN, PORT_AMUX_SWITCH_CLOSED}, origin=Cypress, set at post-build, default-value=PORT_AMUX_SWITCH_OPEN  # T-switch control for Right AMUXBUSB switch for unconfigured AMUX splitter cells.
        enumeration PortDefAmuxBusbSwitchS0: {PORT_AMUX_SWITCH_OPEN, PORT_AMUX_SWITCH_CLOSED}, origin=Cypress, set at post-build, default-value=PORT_AMUX_SWITCH_OPEN  # T-switch control for AMUXBUSB vssa/ground switch for unconfigured AMUX splitter cells.
    container PortTriggerConfigSet [1..*]: multiplicity set at post-build, post-build-variant-multiplicity=true  # Container collecting Trigger Information.
      integer PortTriggerConfigSetId: 0..255, origin=Cypress, set at pre-compile, default-value=0  # Trigger Configuration ID.
      container PortTrGroupContainer [1..*]: multiplicity set at post-build, post-build-variant-multiplicity=true  # Configuration of Trigger Group.
        integer PortTrGroupId: 0..15, origin=Cypress, set at post-build, default-value=0  # Trigger Group ID. - Press 'calc' button after selecting PortTrGroupName.
        enumeration PortTrGroupName: {PDMA1_TR, MDMA, TCPWM_OUT, TCPWM_IN, PASS, CANTT, DEBUGMAIN, DEBUGREDUCTION1, DEBUGREDUCTION2, PDMA0_TR_0, PDMA0_TR_1, TCPWM0_OUT, TCPWM1_OUT, TCPWM1_IN, DEBUGREDUCTION3, PDMA0_0_15, PDMA0_16_31, PDMA1_0_15, TCPWM0, TCPWM0_20_31, TCPWM0_32_59, CAN, DEBUGREDUCATION1, AXIDMA}, origin=Cypress, set at post-build, default-value=PDMA0_TR_0  # Name of Trigger Group.
        container PortOutputTrigger [1..*]: multiplicity set at post-build, post-build-variant-multiplicity=true  # Configuration of Output Trigger.
          enumeration PortTrOutputName: {CPUSS_DW0_TR_IN_0, CPUSS_DW0_TR_IN_1, CPUSS_DW0_TR_IN_2, CPUSS_DW0_TR_IN_3, CPUSS_DW0_TR_IN_4, CPUSS_DW0_TR_IN_5, CPUSS_DW0_TR_IN_6, CPUSS_DW0_TR_IN_7, CPUSS_DW1_TR_IN_0, CPUSS_DW1_TR_IN_1, CPUSS_DW1_TR_IN_2, CPUSS_DW1_TR_IN_3, CPUSS_DW1_TR_IN_4, CPUSS_DW1_TR_IN_5, CPUSS_DW1_TR_IN_6, CPUSS_DW1_TR_IN_7, CPUSS_DMAC_TR_IN_0, CPUSS_DMAC_TR_IN_1, CPUSS_DMAC_TR_IN_2, CPUSS_DMAC_TR_IN_3, CPUSS_DW0_TR_IN_8, CPUSS_DW0_TR_IN_9, CPUSS_DW0_TR_IN_10, CPUSS_DW0_TR_IN_11, CPUSS_DW0_TR_IN_12, CPUSS_DW0_TR_IN_13, CPUSS_DW0_TR_IN_14, CPUSS_DW0_TR_IN_15, TCPWM_0_TR_ALL_CNT_IN_0, TCPWM_0_TR_ALL_CNT_IN_1, TCPWM_0_TR_ALL_CNT_IN_2, TCPWM_0_TR_ALL_CNT_IN_3, TCPWM_0_TR_ALL_CNT_IN_4, TCPWM_0_TR_ALL_CNT_IN_5, TCPWM_0_TR_ALL_CNT_IN_6, TCPWM_0_TR_ALL_CNT_IN_7, TCPWM_0_TR_ALL_CNT_IN_8, TCPWM_0_TR_ALL_CNT_IN_9, TCPWM_0_TR_ALL_CNT_IN_10, TCPWM_0_TR_ALL_CNT_IN_11, TCPWM_0_TR_ALL_CNT_IN_12, TCPWM_0_TR_ALL_CNT_IN_13, TCPWM_0_TR_ALL_CNT_IN_14, TCPWM_0_TR_ALL_CNT_IN_15, TCPWM_0_TR_ALL_CNT_IN_16, TCPWM_0_TR_ALL_CNT_IN_17, TCPWM_0_TR_ALL_CNT_IN_18, TCPWM_0_TR_ALL_CNT_IN_19, TCPWM_0_TR_ALL_CNT_IN_20, TCPWM_0_TR_ALL_CNT_IN_21, TCPWM_0_TR_ALL_CNT_IN_22, TCPWM_0_TR_ALL_CNT_IN_23, TCPWM_0_TR_ALL_CNT_IN_24, TCPWM_0_TR_ALL_CNT_IN_25, TCPWM_0_TR_ALL_CNT_IN_26, PASS_0_TR_SAR_GEN_IN_0, PASS_0_TR_SAR_GEN_IN_1, PASS_0_TR_SAR_GEN_IN_2, PASS_0_TR_SAR_GEN_IN_3, PASS_0_TR_SAR_GEN_IN_4, PASS_0_TR_SAR_GEN_IN_5, PASS_0_TR_SAR_GEN_IN_6, PASS_0_TR_SAR_GEN_IN_7, PASS_0_TR_SAR_GEN_IN_8, PASS_0_TR_SAR_GEN_IN_9, PASS_0_TR_SAR_GEN_IN_10, PASS_0_TR_SAR_GEN_IN_11, CANFD_0_TR_EVT_SWT_IN_0, CANFD_0_TR_EVT_SWT_IN_1, CANFD_0_TR_EVT_SWT_IN_2, CANFD_1_TR_EVT_SWT_IN_0, CANFD_1_TR_EVT_SWT_IN_1, CANFD_1_TR_EVT_SWT_IN_2, PERI_TR_IO_OUTPUT_0, PERI_TR_IO_OUTPUT_1, CPUSS_CTI_TR_IN_0, CPUSS_CTI_TR_IN_1, PERI_TR_DBG_FREEZE, PASS_0_TR_DEBUG_FREEZE, SRSS_TR_DEBUG_FREEZE_WDT, SRSS_TR_DEBUG_FREEZE_MCWDT_0, SRSS_TR_DEBUG_FREEZE_MCWDT_1, TCPWM_0_TR_DEBUG_FREEZE, TR_GROUP_8_INPUT_1, TR_GROUP_8_INPUT_2, TR_GROUP_8_INPUT_3, TR_GROUP_8_INPUT_4, TR_GROUP_8_INPUT_5, TR_GROUP_8_INPUT_6, TR_GROUP_8_INPUT_7, TR_GROUP_8_INPUT_8, TR_GROUP_8_INPUT_9, TR_GROUP_8_INPUT_10, CANFD_1_TR_EVT_SWT_IN_3, CANFD_0_TR_EVT_SWT_IN_3, CPUSS_DW0_TR_IN_16, CPUSS_DW0_TR_IN_17, CPUSS_DW0_TR_IN_18, CPUSS_DW0_TR_IN_19, CPUSS_DW0_TR_IN_20, CPUSS_DW0_TR_IN_21, CPUSS_DW0_TR_IN_22, CPUSS_DW0_TR_IN_23, CPUSS_DW0_TR_IN_24, CPUSS_DW0_TR_IN_25, CPUSS_DW0_TR_IN_26, CPUSS_DW0_TR_IN_27, CPUSS_DW0_TR_IN_28, CPUSS_DW0_TR_IN_29, CPUSS_DW0_TR_IN_30, CPUSS_DW0_TR_IN_31, CPUSS_DW1_TR_IN_8, CPUSS_DW1_TR_IN_9, CPUSS_DW1_TR_IN_10, CPUSS_DW1_TR_IN_11, CPUSS_DW1_TR_IN_12, CPUSS_DW1_TR_IN_13, CPUSS_DW1_TR_IN_14, CPUSS_DW1_TR_IN_15, CPUSS_DMAC_TR_IN_4, CPUSS_DMAC_TR_IN_5, CPUSS_DMAC_TR_IN_6, CPUSS_DMAC_TR_IN_7, TCPWM_1_TR_ALL_CNT_IN_0, TCPWM_1_TR_ALL_CNT_IN_1, TCPWM_1_TR_ALL_CNT_IN_2, TCPWM_1_TR_ALL_CNT_IN_3, TCPWM_1_TR_ALL_CNT_IN_4, TCPWM_1_TR_ALL_CNT_IN_5, TCPWM_1_TR_ALL_CNT_IN_6, TCPWM_1_TR_ALL_CNT_IN_7, TCPWM_1_TR_ALL_CNT_IN_8, TCPWM_1_TR_ALL_CNT_IN_9, TCPWM_1_TR_ALL_CNT_IN_10, TCPWM_1_TR_ALL_CNT_IN_11, TCPWM_1_TR_ALL_CNT_IN_12, TCPWM_1_TR_ALL_CNT_IN_13, TCPWM_1_TR_ALL_CNT_IN_14, TCPWM_1_TR_ALL_CNT_IN_15, TCPWM_1_TR_ALL_CNT_IN_16, TCPWM_1_TR_ALL_CNT_IN_17, TCPWM_1_TR_ALL_CNT_IN_18, TCPWM_1_TR_ALL_CNT_IN_19, TCPWM_1_TR_ALL_CNT_IN_20, TCPWM_1_TR_ALL_CNT_IN_21, TCPWM_1_TR_ALL_CNT_IN_22, TCPWM_1_TR_ALL_CNT_IN_23, TCPWM_1_TR_ALL_CNT_IN_24, TCPWM_1_TR_ALL_CNT_IN_25, TCPWM_1_TR_ALL_CNT_IN_26, TCPWM_1_TR_ALL_CNT_IN_27, TCPWM_1_TR_ALL_CNT_IN_28, TCPWM_1_TR_ALL_CNT_IN_29, TCPWM_1_TR_ALL_CNT_IN_30, TCPWM_1_TR_ALL_CNT_IN_31, TCPWM_1_TR_ALL_CNT_IN_32, TCPWM_1_TR_ALL_CNT_IN_33, TCPWM_1_TR_ALL_CNT_IN_34, TCPWM_1_TR_ALL_CNT_IN_35, TCPWM_1_TR_ALL_CNT_IN_36, TCPWM_1_TR_ALL_CNT_IN_37, TCPWM_1_TR_ALL_CNT_IN_38, TCPWM_1_TR_ALL_CNT_IN_39, TCPWM_1_TR_ALL_CNT_IN_40, CANFD_0_TR_EVT_SWT_IN_4, CANFD_1_TR_EVT_SWT_IN_4, SRSS_TR_DEBUG_FREEZE_MCWDT_2, TCPWM_1_TR_DEBUG_FREEZE, TR_GROUP_9_INPUT_1, TR_GROUP_9_INPUT_2, TR_GROUP_9_INPUT_3, TR_GROUP_9_INPUT_4, TR_GROUP_9_INPUT_5, TR_GROUP_9_INPUT_6, TR_GROUP_9_INPUT_7, TR_GROUP_9_INPUT_8, TR_GROUP_9_INPUT_9, TR_GROUP_9_INPUT_10, TR_GROUP_9_INPUT_11, TR_GROUP_9_INPUT_12, TR_GROUP_9_INPUT_13, TR_GROUP_9_INPUT_14, TR_GROUP_9_INPUT_15, FLEXRAY_0_TR_STPWT_IN, TCPWM_0_TR_ALL_CNT_IN_27, TCPWM_0_TR_ALL_CNT_IN_28, TCPWM_0_TR_ALL_CNT_IN_29, TCPWM_0_TR_ALL_CNT_IN_30, TCPWM_0_TR_ALL_CNT_IN_31, TCPWM_0_TR_ALL_CNT_IN_32, TCPWM_0_TR_ALL_CNT_IN_33, TCPWM_0_TR_ALL_CNT_IN_34, TCPWM_0_TR_ALL_CNT_IN_35, TCPWM_0_TR_ALL_CNT_IN_36, TCPWM_0_TR_ALL_CNT_IN_37, TCPWM_0_TR_ALL_CNT_IN_38, TCPWM_0_TR_ALL_CNT_IN_39, TCPWM_0_TR_ALL_CNT_IN_40, TCPWM_0_TR_ALL_CNT_IN_41, TCPWM_0_TR_ALL_CNT_IN_42, TCPWM_0_TR_ALL_CNT_IN_43, TCPWM_0_TR_ALL_CNT_IN_44, TCPWM_0_TR_ALL_CNT_IN_45, TCPWM_0_TR_ALL_CNT_IN_46, TCPWM_0_TR_ALL_CNT_IN_47, TCPWM_0_TR_ALL_CNT_IN_48, TCPWM_0_TR_ALL_CNT_IN_49, TCPWM_0_TR_ALL_CNT_IN_50, TCPWM_0_TR_ALL_CNT_IN_51, TCPWM_0_TR_ALL_CNT_IN_52, TCPWM_0_TR_ALL_CNT_IN_53, TCPWM_0_TR_ALL_CNT_IN_54, TCPWM_0_TR_ALL_CNT_IN_55, TCPWM_0_TR_ALL_CNT_IN_56, TCPWM_0_TR_ALL_CNT_IN_57, TCPWM_0_TR_ALL_CNT_IN_58, TCPWM_0_TR_ALL_CNT_IN_59, I2S_0_TR_DBG_FREEZE, TDM_0_TR_DBG_FREEZE, SG_0_TR_DBG_FREEZE, PWM_0_TR_DBG_FREEZE, MIXER_0_TR_DBG_FREEZE, MIXER_1_TR_DBG_FREEZE, DAC_0_TR_DBG_FREEZE, AXI_DMAC_TR_IN_0, AXI_DMAC_TR_IN_1, AXI_DMAC_TR_IN_2, AXI_DMAC_TR_IN_3, AXI_DMAC_0_TR_IN_0, AXI_DMAC_0_TR_IN_1, AXI_DMAC_0_TR_IN_2, AXI_DMAC_0_TR_IN_3, AXI_DMAC_0_TR_IN_4, AXI_DMAC_0_TR_IN_5, AXI_DMAC_0_TR_IN_6, AXI_DMAC_0_TR_IN_7}, origin=Cypress, set at post-build, default-value=CPUSS_DW0_TR_IN_0  # Name of Output Trigger.
          enumeration PortTrInputName: {CPUSS_ZERO, CPUSS_DW0_TR_OUT_0, CPUSS_DW0_TR_OUT_1, CPUSS_DW0_TR_OUT_2, CPUSS_DW0_TR_OUT_3, CPUSS_DW0_TR_OUT_4, CPUSS_DW0_TR_OUT_5, CPUSS_DW0_TR_OUT_6, CPUSS_DW0_TR_OUT_7, CPUSS_DW0_TR_OUT_8, CPUSS_DW0_TR_OUT_9, CPUSS_DW0_TR_OUT_10, CPUSS_DW0_TR_OUT_11, CPUSS_DW0_TR_OUT_12, CPUSS_DW0_TR_OUT_13, CPUSS_DW0_TR_OUT_14, CPUSS_DW0_TR_OUT_15, CPUSS_DW1_TR_OUT_0, CPUSS_DW1_TR_OUT_1, CPUSS_DW1_TR_OUT_2, CPUSS_DW1_TR_OUT_3, CPUSS_DW1_TR_OUT_4, CPUSS_DW1_TR_OUT_5, CPUSS_DW1_TR_OUT_6, CPUSS_DW1_TR_OUT_7, CPUSS_DMAC_TR_OUT_0, CPUSS_DMAC_TR_OUT_1, CPUSS_DMAC_TR_OUT_2, CPUSS_DMAC_TR_OUT_3, CPUSS_TR_FAULT_0, CPUSS_TR_FAULT_1, CPUSS_TR_FAULT_2, CPUSS_TR_FAULT_3, CPUSS_CTI_TR_OUT_0, CPUSS_CTI_TR_OUT_1, EVTGEN_0_TR_OUT_3, EVTGEN_0_TR_OUT_4, EVTGEN_0_TR_OUT_5, EVTGEN_0_TR_OUT_6, PERI_TR_IO_INPUT_0, PERI_TR_IO_INPUT_1, PERI_TR_IO_INPUT_2, PERI_TR_IO_INPUT_3, PERI_TR_IO_INPUT_4, PERI_TR_IO_INPUT_5, PERI_TR_IO_INPUT_6, PERI_TR_IO_INPUT_7, PERI_TR_IO_INPUT_8, PERI_TR_IO_INPUT_9, PERI_TR_IO_INPUT_10, PERI_TR_IO_INPUT_11, PERI_TR_IO_INPUT_12, PERI_TR_IO_INPUT_13, PERI_TR_IO_INPUT_14, PERI_TR_IO_INPUT_15, EVTGEN_0_TR_OUT_7, EVTGEN_0_TR_OUT_8, EVTGEN_0_TR_OUT_9, EVTGEN_0_TR_OUT_10, PERI_TR_IO_INPUT_16, PERI_TR_IO_INPUT_17, PERI_TR_IO_INPUT_18, PERI_TR_IO_INPUT_19, PERI_TR_IO_INPUT_20, PERI_TR_IO_INPUT_21, PERI_TR_IO_INPUT_22, PERI_TR_IO_INPUT_23, PERI_TR_IO_INPUT_24, PERI_TR_IO_INPUT_25, PERI_TR_IO_INPUT_26, PERI_TR_IO_INPUT_27, PERI_TR_IO_INPUT_28, PERI_TR_IO_INPUT_29, PERI_TR_IO_INPUT_30, PERI_TR_IO_INPUT_31, PASS_0_TR_SAR_GEN_OUT_0, PASS_0_TR_SAR_GEN_OUT_1, PASS_0_TR_SAR_GEN_OUT_2, PASS_0_TR_SAR_GEN_OUT_3, PASS_0_TR_SAR_GEN_OUT_4, PASS_0_TR_SAR_GEN_OUT_5, TCPWM_0_TR_OUT0_512, TCPWM_0_TR_OUT0_513, TCPWM_0_TR_OUT0_514, TCPWM_0_TR_OUT0_515, TCPWM_0_TR_OUT0_256, TCPWM_0_TR_OUT0_257, TCPWM_0_TR_OUT0_258, TCPWM_0_TR_OUT0_259, TCPWM_0_TR_OUT0_260, TCPWM_0_TR_OUT0_261, TCPWM_0_TR_OUT0_262, TCPWM_0_TR_OUT0_263, TCPWM_0_TR_OUT0_264, TCPWM_0_TR_OUT0_265, TCPWM_0_TR_OUT0_266, TCPWM_0_TR_OUT0_267, TCPWM_0_TR_OUT0_0, TCPWM_0_TR_OUT0_1, TCPWM_0_TR_OUT0_2, TCPWM_0_TR_OUT0_3, TCPWM_0_TR_OUT0_4, TCPWM_0_TR_OUT0_5, TCPWM_0_TR_OUT0_6, TCPWM_0_TR_OUT0_7, TCPWM_0_TR_OUT0_8, TCPWM_0_TR_OUT0_9, TCPWM_0_TR_OUT0_10, TCPWM_0_TR_OUT0_11, TCPWM_0_TR_OUT0_12, TCPWM_0_TR_OUT0_13, TCPWM_0_TR_OUT0_14, TCPWM_0_TR_OUT0_15, TCPWM_0_TR_OUT0_16, TCPWM_0_TR_OUT0_17, TCPWM_0_TR_OUT0_18, TCPWM_0_TR_OUT0_19, TCPWM_0_TR_OUT0_20, TCPWM_0_TR_OUT0_21, TCPWM_0_TR_OUT0_22, TCPWM_0_TR_OUT0_23, TCPWM_0_TR_OUT0_24, TCPWM_0_TR_OUT0_25, TCPWM_0_TR_OUT0_26, TCPWM_0_TR_OUT0_27, TCPWM_0_TR_OUT0_28, TCPWM_0_TR_OUT0_29, TCPWM_0_TR_OUT0_30, TCPWM_0_TR_OUT0_31, TCPWM_0_TR_OUT0_32, TCPWM_0_TR_OUT0_33, TCPWM_0_TR_OUT0_34, TCPWM_0_TR_OUT0_35, TCPWM_0_TR_OUT0_36, TCPWM_0_TR_OUT0_37, TCPWM_0_TR_OUT0_38, TCPWM_0_TR_OUT0_39, TCPWM_0_TR_OUT0_40, TCPWM_0_TR_OUT0_41, TCPWM_0_TR_OUT0_42, TCPWM_0_TR_OUT0_43, TCPWM_0_TR_OUT0_44, TCPWM_0_TR_OUT0_45, TCPWM_0_TR_OUT0_46, TCPWM_0_TR_OUT0_47, TCPWM_0_TR_OUT0_48, TCPWM_0_TR_OUT0_49, TCPWM_0_TR_OUT0_50, TCPWM_0_TR_OUT0_51, TCPWM_0_TR_OUT0_52, TCPWM_0_TR_OUT0_53, TCPWM_0_TR_OUT0_54, TCPWM_0_TR_OUT0_55, TCPWM_0_TR_OUT0_56, TCPWM_0_TR_OUT0_57, TCPWM_0_TR_OUT0_58, TCPWM_0_TR_OUT0_59, TCPWM_0_TR_OUT0_60, TCPWM_0_TR_OUT0_61, TCPWM_0_TR_OUT0_62, CANFD_0_TR_TMP_RTP_OUT_0, CANFD_0_TR_TMP_RTP_OUT_1, CANFD_0_TR_TMP_RTP_OUT_2, CANFD_1_TR_TMP_RTP_OUT_0, CANFD_1_TR_TMP_RTP_OUT_1, CANFD_1_TR_TMP_RTP_OUT_2, TCPWM_0_TR_OUT1_0, TCPWM_0_TR_OUT1_1, TCPWM_0_TR_OUT1_2, TCPWM_0_TR_OUT1_3, TCPWM_0_TR_OUT1_4, TCPWM_0_TR_OUT1_5, TCPWM_0_TR_OUT1_6, TCPWM_0_TR_OUT1_7, SCB_0_TR_TX_REQ, SCB_0_TR_RX_REQ, SCB_0_TR_I2C_SCL_FILTERED, SCB_1_TR_TX_REQ, SCB_1_TR_RX_REQ, SCB_1_TR_I2C_SCL_FILTERED, SCB_2_TR_TX_REQ, SCB_2_TR_RX_REQ, SCB_2_TR_I2C_SCL_FILTERED, SCB_3_TR_TX_REQ, SCB_3_TR_RX_REQ, SCB_3_TR_I2C_SCL_FILTERED, SCB_4_TR_TX_REQ, SCB_4_TR_RX_REQ, SCB_4_TR_I2C_SCL_FILTERED, SCB_5_TR_TX_REQ, SCB_5_TR_RX_REQ, SCB_5_TR_I2C_SCL_FILTERED, SCB_6_TR_TX_REQ, SCB_6_TR_RX_REQ, SCB_6_TR_I2C_SCL_FILTERED, SCB_7_TR_TX_REQ, SCB_7_TR_RX_REQ, SCB_7_TR_I2C_SCL_FILTERED, CANFD_0_TR_DBG_DMA_REQ_0, CANFD_0_TR_DBG_DMA_REQ_1, CANFD_0_TR_DBG_DMA_REQ_2, CANFD_0_TR_FIFO0_0, CANFD_0_TR_FIFO0_1, CANFD_0_TR_FIFO0_2, CANFD_0_TR_FIFO1_0, CANFD_0_TR_FIFO1_1, CANFD_0_TR_FIFO1_2, CANFD_1_TR_DBG_DMA_REQ_0, CANFD_1_TR_DBG_DMA_REQ_1, CANFD_1_TR_DBG_DMA_REQ_2, CANFD_1_TR_FIFO0_0, CANFD_1_TR_FIFO0_1, CANFD_1_TR_FIFO0_2, CANFD_1_TR_FIFO1_0, CANFD_1_TR_FIFO1_1, CANFD_1_TR_FIFO1_2, EVTGEN_0_TR_OUT_0, EVTGEN_0_TR_OUT_1, EVTGEN_0_TR_OUT_2, TCPWM_0_TR_OUT1_512, TCPWM_0_TR_OUT1_513, TCPWM_0_TR_OUT1_514, TCPWM_0_TR_OUT1_515, TCPWM_0_TR_OUT1_256, TCPWM_0_TR_OUT1_257, TCPWM_0_TR_OUT1_258, TCPWM_0_TR_OUT1_259, TCPWM_0_TR_OUT1_260, TCPWM_0_TR_OUT1_261, TCPWM_0_TR_OUT1_262, TCPWM_0_TR_OUT1_263, TCPWM_0_TR_OUT1_264, TCPWM_0_TR_OUT1_265, TCPWM_0_TR_OUT1_266, TCPWM_0_TR_OUT1_267, TR_GROUP_9_OUTPUT_0, TR_GROUP_9_OUTPUT_1, TR_GROUP_9_OUTPUT_2, TR_GROUP_9_OUTPUT_3, TR_GROUP_9_OUTPUT_4, TR_GROUP_10_OUTPUT_0, TR_GROUP_10_OUTPUT_1, TR_GROUP_10_OUTPUT_2, TR_GROUP_10_OUTPUT_3, TR_GROUP_10_OUTPUT_4, CPUSS_DW0_TR_OUT_16, CPUSS_DW0_TR_OUT_17, CPUSS_DW0_TR_OUT_18, CPUSS_DW0_TR_OUT_19, CPUSS_DW0_TR_OUT_20, CPUSS_DW0_TR_OUT_21, CPUSS_DW0_TR_OUT_22, CPUSS_DW0_TR_OUT_23, CPUSS_DW0_TR_OUT_24, CPUSS_DW0_TR_OUT_25, CPUSS_DW0_TR_OUT_26, CPUSS_DW0_TR_OUT_27, CPUSS_DW0_TR_OUT_28, CPUSS_DW0_TR_OUT_29, CPUSS_DW0_TR_OUT_30, CPUSS_DW0_TR_OUT_31, CPUSS_DW0_TR_OUT_32, CPUSS_DW0_TR_OUT_33, CPUSS_DW0_TR_OUT_34, CPUSS_DW0_TR_OUT_35, CPUSS_DW0_TR_OUT_36, CPUSS_DW0_TR_OUT_37, CPUSS_DW0_TR_OUT_38, CPUSS_DW0_TR_OUT_39, CPUSS_DW0_TR_OUT_40, CPUSS_DW0_TR_OUT_41, CPUSS_DW0_TR_OUT_42, CPUSS_DW0_TR_OUT_43, CPUSS_DW0_TR_OUT_44, CPUSS_DW0_TR_OUT_45, CPUSS_DW0_TR_OUT_46, CPUSS_DW0_TR_OUT_47, CPUSS_DW0_TR_OUT_48, CPUSS_DW0_TR_OUT_49, CPUSS_DW0_TR_OUT_50, CPUSS_DW0_TR_OUT_51, CPUSS_DW0_TR_OUT_52, CPUSS_DW0_TR_OUT_53, CPUSS_DW0_TR_OUT_54, CPUSS_DW0_TR_OUT_55, CPUSS_DW0_TR_OUT_56, CPUSS_DW0_TR_OUT_57, CPUSS_DW0_TR_OUT_58, CPUSS_DW0_TR_OUT_59, CPUSS_DW0_TR_OUT_60, CPUSS_DW0_TR_OUT_61, CPUSS_DW0_TR_OUT_62, CPUSS_DW0_TR_OUT_63, CPUSS_DW0_TR_OUT_64, CPUSS_DW0_TR_OUT_65, CPUSS_DW0_TR_OUT_66, CPUSS_DW0_TR_OUT_67, CPUSS_DW0_TR_OUT_68, CPUSS_DW0_TR_OUT_69, CPUSS_DW0_TR_OUT_70, CPUSS_DW0_TR_OUT_71, CPUSS_DW0_TR_OUT_72, CPUSS_DW0_TR_OUT_73, CPUSS_DW0_TR_OUT_74, CPUSS_DW0_TR_OUT_75, CPUSS_DW0_TR_OUT_76, CPUSS_DW0_TR_OUT_77, CPUSS_DW0_TR_OUT_78, CPUSS_DW0_TR_OUT_79, CPUSS_DW0_TR_OUT_80, CPUSS_DW0_TR_OUT_81, CPUSS_DW0_TR_OUT_82, CPUSS_DW0_TR_OUT_83, CPUSS_DW0_TR_OUT_84, CPUSS_DW0_TR_OUT_85, CPUSS_DW0_TR_OUT_86, CPUSS_DW0_TR_OUT_87, CPUSS_DW0_TR_OUT_88, CPUSS_DW1_TR_OUT_8, CPUSS_DW1_TR_OUT_9, CPUSS_DW1_TR_OUT_10, CPUSS_DW1_TR_OUT_11, CPUSS_DW1_TR_OUT_12, CPUSS_DW1_TR_OUT_13, CPUSS_DW1_TR_OUT_14, CPUSS_DW1_TR_OUT_15, CPUSS_DW1_TR_OUT_16, CPUSS_DW1_TR_OUT_17, CPUSS_DW1_TR_OUT_18, CPUSS_DW1_TR_OUT_19, CPUSS_DW1_TR_OUT_20, CPUSS_DW1_TR_OUT_21, CPUSS_DW1_TR_OUT_22, CPUSS_DW1_TR_OUT_23, CPUSS_DW1_TR_OUT_24, CPUSS_DW1_TR_OUT_25, CPUSS_DW1_TR_OUT_26, CPUSS_DW1_TR_OUT_27, CPUSS_DW1_TR_OUT_28, CPUSS_DW1_TR_OUT_29, CPUSS_DW1_TR_OUT_30, CPUSS_DW1_TR_OUT_31, CPUSS_DW1_TR_OUT_32, TCPWM_0_TR_OUT1_8, TCPWM_0_TR_OUT1_9, TCPWM_0_TR_OUT1_10, TCPWM_0_TR_OUT1_11, TCPWM_0_TR_OUT1_12, TCPWM_0_TR_OUT1_13, TCPWM_0_TR_OUT1_14, TCPWM_0_TR_OUT1_15, TCPWM_0_TR_OUT1_16, TCPWM_0_TR_OUT1_17, TCPWM_0_TR_OUT1_18, TCPWM_0_TR_OUT1_19, TCPWM_0_TR_OUT1_20, TCPWM_0_TR_OUT1_21, TCPWM_0_TR_OUT1_22, TCPWM_0_TR_OUT1_23, TCPWM_0_TR_OUT1_24, TCPWM_0_TR_OUT1_25, TCPWM_0_TR_OUT1_26, TCPWM_0_TR_OUT1_27, TCPWM_0_TR_OUT1_28, TCPWM_0_TR_OUT1_29, TCPWM_0_TR_OUT1_30, TCPWM_0_TR_OUT1_31, TCPWM_0_TR_OUT1_32, TCPWM_0_TR_OUT1_33, TCPWM_0_TR_OUT1_34, TCPWM_0_TR_OUT1_35, TCPWM_0_TR_OUT1_36, TCPWM_0_TR_OUT1_37, TCPWM_0_TR_OUT1_38, TCPWM_0_TR_OUT1_39, TCPWM_0_TR_OUT1_40, TCPWM_0_TR_OUT1_41, TCPWM_0_TR_OUT1_42, TCPWM_0_TR_OUT1_43, TCPWM_0_TR_OUT1_44, TCPWM_0_TR_OUT1_45, TCPWM_0_TR_OUT1_46, TCPWM_0_TR_OUT1_47, TCPWM_0_TR_OUT1_48, TCPWM_0_TR_OUT1_49, TCPWM_0_TR_OUT1_50, TCPWM_0_TR_OUT1_51, TCPWM_0_TR_OUT1_52, TCPWM_0_TR_OUT1_53, TCPWM_0_TR_OUT1_54, TCPWM_0_TR_OUT1_55, TCPWM_0_TR_OUT1_56, TCPWM_0_TR_OUT1_57, TCPWM_0_TR_OUT1_58, TCPWM_0_TR_OUT1_59, TCPWM_0_TR_OUT1_60, TCPWM_0_TR_OUT1_61, TCPWM_0_TR_OUT1_62, TCPWM_0_TR_OUT0_516, TCPWM_0_TR_OUT0_517, TCPWM_0_TR_OUT0_518, TCPWM_0_TR_OUT0_519, CXPI_0_TR_TX_REQ_0, CXPI_0_TR_TX_REQ_1, CXPI_0_TR_RX_REQ_0, CXPI_0_TR_RX_REQ_1, TCPWM_0_TR_OUT1_516, TCPWM_0_TR_OUT1_517, TCPWM_0_TR_OUT1_518, TCPWM_0_TR_OUT1_519, CPUSS_DW0_TR_OUT_89, CPUSS_DW0_TR_OUT_90, CPUSS_DW0_TR_OUT_91, CPUSS_DW1_TR_OUT_33, CPUSS_DW1_TR_OUT_34, CPUSS_DW1_TR_OUT_35, CPUSS_DW1_TR_OUT_36, CPUSS_DW1_TR_OUT_37, CPUSS_DW1_TR_OUT_38, CPUSS_DW1_TR_OUT_39, CPUSS_DW1_TR_OUT_40, CPUSS_DW1_TR_OUT_41, CPUSS_DW1_TR_OUT_42, CPUSS_DW1_TR_OUT_43, CANFD_1_TR_TMP_RTP_OUT_3, CANFD_1_TR_DBG_DMA_REQ_3, CANFD_1_TR_FIFO0_3, CANFD_1_TR_FIFO1_3, CXPI_0_TR_TX_REQ_2, CXPI_0_TR_RX_REQ_2, CANFD_0_TR_TMP_RTP_OUT_3, CANFD_0_TR_DBG_DMA_REQ_3, CANFD_0_TR_FIFO0_3, CANFD_0_TR_FIFO1_3, CXPI_0_TR_TX_REQ_3, CXPI_0_TR_RX_REQ_3, CPUSS_DMAC_TR_OUT_4, CPUSS_DMAC_TR_OUT_5, CPUSS_DMAC_TR_OUT_6, CPUSS_DMAC_TR_OUT_7, CANFD_0_TR_TMP_RTP_OUT_4, CANFD_1_TR_TMP_RTP_OUT_4, TCPWM_1_TR_OUT0_0, TCPWM_1_TR_OUT0_1, TCPWM_1_TR_OUT0_2, TCPWM_1_TR_OUT0_3, TCPWM_1_TR_OUT0_4, TCPWM_1_TR_OUT0_5, TCPWM_1_TR_OUT0_6, TCPWM_1_TR_OUT0_7, TCPWM_1_TR_OUT0_8, TCPWM_1_TR_OUT0_9, TCPWM_1_TR_OUT0_10, TCPWM_1_TR_OUT0_11, TCPWM_1_TR_OUT0_12, TCPWM_1_TR_OUT0_13, TCPWM_1_TR_OUT0_14, TCPWM_1_TR_OUT0_15, TCPWM_1_TR_OUT0_16, TCPWM_1_TR_OUT0_17, TCPWM_1_TR_OUT0_18, TCPWM_1_TR_OUT0_19, TCPWM_1_TR_OUT0_20, TCPWM_1_TR_OUT0_21, TCPWM_1_TR_OUT0_22, TCPWM_1_TR_OUT0_23, TCPWM_1_TR_OUT0_24, TCPWM_1_TR_OUT0_25, TCPWM_1_TR_OUT0_26, TCPWM_1_TR_OUT0_27, TCPWM_1_TR_OUT0_28, TCPWM_1_TR_OUT0_29, TCPWM_1_TR_OUT0_256, TCPWM_1_TR_OUT0_257, TCPWM_1_TR_OUT0_258, TCPWM_1_TR_OUT0_259, TCPWM_1_TR_OUT0_260, TCPWM_1_TR_OUT0_261, TCPWM_1_TR_OUT0_262, TCPWM_1_TR_OUT0_263, TCPWM_1_TR_OUT0_264, TCPWM_1_TR_OUT0_265, TCPWM_1_TR_OUT0_266, TCPWM_1_TR_OUT0_267, TCPWM_1_TR_OUT0_512, TCPWM_1_TR_OUT0_513, TCPWM_1_TR_OUT0_514, TCPWM_1_TR_OUT0_515, TCPWM_1_TR_OUT0_516, TCPWM_1_TR_OUT0_517, TCPWM_1_TR_OUT0_518, TCPWM_1_TR_OUT0_519, TCPWM_1_TR_OUT0_520, TCPWM_1_TR_OUT0_521, TCPWM_1_TR_OUT0_522, TCPWM_1_TR_OUT0_523, TCPWM_1_TR_OUT0_524, TCPWM_1_TR_OUT0_30, TCPWM_1_TR_OUT0_31, TCPWM_1_TR_OUT0_32, TCPWM_1_TR_OUT0_33, TCPWM_1_TR_OUT0_34, TCPWM_1_TR_OUT0_35, TCPWM_1_TR_OUT0_36, TCPWM_1_TR_OUT0_37, TCPWM_1_TR_OUT0_38, TCPWM_1_TR_OUT0_39, TCPWM_1_TR_OUT0_40, TCPWM_1_TR_OUT0_41, TCPWM_1_TR_OUT0_42, TCPWM_1_TR_OUT0_43, TCPWM_1_TR_OUT0_44, TCPWM_1_TR_OUT0_45, TCPWM_1_TR_OUT0_46, TCPWM_1_TR_OUT0_47, TCPWM_1_TR_OUT0_48, TCPWM_1_TR_OUT0_49, TCPWM_1_TR_OUT0_50, TCPWM_1_TR_OUT0_51, TCPWM_1_TR_OUT0_52, TCPWM_1_TR_OUT0_53, TCPWM_1_TR_OUT0_54, TCPWM_1_TR_OUT0_55, TCPWM_1_TR_OUT0_56, TCPWM_1_TR_OUT0_57, TCPWM_1_TR_OUT0_58, TCPWM_1_TR_OUT0_59, TCPWM_1_TR_OUT0_60, TCPWM_1_TR_OUT0_61, TCPWM_1_TR_OUT0_62, TCPWM_1_TR_OUT0_63, TCPWM_1_TR_OUT0_64, TCPWM_1_TR_OUT0_65, TCPWM_1_TR_OUT0_66, TCPWM_1_TR_OUT0_67, TCPWM_1_TR_OUT0_68, TCPWM_1_TR_OUT0_69, TCPWM_1_TR_OUT0_70, TCPWM_1_TR_OUT0_71, TCPWM_1_TR_OUT0_72, TCPWM_1_TR_OUT0_73, TCPWM_1_TR_OUT0_74, TCPWM_1_TR_OUT0_75, TCPWM_1_TR_OUT0_76, TCPWM_1_TR_OUT0_77, TCPWM_1_TR_OUT0_78, TCPWM_1_TR_OUT0_79, TCPWM_1_TR_OUT0_80, TCPWM_1_TR_OUT0_81, TCPWM_1_TR_OUT0_82, TCPWM_1_TR_OUT0_83, PERI_TR_IO_INPUT_32, PERI_TR_IO_INPUT_33, PERI_TR_IO_INPUT_34, PERI_TR_IO_INPUT_35, PERI_TR_IO_INPUT_36, PERI_TR_IO_INPUT_37, PERI_TR_IO_INPUT_38, PERI_TR_IO_INPUT_39, PERI_TR_IO_INPUT_40, PERI_TR_IO_INPUT_41, PERI_TR_IO_INPUT_42, PERI_TR_IO_INPUT_43, PERI_TR_IO_INPUT_44, PERI_TR_IO_INPUT_45, PERI_TR_IO_INPUT_46, PERI_TR_IO_INPUT_47, SMIF_0_TR_TX_REQ, SMIF_0_TR_RX_REQ, AUDIOSS_0_TR_I2S_TX_REQ, AUDIOSS_0_TR_I2S_RX_REQ, AUDIOSS_1_TR_I2S_TX_REQ, AUDIOSS_1_TR_I2S_RX_REQ, AUDIOSS_2_TR_I2S_TX_REQ, AUDIOSS_2_TR_I2S_RX_REQ, CANFD_0_TR_DBG_DMA_REQ_4, CANFD_0_TR_FIFO0_4, CANFD_0_TR_FIFO1_4, CANFD_1_TR_DBG_DMA_REQ_4, CANFD_1_TR_FIFO0_4, CANFD_1_TR_FIFO1_4, EVTGEN_0_TR_OUT_11, TCPWM_1_TR_OUT1_0, TCPWM_1_TR_OUT1_1, TCPWM_1_TR_OUT1_2, TCPWM_1_TR_OUT1_3, TCPWM_1_TR_OUT1_4, TCPWM_1_TR_OUT1_5, TCPWM_1_TR_OUT1_6, TCPWM_1_TR_OUT1_7, TCPWM_1_TR_OUT1_8, TCPWM_1_TR_OUT1_9, TCPWM_1_TR_OUT1_10, TCPWM_1_TR_OUT1_11, TCPWM_1_TR_OUT1_12, TCPWM_1_TR_OUT1_13, TCPWM_1_TR_OUT1_14, TCPWM_1_TR_OUT1_15, SCB_8_TR_TX_REQ, SCB_8_TR_RX_REQ, SCB_8_TR_I2C_SCL_FILTERED, SCB_9_TR_TX_REQ, SCB_9_TR_RX_REQ, SCB_9_TR_I2C_SCL_FILTERED, SCB_10_TR_TX_REQ, SCB_10_TR_RX_REQ, SCB_10_TR_I2C_SCL_FILTERED, EVTGEN_0_TR_OUT_12, EVTGEN_0_TR_OUT_13, EVTGEN_0_TR_OUT_14, TR_GROUP_11_OUTPUT_0, TR_GROUP_11_OUTPUT_1, TR_GROUP_11_OUTPUT_2, TR_GROUP_11_OUTPUT_3, TR_GROUP_11_OUTPUT_4, TR_GROUP_12_OUTPUT_0, TR_GROUP_12_OUTPUT_1, TR_GROUP_12_OUTPUT_2, TR_GROUP_12_OUTPUT_3, TR_GROUP_12_OUTPUT_4, CPUSS_DW0_TR_OUT_92, CPUSS_DW0_TR_OUT_93, CPUSS_DW0_TR_OUT_94, CPUSS_DW0_TR_OUT_95, CPUSS_DW0_TR_OUT_96, CPUSS_DW0_TR_OUT_97, CPUSS_DW0_TR_OUT_98, CPUSS_DW0_TR_OUT_99, CPUSS_DW0_TR_OUT_100, CPUSS_DW0_TR_OUT_101, CPUSS_DW0_TR_OUT_102, CPUSS_DW0_TR_OUT_103, CPUSS_DW0_TR_OUT_104, CPUSS_DW0_TR_OUT_105, CPUSS_DW0_TR_OUT_106, CPUSS_DW0_TR_OUT_107, CPUSS_DW0_TR_OUT_108, CPUSS_DW0_TR_OUT_109, CPUSS_DW0_TR_OUT_110, CPUSS_DW0_TR_OUT_111, CPUSS_DW0_TR_OUT_112, CPUSS_DW0_TR_OUT_113, CPUSS_DW0_TR_OUT_114, CPUSS_DW0_TR_OUT_115, CPUSS_DW0_TR_OUT_116, CPUSS_DW0_TR_OUT_117, CPUSS_DW0_TR_OUT_118, CPUSS_DW0_TR_OUT_119, CPUSS_DW0_TR_OUT_120, CPUSS_DW0_TR_OUT_121, CPUSS_DW0_TR_OUT_122, CPUSS_DW0_TR_OUT_123, CPUSS_DW0_TR_OUT_124, CPUSS_DW0_TR_OUT_125, CPUSS_DW0_TR_OUT_126, CPUSS_DW0_TR_OUT_127, CPUSS_DW0_TR_OUT_128, CPUSS_DW0_TR_OUT_129, CPUSS_DW0_TR_OUT_130, CPUSS_DW0_TR_OUT_131, CPUSS_DW0_TR_OUT_132, CPUSS_DW0_TR_OUT_133, CPUSS_DW0_TR_OUT_134, CPUSS_DW0_TR_OUT_135, CPUSS_DW0_TR_OUT_136, CPUSS_DW0_TR_OUT_137, CPUSS_DW0_TR_OUT_138, CPUSS_DW0_TR_OUT_139, CPUSS_DW0_TR_OUT_140, CPUSS_DW0_TR_OUT_141, CPUSS_DW0_TR_OUT_142, EVTGEN_0_TR_OUT_15, CPUSS_DW1_TR_OUT_44, CPUSS_DW1_TR_OUT_45, CPUSS_DW1_TR_OUT_46, CPUSS_DW1_TR_OUT_47, CPUSS_DW1_TR_OUT_48, CPUSS_DW1_TR_OUT_49, CPUSS_DW1_TR_OUT_50, CPUSS_DW1_TR_OUT_51, CPUSS_DW1_TR_OUT_52, CPUSS_DW1_TR_OUT_53, CPUSS_DW1_TR_OUT_54, CPUSS_DW1_TR_OUT_55, CPUSS_DW1_TR_OUT_56, CPUSS_DW1_TR_OUT_57, CPUSS_DW1_TR_OUT_58, CPUSS_DW1_TR_OUT_59, CPUSS_DW1_TR_OUT_60, CPUSS_DW1_TR_OUT_61, CPUSS_DW1_TR_OUT_62, CPUSS_DW1_TR_OUT_63, CPUSS_DW1_TR_OUT_64, TCPWM_1_TR_OUT1_16, TCPWM_1_TR_OUT1_17, TCPWM_1_TR_OUT1_18, TCPWM_1_TR_OUT1_19, TCPWM_1_TR_OUT1_20, TCPWM_1_TR_OUT1_21, TCPWM_1_TR_OUT1_22, TCPWM_1_TR_OUT1_23, TCPWM_1_TR_OUT1_24, TCPWM_1_TR_OUT1_25, TCPWM_1_TR_OUT1_26, TCPWM_1_TR_OUT1_27, TCPWM_1_TR_OUT1_28, TCPWM_1_TR_OUT1_29, TCPWM_1_TR_OUT1_30, TCPWM_1_TR_OUT1_31, TCPWM_1_TR_OUT1_32, TCPWM_1_TR_OUT1_33, TCPWM_1_TR_OUT1_34, TCPWM_1_TR_OUT1_35, TCPWM_1_TR_OUT1_36, TCPWM_1_TR_OUT1_37, TCPWM_1_TR_OUT1_38, TCPWM_1_TR_OUT1_39, TCPWM_1_TR_OUT1_40, TCPWM_1_TR_OUT1_41, TCPWM_1_TR_OUT1_42, TCPWM_1_TR_OUT1_43, TCPWM_1_TR_OUT1_44, TCPWM_1_TR_OUT1_45, TCPWM_1_TR_OUT1_46, TCPWM_1_TR_OUT1_47, TCPWM_1_TR_OUT1_48, TCPWM_1_TR_OUT1_49, TCPWM_1_TR_OUT1_50, TCPWM_1_TR_OUT1_51, TCPWM_1_TR_OUT1_52, TCPWM_1_TR_OUT1_53, TCPWM_1_TR_OUT1_54, TCPWM_1_TR_OUT1_55, TCPWM_1_TR_OUT1_56, TCPWM_1_TR_OUT1_57, TCPWM_1_TR_OUT1_58, TCPWM_1_TR_OUT1_59, TCPWM_1_TR_OUT1_60, TCPWM_1_TR_OUT1_61, TCPWM_1_TR_OUT1_62, TCPWM_1_TR_OUT1_63, TCPWM_1_TR_OUT1_64, TCPWM_1_TR_OUT1_65, TCPWM_1_TR_OUT1_66, TCPWM_1_TR_OUT1_67, TCPWM_1_TR_OUT1_68, TCPWM_1_TR_OUT1_69, TCPWM_1_TR_OUT1_70, TCPWM_1_TR_OUT1_71, TCPWM_1_TR_OUT1_72, TCPWM_1_TR_OUT1_73, TCPWM_1_TR_OUT1_74, TCPWM_1_TR_OUT1_75, TCPWM_1_TR_OUT1_76, TCPWM_1_TR_OUT1_77, TCPWM_1_TR_OUT1_78, TCPWM_1_TR_OUT1_79, TCPWM_1_TR_OUT1_80, TCPWM_1_TR_OUT1_81, TCPWM_1_TR_OUT1_82, TCPWM_1_TR_OUT1_83, TCPWM_1_TR_OUT1_256, TCPWM_1_TR_OUT1_257, TCPWM_1_TR_OUT1_258, TCPWM_1_TR_OUT1_259, TCPWM_1_TR_OUT1_260, TCPWM_1_TR_OUT1_261, TCPWM_1_TR_OUT1_262, TCPWM_1_TR_OUT1_263, TCPWM_1_TR_OUT1_264, TCPWM_1_TR_OUT1_265, TCPWM_1_TR_OUT1_266, TCPWM_1_TR_OUT1_267, TCPWM_1_TR_OUT1_512, TCPWM_1_TR_OUT1_513, TCPWM_1_TR_OUT1_514, TCPWM_1_TR_OUT1_515, TCPWM_1_TR_OUT1_516, TCPWM_1_TR_OUT1_517, TCPWM_1_TR_OUT1_518, TCPWM_1_TR_OUT1_519, TCPWM_1_TR_OUT1_520, TCPWM_1_TR_OUT1_521, TCPWM_1_TR_OUT1_522, TCPWM_1_TR_OUT1_523, TCPWM_1_TR_OUT1_524, FLEXRAY_0_TR_TINT0_OUT, FLEXRAY_0_TR_IBF_OUT, FLEXRAY_0_TR_OBF_OUT, TCPWM_0_TR_OUT0_520, TCPWM_0_TR_OUT0_521, TCPWM_0_TR_OUT0_522, TCPWM_0_TR_OUT0_523, TCPWM_0_TR_OUT0_524, TCPWM_0_TR_OUT0_525, TCPWM_0_TR_OUT0_526, TCPWM_0_TR_OUT0_527, TCPWM_0_TR_OUT0_528, TCPWM_0_TR_OUT0_529, TCPWM_0_TR_OUT0_530, TCPWM_0_TR_OUT0_531, TCPWM_0_TR_OUT0_532, TCPWM_0_TR_OUT0_533, TCPWM_0_TR_OUT0_534, TCPWM_0_TR_OUT0_535, TCPWM_0_TR_OUT0_536, TCPWM_0_TR_OUT0_537, TCPWM_0_TR_OUT0_538, TCPWM_0_TR_OUT0_539, TCPWM_0_TR_OUT0_540, TCPWM_0_TR_OUT0_541, TCPWM_0_TR_OUT0_542, TCPWM_0_TR_OUT0_543, I2S_0_TR_TX_REQ_0, I2S_0_TR_TX_REQ_1, I2S_0_TR_TX_REQ_2, I2S_0_TR_TX_REQ_3, I2S_0_TR_RX_REQ_0, I2S_0_TR_RX_REQ_1, I2S_0_TR_RX_REQ_2, I2S_0_TR_RX_REQ_3, TDM_0_TR_TX_REQ_0, TDM_0_TR_TX_REQ_1, TDM_0_TR_TX_REQ_2, TDM_0_TR_TX_REQ_3, TDM_0_TR_RX_REQ_0, TDM_0_TR_RX_REQ_1, TDM_0_TR_RX_REQ_2, TDM_0_TR_RX_REQ_3, SG_0_TR_COMPLETE_0, SG_0_TR_COMPLETE_1, SG_0_TR_COMPLETE_2, SG_0_TR_COMPLETE_3, SG_0_TR_COMPLETE_4, PWM_0_TR_TX_REQ_0, PWM_0_TR_TX_REQ_1, MIXER_0_TR_SRC_REQ_0, MIXER_0_TR_SRC_REQ_1, MIXER_0_TR_SRC_REQ_2, MIXER_0_TR_SRC_REQ_3, MIXER_0_TR_SRC_REQ_4, MIXER_0_TR_DST_REQ, MIXER_1_TR_SRC_REQ_0, MIXER_1_TR_SRC_REQ_1, MIXER_1_TR_SRC_REQ_2, MIXER_1_TR_SRC_REQ_3, MIXER_1_TR_SRC_REQ_4, MIXER_1_TR_DST_REQ, SCB_11_TR_TX_REQ, SCB_11_TR_RX_REQ, SCB_11_TR_I2C_SCL_FILTERED, CPUSS_DW1_TR_OUT_65, CPUSS_DW1_TR_OUT_66, CPUSS_DW1_TR_OUT_67, CPUSS_DW1_TR_OUT_68, CPUSS_DW1_TR_OUT_69, CPUSS_DW1_TR_OUT_70, CPUSS_DW1_TR_OUT_71, CPUSS_DW1_TR_OUT_72, CPUSS_DW1_TR_OUT_73, CPUSS_DW1_TR_OUT_74, CPUSS_DW1_TR_OUT_75, CPUSS_DW1_TR_OUT_76, CPUSS_DW1_TR_OUT_77, CPUSS_DW1_TR_OUT_78, CPUSS_DW1_TR_OUT_79, CPUSS_DW1_TR_OUT_80, CPUSS_DW1_TR_OUT_81, CPUSS_DW1_TR_OUT_82, CPUSS_DW1_TR_OUT_83, TCPWM_0_TR_OUT1_520, TCPWM_0_TR_OUT1_521, TCPWM_0_TR_OUT1_522, TCPWM_0_TR_OUT1_523, TCPWM_0_TR_OUT1_524, TCPWM_0_TR_OUT1_525, TCPWM_0_TR_OUT1_526, TCPWM_0_TR_OUT1_527, TCPWM_0_TR_OUT1_528, TCPWM_0_TR_OUT1_529, TCPWM_0_TR_OUT1_530, TCPWM_0_TR_OUT1_531, TCPWM_0_TR_OUT1_532, TCPWM_0_TR_OUT1_533, TCPWM_0_TR_OUT1_534, TCPWM_0_TR_OUT1_535, TCPWM_0_TR_OUT1_536, TCPWM_0_TR_OUT1_537, TCPWM_0_TR_OUT1_538, TCPWM_0_TR_OUT1_539, TCPWM_0_TR_OUT1_540, TCPWM_0_TR_OUT1_541, TCPWM_0_TR_OUT1_542, TCPWM_0_TR_OUT1_543, SMIF_1_TR_TX_REQ, SMIF_1_TR_RX_REQ, DAC_0_TR_TX_REQ, AXI_DMAC_TR_OUT_0, AXI_DMAC_TR_OUT_1, AXI_DMAC_TR_OUT_2, AXI_DMAC_TR_OUT_3, AXI_DMAC_0_TR_OUT_0, AXI_DMAC_0_TR_OUT_1, AXI_DMAC_0_TR_OUT_2, AXI_DMAC_0_TR_OUT_3, AXI_DMAC_0_TR_OUT_4, AXI_DMAC_0_TR_OUT_5, AXI_DMAC_0_TR_OUT_6, AXI_DMAC_0_TR_OUT_7, SMIF_0_SMIF0_TR_TX_REQ, SMIF_0_SMIF0_TR_RX_REQ, SMIF_0_SMIF1_TR_TX_REQ, SMIF_0_SMIF1_TR_RX_REQ}, origin=Cypress, set at post-build, default-value=CPUSS_ZERO  # Specifies input trigger.
          boolean PortTrInvertEnable: origin=Cypress, set at post-build, default-value=false  # Specifies if the output trigger is inverted.
          enumeration PortTrSensitiveType: {PORT_TR_SENSITIVE_LEVEL, PORT_TR_SENSITIVE_EDGE}, origin=Cypress, set at post-build, default-value=PORT_TR_SENSITIVE_LEVEL  # Specifies if the output trigger is treated as a level sensitive or edge sensitive trigger.
          boolean PortTrDbgFreezeEnable: origin=Cypress, set at post-build, default-value=false  # Specifies if the output trigger is blocked in debug mode.
      container PortTr1To1GroupContainer [1..*]: multiplicity set at post-build, post-build-variant-multiplicity=true  # Configuration of Trigger 1-to-1 Group.
        integer PortTr1To1GroupId: 0..15, origin=Cypress, set at post-build, default-value=0  # Trigger 1-to-1 Group ID. - Press 'calc' button after selecting PortTr1To1GroupName.
        enumeration PortTr1To1GroupName: {TCPWM_TO_LIN, PWM0_TO_PASS, PASS_TO_DW0, PASS_TO_PWM, CAN0_DW_TR, CAN1_DW_TR, CAN0_DW_ACK, CAN1_DW_ACK, SCB_DW_TR, EVTGEN_CXPI_TR, CXPI_DW_TR, CAN0_DW0_TR, SCB_DW1_TR, SMIF_DW1_TR, CAN1_DW1_TR, I2S_DW1_TR, PWM_TO_PASS, CAN1_DW1_ACK, CAN0_DW0_ACK, DW1_DW1_TR, FLEXYRAY_DW1_TR, DW1_FLEXRAY_TR, TO_PDMA0, TO_PDMA1, TO_TCPWM0, TO_PASS0, TO_CANFD1, TO_CANFD0, TO_LIN0, TO_CXPI0}, origin=Cypress, set at post-build, default-value=TCPWM_TO_LIN  # Name of Trigger 1-to-1 Group.
        container Port1To1OutputTrigger [1..*]: multiplicity set at post-build, post-build-variant-multiplicity=true  # Configuration of 1-to-1 Output Trigger.
          enumeration PortTr1To1OutputName: {LIN_0_TR_CMD_TX_HEADER_0, LIN_0_TR_CMD_TX_HEADER_1, LIN_0_TR_CMD_TX_HEADER_2, LIN_0_TR_CMD_TX_HEADER_3, LIN_0_TR_CMD_TX_HEADER_4, LIN_0_TR_CMD_TX_HEADER_5, LIN_0_TR_CMD_TX_HEADER_6, LIN_0_TR_CMD_TX_HEADER_7, PASS_0_TR_SAR_CH_IN_0, PASS_0_TR_SAR_CH_IN_1, PASS_0_TR_SAR_CH_IN_2, PASS_0_TR_SAR_CH_IN_3, PASS_0_TR_SAR_CH_IN_4, PASS_0_TR_SAR_CH_IN_5, PASS_0_TR_SAR_CH_IN_6, PASS_0_TR_SAR_CH_IN_7, PASS_0_TR_SAR_CH_IN_8, PASS_0_TR_SAR_CH_IN_9, PASS_0_TR_SAR_CH_IN_10, PASS_0_TR_SAR_CH_IN_11, PASS_0_TR_SAR_CH_IN_12, PASS_0_TR_SAR_CH_IN_13, PASS_0_TR_SAR_CH_IN_14, PASS_0_TR_SAR_CH_IN_15, PASS_0_TR_SAR_CH_IN_16, PASS_0_TR_SAR_CH_IN_17, PASS_0_TR_SAR_CH_IN_18, PASS_0_TR_SAR_CH_IN_19, PASS_0_TR_SAR_CH_IN_20, PASS_0_TR_SAR_CH_IN_21, PASS_0_TR_SAR_CH_IN_22, PASS_0_TR_SAR_CH_IN_23, PASS_0_TR_SAR_CH_IN_32, PASS_0_TR_SAR_CH_IN_33, PASS_0_TR_SAR_CH_IN_34, PASS_0_TR_SAR_CH_IN_35, PASS_0_TR_SAR_CH_IN_36, PASS_0_TR_SAR_CH_IN_37, PASS_0_TR_SAR_CH_IN_38, PASS_0_TR_SAR_CH_IN_39, PASS_0_TR_SAR_CH_IN_40, PASS_0_TR_SAR_CH_IN_41, PASS_0_TR_SAR_CH_IN_42, PASS_0_TR_SAR_CH_IN_43, PASS_0_TR_SAR_CH_IN_44, PASS_0_TR_SAR_CH_IN_45, PASS_0_TR_SAR_CH_IN_46, PASS_0_TR_SAR_CH_IN_47, PASS_0_TR_SAR_CH_IN_48, PASS_0_TR_SAR_CH_IN_49, PASS_0_TR_SAR_CH_IN_50, PASS_0_TR_SAR_CH_IN_51, PASS_0_TR_SAR_CH_IN_52, PASS_0_TR_SAR_CH_IN_53, PASS_0_TR_SAR_CH_IN_54, PASS_0_TR_SAR_CH_IN_55, PASS_0_TR_SAR_CH_IN_56, PASS_0_TR_SAR_CH_IN_57, PASS_0_TR_SAR_CH_IN_58, PASS_0_TR_SAR_CH_IN_59, PASS_0_TR_SAR_CH_IN_60, PASS_0_TR_SAR_CH_IN_61, PASS_0_TR_SAR_CH_IN_62, PASS_0_TR_SAR_CH_IN_63, PASS_0_TR_SAR_CH_IN_64, PASS_0_TR_SAR_CH_IN_65, PASS_0_TR_SAR_CH_IN_66, PASS_0_TR_SAR_CH_IN_67, PASS_0_TR_SAR_CH_IN_68, PASS_0_TR_SAR_CH_IN_69, PASS_0_TR_SAR_CH_IN_70, PASS_0_TR_SAR_CH_IN_71, CPUSS_DW0_TR_IN_25, CPUSS_DW0_TR_IN_26, CPUSS_DW0_TR_IN_27, CPUSS_DW0_TR_IN_28, CPUSS_DW0_TR_IN_29, CPUSS_DW0_TR_IN_30, CPUSS_DW0_TR_IN_31, CPUSS_DW0_TR_IN_32, CPUSS_DW0_TR_IN_33, CPUSS_DW0_TR_IN_34, CPUSS_DW0_TR_IN_35, CPUSS_DW0_TR_IN_36, CPUSS_DW0_TR_IN_37, CPUSS_DW0_TR_IN_38, CPUSS_DW0_TR_IN_39, CPUSS_DW0_TR_IN_40, CPUSS_DW0_TR_IN_41, CPUSS_DW0_TR_IN_42, CPUSS_DW0_TR_IN_43, CPUSS_DW0_TR_IN_44, CPUSS_DW0_TR_IN_45, CPUSS_DW0_TR_IN_46, CPUSS_DW0_TR_IN_47, CPUSS_DW0_TR_IN_48, CPUSS_DW0_TR_IN_49, CPUSS_DW0_TR_IN_50, CPUSS_DW0_TR_IN_51, CPUSS_DW0_TR_IN_52, CPUSS_DW0_TR_IN_53, CPUSS_DW0_TR_IN_54, CPUSS_DW0_TR_IN_55, CPUSS_DW0_TR_IN_56, CPUSS_DW0_TR_IN_57, CPUSS_DW0_TR_IN_58, CPUSS_DW0_TR_IN_59, CPUSS_DW0_TR_IN_60, CPUSS_DW0_TR_IN_61, CPUSS_DW0_TR_IN_62, CPUSS_DW0_TR_IN_63, CPUSS_DW0_TR_IN_64, CPUSS_DW0_TR_IN_65, CPUSS_DW0_TR_IN_66, CPUSS_DW0_TR_IN_67, CPUSS_DW0_TR_IN_68, CPUSS_DW0_TR_IN_69, CPUSS_DW0_TR_IN_70, CPUSS_DW0_TR_IN_71, CPUSS_DW0_TR_IN_72, CPUSS_DW0_TR_IN_73, CPUSS_DW0_TR_IN_74, CPUSS_DW0_TR_IN_75, CPUSS_DW0_TR_IN_76, CPUSS_DW0_TR_IN_77, CPUSS_DW0_TR_IN_78, CPUSS_DW0_TR_IN_79, CPUSS_DW0_TR_IN_80, CPUSS_DW0_TR_IN_81, CPUSS_DW0_TR_IN_82, CPUSS_DW0_TR_IN_83, CPUSS_DW0_TR_IN_84, CPUSS_DW0_TR_IN_85, CPUSS_DW0_TR_IN_86, CPUSS_DW0_TR_IN_87, CPUSS_DW0_TR_IN_88, TCPWM_0_TR_ONE_CNT_IN_770, TCPWM_0_TR_ONE_CNT_IN_779, TCPWM_0_TR_ONE_CNT_IN_788, TCPWM_0_TR_ONE_CNT_IN_797, TCPWM_0_TR_ONE_CNT_IN_2, TCPWM_0_TR_ONE_CNT_IN_5, TCPWM_0_TR_ONE_CNT_IN_8, TCPWM_0_TR_ONE_CNT_IN_11, TCPWM_0_TR_ONE_CNT_IN_14, TCPWM_0_TR_ONE_CNT_IN_17, TCPWM_0_TR_ONE_CNT_IN_20, TCPWM_0_TR_ONE_CNT_IN_23, TCPWM_0_TR_ONE_CNT_IN_26, TCPWM_0_TR_ONE_CNT_IN_29, TCPWM_0_TR_ONE_CNT_IN_32, TCPWM_0_TR_ONE_CNT_IN_35, TCPWM_0_TR_ONE_CNT_IN_38, TCPWM_0_TR_ONE_CNT_IN_41, TCPWM_0_TR_ONE_CNT_IN_44, TCPWM_0_TR_ONE_CNT_IN_47, TCPWM_0_TR_ONE_CNT_IN_50, TCPWM_0_TR_ONE_CNT_IN_53, TCPWM_0_TR_ONE_CNT_IN_56, TCPWM_0_TR_ONE_CNT_IN_59, TCPWM_0_TR_ONE_CNT_IN_773, TCPWM_0_TR_ONE_CNT_IN_782, TCPWM_0_TR_ONE_CNT_IN_791, TCPWM_0_TR_ONE_CNT_IN_800, TCPWM_0_TR_ONE_CNT_IN_62, TCPWM_0_TR_ONE_CNT_IN_65, TCPWM_0_TR_ONE_CNT_IN_68, TCPWM_0_TR_ONE_CNT_IN_71, TCPWM_0_TR_ONE_CNT_IN_74, TCPWM_0_TR_ONE_CNT_IN_77, TCPWM_0_TR_ONE_CNT_IN_80, TCPWM_0_TR_ONE_CNT_IN_83, TCPWM_0_TR_ONE_CNT_IN_86, TCPWM_0_TR_ONE_CNT_IN_89, TCPWM_0_TR_ONE_CNT_IN_92, TCPWM_0_TR_ONE_CNT_IN_95, TCPWM_0_TR_ONE_CNT_IN_98, TCPWM_0_TR_ONE_CNT_IN_101, TCPWM_0_TR_ONE_CNT_IN_104, TCPWM_0_TR_ONE_CNT_IN_107, TCPWM_0_TR_ONE_CNT_IN_110, TCPWM_0_TR_ONE_CNT_IN_113, TCPWM_0_TR_ONE_CNT_IN_116, TCPWM_0_TR_ONE_CNT_IN_119, TCPWM_0_TR_ONE_CNT_IN_122, TCPWM_0_TR_ONE_CNT_IN_125, TCPWM_0_TR_ONE_CNT_IN_128, TCPWM_0_TR_ONE_CNT_IN_131, TCPWM_0_TR_ONE_CNT_IN_134, TCPWM_0_TR_ONE_CNT_IN_137, TCPWM_0_TR_ONE_CNT_IN_140, TCPWM_0_TR_ONE_CNT_IN_143, TCPWM_0_TR_ONE_CNT_IN_776, TCPWM_0_TR_ONE_CNT_IN_785, TCPWM_0_TR_ONE_CNT_IN_794, TCPWM_0_TR_ONE_CNT_IN_803, TCPWM_0_TR_ONE_CNT_IN_146, TCPWM_0_TR_ONE_CNT_IN_149, TCPWM_0_TR_ONE_CNT_IN_152, TCPWM_0_TR_ONE_CNT_IN_155, CPUSS_DW0_TR_IN_16, CPUSS_DW0_TR_IN_17, CPUSS_DW0_TR_IN_18, CPUSS_DW0_TR_IN_19, CPUSS_DW0_TR_IN_20, CPUSS_DW0_TR_IN_21, CPUSS_DW0_TR_IN_22, CPUSS_DW0_TR_IN_23, CPUSS_DW0_TR_IN_24, CPUSS_DW1_TR_IN_24, CPUSS_DW1_TR_IN_25, CPUSS_DW1_TR_IN_26, CPUSS_DW1_TR_IN_27, CPUSS_DW1_TR_IN_28, CPUSS_DW1_TR_IN_29, CPUSS_DW1_TR_IN_30, CPUSS_DW1_TR_IN_31, CPUSS_DW1_TR_IN_32, CANFD_0_TR_DBG_DMA_ACK_0, CANFD_0_TR_DBG_DMA_ACK_1, CANFD_0_TR_DBG_DMA_ACK_2, CANFD_1_TR_DBG_DMA_ACK_0, CANFD_1_TR_DBG_DMA_ACK_1, CANFD_1_TR_DBG_DMA_ACK_2, CPUSS_DW1_TR_IN_8, CPUSS_DW1_TR_IN_9, CPUSS_DW1_TR_IN_10, CPUSS_DW1_TR_IN_11, CPUSS_DW1_TR_IN_12, CPUSS_DW1_TR_IN_13, CPUSS_DW1_TR_IN_14, CPUSS_DW1_TR_IN_15, CPUSS_DW1_TR_IN_16, CPUSS_DW1_TR_IN_17, CPUSS_DW1_TR_IN_18, CPUSS_DW1_TR_IN_19, CPUSS_DW1_TR_IN_20, CPUSS_DW1_TR_IN_21, CPUSS_DW1_TR_IN_22, CPUSS_DW1_TR_IN_23, LIN_0_TR_CMD_TX_HEADER_9, CPUSS_DW0_TR_IN_89, CPUSS_DW0_TR_IN_90, CPUSS_DW0_TR_IN_91, CPUSS_DW1_TR_IN_33, CPUSS_DW1_TR_IN_34, CPUSS_DW1_TR_IN_35, CXPI_0_TR_CMD_TX_HEADER_0, CXPI_0_TR_CMD_TX_HEADER_1, CPUSS_DW1_TR_IN_36, CPUSS_DW1_TR_IN_37, CPUSS_DW1_TR_IN_38, CPUSS_DW1_TR_IN_39, CPUSS_DW1_TR_IN_40, CPUSS_DW1_TR_IN_41, CPUSS_DW1_TR_IN_42, CPUSS_DW1_TR_IN_43, LIN_0_TR_CMD_TX_HEADER_8, CANFD_1_TR_DBG_DMA_ACK_3, CXPI_0_TR_CMD_TX_HEADER_2, CANFD_0_TR_DBG_DMA_ACK_3, CXPI_0_TR_CMD_TX_HEADER_3, LIN_0_TR_CMD_TX_HEADER_10, LIN_0_TR_CMD_TX_HEADER_11, CPUSS_DW0_TR_IN_92, CPUSS_DW0_TR_IN_93, CPUSS_DW0_TR_IN_94, CPUSS_DW0_TR_IN_95, CPUSS_DW0_TR_IN_96, CPUSS_DW0_TR_IN_97, CPUSS_DW0_TR_IN_98, CPUSS_DW0_TR_IN_99, CPUSS_DW0_TR_IN_100, CPUSS_DW0_TR_IN_101, CPUSS_DW0_TR_IN_102, CPUSS_DW0_TR_IN_103, CPUSS_DW0_TR_IN_104, CPUSS_DW0_TR_IN_105, CPUSS_DW0_TR_IN_106, CPUSS_DW0_TR_IN_107, CPUSS_DW0_TR_IN_108, CPUSS_DW0_TR_IN_109, CPUSS_DW0_TR_IN_110, CPUSS_DW0_TR_IN_111, CPUSS_DW0_TR_IN_112, CPUSS_DW0_TR_IN_113, CPUSS_DW0_TR_IN_114, CPUSS_DW0_TR_IN_115, CPUSS_DW0_TR_IN_116, CPUSS_DW0_TR_IN_117, CPUSS_DW0_TR_IN_118, CPUSS_DW0_TR_IN_119, CPUSS_DW0_TR_IN_120, CPUSS_DW0_TR_IN_121, CPUSS_DW0_TR_IN_122, CPUSS_DW0_TR_IN_123, CPUSS_DW0_TR_IN_124, CPUSS_DW0_TR_IN_125, CPUSS_DW0_TR_IN_126, CPUSS_DW0_TR_IN_127, CPUSS_DW0_TR_IN_128, CPUSS_DW0_TR_IN_129, CPUSS_DW0_TR_IN_130, CPUSS_DW0_TR_IN_131, CPUSS_DW0_TR_IN_132, CPUSS_DW0_TR_IN_133, CPUSS_DW0_TR_IN_134, CPUSS_DW0_TR_IN_135, CPUSS_DW0_TR_IN_136, CPUSS_DW0_TR_IN_137, CPUSS_DW0_TR_IN_138, CPUSS_DW0_TR_IN_139, CPUSS_DW0_TR_IN_140, CPUSS_DW0_TR_IN_141, CPUSS_DW0_TR_IN_142, CPUSS_DW1_TR_IN_53, CPUSS_DW1_TR_IN_54, CPUSS_DW1_TR_IN_44, CPUSS_DW1_TR_IN_45, CPUSS_DW1_TR_IN_46, CPUSS_DW1_TR_IN_47, CPUSS_DW1_TR_IN_48, CPUSS_DW1_TR_IN_49, CPUSS_DW1_TR_IN_50, CPUSS_DW1_TR_IN_51, CPUSS_DW1_TR_IN_52, CPUSS_DW1_TR_IN_55, CPUSS_DW1_TR_IN_56, CPUSS_DW1_TR_IN_57, CPUSS_DW1_TR_IN_58, CPUSS_DW1_TR_IN_59, CPUSS_DW1_TR_IN_60, TCPWM_1_TR_ONE_CNT_IN_770, TCPWM_1_TR_ONE_CNT_IN_779, TCPWM_1_TR_ONE_CNT_IN_788, TCPWM_1_TR_ONE_CNT_IN_797, TCPWM_1_TR_ONE_CNT_IN_2, TCPWM_1_TR_ONE_CNT_IN_5, TCPWM_1_TR_ONE_CNT_IN_8, TCPWM_1_TR_ONE_CNT_IN_11, TCPWM_1_TR_ONE_CNT_IN_14, TCPWM_1_TR_ONE_CNT_IN_17, TCPWM_1_TR_ONE_CNT_IN_20, TCPWM_1_TR_ONE_CNT_IN_23, TCPWM_1_TR_ONE_CNT_IN_26, TCPWM_1_TR_ONE_CNT_IN_29, TCPWM_1_TR_ONE_CNT_IN_32, TCPWM_1_TR_ONE_CNT_IN_35, TCPWM_1_TR_ONE_CNT_IN_38, TCPWM_1_TR_ONE_CNT_IN_41, TCPWM_1_TR_ONE_CNT_IN_44, TCPWM_1_TR_ONE_CNT_IN_47, TCPWM_1_TR_ONE_CNT_IN_50, TCPWM_1_TR_ONE_CNT_IN_53, TCPWM_1_TR_ONE_CNT_IN_56, TCPWM_1_TR_ONE_CNT_IN_59, TCPWM_1_TR_ONE_CNT_IN_62, TCPWM_1_TR_ONE_CNT_IN_65, TCPWM_1_TR_ONE_CNT_IN_68, TCPWM_1_TR_ONE_CNT_IN_71, TCPWM_1_TR_ONE_CNT_IN_74, TCPWM_1_TR_ONE_CNT_IN_77, TCPWM_1_TR_ONE_CNT_IN_80, TCPWM_1_TR_ONE_CNT_IN_83, TCPWM_1_TR_ONE_CNT_IN_773, TCPWM_1_TR_ONE_CNT_IN_782, TCPWM_1_TR_ONE_CNT_IN_791, TCPWM_1_TR_ONE_CNT_IN_800, TCPWM_1_TR_ONE_CNT_IN_86, TCPWM_1_TR_ONE_CNT_IN_89, TCPWM_1_TR_ONE_CNT_IN_92, TCPWM_1_TR_ONE_CNT_IN_95, TCPWM_1_TR_ONE_CNT_IN_98, TCPWM_1_TR_ONE_CNT_IN_101, TCPWM_1_TR_ONE_CNT_IN_104, TCPWM_1_TR_ONE_CNT_IN_107, TCPWM_1_TR_ONE_CNT_IN_110, TCPWM_1_TR_ONE_CNT_IN_113, TCPWM_1_TR_ONE_CNT_IN_116, TCPWM_1_TR_ONE_CNT_IN_119, TCPWM_1_TR_ONE_CNT_IN_122, TCPWM_1_TR_ONE_CNT_IN_125, TCPWM_1_TR_ONE_CNT_IN_128, TCPWM_1_TR_ONE_CNT_IN_131, TCPWM_1_TR_ONE_CNT_IN_134, TCPWM_1_TR_ONE_CNT_IN_137, TCPWM_1_TR_ONE_CNT_IN_140, TCPWM_1_TR_ONE_CNT_IN_143, TCPWM_1_TR_ONE_CNT_IN_146, TCPWM_1_TR_ONE_CNT_IN_149, TCPWM_1_TR_ONE_CNT_IN_152, TCPWM_1_TR_ONE_CNT_IN_155, TCPWM_1_TR_ONE_CNT_IN_158, TCPWM_1_TR_ONE_CNT_IN_161, TCPWM_1_TR_ONE_CNT_IN_164, TCPWM_1_TR_ONE_CNT_IN_167, TCPWM_1_TR_ONE_CNT_IN_776, TCPWM_1_TR_ONE_CNT_IN_785, TCPWM_1_TR_ONE_CNT_IN_794, TCPWM_1_TR_ONE_CNT_IN_803, TCPWM_1_TR_ONE_CNT_IN_170, TCPWM_1_TR_ONE_CNT_IN_173, TCPWM_1_TR_ONE_CNT_IN_176, TCPWM_1_TR_ONE_CNT_IN_179, TCPWM_1_TR_ONE_CNT_IN_182, TCPWM_1_TR_ONE_CNT_IN_185, TCPWM_1_TR_ONE_CNT_IN_188, TCPWM_1_TR_ONE_CNT_IN_191, TCPWM_1_TR_ONE_CNT_IN_194, TCPWM_1_TR_ONE_CNT_IN_197, TCPWM_1_TR_ONE_CNT_IN_200, TCPWM_1_TR_ONE_CNT_IN_203, TCPWM_1_TR_ONE_CNT_IN_206, TCPWM_1_TR_ONE_CNT_IN_209, TCPWM_1_TR_ONE_CNT_IN_212, TCPWM_1_TR_ONE_CNT_IN_215, TCPWM_1_TR_ONE_CNT_IN_218, TCPWM_1_TR_ONE_CNT_IN_221, TCPWM_1_TR_ONE_CNT_IN_224, TCPWM_1_TR_ONE_CNT_IN_227, TCPWM_1_TR_ONE_CNT_IN_230, TCPWM_1_TR_ONE_CNT_IN_233, TCPWM_1_TR_ONE_CNT_IN_236, TCPWM_1_TR_ONE_CNT_IN_239, TCPWM_1_TR_ONE_CNT_IN_242, TCPWM_1_TR_ONE_CNT_IN_245, TCPWM_1_TR_ONE_CNT_IN_248, TCPWM_1_TR_ONE_CNT_IN_251, PASS_0_TR_SAR_CH_IN_24, PASS_0_TR_SAR_CH_IN_25, PASS_0_TR_SAR_CH_IN_26, PASS_0_TR_SAR_CH_IN_27, PASS_0_TR_SAR_CH_IN_28, PASS_0_TR_SAR_CH_IN_29, PASS_0_TR_SAR_CH_IN_30, PASS_0_TR_SAR_CH_IN_31, PASS_0_TR_SAR_CH_IN_72, PASS_0_TR_SAR_CH_IN_73, PASS_0_TR_SAR_CH_IN_74, PASS_0_TR_SAR_CH_IN_75, PASS_0_TR_SAR_CH_IN_76, PASS_0_TR_SAR_CH_IN_77, PASS_0_TR_SAR_CH_IN_78, PASS_0_TR_SAR_CH_IN_79, PASS_0_TR_SAR_CH_IN_80, PASS_0_TR_SAR_CH_IN_81, PASS_0_TR_SAR_CH_IN_82, PASS_0_TR_SAR_CH_IN_83, PASS_0_TR_SAR_CH_IN_84, PASS_0_TR_SAR_CH_IN_85, PASS_0_TR_SAR_CH_IN_86, PASS_0_TR_SAR_CH_IN_87, PASS_0_TR_SAR_CH_IN_88, PASS_0_TR_SAR_CH_IN_89, PASS_0_TR_SAR_CH_IN_90, PASS_0_TR_SAR_CH_IN_91, PASS_0_TR_SAR_CH_IN_92, PASS_0_TR_SAR_CH_IN_93, PASS_0_TR_SAR_CH_IN_94, PASS_0_TR_SAR_CH_IN_95, CANFD_1_TR_DBG_DMA_ACK_4, CANFD_0_TR_DBG_DMA_ACK_4, LIN_0_TR_CMD_TX_HEADER_12, LIN_0_TR_CMD_TX_HEADER_13, LIN_0_TR_CMD_TX_HEADER_14, LIN_0_TR_CMD_TX_HEADER_15, LIN_0_TR_CMD_TX_HEADER_16, LIN_0_TR_CMD_TX_HEADER_17, LIN_0_TR_CMD_TX_HEADER_18, LIN_0_TR_CMD_TX_HEADER_19, CPUSS_DW1_TR_IN_63, CPUSS_DW1_TR_IN_64, CPUSS_DW1_TR_IN_61, CPUSS_DW1_TR_IN_62, FLEXRAY_0_TR_IBF_IN, FLEXRAY_0_TR_OBF_IN, CPUSS_DW1_TR_IN_65, CPUSS_DW1_TR_IN_66, CPUSS_DW1_TR_IN_67, CPUSS_DW1_TR_IN_68, CPUSS_DW1_TR_IN_69, CPUSS_DW1_TR_IN_70, CPUSS_DW1_TR_IN_71, CPUSS_DW1_TR_IN_72, CPUSS_DW1_TR_IN_73, CPUSS_DW1_TR_IN_74, CPUSS_DW1_TR_IN_75, CPUSS_DW1_TR_IN_76, CPUSS_DW1_TR_IN_77, CPUSS_DW1_TR_IN_78, CPUSS_DW1_TR_IN_79, CPUSS_DW1_TR_IN_80, CPUSS_DW1_TR_IN_81, CPUSS_DW1_TR_IN_82, CPUSS_DW1_TR_IN_83, TCPWM_0_TR_ONE_CNT_IN_0, TCPWM_0_TR_ONE_CNT_IN_1, TCPWM_0_TR_ONE_CNT_IN_3, TCPWM_0_TR_ONE_CNT_IN_4, TCPWM_0_TR_ONE_CNT_IN_6, TCPWM_0_TR_ONE_CNT_IN_7, TCPWM_0_TR_ONE_CNT_IN_9, TCPWM_0_TR_ONE_CNT_IN_10, TCPWM_0_TR_ONE_CNT_IN_12, TCPWM_0_TR_ONE_CNT_IN_13, TCPWM_0_TR_ONE_CNT_IN_15, TCPWM_0_TR_ONE_CNT_IN_16, TCPWM_0_TR_ONE_CNT_IN_18, TCPWM_0_TR_ONE_CNT_IN_19, TCPWM_0_TR_ONE_CNT_IN_256, TCPWM_0_TR_ONE_CNT_IN_257, TCPWM_0_TR_ONE_CNT_IN_258, TCPWM_0_TR_ONE_CNT_IN_259, TCPWM_0_TR_ONE_CNT_IN_260, TCPWM_0_TR_ONE_CNT_IN_261, TCPWM_0_TR_ONE_CNT_IN_262, TCPWM_0_TR_ONE_CNT_IN_263, TCPWM_0_TR_ONE_CNT_IN_264, TCPWM_0_TR_ONE_CNT_IN_265, TCPWM_0_TR_ONE_CNT_IN_266, TCPWM_0_TR_ONE_CNT_IN_267, TCPWM_0_TR_ONE_CNT_IN_158, TCPWM_0_TR_ONE_CNT_IN_161, TCPWM_0_TR_ONE_CNT_IN_164, TCPWM_0_TR_ONE_CNT_IN_167, TCPWM_0_TR_ONE_CNT_IN_170, TCPWM_0_TR_ONE_CNT_IN_173, TCPWM_0_TR_ONE_CNT_IN_176, TCPWM_0_TR_ONE_CNT_IN_179}, origin=Cypress, set at post-build, default-value=LIN_0_TR_CMD_TX_HEADER_0  # Name of 1-to-1 Output Trigger.
          enumeration PortTr1To1InputType: {PORT_TR_1TO1_IN_CONST0, PORT_TR_1TO1_IN_INPUT}, origin=Cypress, set at post-build, default-value=PORT_TR_1TO1_IN_CONST0  # Specifies input trigger.
          boolean PortTr1To1InvertEnable: origin=Cypress, set at post-build, default-value=false  # Specifies if the 1-to-1 output trigger is inverted.
          enumeration PortTr1To1SensitiveType: {PORT_TR_SENSITIVE_LEVEL, PORT_TR_SENSITIVE_EDGE}, origin=Cypress, set at post-build, default-value=PORT_TR_SENSITIVE_LEVEL  # Specifies if the 1-to-1 output trigger is treated as a level sensitive or edge sensitive trigger.
          boolean PortTr1To1DbgFreezeEnable: origin=Cypress, set at post-build, default-value=false  # Specifies if the 1-to-1 output trigger is blocked in debug mode.
