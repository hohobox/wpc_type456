AUTOSAR XML (schema 4-2-2)
package /TS_T40D13M1I0R0
  ecuc definition collection RESOURCE_EcuParameterDefinition: module=Resource
  module definition Resource: variants pre-compile  # Configuration of the Resource module.
    container ResourceGeneral  # This container contains the configuration (parameters) of the Resource driver.
      enumeration ResourceSubDerivative: {CYT2A0100E, CYT2B63BAE, CYT2B63BAS, CYT2B63CAE, CYT2B63CAS, CYT2B64BAE, CYT2B64BAS, CYT2B64CAE, CYT2B64CAS, CYT2B65BAE, CYT2B65BAS, CYT2B65CAE, CYT2B65CAS, CYT2B73BAE, CYT2B73BAS, CYT2B73CAE, CYT2B73CAS, CYT2B74BAE, CYT2B74BAS, CYT2B74CAE, CYT2B74CAS, CYT2B75BAE, CYT2B75BAS, CYT2B75CAE, CYT2B75CAS, CYT2B77BAE, CYT2B77BAS, CYT2B77CAE, CYT2B77CAS, CYT2B78BAE, CYT2B78BAS, CYT2B78CAE, CYT2B78CAS, CYT2B93BAE, CYT2B93BAS, CYT2B93CAE, CYT2B93CAS, CYT2B94BAE, CYT2B94BAS, CYT2B94CAE, CYT2B94CAS, CYT2B95BAE, CYT2B95BAS, CYT2B95CAE, CYT2B95CAS, CYT2B97BAE, CYT2B97BAS, CYT2B97CAE, CYT2B97CAS, CYT2B98BAE, CYT2B98BAS, CYT2B98CAE, CYT2B98CAS, CYT2BL3BAE, CYT2BL3BAS, CYT2BL3CAE, CYT2BL3CAS, CYT2BL4BAE, CYT2BL4BAS, CYT2BL4CAE, CYT2BL4CAS, CYT2BL5BAE, CYT2BL5BAS, CYT2BL5CAE, CYT2BL5CAS, CYT2BL7BAE, CYT2BL7BAS, CYT2BL7CAE, CYT2BL7CAS, CYT2BL8BAE, CYT2BL8BAS, CYT2BL8CAE, CYT2BL8CAS, CYT2C9HBAS, CYT2C97BAS, CYT2C98BAS, CYT2CL7BAS, CYT2CL8BAS, CYT2CLHBAS, CYT3BB5CEE, CYT3BB5CES, CYT3BB7CEE, CYT3BB7CES, CYT3BB8CEE, CYT3BB8CES, CYT3BBBCEE, CYT3BBBCES, CYT3DL9BAS, CYT3DL9BBS, CYT3DL9BCS, CYT3DL9BDS, CYT3DL9BES, CYT3DL9BFS, CYT3DL9BGS, CYT3DL9BHS, CYT3DLABAS, CYT3DLABBS, CYT3DLABCS, CYT3DLABDS, CYT3DLABES, CYT3DLABFS, CYT3DLABGS, CYT3DLABHS, CYT3DLBBAS, CYT3DLBBBS, CYT3DLBBCS, CYT3DLBBDS, CYT3DLBBES, CYT3DLBBFS, CYT3DLBBGS, CYT3DLBBHS, CYT3DLJBBS, CYT3DLJBDS, CYT3DLJBFS, CYT3DLJBHS, CYT4A0100S, CYT4BB5CEE, CYT4BB5CES, CYT4BB7CEE, CYT4BB7CES, CYT4BB8CEE, CYT4BB8CES, CYT4BBBCEE, CYT4BBBCES, CYT4BF8CDE, CYT4BF8CDS, CYT4BF8CEE, CYT4BF8CES, CYT4BFBCHE, CYT4BFBCHS, CYT4BFBCJE, CYT4BFBCJS, CYT4BFCCHE, CYT4BFCCHS, CYT4BFCCJE, CYT4BFCCJS, CYT4DNJBAS, CYT4DNJBBS, CYT4DNJBCS, CYT4DNJBDS, CYT4DNJBES, CYT4DNJBFS, CYT4DNJBGS, CYT4DNJBHS, CYT4DNJBJS, CYT4DNJBKS, CYT4DNJBLS, CYT4DNJBMS, CYT4DNJBNS, CYT4DNJBPS, CYT4DNJBQS, CYT4DNJBRS, CYT4ENDBAS, CYT4ENDBCS, CYT4ENDBES, CYT4ENDBGS, CYT4ENDBJS, CYT4ENDBLS, CYT4ENDBNS, CYT4ENDBQS}, origin=Cypress, set at pre-compile, default-value=CYT2B78CAS  # Selects a sub-derivative
