AUTOSAR XML (schema 4-2-2)
package /TS_T40D13M1I0R0
  ecuc definition collection FEE_EcuParameterDefinition: module=Fee
  module definition Fee: refined-module-def=Fee, variants pre-compile  # Configuration of the Fee (Flash EEPROM Emulation) module.
    container FeeBlockConfiguration [1..*]  # Configuration of block specific parameters for the Flash EEPROM Emulation module.
      integer FeeBlockNumber: 1..65534, scope=ECU, set at pre-compile, symbolic-name-value=true, default-value=1  # Block identifier (handle).
      integer FeeBlockSize: 1..3072, scope=ECU, set at pre-compile, default-value=1  # Size of a logical block in bytes.
      boolean FeeImmediateData: scope=ECU, set at pre-compile, default-value=true  # Marker for high priority data.
      integer FeeNumberOfWriteCycles: 0..4294967295, set at pre-compile, default-value=0  # Number of write cycles required for this block.
      boolean FeeSelectConfigEx: origin=Cypress, set at pre-compile, default-value=false  # Marker for high priority data.
      symbolic name reference FeeDeviceIndex: set at pre-compile, destination=FlsGeneral  # Device index (handle).
    container FeeGeneral  # Container for general parameters. These parameters are not specific to a block.
      boolean FeeDevErrorDetect: set at pre-compile, default-value=true  # Pre-processor switch to enable and disable development error detection.
      function name FeeNvmJobEndNotification [0..1]: multiplicity set at pre-compile, set at pre-compile, default-value=NvM_JobEndNotification  # Mapped to the job end notification routine provided by the upper layer module (NvM_JobEndNotification).
      function name FeeNvmJobErrorNotification [0..1]: multiplicity set at pre-compile, set at pre-compile, default-value=NvM_JobErrorNotification  # Mapped to the job error notification routine provided by the upper layer module (NvM_JobErrorNotification).
      boolean FeeInitiallyEraseEmptySectors: origin=CYPRESS, set at pre-compile, default-value=true  # FeeInitiallyEraseEmptySectors switch to enable and disable the erace sector when Fee_Init.
      boolean FeeUnmatchedBlockCheck: set at pre-compile, origin=CYPRESS, default-value=true  # FeeUnmatchedBlockCheck switch to enable and disable the ability of changing the configuration of blocks.
      boolean FeeDelayRecycleOperation: set at pre-compile, origin=CYPRESS, default-value=false  # FeeDelayRecycleOperation switch to enable and disable the recycle operation during initialization.
      boolean FeeBchkOffBlock: set at pre-compile, origin=CYPRESS, default-value=false  # FeeBchkOffBlock switch to enable and disable the execution of block blank check.
      boolean FeeBchkOffSector: set at pre-compile, origin=CYPRESS, default-value=false  # FeeBchkOffSector switch to enable and disable the execution of sector blank check.
      boolean FeePollingMode: set at pre-compile, default-value=true  # Pre-processor switch to enable and disable the polling mode for this module.
      boolean FeeSetModeSupported: set at pre-compile, default-value=true  # Compiler switch to enable/disable the 'SetMode' functionality of the FEE module.
      boolean FeeVersionInfoApi: set at pre-compile, default-value=true  # Pre-processor switch to enable / disable the API to read out the modules version information.
      boolean FeeSetCycleModeApi: origin=Cypress, set at pre-compile, default-value=true  # Pre-processor switch to enable / disable the API for the cycle mode setting.
      boolean FeeBlankCheckApi: origin=Cypress, set at pre-compile, default-value=true  # Pre-processor switch to enable / disable the API for the blank check setting.
      boolean FeeClearApi: origin=Cypress, set at pre-compile, default-value=false  # Pre-processor switch to enable / disable the API for the entire area erase.
      boolean FeeGetRemainingPagesApi: origin=Cypress, set at pre-compile, default-value=false  # Pre-processor switch to enable / disable the API to get the number of remaining pages.
      boolean FeeCleanupAndEraseApi: origin=Cypress, set at pre-compile, default-value=false  # Preprocessor switch to enable / disable the API in order to reuse the sector.
      integer FeeVirtualPageSize: 0..255, set at pre-compile, default-value=4  # The size in bytes to which logical blocks shall be aligned.
      integer FeeBlockMaxSize: 1..3072, origin=Cypress, set at pre-compile, default-value=32  # The size in bytes to which logical blocks maximum size.
      enumeration FeeDefaultCycleMode: {MEMIF_MODE_SLOW, MEMIF_MODE_FAST}, origin=Cypress, set at pre-compile, default-value=MEMIF_MODE_SLOW  # parameter for setting the FEE and the FLS timeout monitoring operation mode. MEMIF_MODE_SLOW : wait cycle time of MainFunction is FeeMainFunctionPeriod. MEMIF_MODE_FAST : no wait cycle time for MainFunction
      float FeeMainFunctionPeriod: 0.01..1000.0, scope=ECU, set at pre-compile, default-value=1.0  # FeeMainFunctionPeriod;br/> The value of "FeeMainFunctionPeriod for FEE" and "FlsCallCycle for FLS"should be set the same. Example: In case of FeeMainFunctionPeriod = 10 (msec) FlsCallCycle = 0.01 (sec)
      function name FeeErrorCalloutFunction: origin=Cypress, set at pre-compile, default-value=ErrorCalloutHandler  # Error callout function. Syntax: void ErrorCalloutHandler (uint16 ModuleId, uint8 InstanceId, uint8 ApiId, uint8 ErrorId) The error callout function is called on every error. The ASIL level of this function limits the ASIL level of the Fls driver.
      integer FeeWorkFlashRelativeEndAddress [0..1]: 0..90112, origin=Cypress, set at pre-compile, default-value=0  # Relative end address of the Flash domain
      integer FeeResourceLargeSectorTotalSize [0..1]: 0..196608, origin=Cypress, set at pre-compile, default-value=196608  # Large sector total size from resource.
      integer FeeResourceSmallSectorTotalSize [0..1]: 0..65536, origin=Cypress, set at pre-compile, default-value=65536  # Small sector total size from resource.
      string FeeIncludeFile [0..*]: origin=Cypress, set at pre-compile, default-value=ErrorCalloutHandler.h  # A file that shall be included by Fee_Cfg.h. Any application specific symbol that is used by the Fee configuration (e.g. Error callout function) should be included by configuring this parameter.
      container FeeUseConfig  # Setting the sector information
        container Config  # Setting the sector information (start address, number of sectors, effective data size)
          integer FeeSectorStartAddress: 0..90112, origin=Cypress, set at pre-compile, default-value=0  # Top addressing of the Flash domain
          container ConfigIfUseThresholdPageSize [0..1]  # Config use threshold page size or not
            integer FeeThresholdPageSize: 0..46080, origin=Cypress, set at pre-compile, default-value=256  # Reserved size for writing immediate block.
            integer FeeNormalPageSize: 8192..49152, origin=Cypress, set at pre-compile, default-value=8192  # Set logical sector size manually.
          integer FeeValidDataSize: 512..4032, origin=Cypress, set at pre-compile, default-value=512  # It specifies the total size of the valid data to be handled in one sector
        container ConfigEx [0..1]  # Setting the sector information (start address, number of sectors, effective data size)
          integer FeeSectorStartAddressEx: 8192..90112, origin=Cypress, set at pre-compile, default-value=0  # Top addressing of the Flash domain
          container ConfigExIfUseThresholdPageSize [0..1]  # ConfigEx use threshold page size or not
            integer FeeThresholdPageSizeEx: 0..41984, origin=Cypress, set at pre-compile, default-value=256  # Reserved size for writing immediate block in configex.
            integer FeeNormalPageSizeEx: 8192..45056, origin=Cypress, set at pre-compile, default-value=8192  # Set logical sector size manually in configex.
          integer FeeBlockMaxSizeEx: 1..3072, origin=Cypress, set at pre-compile, default-value=32  # The size in bytes to which logical blocks maximum size.
          integer FeeValidDataSizeEx: 512..4032, origin=Cypress, set at pre-compile, default-value=512  # It specifies the total size of the valid data to be handled in one sector
    container FeePublishedInformation  # Additional published parameters not covered by CommonPublishedInformation container.
      integer FeeInstanceId: 0..0, origin=Cypress, set at published-information, default-value=0  # Management overhead per page in bytes.
      integer FeeBlockOverhead: 20..65535, set at published-information, default-value=20  # Management overhead per logical block in bytes.
      integer FeePageOverhead: 0..65535, set at published-information, default-value=16  # Management overhead per page in bytes.
