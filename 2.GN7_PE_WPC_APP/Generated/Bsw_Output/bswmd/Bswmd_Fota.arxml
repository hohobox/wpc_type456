AUTOSAR XML (schema 00047)
# (C) 2022 HYUNDAI AUTOEVER Corp.
# Confidential Proprietary Information. Distribution Limited.
# Do Not Copy Without Prior Permission
package /Bsw_Fota
  bsw implementation BswImplementation_Fota: sw-version=1.3.0, vendor-id=76, ar-release-version=4.4.0, behavior=BswInternalBehavior_Fota
  bsw module description Fota: module-id=255
    bsw internal behavior BswInternalBehavior_Fota
      exclusive area CRITICAL_SECTION
      bsw schedulable entity BswSchedulableEntity_Fota: can-enter-exclusive-area=CRITICAL_SECTION, implemented-entry=Fota_MainFunction
      bsw timing event BswTimingEvent_Fota: starts-on-event=BswSchedulableEntity_Fota, period=0.005
      bsw distinguished partition BswDistinguishedPartition_Fota
  bsw module entry Fota_MainFunction: service-id=3, is-reentrant=false, is-synchronous=false, call-type=SCHEDULED, execution-context=TASK, sw-service-impl-policy=STANDARD
