AUTOSAR XML (schema 4-0-3)
package /Bsw_IoHwAb
  bsw module description IoHwAb: module-id=254
    required-mode-groups:
      mode declaration group prototype IoHwAb_EM_R: type=EcuMode
    bsw internal behavior BswInternalBehavior_IoHwAb: data-type-mapping=EcuModeMap
      exclusive area IoHwAbProtection
      bsw schedulable entity BswSE_IoHwAb_IOM_10ms: accessed-mode-groups=IoHwAb_EM_R, implemented-entry=IoHwAb_IOM_10ms
      bsw schedulable entity BswSE_IoHwAb_IOM_5ms: accessed-mode-groups=IoHwAb_EM_R, implemented-entry=IoHwAb_IOM_5ms
      19 x bsw called entity, all with can-enter-exclusive-area=IoHwAbProtection:
        IoHwAb_AnaInDirReadDirect: implemented-entry=IoHwAb_AnaInDirReadDirect
        IoHwAb_DigDirIsInput: implemented-entry=IoHwAb_DigDirIsInput
        IoHwAb_DigDirIsOutput: implemented-entry=IoHwAb_DigDirIsOutput
        IoHwAb_DigDirReadDirect: implemented-entry=IoHwAb_DigDirReadDirect
        IoHwAb_DigDirSetToInput: implemented-entry=IoHwAb_DigDirSetToInput
        IoHwAb_DigDirSetToOutput: implemented-entry=IoHwAb_DigDirSetToOutput
        IoHwAb_DigDirWriteDirect: implemented-entry=IoHwAb_DigDirWriteDirect
        IoHwAb_GptDisableNotification: implemented-entry=IoHwAb_GptDisableNotification
        IoHwAb_GptEnableNotification: implemented-entry=IoHwAb_GptEnableNotification
        IoHwAb_GptGetTimeElapsed: implemented-entry=IoHwAb_GptGetTimeElapsed
        IoHwAb_GptGetTimeRemaining: implemented-entry=IoHwAb_GptGetTimeRemaining
        IoHwAb_GptStartTimer: implemented-entry=IoHwAb_GptStartTimer
        IoHwAb_GptStopTimer: implemented-entry=IoHwAb_GptStopTimer
        IoHwAb_PwmDisableNotification: implemented-entry=IoHwAb_PwmDisableNotification
        IoHwAb_PwmEnableNotification: implemented-entry=IoHwAb_PwmEnableNotification
        IoHwAb_PwmGetOutputState: implemented-entry=IoHwAb_PwmGetOutputState
        IoHwAb_PwmSetDutyCycle: implemented-entry=IoHwAb_PwmSetDutyCycle
        IoHwAb_PwmSetOutputToIdle: implemented-entry=IoHwAb_PwmSetOutputToIdle
        IoHwAb_PwmSetPeriodAndDuty: implemented-entry=IoHwAb_PwmSetPeriodAndDuty
      bsw timing event BswTE_IoHwAb_IOM_10ms: context-limitation=BswDistinguishedPartition_IoHwAb, disabled-in-mode=[IoHwAb_EM_R.ECUM_STATE_STARTUP_ONE, IoHwAb_EM_R.ECUM_STATE_STARTUP_TWO], starts-on-event=BswSE_IoHwAb_IOM_10ms, period=0.01
      bsw timing event BswTE_IoHwAb_IOM_5ms: context-limitation=BswDistinguishedPartition_IoHwAb, starts-on-event=BswSE_IoHwAb_IOM_5ms, period=0.005
      bsw distinguished partition BswDistinguishedPartition_IoHwAb
  bsw implementation BswImplementation_IoHwAb: sw-version=1.15.4, swc-bsw-mapping=SwcBswMapping_IoHwAb, vendor-id=76, ar-release-version=4.0.3, behavior=BswInternalBehavior_IoHwAb
  19 x bsw module entry, all with is-synchronous=true, call-type=REGULAR, execution-context=UNSPECIFIED, sw-service-impl-policy=STANDARD:
    IoHwAb_AnaInDirReadDirect: service-id=0, is-reentrant=false
      sw service arg ChIdx: direction=IN
      sw service arg Value: direction=OUT
      sw service arg AnaInDirLength: direction=IN
    IoHwAb_DigDirIsInput: service-id=1, is-reentrant=true
      sw service arg ChIdx: direction=IN
      sw service arg blResult: direction=OUT
    IoHwAb_DigDirIsOutput: service-id=2, is-reentrant=true
      sw service arg ChIdx: direction=IN
      sw service arg blResult: direction=OUT
    IoHwAb_DigDirReadDirect: service-id=3, is-reentrant=true
      sw service arg ChIdx: direction=IN
      sw service arg Level: direction=OUT
    IoHwAb_DigDirSetToInput: service-id=4, is-reentrant=true
      sw service arg ChIdx: direction=IN
    IoHwAb_DigDirSetToOutput: service-id=5, is-reentrant=true
      sw service arg ChIdx: direction=IN
    IoHwAb_DigDirWriteDirect: service-id=6, is-reentrant=true
      sw service arg ChIdx: direction=IN
      sw service arg Level: direction=IN
    IoHwAb_GptDisableNotification: service-id=7, is-reentrant=true
      sw service arg ChIdx: direction=IN
    IoHwAb_GptEnableNotification: service-id=8, is-reentrant=true
      sw service arg ChIdx: direction=IN
    IoHwAb_GptGetTimeElapsed: service-id=9, is-reentrant=true
      sw service arg ChIdx: direction=IN
      sw service arg Value: direction=OUT
    IoHwAb_GptGetTimeRemaining: service-id=10, is-reentrant=true
      sw service arg ChIdx: direction=IN
      sw service arg Value: direction=OUT
    IoHwAb_GptStartTimer: service-id=11, is-reentrant=true
      sw service arg ChIdx: direction=IN
      sw service arg Value: direction=IN
    IoHwAb_GptStopTimer: service-id=12, is-reentrant=true
      sw service arg ChIdx: direction=IN
    IoHwAb_PwmDisableNotification: service-id=13, is-reentrant=true
      sw service arg ChIdx: direction=IN
    IoHwAb_PwmEnableNotification: service-id=14, is-reentrant=true
      sw service arg ChIdx: direction=IN
      sw service arg NotificationEdge: direction=IN
    IoHwAb_PwmGetOutputState: service-id=15, is-reentrant=true
      sw service arg ChIdx: direction=IN
      sw service arg Level: direction=OUT
    IoHwAb_PwmSetDutyCycle: service-id=16, is-reentrant=true
      sw service arg ChIdx: direction=IN
      sw service arg Duty: direction=IN
    IoHwAb_PwmSetOutputToIdle: service-id=17, is-reentrant=true
      sw service arg ChIdx: direction=IN
    IoHwAb_PwmSetPeriodAndDuty: service-id=18, is-reentrant=true
      sw service arg ChIdx: direction=IN
      sw service arg Period: direction=IN
      sw service arg Duty: direction=IN
  swc bsw mapping SwcBswMapping_IoHwAb: bsw-behavior=BswInternalBehavior_IoHwAb, swc-behavior=IB_IoHwAb
    runnable-mappings:
      bsw-entity=IoHwAb_AnaInDirReadDirect, swc-runnable=IoHwAb_Re_AnaInDir_ReadDirect
      bsw-entity=IoHwAb_DigDirIsInput, swc-runnable=IoHwAb_Re_DigDir_IsInput
      bsw-entity=IoHwAb_DigDirIsOutput, swc-runnable=IoHwAb_Re_DigDir_IsOutput
      bsw-entity=IoHwAb_DigDirReadDirect, swc-runnable=IoHwAb_Re_DigDir_ReadDirect
      bsw-entity=IoHwAb_DigDirSetToInput, swc-runnable=IoHwAb_Re_DigDir_SetToInput
      bsw-entity=IoHwAb_DigDirSetToOutput, swc-runnable=IoHwAb_Re_DigDir_SetToOutput
      bsw-entity=IoHwAb_DigDirWriteDirect, swc-runnable=IoHwAb_Re_DigDir_WriteDirect
      bsw-entity=IoHwAb_GptDisableNotification, swc-runnable=IoHwAb_Re_Gpt_DisableNotification
      bsw-entity=IoHwAb_GptEnableNotification, swc-runnable=IoHwAb_Re_Gpt_EnableNotification
      bsw-entity=IoHwAb_GptGetTimeElapsed, swc-runnable=IoHwAb_Re_Gpt_GetTimeElapsed
      bsw-entity=IoHwAb_GptGetTimeRemaining, swc-runnable=IoHwAb_Re_Gpt_GetTimeRemaining
      bsw-entity=IoHwAb_GptStartTimer, swc-runnable=IoHwAb_Re_Gpt_StartTimer
      bsw-entity=IoHwAb_GptStopTimer, swc-runnable=IoHwAb_Re_Gpt_StopTimer
      bsw-entity=IoHwAb_PwmDisableNotification, swc-runnable=IoHwAb_Re_Pwm_DisableNotification
      bsw-entity=IoHwAb_PwmEnableNotification, swc-runnable=IoHwAb_Re_Pwm_EnableNotification
      bsw-entity=IoHwAb_PwmGetOutputState, swc-runnable=IoHwAb_Re_Pwm_GetOutputState
      bsw-entity=IoHwAb_PwmSetDutyCycle, swc-runnable=IoHwAb_Re_Pwm_SetDutyCycle
      bsw-entity=IoHwAb_PwmSetOutputToIdle, swc-runnable=IoHwAb_Re_Pwm_SetOutputToIdle
      bsw-entity=IoHwAb_PwmSetPeriodAndDuty, swc-runnable=IoHwAb_Re_Pwm_SetPeriodAndDuty
  bsw module entry IoHwAb_IOM_10ms: is-reentrant=false, is-synchronous=false, call-type=SCHEDULED, execution-context=TASK, sw-service-impl-policy=STANDARD
  bsw module entry IoHwAb_IOM_5ms: is-reentrant=false, is-synchronous=false, call-type=SCHEDULED, execution-context=TASK, sw-service-impl-policy=STANDARD
