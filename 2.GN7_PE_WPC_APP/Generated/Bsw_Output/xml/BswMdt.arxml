AUTOSAR XML (schema 4-0-3)
standard types defined: Std_ReturnType, uint8, uint16
package /Autosar_Rte
  bsw implementation BswImplementation_0: programming-language=C, sw-version=4.11.1, used-code-generator=RteCodeGenerator, vendor-id=76, ar-release-version=4.0.3, behavior=BswInternalBehavior_0
    resource consumption ResourceConsumption_0
      6 x memory section, all with prefix=SectionNamePrefix_0:
        RTE_START_SEC_CODE: alignment=CODE, symbol=START
        RTE_STOP_SEC_CODE: alignment=CODE, symbol=STOP
        RTE_START_SEC_VAR_8: alignment=8, symbol=START
        RTE_STOP_SEC_VAR_8: alignment=8, symbol=STOP
        RTE_START_SEC_VAR_NO_INIT_8: alignment=8, symbol=START
        RTE_STOP_SEC_VAR_NO_INIT_8: alignment=8, symbol=STOP
      section name prefix SectionNamePrefix_0: symbol=RTE
  51 x bsw module entry, all with is-reentrant=true, is-synchronous=true, sw-service-impl-policy=STANDARD:
    Rte_Start: service-id=0x70, role=Rte_Start, call-type=REGULAR, execution-context=UNSPECIFIED
      return type Std_ReturnType: direction=OUT, implementation-data-type=Std_ReturnType
    Rte_Stop: service-id=0x71, role=Rte_Stop, call-type=REGULAR, execution-context=UNSPECIFIED
      return type Std_ReturnType: direction=OUT, implementation-data-type=Std_ReturnType
    SchM_Init: service-id=0x00, role=SchM_Init, call-type=REGULAR, execution-context=UNSPECIFIED
    SchM_Deinit: service-id=0x01, role=SchM_Deinit, call-type=REGULAR, execution-context=UNSPECIFIED
    SchM_GetVersionInfo: service-id=0x02, role=SchM_GetVersionInfo, call-type=REGULAR, execution-context=UNSPECIFIED
      sw service arg LpVersionInfo: direction=IN, implementation-data-type=Std_VersionInfoType
    Rte_COMCbkRxTOut_ComISignal_BCAN_CLU_01_20ms_CLU_DisSpdVal_KPH: service-id=0x93, role=Rte_COMCbkRxTOut_ComISignal_BCAN_CLU_01_20ms_CLU_DisSpdVal_KPH, call-type=CALLBACK, execution-context=TASK
    Rte_COMCbkRxTOut_ComISignal_BCAN_CLU_01_20ms_CLU_RhstaLvlSta: service-id=0x93, role=Rte_COMCbkRxTOut_ComISignal_BCAN_CLU_01_20ms_CLU_RhstaLvlSta, call-type=CALLBACK, execution-context=TASK
    Rte_COMCbkRxTOut_ComISignal_BCAN_EMS_07_10ms_HEV_EngOpSta: service-id=0x93, role=Rte_COMCbkRxTOut_ComISignal_BCAN_EMS_07_10ms_HEV_EngOpSta, call-type=CALLBACK, execution-context=TASK
    Rte_COMCbk_ComISignalGroup_MsgGr_E2E_BCAN_PDC_FD_15_300ms: service-id=0x95, role=Rte_COMCbk_ComISignalGroup_MsgGr_E2E_BCAN_PDC_FD_15_300ms, call-type=CALLBACK, execution-context=TASK
    Rte_COMCbk_ComISignal_BCAN_BDC_FD_02_200ms_BCM_SmkOptTyp: service-id=0x95, role=Rte_COMCbk_ComISignal_BCAN_BDC_FD_02_200ms_BCM_SmkOptTyp, call-type=CALLBACK, execution-context=TASK
    Rte_COMCbk_ComISignal_BCAN_BDC_FD_05_200ms_Lamp_IntTailLmpOnReq: service-id=0x95, role=Rte_COMCbk_ComISignal_BCAN_BDC_FD_05_200ms_Lamp_IntTailLmpOnReq, call-type=CALLBACK, execution-context=TASK
    Rte_COMCbk_ComISignal_BCAN_BDC_FD_SMK_02_200ms_LFAnt_SrchSta: service-id=0x95, role=Rte_COMCbk_ComISignal_BCAN_BDC_FD_SMK_02_200ms_LFAnt_SrchSta, call-type=CALLBACK, execution-context=TASK
    Rte_COMCbk_ComISignal_BCAN_CLU_01_20ms_CLU_AutoBrightSta: service-id=0x95, role=Rte_COMCbk_ComISignal_BCAN_CLU_01_20ms_CLU_AutoBrightSta, call-type=CALLBACK, execution-context=TASK
    Rte_COMCbk_ComISignal_BCAN_CLU_01_20ms_CLU_DisSpdVal_KPH: service-id=0x95, role=Rte_COMCbk_ComISignal_BCAN_CLU_01_20ms_CLU_DisSpdVal_KPH, call-type=CALLBACK, execution-context=TASK
    Rte_COMCbk_ComISignal_BCAN_CLU_01_20ms_CLU_DtntOutSta: service-id=0x95, role=Rte_COMCbk_ComISignal_BCAN_CLU_01_20ms_CLU_DtntOutSta, call-type=CALLBACK, execution-context=TASK
    Rte_COMCbk_ComISignal_BCAN_CLU_01_20ms_CLU_RhstaLvlSta: service-id=0x95, role=Rte_COMCbk_ComISignal_BCAN_CLU_01_20ms_CLU_RhstaLvlSta, call-type=CALLBACK, execution-context=TASK
    Rte_COMCbk_ComISignal_BCAN_CLU_05_00ms_USM_StaRst1Req: service-id=0x95, role=Rte_COMCbk_ComISignal_BCAN_CLU_05_00ms_USM_StaRst1Req, call-type=CALLBACK, execution-context=TASK
    Rte_COMCbk_ComISignal_BCAN_CLU_09_00ms_USM_Wpc2SetReq: service-id=0x95, role=Rte_COMCbk_ComISignal_BCAN_CLU_09_00ms_USM_Wpc2SetReq, call-type=CALLBACK, execution-context=TASK
    Rte_COMCbk_ComISignal_BCAN_CLU_09_00ms_USM_WpcSetReq: service-id=0x95, role=Rte_COMCbk_ComISignal_BCAN_CLU_09_00ms_USM_WpcSetReq, call-type=CALLBACK, execution-context=TASK
    Rte_COMCbk_ComISignal_BCAN_CLU_20_200ms_CLU_ClusterUSM: service-id=0x95, role=Rte_COMCbk_ComISignal_BCAN_CLU_20_200ms_CLU_ClusterUSM, call-type=CALLBACK, execution-context=TASK
    Rte_COMCbk_ComISignal_BCAN_EMS_02_10ms_ENG_EngSta: service-id=0x95, role=Rte_COMCbk_ComISignal_BCAN_EMS_02_10ms_ENG_EngSta, call-type=CALLBACK, execution-context=TASK
    Rte_COMCbk_ComISignal_BCAN_EMS_07_10ms_HEV_EngOpSta: service-id=0x95, role=Rte_COMCbk_ComISignal_BCAN_EMS_07_10ms_HEV_EngOpSta, call-type=CALLBACK, execution-context=TASK
    Rte_COMCbk_ComISignal_BCAN_HCU_03_10ms_HCU_HevRdySta: service-id=0x95, role=Rte_COMCbk_ComISignal_BCAN_HCU_03_10ms_HCU_HevRdySta, call-type=CALLBACK, execution-context=TASK
    Rte_COMCbk_ComISignal_BCAN_HU_GW_03_200ms_CF_AVN_ProfileIDRValue: service-id=0x95, role=Rte_COMCbk_ComISignal_BCAN_HU_GW_03_200ms_CF_AVN_ProfileIDRValue, call-type=CALLBACK, execution-context=TASK
    Rte_COMCbk_ComISignal_BCAN_HU_USM_01_00ms_CF_Gway_WPCNValueSet: service-id=0x95, role=Rte_COMCbk_ComISignal_BCAN_HU_USM_01_00ms_CF_Gway_WPCNValueSet, call-type=CALLBACK, execution-context=TASK
    Rte_COMCbk_ComISignal_BCAN_HU_USM_02_00ms_CF_AVN_CluUSMReset: service-id=0x95, role=Rte_COMCbk_ComISignal_BCAN_HU_USM_02_00ms_CF_AVN_CluUSMReset, call-type=CALLBACK, execution-context=TASK
    Rte_COMCbk_ComISignal_BCAN_HU_USM_04_00ms_CF_Gway_WPC2_NValueSet: service-id=0x95, role=Rte_COMCbk_ComISignal_BCAN_HU_USM_04_00ms_CF_Gway_WPC2_NValueSet, call-type=CALLBACK, execution-context=TASK
    Rte_COMCbk_ComISignal_BCAN_HU_USM_05_00ms_CF_Gway_WPCAnimationNvalueSet: service-id=0x95, role=Rte_COMCbk_ComISignal_BCAN_HU_USM_05_00ms_CF_Gway_WPCAnimationNvalueSet, call-type=CALLBACK, execution-context=TASK
    Rte_COMCbk_ComISignal_BCAN_IAU_FD_04_200ms_IAU_DigitalKey2Opt: service-id=0x95, role=Rte_COMCbk_ComISignal_BCAN_IAU_FD_04_200ms_IAU_DigitalKey2Opt, call-type=CALLBACK, execution-context=TASK
    Rte_COMCbk_ComISignal_BCAN_IAU_FD_04_200ms_IAU_ProfileIDRVal: service-id=0x95, role=Rte_COMCbk_ComISignal_BCAN_IAU_FD_04_200ms_IAU_ProfileIDRVal, call-type=CALLBACK, execution-context=TASK
    Rte_COMCbk_ComISignal_BCAN_PDC_FD_03_200ms_Warn_AsstDrSwSta: service-id=0x95, role=Rte_COMCbk_ComISignal_BCAN_PDC_FD_03_200ms_Warn_AsstDrSwSta, call-type=CALLBACK, execution-context=TASK
    Rte_COMCbk_ComISignal_BCAN_PDC_FD_03_200ms_Warn_DrvDrSwSta: service-id=0x95, role=Rte_COMCbk_ComISignal_BCAN_PDC_FD_03_200ms_Warn_DrvDrSwSta, call-type=CALLBACK, execution-context=TASK
    Rte_COMCbk_ComISignal_BCAN_PDC_FD_03_200ms_Warn_RrLftDrSwSta: service-id=0x95, role=Rte_COMCbk_ComISignal_BCAN_PDC_FD_03_200ms_Warn_RrLftDrSwSta, call-type=CALLBACK, execution-context=TASK
    Rte_COMCbk_ComISignal_BCAN_PDC_FD_03_200ms_Warn_RrRtDrSwSta: service-id=0x95, role=Rte_COMCbk_ComISignal_BCAN_PDC_FD_03_200ms_Warn_RrRtDrSwSta, call-type=CALLBACK, execution-context=TASK
    Rte_COMCbk_ComISignal_BCAN_RWPC_FD_01_200ms_RWPC_IndSyncVal: service-id=0x95, role=Rte_COMCbk_ComISignal_BCAN_RWPC_FD_01_200ms_RWPC_IndSyncVal, call-type=CALLBACK, execution-context=TASK
    Rte_COMCbk_ComISignal_BCAN_SBCM_AST_FD_01_200ms_Warn_AsstDrSwSta_SBCM: service-id=0x95, role=Rte_COMCbk_ComISignal_BCAN_SBCM_AST_FD_01_200ms_Warn_AsstDrSwSta_SBCM, call-type=CALLBACK, execution-context=TASK
    Rte_COMCbk_ComISignal_BCAN_SBCM_DRV_FD_01_200ms_Latch_TypeOption_DRV: service-id=0x95, role=Rte_COMCbk_ComISignal_BCAN_SBCM_DRV_FD_01_200ms_Latch_TypeOption_DRV, call-type=CALLBACK, execution-context=TASK
    Rte_COMCbk_ComISignal_BCAN_SBCM_DRV_FD_01_200ms_Warn_DrvDrSwSta_SBCM: service-id=0x95, role=Rte_COMCbk_ComISignal_BCAN_SBCM_DRV_FD_01_200ms_Warn_DrvDrSwSta_SBCM, call-type=CALLBACK, execution-context=TASK
    Rte_COMCbk_ComISignal_BCAN_SBCM_RL_FD_01_200ms_Warn_RrLftDrSwSta_SBCM: service-id=0x95, role=Rte_COMCbk_ComISignal_BCAN_SBCM_RL_FD_01_200ms_Warn_RrLftDrSwSta_SBCM, call-type=CALLBACK, execution-context=TASK
    Rte_COMCbk_ComISignal_BCAN_SBCM_RR_FD_01_200ms_Warn_RrRtDrSwSta_SBCM: service-id=0x95, role=Rte_COMCbk_ComISignal_BCAN_SBCM_RR_FD_01_200ms_Warn_RrRtDrSwSta_SBCM, call-type=CALLBACK, execution-context=TASK
    Rte_COMCbk_ComISignal_BCAN_VCU_01_10ms_VCU_EvDrvRdySta: service-id=0x95, role=Rte_COMCbk_ComISignal_BCAN_VCU_01_10ms_VCU_EvDrvRdySta, call-type=CALLBACK, execution-context=TASK
    Rte_COMCbk_ComISignal_LCAN_CCU_01_00ms_CCU_ForcedPowerOffReq: service-id=0x95, role=Rte_COMCbk_ComISignal_LCAN_CCU_01_00ms_CCU_ForcedPowerOffReq, call-type=CALLBACK, execution-context=TASK
    Rte_COMCbk_ComISignal_LCAN_IAU_FD_04_200ms_IAU_DKOwnerSwapOption: service-id=0x95, role=Rte_COMCbk_ComISignal_LCAN_IAU_FD_04_200ms_IAU_DKOwnerSwapOption, call-type=CALLBACK, execution-context=TASK
    Rte_COMCbk_ComISignal_LCAN_IAU_FD_04_200ms_IAU_OwnerPhnRegRVal: service-id=0x95, role=Rte_COMCbk_ComISignal_LCAN_IAU_FD_04_200ms_IAU_OwnerPhnRegRVal, call-type=CALLBACK, execution-context=TASK
    Rte_COMCbk_ComISignal_LCAN_IAU_FD_05_200ms_IAU_SharedPhnRegStat: service-id=0x95, role=Rte_COMCbk_ComISignal_LCAN_IAU_FD_05_200ms_IAU_SharedPhnRegStat, call-type=CALLBACK, execution-context=TASK
    Rte_COMCbk_ComISignal_LCAN_L_BDC_FD_IAU_01_00ms_WPC2_NFC_Deselect_Cmd: service-id=0x95, role=Rte_COMCbk_ComISignal_LCAN_L_BDC_FD_IAU_01_00ms_WPC2_NFC_Deselect_Cmd, call-type=CALLBACK, execution-context=TASK
    Rte_COMCbk_ComISignal_LCAN_L_BDC_FD_IAU_01_00ms_WPC_NFC_Deselect_Cmd: service-id=0x95, role=Rte_COMCbk_ComISignal_LCAN_L_BDC_FD_IAU_01_00ms_WPC_NFC_Deselect_Cmd, call-type=CALLBACK, execution-context=TASK
    Rte_COMCbk_ComISignal_LCAN_L_BDC_FD_IAU_10_200ms_BDC_TP_CAN_Sta: service-id=0x95, role=Rte_COMCbk_ComISignal_LCAN_L_BDC_FD_IAU_10_200ms_BDC_TP_CAN_Sta, call-type=CALLBACK, execution-context=TASK
    Rte_COMCbk_ComISignal_LCAN_L_BDC_FD_IAU_10_200ms_OPAdv_On_Cmd: service-id=0x95, role=Rte_COMCbk_ComISignal_LCAN_L_BDC_FD_IAU_10_200ms_OPAdv_On_Cmd, call-type=CALLBACK, execution-context=TASK
    Rte_COMCbk_ComISignal_LCAN_L_BDC_FD_IAU_10_200ms_WPC_Device_On_Cmd: service-id=0x95, role=Rte_COMCbk_ComISignal_LCAN_L_BDC_FD_IAU_10_200ms_WPC_Device_On_Cmd, call-type=CALLBACK, execution-context=TASK
    Rte_COMCbk_ComISignal_LCAN_L_TP_BDC_FD_L_WPC_FD_LCAN_L_TP_BDC_FD_L_WPC_FD_signal: service-id=0x95, role=Rte_COMCbk_ComISignal_LCAN_L_TP_BDC_FD_L_WPC_FD_LCAN_L_TP_BDC_FD_L_WPC_FD_signal, call-type=CALLBACK, execution-context=TASK
  bsw module description BswModuleDescription_0: provided-entrys=[Rte_Start, Rte_Stop, SchM_Init, SchM_Deinit, SchM_GetVersionInfo]
    bsw module dependency BswModuleDependency_0: target-module-id=2, required-entrys=[Rte_Start, Rte_Stop, SchM_Init, SchM_Deinit, SchM_GetVersionInfo]
    bsw module dependency BswModuleDependency_1: target-module-id=50
      expected-callbacks:
        Rte_COMCbkRxTOut_ComISignal_BCAN_CLU_01_20ms_CLU_DisSpdVal_KPH
        Rte_COMCbkRxTOut_ComISignal_BCAN_CLU_01_20ms_CLU_RhstaLvlSta
        Rte_COMCbkRxTOut_ComISignal_BCAN_EMS_07_10ms_HEV_EngOpSta
        Rte_COMCbk_ComISignalGroup_MsgGr_E2E_BCAN_PDC_FD_15_300ms
        Rte_COMCbk_ComISignal_BCAN_BDC_FD_02_200ms_BCM_SmkOptTyp
        Rte_COMCbk_ComISignal_BCAN_BDC_FD_05_200ms_Lamp_IntTailLmpOnReq
        Rte_COMCbk_ComISignal_BCAN_BDC_FD_SMK_02_200ms_LFAnt_SrchSta
        Rte_COMCbk_ComISignal_BCAN_CLU_01_20ms_CLU_AutoBrightSta
        Rte_COMCbk_ComISignal_BCAN_CLU_01_20ms_CLU_DisSpdVal_KPH
        Rte_COMCbk_ComISignal_BCAN_CLU_01_20ms_CLU_DtntOutSta
        Rte_COMCbk_ComISignal_BCAN_CLU_01_20ms_CLU_RhstaLvlSta
        Rte_COMCbk_ComISignal_BCAN_CLU_05_00ms_USM_StaRst1Req
        Rte_COMCbk_ComISignal_BCAN_CLU_09_00ms_USM_Wpc2SetReq
        Rte_COMCbk_ComISignal_BCAN_CLU_09_00ms_USM_WpcSetReq
        Rte_COMCbk_ComISignal_BCAN_CLU_20_200ms_CLU_ClusterUSM
        Rte_COMCbk_ComISignal_BCAN_EMS_02_10ms_ENG_EngSta
        Rte_COMCbk_ComISignal_BCAN_EMS_07_10ms_HEV_EngOpSta
        Rte_COMCbk_ComISignal_BCAN_HCU_03_10ms_HCU_HevRdySta
        Rte_COMCbk_ComISignal_BCAN_HU_GW_03_200ms_CF_AVN_ProfileIDRValue
        Rte_COMCbk_ComISignal_BCAN_HU_USM_01_00ms_CF_Gway_WPCNValueSet
        Rte_COMCbk_ComISignal_BCAN_HU_USM_02_00ms_CF_AVN_CluUSMReset
        Rte_COMCbk_ComISignal_BCAN_HU_USM_04_00ms_CF_Gway_WPC2_NValueSet
        Rte_COMCbk_ComISignal_BCAN_HU_USM_05_00ms_CF_Gway_WPCAnimationNvalueSet
        Rte_COMCbk_ComISignal_BCAN_IAU_FD_04_200ms_IAU_DigitalKey2Opt
        Rte_COMCbk_ComISignal_BCAN_IAU_FD_04_200ms_IAU_ProfileIDRVal
        Rte_COMCbk_ComISignal_BCAN_PDC_FD_03_200ms_Warn_AsstDrSwSta
        Rte_COMCbk_ComISignal_BCAN_PDC_FD_03_200ms_Warn_DrvDrSwSta
        Rte_COMCbk_ComISignal_BCAN_PDC_FD_03_200ms_Warn_RrLftDrSwSta
        Rte_COMCbk_ComISignal_BCAN_PDC_FD_03_200ms_Warn_RrRtDrSwSta
        Rte_COMCbk_ComISignal_BCAN_RWPC_FD_01_200ms_RWPC_IndSyncVal
        Rte_COMCbk_ComISignal_BCAN_SBCM_AST_FD_01_200ms_Warn_AsstDrSwSta_SBCM
        Rte_COMCbk_ComISignal_BCAN_SBCM_DRV_FD_01_200ms_Latch_TypeOption_DRV
        Rte_COMCbk_ComISignal_BCAN_SBCM_DRV_FD_01_200ms_Warn_DrvDrSwSta_SBCM
        Rte_COMCbk_ComISignal_BCAN_SBCM_RL_FD_01_200ms_Warn_RrLftDrSwSta_SBCM
        Rte_COMCbk_ComISignal_BCAN_SBCM_RR_FD_01_200ms_Warn_RrRtDrSwSta_SBCM
        Rte_COMCbk_ComISignal_BCAN_VCU_01_10ms_VCU_EvDrvRdySta
        Rte_COMCbk_ComISignal_LCAN_CCU_01_00ms_CCU_ForcedPowerOffReq
        Rte_COMCbk_ComISignal_LCAN_IAU_FD_04_200ms_IAU_DKOwnerSwapOption
        Rte_COMCbk_ComISignal_LCAN_IAU_FD_04_200ms_IAU_OwnerPhnRegRVal
        Rte_COMCbk_ComISignal_LCAN_IAU_FD_05_200ms_IAU_SharedPhnRegStat
        Rte_COMCbk_ComISignal_LCAN_L_BDC_FD_IAU_01_00ms_WPC2_NFC_Deselect_Cmd
        Rte_COMCbk_ComISignal_LCAN_L_BDC_FD_IAU_01_00ms_WPC_NFC_Deselect_Cmd
        Rte_COMCbk_ComISignal_LCAN_L_BDC_FD_IAU_10_200ms_BDC_TP_CAN_Sta
        Rte_COMCbk_ComISignal_LCAN_L_BDC_FD_IAU_10_200ms_OPAdv_On_Cmd
        Rte_COMCbk_ComISignal_LCAN_L_BDC_FD_IAU_10_200ms_WPC_Device_On_Cmd
        Rte_COMCbk_ComISignal_LCAN_L_TP_BDC_FD_L_WPC_FD_LCAN_L_TP_BDC_FD_L_WPC_FD_signal
    bsw internal behavior BswInternalBehavior_0
      static-memorys:
        88 x data:
          Rte_GucDcmApplicationUpdated_CurrentMode_modeSwitchPort_DcmApplicationUpdatedBswM: type=uint8
          Rte_GucInitState_NewMode_modeSwitchPort_InitStateBswM: type=uint8
          Rte_GucPduGroupRx_LCAN_PNC32_NewMode_modeSwitchPort_PduGroupRx_LCAN_PNC32BswM: type=uint8
          Rte_GucComMMode_PNC153_NewMode_modeSwitchPort_ComMMode_PNC153BswM: type=uint8
          Rte_GucComMMode_LCAN_NewMode_modeSwitchPort_ComMMode_LCANBswM: type=uint8
          Rte_GucComMMode_BCAN_CurrentMode_modeSwitchPort_ComMMode_BCANBswM: type=uint8
          Rte_GucWakeupEvent_CurrentMode_modeSwitchPort_WakeupEventBswM: type=uint8
          Rte_GucPduGroupTx_BCAN_PNC32_OldMode_modeSwitchPort_PduGroupTx_BCAN_PNC32BswM: type=uint8
          Rte_GucPduGroupRx_BCAN_PNC32_CurrentMode_modeSwitchPort_PduGroupRx_BCAN_PNC32BswM: type=uint8
          Rte_GucCanSMState_BCAN_NewMode_modeSwitchPort_CanSMState_BCANBswM: type=uint8
          Rte_GucComMMode_PNC32_CurrentMode_modeSwitchPort_ComMMode_PNC32BswM: type=uint8
          Rte_GuccurrentMode_CurrentMode_globalModeWdgM: type=uint8
          Rte_GuccurrentMode_CurrentMode_UM000_PComM: type=ComM_ModeType
          Rte_GucPduGroupTx_BCAN_PNC32_NewMode_modeSwitchPort_PduGroupTx_BCAN_PNC32BswM: type=uint8
          Rte_GucCanSMBORState_LCAN_NewMode_modeSwitchPort_CanSMBORState_LCANBswM: type=uint8
          Rte_GuccurrentMode_OldMode_globalModeWdgM: type=uint8
          Rte_GucPduGroupTx_BCAN_PNC141_OldMode_modeSwitchPort_PduGroupTx_BCAN_PNC141BswM: type=uint8
          Rte_GucDcmApplicationUpdated_NewMode_modeSwitchPort_DcmApplicationUpdatedBswM: type=uint8
          Rte_GuccurrentMode_NewMode_globalModeWdgM: type=uint8
          Rte_GucDcmModeRapidPowerShutDown_CurrentMode_modeSwitchPort_DcmModeRapidPowerShutDownBswM: type=uint8
          Rte_GucPduGroupRx_BCAN_PNC141_OldMode_modeSwitchPort_PduGroupRx_BCAN_PNC141BswM: type=uint8
          Rte_GucCanSMBORState_LCAN_CurrentMode_modeSwitchPort_CanSMBORState_LCANBswM: type=uint8
          Rte_GucCanSMState_BCAN_CurrentMode_modeSwitchPort_CanSMState_BCANBswM: type=uint8
          Rte_GucPduGroupTx_BCAN_PNC141_NewMode_modeSwitchPort_PduGroupTx_BCAN_PNC141BswM: type=uint8
          Rte_GucComMMode_PNC141_CurrentMode_modeSwitchPort_ComMMode_PNC141BswM: type=uint8
          Rte_GucPduGroupRx_BCAN_PNC153_OldMode_modeSwitchPort_PduGroupRx_BCAN_PNC153BswM: type=uint8
          Rte_GucDcmDiagnosticSessionControl_NewMode_modeSwitchPort_DcmDiagnosticSessionControlBswM: type=uint8
          Rte_GucPduGroupRx_LCAN_PNC32_CurrentMode_modeSwitchPort_PduGroupRx_LCAN_PNC32BswM: type=uint8
          Rte_GucPduGroupTx_LCAN_PNC32_CurrentMode_modeSwitchPort_PduGroupTx_LCAN_PNC32BswM: type=uint8
          Rte_GucComMMode_BCAN_OldMode_modeSwitchPort_ComMMode_BCANBswM: type=uint8
          Rte_GucEcuMode_CurrentMode_modeSwitchPort_EcuModeBswM: type=EcuM_StateType
          Rte_GucPduGroupRx_BCAN_PNC141_CurrentMode_modeSwitchPort_PduGroupRx_BCAN_PNC141BswM: type=uint8
          Rte_GucDcmCommunicationControl_0_NewMode_modeSwitchPort_DcmCommunicationControl_0BswM: type=uint8
          Rte_GucComMMode_PNC32_NewMode_modeSwitchPort_ComMMode_PNC32BswM: type=uint8
          Rte_GucComMMode_PNC153_CurrentMode_modeSwitchPort_ComMMode_PNC153BswM: type=uint8
          Rte_GuccurrentMode_CurrentMode_UM002_PComM: type=ComM_ModeType
          Rte_GucPduGroupRx_LCAN_PNC159_OldMode_modeSwitchPort_PduGroupRx_LCAN_PNC159BswM: type=uint8
          Rte_GucCanSMBORState_BCAN_OldMode_modeSwitchPort_CanSMBORState_BCANBswM: type=uint8
          Rte_GucPduGroupTx_BCAN_PNC32_CurrentMode_modeSwitchPort_PduGroupTx_BCAN_PNC32BswM: type=uint8
          Rte_GucInitState_CurrentMode_modeSwitchPort_InitStateBswM: type=uint8
          Rte_GucWakeupEvent_OldMode_modeSwitchPort_WakeupEventBswM: type=uint8
          Rte_GucPduGroupRx_BCAN_PNC32_OldMode_modeSwitchPort_PduGroupRx_BCAN_PNC32BswM: type=uint8
          Rte_GucComMMode_PNC153_OldMode_modeSwitchPort_ComMMode_PNC153BswM: type=uint8
          Rte_GucDcmApplicationUpdated_OldMode_modeSwitchPort_DcmApplicationUpdatedBswM: type=uint8
          Rte_GucEcuMode_NewMode_modeSwitchPort_EcuModeBswM: type=EcuM_StateType
          Rte_GuccurrentMode_CurrentMode_UM001_PComM: type=ComM_ModeType
          Rte_GucCanSMState_LCAN_CurrentMode_modeSwitchPort_CanSMState_LCANBswM: type=uint8
          Rte_GucComMMode_PNC32_OldMode_modeSwitchPort_ComMMode_PNC32BswM: type=uint8
          Rte_GucPduGroupRx_BCAN_PNC153_NewMode_modeSwitchPort_PduGroupRx_BCAN_PNC153BswM: type=uint8
          Rte_GucPduGroupTx_BCAN_PNC141_CurrentMode_modeSwitchPort_PduGroupTx_BCAN_PNC141BswM: type=uint8
          Rte_GucCanSMState_BCAN_OldMode_modeSwitchPort_CanSMState_BCANBswM: type=uint8
          Rte_GucCanSMState_LCAN_NewMode_modeSwitchPort_CanSMState_LCANBswM: type=uint8
          Rte_GucDcmCommunicationControl_0_CurrentMode_modeSwitchPort_DcmCommunicationControl_0BswM: type=uint8
          Rte_GucPduGroupRx_LCAN_PNC32_OldMode_modeSwitchPort_PduGroupRx_LCAN_PNC32BswM: type=uint8
          Rte_GucEcuMode_OldMode_modeSwitchPort_EcuModeBswM: type=EcuM_StateType
          Rte_GucPduGroupRx_BCAN_PNC141_NewMode_modeSwitchPort_PduGroupRx_BCAN_PNC141BswM: type=uint8
          Rte_GucPduGroupRx_LCAN_PNC159_NewMode_modeSwitchPort_PduGroupRx_LCAN_PNC159BswM: type=uint8
          Rte_GucComMMode_PNC141_OldMode_modeSwitchPort_ComMMode_PNC141BswM: type=uint8
          Rte_GucDcmDiagnosticSessionControl_CurrentMode_modeSwitchPort_DcmDiagnosticSessionControlBswM: type=uint8
          Rte_GucComMMode_PNC159_CurrentMode_modeSwitchPort_ComMMode_PNC159BswM: type=uint8
          Rte_GucDcmDiagnosticSessionControl_OldMode_modeSwitchPort_DcmDiagnosticSessionControlBswM: type=uint8
          Rte_GucPduGroupRx_LCAN_PNC159_CurrentMode_modeSwitchPort_PduGroupRx_LCAN_PNC159BswM: type=uint8
          Rte_GucPduGroupTx_LCAN_PNC32_NewMode_modeSwitchPort_PduGroupTx_LCAN_PNC32BswM: type=uint8
          Rte_GucPduGroupTx_LCAN_PNC159_NewMode_modeSwitchPort_PduGroupTx_LCAN_PNC159BswM: type=uint8
          Rte_GucPduGroupTx_BCAN_PNC153_CurrentMode_modeSwitchPort_PduGroupTx_BCAN_PNC153BswM: type=uint8
          Rte_GucComMMode_PNC141_NewMode_modeSwitchPort_ComMMode_PNC141BswM: type=uint8
          Rte_GucPduGroupTx_LCAN_PNC159_CurrentMode_modeSwitchPort_PduGroupTx_LCAN_PNC159BswM: type=uint8
          Rte_GucCanSMBORState_BCAN_NewMode_modeSwitchPort_CanSMBORState_BCANBswM: type=uint8
          Rte_GucComMMode_BCAN_NewMode_modeSwitchPort_ComMMode_BCANBswM: type=uint8
          Rte_GucComMMode_LCAN_CurrentMode_modeSwitchPort_ComMMode_LCANBswM: type=uint8
          Rte_GucDcmCommunicationControl_0_OldMode_modeSwitchPort_DcmCommunicationControl_0BswM: type=uint8
          Rte_GucPduGroupRx_BCAN_PNC153_CurrentMode_modeSwitchPort_PduGroupRx_BCAN_PNC153BswM: type=uint8
          Rte_GuccurrentMode_CurrentMode_mode_SE_InitWdgM: type=uint8
          Rte_GucCanSMBORState_LCAN_OldMode_modeSwitchPort_CanSMBORState_LCANBswM: type=uint8
          Rte_GucDcmControlDTCSetting_CurrentMode_modeSwitchPort_DcmControlDTCSettingBswM: type=uint8
          Rte_GucPduGroupTx_BCAN_PNC153_NewMode_modeSwitchPort_PduGroupTx_BCAN_PNC153BswM: type=uint8
          Rte_GucCanSMBORState_BCAN_CurrentMode_modeSwitchPort_CanSMBORState_BCANBswM: type=uint8
          Rte_GucPduGroupRx_BCAN_PNC32_NewMode_modeSwitchPort_PduGroupRx_BCAN_PNC32BswM: type=uint8
          Rte_GucWakeupEvent_NewMode_modeSwitchPort_WakeupEventBswM: type=uint8
          Rte_GucInitState_OldMode_modeSwitchPort_InitStateBswM: type=uint8
          Rte_GucPduGroupTx_BCAN_PNC153_OldMode_modeSwitchPort_PduGroupTx_BCAN_PNC153BswM: type=uint8
          Rte_GuccurrentMode_CurrentMode_mode_SE_WdgMTestWdgM: type=uint8
          Rte_GucComMMode_PNC159_NewMode_modeSwitchPort_ComMMode_PNC159BswM: type=uint8
          Rte_GucCanSMState_LCAN_OldMode_modeSwitchPort_CanSMState_LCANBswM: type=uint8
          Rte_GucPduGroupTx_LCAN_PNC32_OldMode_modeSwitchPort_PduGroupTx_LCAN_PNC32BswM: type=uint8
          Rte_GucComMMode_PNC159_OldMode_modeSwitchPort_ComMMode_PNC159BswM: type=uint8
          Rte_GucComMMode_LCAN_OldMode_modeSwitchPort_ComMMode_LCANBswM: type=uint8
          Rte_GucPduGroupTx_LCAN_PNC159_OldMode_modeSwitchPort_PduGroupTx_LCAN_PNC159BswM: type=uint8
      5 x bsw called entity:
        BswCalledEntity_0: implemented-entry=Rte_Start
        BswCalledEntity_1: implemented-entry=Rte_Stop
        BswCalledEntity_3: implemented-entry=SchM_Init
        BswCalledEntity_4: implemented-entry=SchM_Deinit
        BswCalledEntity_5: implemented-entry=SchM_GetVersionInfo
  impl type Std_VersionInfoType: category=DATA_REFERENCE
    5 x element:
      vendorID: base-type=uint16
      moduleID: base-type=uint16
      sw_major_version: base-type=uint8
      sw_minor_version: base-type=uint8
      sw_patch_version: base-type=uint8
