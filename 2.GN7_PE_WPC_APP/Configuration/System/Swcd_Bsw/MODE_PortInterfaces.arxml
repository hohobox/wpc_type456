AUTOSAR XML (schema 4-0-3)
package /MODE/ApplicationPrimitiveDataTypes
  4 x app type, all with category=VALUE:
    ENUM_ComMMode: compu {0=COMM_MODE_NO_COM, 2=COMM_MODE_FULL_COM}
    ENUM_PduRouter: compu {0=PDU_ROUTER_ENABLE, 1=PDU_ROUTER_DISABLE}
    ENUM_AppMode: compu {0=APP_MODE_ACTIVE, 1=APP_MODE_INACTIVE_OFF, 2=APP_MODE_INACTIVE_RESET, 3=APP_MODE_INACTIVE_SLEEP}
    ENUM_ComMMode_PNC: compu {0=COMM_MODE_PNC_REQUESTED, 1=COMM_MODE_PNC_READY_SLEEP, 2=COMM_MODE_PNC_PREPARE_SLEEP, 3=COMM_MODE_PNC_NO_COMMUNICATION, 4=COMM_MODE_PNC_FULL_COMMUNICATION}
package /MODE/ModeDeclarationGroups
  9 x mode declaration group:
    MDG_ComMMode: category=EXPLICIT_ORDER, initial-mode=MDG_ComMMode/NO_COM, on-transition-value=255
      mode NO_COM: value=0
      mode SILENT_COM: value=1
      mode FULL_COM: value=2
    MDG_CanSMState: category=EXPLICIT_ORDER, initial-mode=MDG_CanSMState/NO_COM, on-transition-value=255
      5 x mode:
        NO_COM: value=0
        SILENT_COM: value=1
        FULL_COM: value=2
        BUS_OFF: value=3
        CHANGE_BAUDRATE: value=4
    MDG_CanSMBORState: category=EXPLICIT_ORDER, initial-mode=MDG_CanSMBORState/COMPLETE, on-transition-value=255
      mode COMPLETE: value=0
      mode START: value=1
    MDG_LinSMState: category=EXPLICIT_ORDER, initial-mode=MDG_LinSMState/NO_COM, on-transition-value=255
      mode NO_COM: value=0
      mode FULL_COM: value=1
    MDG_WakeupEvent: category=EXPLICIT_ORDER, initial-mode=INITIAL_MODE, on-transition-value=255
      12 x mode:
        POWER: value=0
        RESET: value=1
        INTERNAL_RESET: value=2
        INTERNAL_WDG: value=3
        EXTERNAL_WDG: value=4
        GPT: value=5
        BCAN_RX: value=6
        BCAN_RX_POLL: value=7
        IGN1: value=8
        LCAN_RX: value=9
        LCAN_RX_POLL: value=10
        INITIAL_MODE: value=32
    MDG_InitState: category=EXPLICIT_ORDER, initial-mode=MDG_InitState/START, on-transition-value=255
      mode START: value=0
      mode COMPLETE: value=1
    MDG_PduGroup: category=EXPLICIT_ORDER, initial-mode=STOP, on-transition-value=255
      mode STOP: value=0
      mode START: value=1
    MDG_WaitMode: category=ALPHABETIC_ORDER, initial-mode=READY, on-transition-value=3
      mode READY: value=0
      mode RUN: value=1
      mode COMPLETE: value=2
    MDG_ComMMode_PNC: category=EXPLICIT_ORDER, initial-mode=PNC_NO_COMMUNICATION, on-transition-value=255
      5 x mode:
        PNC_REQUESTED: value=0
        PNC_READY_SLEEP: value=1
        PNC_PREPARE_SLEEP: value=2
        PNC_NO_COMMUNICATION: value=3
        PNC_FULL_COMMUNICATION: value=4
package /MODE/DataTypeMappingSets
  11 x data type mapping set:
    MAP_ComMMode: data-type-map{application-data-type=ENUM_ComMMode, implementation-data-type=uint8}, mode-request-type-map{implementation-data-type=uint8, mode-group=MDG_ComMMode}
    MAP_CanSMState: mode-request-type-map{implementation-data-type=uint8, mode-group=MDG_CanSMState}
    MAP_CanSMBORState: mode-request-type-map{implementation-data-type=uint8, mode-group=MDG_CanSMBORState}
    MAP_LinSMState: mode-request-type-map{implementation-data-type=uint8, mode-group=MDG_LinSMState}
    MAP_WakeupEvent: mode-request-type-map{implementation-data-type=uint8, mode-group=MDG_WakeupEvent}
    MAP_PduRouter: data-type-map{application-data-type=ENUM_PduRouter, implementation-data-type=uint8}
    MAP_InitState: mode-request-type-map{implementation-data-type=uint8, mode-group=MDG_InitState}
    MAP_AppMode: data-type-map{application-data-type=ENUM_AppMode, implementation-data-type=uint8}
    MAP_PduGroup: mode-request-type-map{implementation-data-type=uint8, mode-group=MDG_PduGroup}
    MAP_WaitMode: mode-request-type-map{implementation-data-type=uint8, mode-group=MDG_WaitMode}
    MAP_ComMMode_PNC: data-type-map{application-data-type=ENUM_ComMMode_PNC, implementation-data-type=uint8}, mode-request-type-map{implementation-data-type=uint8, mode-group=MDG_ComMMode_PNC}
package /MODE/SenderReceiverInterfaces
  sender receiver interface PduRouterRequestInterface: is-service=true, service-kind=BASIC-SOFTWARE-MODE-MANAGER
    data PduRouter_Test: type=ENUM_PduRouter
  sender receiver interface AppModeRequestInterface: is-service=true, service-kind=BASIC-SOFTWARE-MODE-MANAGER
    data AppMode: type=ENUM_AppMode
package /MODE/ModeSwitchInterfaces
  5 x mode switch interface, all with is-service=true, service-kind=BASIC-SOFTWARE-MODE-MANAGER:
    WakeupEventInterface
      mode group WakeupEvent: type=MDG_WakeupEvent
    InitStateInterface
      mode group InitState: type=MDG_InitState
    EcuModeInterface
      mode group EcuMode: type=EcuMode
    WaitModeComplete
      mode group WaitModeComplete: type=MDG_WaitMode
    WaitModeRun
      mode group WaitModeRun: type=MDG_WaitMode
package /MODE_BCAN/ModeSwitchInterfaces
  9 x mode switch interface, all with is-service=true, service-kind=BASIC-SOFTWARE-MODE-MANAGER:
    CanSMBORStateInterface_BCAN
      mode group CanSMBORState_BCAN: type=MDG_CanSMBORState
    CanSMStateInterface_BCAN
      mode group CanSMState_BCAN: type=MDG_CanSMState
    ComMModeInterface_BCAN
      mode group ComMMode_BCAN: type=MDG_ComMMode
    PduGroupTxInterface_BCAN_PNC32
      mode group PduGroupTx_BCAN_PNC32: type=MDG_PduGroup
    PduGroupRxInterface_BCAN_PNC141
      mode group PduGroupRx_BCAN_PNC141: type=MDG_PduGroup
    PduGroupRxInterface_BCAN_PNC153
      mode group PduGroupRx_BCAN_PNC153: type=MDG_PduGroup
    PduGroupTxInterface_BCAN_PNC141
      mode group PduGroupTx_BCAN_PNC141: type=MDG_PduGroup
    PduGroupTxInterface_BCAN_PNC153
      mode group PduGroupTx_BCAN_PNC153: type=MDG_PduGroup
    PduGroupRxInterface_BCAN_PNC32
      mode group PduGroupRx_BCAN_PNC32: type=MDG_PduGroup
package /MODE_PNC141/SenderReceiverInterfaces
  sender receiver interface ComMModeRequestInterface_PNC141: is-service=true, service-kind=BASIC-SOFTWARE-MODE-MANAGER
    data ComMMode_PNC141: type=ENUM_ComMMode
package /MODE_PNC141/ModeSwitchInterfaces
  mode switch interface ComMModeInterface_PNC141: is-service=true, service-kind=BASIC-SOFTWARE-MODE-MANAGER
    mode group ComMMode_PNC141: type=MDG_ComMMode_PNC
package /MODE_PNC153/SenderReceiverInterfaces
  sender receiver interface ComMModeRequestInterface_PNC153: is-service=true, service-kind=BASIC-SOFTWARE-MODE-MANAGER
    data ComMMode_PNC153: type=ENUM_ComMMode
package /MODE_PNC153/ModeSwitchInterfaces
  mode switch interface ComMModeInterface_PNC153: is-service=true, service-kind=BASIC-SOFTWARE-MODE-MANAGER
    mode group ComMMode_PNC153: type=MDG_ComMMode_PNC
package /MODE_LCAN/ModeSwitchInterfaces
  7 x mode switch interface, all with is-service=true, service-kind=BASIC-SOFTWARE-MODE-MANAGER:
    CanSMBORStateInterface_LCAN
      mode group CanSMBORState_LCAN: type=MDG_CanSMBORState
    CanSMStateInterface_LCAN
      mode group CanSMState_LCAN: type=MDG_CanSMState
    ComMModeInterface_LCAN
      mode group ComMMode_LCAN: type=MDG_ComMMode
    PduGroupRxInterface_LCAN_PNC159
      mode group PduGroupRx_LCAN_PNC159: type=MDG_PduGroup
    PduGroupRxInterface_LCAN_PNC32
      mode group PduGroupRx_LCAN_PNC32: type=MDG_PduGroup
    PduGroupTxInterface_LCAN_PNC159
      mode group PduGroupTx_LCAN_PNC159: type=MDG_PduGroup
    PduGroupTxInterface_LCAN_PNC32
      mode group PduGroupTx_LCAN_PNC32: type=MDG_PduGroup
package /MODE_PNC159/SenderReceiverInterfaces
  sender receiver interface ComMModeRequestInterface_PNC159: is-service=true, service-kind=BASIC-SOFTWARE-MODE-MANAGER
    data ComMMode_PNC159: type=ENUM_ComMMode
package /MODE_PNC159/ModeSwitchInterfaces
  mode switch interface ComMModeInterface_PNC159: is-service=true, service-kind=BASIC-SOFTWARE-MODE-MANAGER
    mode group ComMMode_PNC159: type=MDG_ComMMode_PNC
package /MODE_PNC32/SenderReceiverInterfaces
  sender receiver interface ComMModeRequestInterface_PNC32: is-service=true, service-kind=BASIC-SOFTWARE-MODE-MANAGER
    data ComMMode_PNC32: type=ENUM_ComMMode
package /MODE_PNC32/ModeSwitchInterfaces
  mode switch interface ComMModeInterface_PNC32: is-service=true, service-kind=BASIC-SOFTWARE-MODE-MANAGER
    mode group ComMMode_PNC32: type=MDG_ComMMode_PNC
