AUTOSAR XML (schema 00047)
package /Svc_Nml
  service sw component type Nml
    behavior InternalBehavior
      timing event TE_Nml_main: start-on-event=Nml_Main, period=0.1
      runnable Nml_Main
