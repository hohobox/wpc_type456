AUTOSAR XML (schema 4-0-3)
package /PortInterface
  client server interface CtrlRamService: is-service=true, service-kind=NON-VOLATILE-RAM-MANAGER
    5 x operation, all with possible-error=E_NOT_OK:
      GetStatus
        arg StatusPtr: type=CtrlRam_StatusType, direction=OUT
      ByteWrite
        arg lpub_PtrByte: type=uint8, direction=INOUT
        arg lub_Value: type=uint8, direction=IN
      WordWrite
        arg lpuw_PtrWord: type=uint16, direction=INOUT
        arg luw_Value: type=uint16, direction=IN
      LongWrite
        arg lpul_PtrLong: type=uint32, direction=INOUT
        arg lul_Value: type=uint32, direction=IN
      StructWrite
        arg lpub_Struct: type=uint8, direction=INOUT
        arg lpub_Src: type=uint8Array, direction=IN
        arg lub_Size: type=uint8, direction=IN
    error CRAM_LOST: error-code=2
    error E_NOT_OK: error-code=1
package /ServiceSwComponentTypes
  service sw component type CtrlRam
    provide port PS_CtrlRam: provided-interface=CtrlRamService
      provided-com-specs:
        operation=ByteWrite, queue-length=1
        operation=WordWrite, queue-length=1
        operation=LongWrite, queue-length=1
        operation=StructWrite, queue-length=1
        operation=GetStatus, queue-length=1
    behavior IB_CtrlRam: included-data-type-set=data-type=CtrlRam_StatusType
      5 x operation invoked event:
        OperationInvokedEvent_ByteWrite: start-on-event=ByteWrite, operation=PS_CtrlRam.ByteWrite
        OperationInvokedEvent_WordWrite: start-on-event=WordWrite, operation=PS_CtrlRam.WordWrite
        OperationInvokedEvent_LongWrite: start-on-event=LongWrite, operation=PS_CtrlRam.LongWrite
        OperationInvokedEvent_StructWrite: start-on-event=StructWrite, operation=PS_CtrlRam.StructWrite
        OperationInvokedEvent_GetErrorStatus: start-on-event=GetStatus, operation=PS_CtrlRam.GetStatus
      5 x runnable, all with can-be-invoked-concurrently=true:
        ByteWrite: symbol=bsramctl_ByteWrite
        WordWrite: symbol=bsramctl_WordWrite
        LongWrite: symbol=bsramctl_LongWrite
        StructWrite: symbol=bsramctl_StructWrite
        GetStatus: symbol=Ctrlram_GetStatus
package /ImplementationDataTypes
  impl type uint8Array: category=ARRAY
    element uint8ArrayMember: array-size=2, array-size-semantics=FIXED-SIZE, implementation-data-type=uint8
  impl type CtrlRam_StatusType: compu {0=CRAM_OK, 1=CRAM_LOST}, implementation-data-type=uint8
