AUTOSAR XML (schema 4-0-3)
package /ECU_EXTRACT
  system EcuExtract: category=ECU_EXTRACT, pnc-vector-length=28, pnc-vector-offset=4
    system mapping DataMappings
      data-mappings:
        sender-receiver-to-signal-mapping={communication-direction=IN, data-element=App_CAN_RX.RootSwCompositionPrototype.BCAN_HCU_03_10ms.HCU_HevRdySta, system-signal=SystemSignal_BCAN_HCU_03_10ms_HCU_HevRdySta}
        sender-receiver-to-signal-mapping={communication-direction=IN, data-element=App_CAN_RX.RootSwCompositionPrototype.BCAN_CLU_20_200ms.CLU_ClusterUSM, system-signal=SystemSignal_BCAN_CLU_20_200ms_CLU_ClusterUSM}
        sender-receiver-to-signal-mapping={communication-direction=IN, data-element=App_CAN_RX.RootSwCompositionPrototype.BCAN_CLU_01_20ms.CLU_RhstaLvlSta, system-signal=SystemSignal_BCAN_CLU_01_20ms_CLU_RhstaLvlSta}
        sender-receiver-to-signal-mapping={communication-direction=IN, data-element=App_CAN_RX.RootSwCompositionPrototype.BCAN_CLU_05_00ms.USM_StaRst1Req, system-signal=SystemSignal_BCAN_CLU_05_00ms_USM_StaRst1Req}
        sender-receiver-to-signal-mapping={communication-direction=IN, data-element=App_CAN_RX.RootSwCompositionPrototype.BCAN_EMS_02_10ms.ENG_EngSta, system-signal=SystemSignal_BCAN_EMS_02_10ms_ENG_EngSta}
        sender-receiver-to-signal-mapping={communication-direction=IN, data-element=App_CAN_RX.RootSwCompositionPrototype.BCAN_CLU_01_20ms.CLU_DtntOutSta, system-signal=SystemSignal_BCAN_CLU_01_20ms_CLU_DtntOutSta}
        sender-receiver-to-signal-mapping={communication-direction=IN, data-element=App_CAN_RX.RootSwCompositionPrototype.BCAN_CLU_09_00ms.USM_WpcSetReq, system-signal=SystemSignal_BCAN_CLU_09_00ms_USM_WpcSetReq}
        sender-receiver-to-signal-mapping={communication-direction=IN, data-element=App_CAN_RX.RootSwCompositionPrototype.BCAN_CLU_01_20ms.CLU_AutoBrightSta, system-signal=SystemSignal_BCAN_CLU_01_20ms_CLU_AutoBrightSta}
        sender-receiver-to-signal-mapping={communication-direction=IN, data-element=App_CAN_RX.RootSwCompositionPrototype.BCAN_VCU_01_10ms.VCU_EvDrvRdySta, system-signal=SystemSignal_BCAN_VCU_01_10ms_VCU_EvDrvRdySta}
        sender-receiver-to-signal-mapping={communication-direction=IN, data-element=App_CAN_RX.RootSwCompositionPrototype.BCAN_EMS_07_10ms.HEV_EngOpSta, system-signal=SystemSignal_BCAN_EMS_07_10ms_HEV_EngOpSta}
        sender-receiver-to-signal-mapping={communication-direction=IN, data-element=App_CAN_RX.RootSwCompositionPrototype.BCAN_CLU_01_20ms.CLU_DisSpdVal_KPH, system-signal=SystemSignal_BCAN_CLU_01_20ms_CLU_DisSpdVal_KPH}
        sender-receiver-to-signal-mapping={communication-direction=IN, data-element=App_CAN_RX.RootSwCompositionPrototype.BCAN_SBCM_AST_FD_01_200ms.Warn_AsstDrSwSta_SBCM, system-signal=SystemSignal_BCAN_SBCM_AST_FD_01_200ms_Warn_AsstDrSwSta_SBCM}
        sender-receiver-to-signal-mapping={communication-direction=IN, data-element=App_CAN_RX.RootSwCompositionPrototype.BCAN_HU_USM_02_00ms.CF_AVN_CluUSMReset, system-signal=SystemSignal_BCAN_HU_USM_02_00ms_CF_AVN_CluUSMReset}
        sender-receiver-to-signal-mapping={communication-direction=IN, data-element=App_CAN_RX.RootSwCompositionPrototype.BCAN_HU_GW_03_200ms.CF_AVN_ProfileIDRValue, system-signal=SystemSignal_BCAN_HU_GW_03_200ms_CF_AVN_ProfileIDRValue}
        sender-receiver-to-signal-mapping={communication-direction=IN, data-element=App_CAN_RX.RootSwCompositionPrototype.BCAN_RWPC_FD_01_200ms.RWPC_IndSyncVal, system-signal=SystemSignal_BCAN_RWPC_FD_01_200ms_RWPC_IndSyncVal}
        sender-receiver-to-signal-mapping={communication-direction=IN, data-element=App_CAN_RX.RootSwCompositionPrototype.BCAN_HU_USM_05_00ms.CF_Gway_WPCAnimationNvalueSet, system-signal=SystemSignal_BCAN_HU_USM_05_00ms_CF_Gway_WPCAnimationNvalueSet}
        sender-receiver-to-signal-mapping={communication-direction=IN, data-element=App_CAN_RX.RootSwCompositionPrototype.BCAN_IAU_FD_04_200ms.IAU_ProfileIDRVal, system-signal=SystemSignal_BCAN_IAU_FD_04_200ms_IAU_ProfileIDRVal}
        sender-receiver-to-signal-mapping={communication-direction=IN, data-element=App_CAN_RX.RootSwCompositionPrototype.BCAN_HU_USM_04_00ms.CF_Gway_WPC2_NValueSet, system-signal=SystemSignal_BCAN_HU_USM_04_00ms_CF_Gway_WPC2_NValueSet}
        sender-receiver-to-signal-mapping={communication-direction=IN, data-element=App_CAN_RX.RootSwCompositionPrototype.BCAN_SBCM_DRV_FD_01_200ms.Warn_DrvDrSwSta_SBCM, system-signal=SystemSignal_BCAN_SBCM_DRV_FD_01_200ms_Warn_DrvDrSwSta_SBCM}
        sender-receiver-to-signal-mapping={communication-direction=IN, data-element=App_CAN_RX.RootSwCompositionPrototype.BCAN_SBCM_DRV_FD_01_200ms.Latch_TypeOption_DRV, system-signal=SystemSignal_BCAN_SBCM_DRV_FD_01_200ms_Latch_TypeOption_DRV}
        sender-receiver-to-signal-mapping={communication-direction=IN, data-element=App_CAN_RX.RootSwCompositionPrototype.BCAN_SBCM_RR_FD_01_200ms.Warn_RrRtDrSwSta_SBCM, system-signal=SystemSignal_BCAN_SBCM_RR_FD_01_200ms_Warn_RrRtDrSwSta_SBCM}
        sender-receiver-to-signal-mapping={communication-direction=IN, data-element=App_CAN_RX.RootSwCompositionPrototype.BCAN_BDC_FD_SMK_02_200ms.LFAnt_SrchSta, system-signal=SystemSignal_BCAN_BDC_FD_SMK_02_200ms_LFAnt_SrchSta}
        sender-receiver-to-signal-mapping={communication-direction=IN, data-element=App_CAN_RX.RootSwCompositionPrototype.BCAN_PDC_FD_03_200ms.Warn_RrRtDrSwSta, system-signal=SystemSignal_BCAN_PDC_FD_03_200ms_Warn_RrRtDrSwSta}
        sender-receiver-to-signal-mapping={communication-direction=IN, data-element=App_CAN_RX.RootSwCompositionPrototype.BCAN_BDC_FD_05_200ms.Lamp_IntTailLmpOnReq, system-signal=SystemSignal_BCAN_BDC_FD_05_200ms_Lamp_IntTailLmpOnReq}
        sender-receiver-to-signal-mapping={communication-direction=IN, data-element=App_CAN_RX.RootSwCompositionPrototype.BCAN_PDC_FD_03_200ms.Warn_AsstDrSwSta, system-signal=SystemSignal_BCAN_PDC_FD_03_200ms_Warn_AsstDrSwSta}
        sender-receiver-to-signal-mapping={communication-direction=IN, data-element=App_CAN_RX.RootSwCompositionPrototype.BCAN_IAU_FD_04_200ms.IAU_DigitalKey2Opt, system-signal=SystemSignal_BCAN_IAU_FD_04_200ms_IAU_DigitalKey2Opt}
        sender-receiver-to-signal-mapping={communication-direction=IN, data-element=App_CAN_RX.RootSwCompositionPrototype.BCAN_HU_USM_01_00ms.CF_Gway_WPCNValueSet, system-signal=SystemSignal_BCAN_HU_USM_01_00ms_CF_Gway_WPCNValueSet}
        sender-receiver-to-signal-mapping={communication-direction=IN, data-element=App_CAN_RX.RootSwCompositionPrototype.BCAN_SBCM_RL_FD_01_200ms.Warn_RrLftDrSwSta_SBCM, system-signal=SystemSignal_BCAN_SBCM_RL_FD_01_200ms_Warn_RrLftDrSwSta_SBCM}
        sender-receiver-to-signal-mapping={communication-direction=IN, data-element=App_CAN_RX.RootSwCompositionPrototype.BCAN_PDC_FD_03_200ms.Warn_DrvDrSwSta, system-signal=SystemSignal_BCAN_PDC_FD_03_200ms_Warn_DrvDrSwSta}
        sender-receiver-to-signal-mapping={communication-direction=IN, data-element=App_CAN_RX.RootSwCompositionPrototype.BCAN_BDC_FD_02_200ms.BCM_SmkOptTyp, system-signal=SystemSignal_BCAN_BDC_FD_02_200ms_BCM_SmkOptTyp}
        sender-receiver-to-signal-mapping={communication-direction=IN, data-element=App_CAN_RX.RootSwCompositionPrototype.BCAN_PDC_FD_03_200ms.Warn_RrLftDrSwSta, system-signal=SystemSignal_BCAN_PDC_FD_03_200ms_Warn_RrLftDrSwSta}
        sender-receiver-to-signal-group-mapping={communication-direction=OUT, data-element=App_CAN_TX.RootSwCompositionPrototype.Gr_MsgGr_E2E_BCAN_WPC_FD_VCRM_01_00ms.MsgGr_E2E_BCAN_WPC_FD_VCRM_01_00ms, signal-group=MsgGr_E2E_BCAN_WPC_FD_VCRM_01_00ms, type-mapping=sender-rec-record-type-mapping=record-element-mappings=[{implementation-record-element=WPC_PhnUsingTime, system-signal=SystemSignal_BCAN_WPC_FD_VCRM_01_00ms_WPC_PhnUsingTime}, {implementation-record-element=WPC_PhnChargingCompleteCnt, system-signal=SystemSignal_BCAN_WPC_FD_VCRM_01_00ms_WPC_PhnChargingCompleteCnt}, {implementation-record-element=WPC_EPPChargingCnt, system-signal=SystemSignal_BCAN_WPC_FD_VCRM_01_00ms_WPC_EPPChargingCnt}, {implementation-record-element=WPC_MPPChargingCnt, system-signal=SystemSignal_BCAN_WPC_FD_VCRM_01_00ms_WPC_MPPChargingCnt}, {implementation-record-element=WPC_DigitalKeyAuth, system-signal=SystemSignal_BCAN_WPC_FD_VCRM_01_00ms_WPC_DigitalKeyAuth}, {implementation-record-element=WPC_DigitalKeyDevice, system-signal=SystemSignal_BCAN_WPC_FD_VCRM_01_00ms_WPC_DigitalKeyDevice}, {implementation-record-element=WPC_PhnChargingErrCnt, system-signal=SystemSignal_BCAN_WPC_FD_VCRM_01_00ms_WPC_PhnChargingErrCnt}, {implementation-record-element=WPC_ThermalSnsrMaxTemp, system-signal=SystemSignal_BCAN_WPC_FD_VCRM_01_00ms_WPC_ThermalSnsrMaxTemp}, {implementation-record-element=WPC_CANBusOffDTC, system-signal=SystemSignal_BCAN_WPC_FD_VCRM_01_00ms_WPC_CANBusOffDTC}, {implementation-record-element=WPC_LocalCANBusOffDTC, system-signal=SystemSignal_BCAN_WPC_FD_VCRM_01_00ms_WPC_LocalCANBusOffDTC}, {implementation-record-element=WPC_TempSnsrFltDTC, system-signal=SystemSignal_BCAN_WPC_FD_VCRM_01_00ms_WPC_TempSnsrFltDTC}, {implementation-record-element=WPC_FANFltDTC, system-signal=SystemSignal_BCAN_WPC_FD_VCRM_01_00ms_WPC_FANFltDTC}, {implementation-record-element=WPC_InternalECUErrDTC, system-signal=SystemSignal_BCAN_WPC_FD_VCRM_01_00ms_WPC_InternalECUErrDTC}, {implementation-record-element=WPC_FD_VCRM_01_00ms_E2EReserved, system-signal=SystemSignal_BCAN_WPC_FD_VCRM_01_00ms_WPC_FD_VCRM_01_00ms_E2EReserved}]}
        sender-receiver-to-signal-group-mapping={communication-direction=OUT, data-element=App_CAN_TX.RootSwCompositionPrototype.Gr_MsgGr_E2E_BCAN_WPC_FD_01_200ms.MsgGr_E2E_BCAN_WPC_FD_01_200ms, signal-group=MsgGr_E2E_BCAN_WPC_FD_01_200ms, type-mapping=sender-rec-record-type-mapping=record-element-mappings=[{implementation-record-element=USM_CmdWPCSta, system-signal=SystemSignal_BCAN_WPC_FD_01_200ms_USM_CmdWPCSta}, {implementation-record-element=WPC_PhnLftWrngSta, system-signal=SystemSignal_BCAN_WPC_FD_01_200ms_WPC_PhnLftWrngSta}, {implementation-record-element=WPC_DualWPCOptSta, system-signal=SystemSignal_BCAN_WPC_FD_01_200ms_WPC_DualWPCOptSta}, {implementation-record-element=WPC_SWVerMajor1, system-signal=SystemSignal_BCAN_WPC_FD_01_200ms_WPC_SWVerMajor1}, {implementation-record-element=WPC_SWVerMinor1, system-signal=SystemSignal_BCAN_WPC_FD_01_200ms_WPC_SWVerMinor1}, {implementation-record-element=WPC_SWVerMinor2, system-signal=SystemSignal_BCAN_WPC_FD_01_200ms_WPC_SWVerMinor2}, {implementation-record-element=WPC_IndSyncVal, system-signal=SystemSignal_BCAN_WPC_FD_01_200ms_WPC_IndSyncVal}, {implementation-record-element=USM_CmdWPCIndSta, system-signal=SystemSignal_BCAN_WPC_FD_01_200ms_USM_CmdWPCIndSta}, {implementation-record-element=WPC_ResetOpSta, system-signal=SystemSignal_BCAN_WPC_FD_01_200ms_WPC_ResetOpSta}, {implementation-record-element=WPC_FD_01_200ms_E2EReserved, system-signal=SystemSignal_BCAN_WPC_FD_01_200ms_WPC_FD_01_200ms_E2EReserved}]}
        sender-receiver-to-signal-group-mapping={communication-direction=OUT, data-element=App_CAN_TX.RootSwCompositionPrototype.Gr_MsgGr_E2E_BCAN_WPC2_FD_01_200ms.MsgGr_E2E_BCAN_WPC2_FD_01_200ms, signal-group=MsgGr_E2E_BCAN_WPC2_FD_01_200ms, type-mapping=sender-rec-record-type-mapping=record-element-mappings=[{implementation-record-element=USM_CmdWPC2Sta, system-signal=SystemSignal_BCAN_WPC2_FD_01_200ms_USM_CmdWPC2Sta}, {implementation-record-element=WPC2_PhnLftWrngSta, system-signal=SystemSignal_BCAN_WPC2_FD_01_200ms_WPC2_PhnLftWrngSta}, {implementation-record-element=WPC2_OptSta, system-signal=SystemSignal_BCAN_WPC2_FD_01_200ms_WPC2_OptSta}, {implementation-record-element=WPC2_SWVerMajor1, system-signal=SystemSignal_BCAN_WPC2_FD_01_200ms_WPC2_SWVerMajor1}, {implementation-record-element=WPC2_SWVerMinor1, system-signal=SystemSignal_BCAN_WPC2_FD_01_200ms_WPC2_SWVerMinor1}, {implementation-record-element=WPC2_SWVerMinor2, system-signal=SystemSignal_BCAN_WPC2_FD_01_200ms_WPC2_SWVerMinor2}, {implementation-record-element=WPC2_IndSyncVal, system-signal=SystemSignal_BCAN_WPC2_FD_01_200ms_WPC2_IndSyncVal}, {implementation-record-element=WPC2_ResetOpSta, system-signal=SystemSignal_BCAN_WPC2_FD_01_200ms_WPC2_ResetOpSta}, {implementation-record-element=WPC2_FD_01_200ms_E2EReserved, system-signal=SystemSignal_BCAN_WPC2_FD_01_200ms_WPC2_FD_01_200ms_E2EReserved}]}
        sender-receiver-to-signal-mapping={communication-direction=OUT, data-element=App_CAN_TX.RootSwCompositionPrototype.BCAN_WPCmsgDvp1.WPCmsgDvp1DataByte32, system-signal=SystemSignal_BCAN_WPCmsgDvp1_WPCmsgDvp1DataByte32}
        sender-receiver-to-signal-mapping={communication-direction=OUT, data-element=App_CAN_TX.RootSwCompositionPrototype.BCAN_WPCmsgDvp1.WPCmsgDvp1DataByte31, system-signal=SystemSignal_BCAN_WPCmsgDvp1_WPCmsgDvp1DataByte31}
        sender-receiver-to-signal-mapping={communication-direction=OUT, data-element=App_CAN_TX.RootSwCompositionPrototype.BCAN_WPCmsgDvp1.WPCmsgDvp1DataByte30, system-signal=SystemSignal_BCAN_WPCmsgDvp1_WPCmsgDvp1DataByte30}
        sender-receiver-to-signal-mapping={communication-direction=OUT, data-element=App_CAN_TX.RootSwCompositionPrototype.BCAN_WPCmsgDvp1.WPCmsgDvp1DataByte39, system-signal=SystemSignal_BCAN_WPCmsgDvp1_WPCmsgDvp1DataByte39}
        sender-receiver-to-signal-mapping={communication-direction=OUT, data-element=App_CAN_TX.RootSwCompositionPrototype.BCAN_WPCmsgDvp1.WPCmsgDvp1DataByte38, system-signal=SystemSignal_BCAN_WPCmsgDvp1_WPCmsgDvp1DataByte38}
        sender-receiver-to-signal-mapping={communication-direction=OUT, data-element=App_CAN_TX.RootSwCompositionPrototype.BCAN_WPCmsgDvp1.WPCmsgDvp1DataByte37, system-signal=SystemSignal_BCAN_WPCmsgDvp1_WPCmsgDvp1DataByte37}
        sender-receiver-to-signal-mapping={communication-direction=OUT, data-element=App_CAN_TX.RootSwCompositionPrototype.BCAN_WPCmsgDvp1.WPCmsgDvp1DataByte36, system-signal=SystemSignal_BCAN_WPCmsgDvp1_WPCmsgDvp1DataByte36}
        sender-receiver-to-signal-mapping={communication-direction=OUT, data-element=App_CAN_TX.RootSwCompositionPrototype.BCAN_WPCmsgDvp1.WPCmsgDvp1DataByte35, system-signal=SystemSignal_BCAN_WPCmsgDvp1_WPCmsgDvp1DataByte35}
        sender-receiver-to-signal-mapping={communication-direction=OUT, data-element=App_CAN_TX.RootSwCompositionPrototype.BCAN_WPCmsgDvp1.WPCmsgDvp1DataByte34, system-signal=SystemSignal_BCAN_WPCmsgDvp1_WPCmsgDvp1DataByte34}
        sender-receiver-to-signal-mapping={communication-direction=OUT, data-element=App_CAN_TX.RootSwCompositionPrototype.BCAN_WPCmsgDvp1.WPCmsgDvp1DataByte33, system-signal=SystemSignal_BCAN_WPCmsgDvp1_WPCmsgDvp1DataByte33}
        sender-receiver-to-signal-mapping={communication-direction=OUT, data-element=App_CAN_TX.RootSwCompositionPrototype.BCAN_WPCmsgDvp1.WPCmsgDvp1DataByte43, system-signal=SystemSignal_BCAN_WPCmsgDvp1_WPCmsgDvp1DataByte43}
        sender-receiver-to-signal-mapping={communication-direction=OUT, data-element=App_CAN_TX.RootSwCompositionPrototype.BCAN_WPCmsgDvp1.WPCmsgDvp1DataByte42, system-signal=SystemSignal_BCAN_WPCmsgDvp1_WPCmsgDvp1DataByte42}
        sender-receiver-to-signal-mapping={communication-direction=OUT, data-element=App_CAN_TX.RootSwCompositionPrototype.BCAN_WPCmsgDvp1.WPCmsgDvp1DataByte41, system-signal=SystemSignal_BCAN_WPCmsgDvp1_WPCmsgDvp1DataByte41}
        sender-receiver-to-signal-mapping={communication-direction=OUT, data-element=App_CAN_TX.RootSwCompositionPrototype.BCAN_WPCmsgDvp1.WPCmsgDvp1DataByte40, system-signal=SystemSignal_BCAN_WPCmsgDvp1_WPCmsgDvp1DataByte40}
        sender-receiver-to-signal-mapping={communication-direction=OUT, data-element=App_CAN_TX.RootSwCompositionPrototype.BCAN_WPCmsgDvp1.WPCmsgDvp1DataByte49, system-signal=SystemSignal_BCAN_WPCmsgDvp1_WPCmsgDvp1DataByte49}
        sender-receiver-to-signal-mapping={communication-direction=OUT, data-element=App_CAN_TX.RootSwCompositionPrototype.BCAN_WPCmsgDvp1.WPCmsgDvp1DataByte48, system-signal=SystemSignal_BCAN_WPCmsgDvp1_WPCmsgDvp1DataByte48}
        sender-receiver-to-signal-mapping={communication-direction=OUT, data-element=App_CAN_TX.RootSwCompositionPrototype.BCAN_WPCmsgDvp1.WPCmsgDvp1DataByte47, system-signal=SystemSignal_BCAN_WPCmsgDvp1_WPCmsgDvp1DataByte47}
        sender-receiver-to-signal-mapping={communication-direction=OUT, data-element=App_CAN_TX.RootSwCompositionPrototype.BCAN_WPCmsgDvp1.WPCmsgDvp1DataByte46, system-signal=SystemSignal_BCAN_WPCmsgDvp1_WPCmsgDvp1DataByte46}
        sender-receiver-to-signal-mapping={communication-direction=OUT, data-element=App_CAN_TX.RootSwCompositionPrototype.BCAN_WPCmsgDvp1.WPCmsgDvp1DataByte45, system-signal=SystemSignal_BCAN_WPCmsgDvp1_WPCmsgDvp1DataByte45}
        sender-receiver-to-signal-mapping={communication-direction=OUT, data-element=App_CAN_TX.RootSwCompositionPrototype.BCAN_WPCmsgDvp1.WPCmsgDvp1DataByte44, system-signal=SystemSignal_BCAN_WPCmsgDvp1_WPCmsgDvp1DataByte44}
        sender-receiver-to-signal-mapping={communication-direction=OUT, data-element=App_CAN_TX.RootSwCompositionPrototype.BCAN_WPCmsgDvp1.WPCmsgDvp1DataByte10, system-signal=SystemSignal_BCAN_WPCmsgDvp1_WPCmsgDvp1DataByte10}
        sender-receiver-to-signal-mapping={communication-direction=OUT, data-element=App_CAN_TX.RootSwCompositionPrototype.BCAN_WPCmsgDvp1.WPCmsgDvp1DataByte18, system-signal=SystemSignal_BCAN_WPCmsgDvp1_WPCmsgDvp1DataByte18}
        sender-receiver-to-signal-mapping={communication-direction=OUT, data-element=App_CAN_TX.RootSwCompositionPrototype.BCAN_WPCmsgDvp1.WPCmsgDvp1DataByte17, system-signal=SystemSignal_BCAN_WPCmsgDvp1_WPCmsgDvp1DataByte17}
        sender-receiver-to-signal-mapping={communication-direction=OUT, data-element=App_CAN_TX.RootSwCompositionPrototype.BCAN_WPCmsgDvp1.WPCmsgDvp1DataByte16, system-signal=SystemSignal_BCAN_WPCmsgDvp1_WPCmsgDvp1DataByte16}
        sender-receiver-to-signal-mapping={communication-direction=OUT, data-element=App_CAN_TX.RootSwCompositionPrototype.BCAN_WPCmsgDvp1.WPCmsgDvp1DataByte15, system-signal=SystemSignal_BCAN_WPCmsgDvp1_WPCmsgDvp1DataByte15}
        sender-receiver-to-signal-mapping={communication-direction=OUT, data-element=App_CAN_TX.RootSwCompositionPrototype.BCAN_WPCmsgDvp1.WPCmsgDvp1DataByte14, system-signal=SystemSignal_BCAN_WPCmsgDvp1_WPCmsgDvp1DataByte14}
        sender-receiver-to-signal-mapping={communication-direction=OUT, data-element=App_CAN_TX.RootSwCompositionPrototype.BCAN_WPCmsgDvp1.WPCmsgDvp1DataByte13, system-signal=SystemSignal_BCAN_WPCmsgDvp1_WPCmsgDvp1DataByte13}
        sender-receiver-to-signal-mapping={communication-direction=OUT, data-element=App_CAN_TX.RootSwCompositionPrototype.BCAN_WPCmsgDvp1.WPCmsgDvp1DataByte12, system-signal=SystemSignal_BCAN_WPCmsgDvp1_WPCmsgDvp1DataByte12}
        sender-receiver-to-signal-mapping={communication-direction=OUT, data-element=App_CAN_TX.RootSwCompositionPrototype.BCAN_WPCmsgDvp1.WPCmsgDvp1DataByte11, system-signal=SystemSignal_BCAN_WPCmsgDvp1_WPCmsgDvp1DataByte11}
        sender-receiver-to-signal-mapping={communication-direction=OUT, data-element=App_CAN_TX.RootSwCompositionPrototype.BCAN_WPCmsgDvp1.WPCmsgDvp1DataByte19, system-signal=SystemSignal_BCAN_WPCmsgDvp1_WPCmsgDvp1DataByte19}
        sender-receiver-to-signal-mapping={communication-direction=OUT, data-element=App_CAN_TX.RootSwCompositionPrototype.BCAN_WPCmsgDvp1.WPCmsgDvp1DataByte21, system-signal=SystemSignal_BCAN_WPCmsgDvp1_WPCmsgDvp1DataByte21}
        sender-receiver-to-signal-mapping={communication-direction=OUT, data-element=App_CAN_TX.RootSwCompositionPrototype.BCAN_WPCmsgDvp1.WPCmsgDvp1DataByte20, system-signal=SystemSignal_BCAN_WPCmsgDvp1_WPCmsgDvp1DataByte20}
        sender-receiver-to-signal-mapping={communication-direction=OUT, data-element=App_CAN_TX.RootSwCompositionPrototype.BCAN_WPCmsgDvp1.WPCmsgDvp1DataByte29, system-signal=SystemSignal_BCAN_WPCmsgDvp1_WPCmsgDvp1DataByte29}
        sender-receiver-to-signal-mapping={communication-direction=OUT, data-element=App_CAN_TX.RootSwCompositionPrototype.BCAN_WPCmsgDvp1.WPCmsgDvp1DataByte28, system-signal=SystemSignal_BCAN_WPCmsgDvp1_WPCmsgDvp1DataByte28}
        sender-receiver-to-signal-mapping={communication-direction=OUT, data-element=App_CAN_TX.RootSwCompositionPrototype.BCAN_WPCmsgDvp1.WPCmsgDvp1DataByte27, system-signal=SystemSignal_BCAN_WPCmsgDvp1_WPCmsgDvp1DataByte27}
        sender-receiver-to-signal-mapping={communication-direction=OUT, data-element=App_CAN_TX.RootSwCompositionPrototype.BCAN_WPCmsgDvp1.WPCmsgDvp1DataByte26, system-signal=SystemSignal_BCAN_WPCmsgDvp1_WPCmsgDvp1DataByte26}
        sender-receiver-to-signal-mapping={communication-direction=OUT, data-element=App_CAN_TX.RootSwCompositionPrototype.BCAN_WPCmsgDvp1.WPCmsgDvp1DataByte25, system-signal=SystemSignal_BCAN_WPCmsgDvp1_WPCmsgDvp1DataByte25}
        sender-receiver-to-signal-mapping={communication-direction=OUT, data-element=App_CAN_TX.RootSwCompositionPrototype.BCAN_WPCmsgDvp1.WPCmsgDvp1DataByte24, system-signal=SystemSignal_BCAN_WPCmsgDvp1_WPCmsgDvp1DataByte24}
        sender-receiver-to-signal-mapping={communication-direction=OUT, data-element=App_CAN_TX.RootSwCompositionPrototype.BCAN_WPCmsgDvp1.WPCmsgDvp1DataByte23, system-signal=SystemSignal_BCAN_WPCmsgDvp1_WPCmsgDvp1DataByte23}
        sender-receiver-to-signal-mapping={communication-direction=OUT, data-element=App_CAN_TX.RootSwCompositionPrototype.BCAN_WPCmsgDvp1.WPCmsgDvp1DataByte22, system-signal=SystemSignal_BCAN_WPCmsgDvp1_WPCmsgDvp1DataByte22}
        sender-receiver-to-signal-mapping={communication-direction=OUT, data-element=App_CAN_TX.RootSwCompositionPrototype.BCAN_WPCmsgDvp1.WPCmsgDvp1DataByte07, system-signal=SystemSignal_BCAN_WPCmsgDvp1_WPCmsgDvp1DataByte07}
        sender-receiver-to-signal-mapping={communication-direction=OUT, data-element=App_CAN_TX.RootSwCompositionPrototype.BCAN_WPCmsgDvp1.WPCmsgDvp1DataByte06, system-signal=SystemSignal_BCAN_WPCmsgDvp1_WPCmsgDvp1DataByte06}
        sender-receiver-to-signal-mapping={communication-direction=OUT, data-element=App_CAN_TX.RootSwCompositionPrototype.BCAN_WPCmsgDvp1.WPCmsgDvp1DataByte05, system-signal=SystemSignal_BCAN_WPCmsgDvp1_WPCmsgDvp1DataByte05}
        sender-receiver-to-signal-mapping={communication-direction=OUT, data-element=App_CAN_TX.RootSwCompositionPrototype.BCAN_WPCmsgDvp1.WPCmsgDvp1DataByte04, system-signal=SystemSignal_BCAN_WPCmsgDvp1_WPCmsgDvp1DataByte04}
        sender-receiver-to-signal-mapping={communication-direction=OUT, data-element=App_CAN_TX.RootSwCompositionPrototype.BCAN_WPCmsgDvp1.WPCmsgDvp1DataByte03, system-signal=SystemSignal_BCAN_WPCmsgDvp1_WPCmsgDvp1DataByte03}
        sender-receiver-to-signal-mapping={communication-direction=OUT, data-element=App_CAN_TX.RootSwCompositionPrototype.BCAN_WPCmsgDvp1.WPCmsgDvp1DataByte02, system-signal=SystemSignal_BCAN_WPCmsgDvp1_WPCmsgDvp1DataByte02}
        sender-receiver-to-signal-mapping={communication-direction=OUT, data-element=App_CAN_TX.RootSwCompositionPrototype.BCAN_WPCmsgDvp1.WPCmsgDvp1DataByte01, system-signal=SystemSignal_BCAN_WPCmsgDvp1_WPCmsgDvp1DataByte01}
        sender-receiver-to-signal-mapping={communication-direction=OUT, data-element=App_CAN_TX.RootSwCompositionPrototype.BCAN_WPCmsgDvp1.WPCmsgDvp1DataByte00, system-signal=SystemSignal_BCAN_WPCmsgDvp1_WPCmsgDvp1DataByte00}
        sender-receiver-to-signal-mapping={communication-direction=OUT, data-element=App_CAN_TX.RootSwCompositionPrototype.BCAN_WPCmsgDvp1.WPCmsgDvp1DataByte09, system-signal=SystemSignal_BCAN_WPCmsgDvp1_WPCmsgDvp1DataByte09}
        sender-receiver-to-signal-mapping={communication-direction=OUT, data-element=App_CAN_TX.RootSwCompositionPrototype.BCAN_WPCmsgDvp1.WPCmsgDvp1DataByte08, system-signal=SystemSignal_BCAN_WPCmsgDvp1_WPCmsgDvp1DataByte08}
        sender-receiver-to-signal-mapping={communication-direction=OUT, data-element=App_CAN_TX.RootSwCompositionPrototype.BCAN_WPCmsgDvp1.WPCmsgDvp1DataByte54, system-signal=SystemSignal_BCAN_WPCmsgDvp1_WPCmsgDvp1DataByte54}
        sender-receiver-to-signal-mapping={communication-direction=OUT, data-element=App_CAN_TX.RootSwCompositionPrototype.BCAN_WPCmsgDvp1.WPCmsgDvp1DataByte53, system-signal=SystemSignal_BCAN_WPCmsgDvp1_WPCmsgDvp1DataByte53}
        sender-receiver-to-signal-mapping={communication-direction=OUT, data-element=App_CAN_TX.RootSwCompositionPrototype.BCAN_WPCmsgDvp1.WPCmsgDvp1DataByte52, system-signal=SystemSignal_BCAN_WPCmsgDvp1_WPCmsgDvp1DataByte52}
        sender-receiver-to-signal-mapping={communication-direction=OUT, data-element=App_CAN_TX.RootSwCompositionPrototype.BCAN_WPCmsgDvp1.WPCmsgDvp1DataByte51, system-signal=SystemSignal_BCAN_WPCmsgDvp1_WPCmsgDvp1DataByte51}
        sender-receiver-to-signal-mapping={communication-direction=OUT, data-element=App_CAN_TX.RootSwCompositionPrototype.BCAN_WPCmsgDvp1.WPCmsgDvp1DataByte50, system-signal=SystemSignal_BCAN_WPCmsgDvp1_WPCmsgDvp1DataByte50}
        sender-receiver-to-signal-mapping={communication-direction=OUT, data-element=App_CAN_TX.RootSwCompositionPrototype.BCAN_WPCmsgDvp1.WPCmsgDvp1DataByte59, system-signal=SystemSignal_BCAN_WPCmsgDvp1_WPCmsgDvp1DataByte59}
        sender-receiver-to-signal-mapping={communication-direction=OUT, data-element=App_CAN_TX.RootSwCompositionPrototype.BCAN_WPCmsgDvp1.WPCmsgDvp1DataByte58, system-signal=SystemSignal_BCAN_WPCmsgDvp1_WPCmsgDvp1DataByte58}
        sender-receiver-to-signal-mapping={communication-direction=OUT, data-element=App_CAN_TX.RootSwCompositionPrototype.BCAN_WPCmsgDvp1.WPCmsgDvp1DataByte57, system-signal=SystemSignal_BCAN_WPCmsgDvp1_WPCmsgDvp1DataByte57}
        sender-receiver-to-signal-mapping={communication-direction=OUT, data-element=App_CAN_TX.RootSwCompositionPrototype.BCAN_WPCmsgDvp1.WPCmsgDvp1DataByte56, system-signal=SystemSignal_BCAN_WPCmsgDvp1_WPCmsgDvp1DataByte56}
        sender-receiver-to-signal-mapping={communication-direction=OUT, data-element=App_CAN_TX.RootSwCompositionPrototype.BCAN_WPCmsgDvp1.WPCmsgDvp1DataByte55, system-signal=SystemSignal_BCAN_WPCmsgDvp1_WPCmsgDvp1DataByte55}
        sender-receiver-to-signal-mapping={communication-direction=OUT, data-element=App_CAN_TX.RootSwCompositionPrototype.BCAN_WPCmsgDvp1.WPCmsgDvp1DataByte63, system-signal=SystemSignal_BCAN_WPCmsgDvp1_WPCmsgDvp1DataByte63}
        sender-receiver-to-signal-mapping={communication-direction=OUT, data-element=App_CAN_TX.RootSwCompositionPrototype.BCAN_WPCmsgDvp1.WPCmsgDvp1DataByte62, system-signal=SystemSignal_BCAN_WPCmsgDvp1_WPCmsgDvp1DataByte62}
        sender-receiver-to-signal-mapping={communication-direction=OUT, data-element=App_CAN_TX.RootSwCompositionPrototype.BCAN_WPCmsgDvp1.WPCmsgDvp1DataByte61, system-signal=SystemSignal_BCAN_WPCmsgDvp1_WPCmsgDvp1DataByte61}
        sender-receiver-to-signal-mapping={communication-direction=OUT, data-element=App_CAN_TX.RootSwCompositionPrototype.BCAN_WPCmsgDvp1.WPCmsgDvp1DataByte60, system-signal=SystemSignal_BCAN_WPCmsgDvp1_WPCmsgDvp1DataByte60}
        sender-receiver-to-signal-mapping={communication-direction=IN, data-element=App_CAN_RX.RootSwCompositionPrototype.LCAN_L_BDC_FD_IAU_01_00ms.WPC2_NFC_Deselect_Cmd, system-signal=SystemSignal_LCAN_L_BDC_FD_IAU_01_00ms_WPC2_NFC_Deselect_Cmd}
        sender-receiver-to-signal-mapping={communication-direction=IN, data-element=App_CAN_RX.RootSwCompositionPrototype.LCAN_IAU_FD_04_200ms.IAU_DKOwnerSwapOption, system-signal=SystemSignal_LCAN_IAU_FD_04_200ms_IAU_DKOwnerSwapOption}
        sender-receiver-to-signal-mapping={communication-direction=IN, data-element=App_CAN_RX.RootSwCompositionPrototype.LCAN_L_BDC_FD_IAU_10_200ms.BDC_TP_CAN_Sta, system-signal=SystemSignal_LCAN_L_BDC_FD_IAU_10_200ms_BDC_TP_CAN_Sta}
        sender-receiver-to-signal-mapping={communication-direction=IN, data-element=App_CAN_RX.RootSwCompositionPrototype.LCAN_L_BDC_FD_IAU_01_00ms.WPC_NFC_Deselect_Cmd, system-signal=SystemSignal_LCAN_L_BDC_FD_IAU_01_00ms_WPC_NFC_Deselect_Cmd}
        sender-receiver-to-signal-mapping={communication-direction=IN, data-element=App_CAN_RX.RootSwCompositionPrototype.LCAN_L_BDC_FD_IAU_10_200ms.OPAdv_On_Cmd, system-signal=SystemSignal_LCAN_L_BDC_FD_IAU_10_200ms_OPAdv_On_Cmd}
        sender-receiver-to-signal-mapping={communication-direction=IN, data-element=App_CAN_RX.RootSwCompositionPrototype.LCAN_IAU_FD_04_200ms.IAU_OwnerPhnRegRVal, system-signal=SystemSignal_LCAN_IAU_FD_04_200ms_IAU_OwnerPhnRegRVal}
        sender-receiver-to-signal-mapping={communication-direction=IN, data-element=App_CAN_RX.RootSwCompositionPrototype.LCAN_L_BDC_FD_IAU_10_200ms.WPC_Device_On_Cmd, system-signal=SystemSignal_LCAN_L_BDC_FD_IAU_10_200ms_WPC_Device_On_Cmd}
        sender-receiver-to-signal-mapping={communication-direction=IN, data-element=App_CAN_RX.RootSwCompositionPrototype.LCAN_IAU_FD_05_200ms.IAU_SharedPhnRegStat, system-signal=SystemSignal_LCAN_IAU_FD_05_200ms_IAU_SharedPhnRegStat}
        sender-receiver-to-signal-mapping={communication-direction=IN, data-element=App_CAN_RX.RootSwCompositionPrototype.LCAN_CCU_01_00ms.CCU_ForcedPowerOffReq, system-signal=SystemSignal_LCAN_CCU_01_00ms_CCU_ForcedPowerOffReq}
        sender-receiver-to-signal-group-mapping={communication-direction=OUT, data-element=App_CAN_TX.RootSwCompositionPrototype.Gr_MsgGr_E2E_LCAN_L_WPC_FD_01_00ms.MsgGr_E2E_LCAN_L_WPC_FD_01_00ms, signal-group=MsgGr_E2E_LCAN_L_WPC_FD_01_00ms, type-mapping=sender-rec-record-type-mapping=record-element-mappings=[{implementation-record-element=WPC_NFCDetection_Sta, system-signal=SystemSignal_LCAN_L_WPC_FD_01_00ms_WPC_NFCDetection_Sta}, {implementation-record-element=WPC_NFCReset_Sta, system-signal=SystemSignal_LCAN_L_WPC_FD_01_00ms_WPC_NFCReset_Sta}, {implementation-record-element=WPC2_NFCDetection_Sta, system-signal=SystemSignal_LCAN_L_WPC_FD_01_00ms_WPC2_NFCDetection_Sta}, {implementation-record-element=WPC2_NFCReset_Sta, system-signal=SystemSignal_LCAN_L_WPC_FD_01_00ms_WPC2_NFCReset_Sta}, {implementation-record-element=L_WPC_FD_01_00ms_E2EReserved, system-signal=SystemSignal_LCAN_L_WPC_FD_01_00ms_L_WPC_FD_01_00ms_E2EReserved}]}
        sender-receiver-to-signal-group-mapping={communication-direction=OUT, data-element=App_CAN_TX.RootSwCompositionPrototype.Gr_MsgGr_E2E_LCAN_L_WPC_FD_20_200ms.MsgGr_E2E_LCAN_L_WPC_FD_20_200ms, signal-group=MsgGr_E2E_LCAN_L_WPC_FD_20_200ms, type-mapping=sender-rec-record-type-mapping=record-element-mappings=[{implementation-record-element=WPC_Status, system-signal=SystemSignal_LCAN_L_WPC_FD_20_200ms_WPC_Status}, {implementation-record-element=WPC2_Status, system-signal=SystemSignal_LCAN_L_WPC_FD_20_200ms_WPC2_Status}, {implementation-record-element=WPC_NFC_Opt, system-signal=SystemSignal_LCAN_L_WPC_FD_20_200ms_WPC_NFC_Opt}, {implementation-record-element=L_WPC_FD_20_200ms_E2EReserved, system-signal=SystemSignal_LCAN_L_WPC_FD_20_200ms_L_WPC_FD_20_200ms_E2EReserved}]}
        sender-receiver-to-signal-mapping={communication-direction=IN, data-element=App_NFC.RootSwCompositionPrototype.LCAN_L_TP_BDC_FD_L_WPC_FD.LCAN_L_TP_BDC_FD_L_WPC_FD_signal, system-signal=SystemSignal_LCAN_L_TP_BDC_FD_L_WPC_FD_LCAN_L_TP_BDC_FD_L_WPC_FD_signal}
        sender-receiver-to-signal-mapping={communication-direction=OUT, data-element=App_NFC.RootSwCompositionPrototype.LCAN_L_TP_L_WPC_FD_BDC_FD.LCAN_L_TP_L_WPC_FD_BDC_FD_signal, system-signal=SystemSignal_LCAN_L_TP_L_WPC_FD_BDC_FD_LCAN_L_TP_L_WPC_FD_BDC_FD_signal}
        sender-receiver-to-signal-mapping={communication-direction=IN, data-element=App_CAN_RX.RootSwCompositionPrototype.BCAN_VCU_01_10ms.VCU_GearPosSta, system-signal=SystemSignal_BCAN_VCU_01_10ms_VCU_GearPosSta}
        sender-receiver-to-signal-group-mapping={communication-direction=OUT, data-element=App_CAN_TX.RootSwCompositionPrototype.Gr_MsgGr_E2E_BCAN_WPC_WU_01_500ms.MsgGr_E2E_BCAN_WPC_WU_01_500ms, signal-group=MsgGr_E2E_BCAN_WPC_WU_01_500ms, type-mapping=sender-rec-record-type-mapping=record-element-mappings=[{implementation-record-element=WPC_WU_NM_B2, system-signal=SystemSignal_BCAN_WPC_WU_01_500ms_WPC_WU_NM_B2}, {implementation-record-element=WPC_WU_NM_BDCLocal, system-signal=SystemSignal_BCAN_WPC_WU_01_500ms_WPC_WU_NM_BDCLocal}, {implementation-record-element=WPC_WU_PWR_ACC, system-signal=SystemSignal_BCAN_WPC_WU_01_500ms_WPC_WU_PWR_ACC}, {implementation-record-element=WPC_WU_PWR_IGN1, system-signal=SystemSignal_BCAN_WPC_WU_01_500ms_WPC_WU_PWR_IGN1}, {implementation-record-element=WPC_WU_R_DrvDoorSw, system-signal=SystemSignal_BCAN_WPC_WU_01_500ms_WPC_WU_R_DrvDoorSw}, {implementation-record-element=WPC_WU_R_B1CAN, system-signal=SystemSignal_BCAN_WPC_WU_01_500ms_WPC_WU_R_B1CAN}, {implementation-record-element=WPC_WU_R_BDCLocalCAN, system-signal=SystemSignal_BCAN_WPC_WU_01_500ms_WPC_WU_R_BDCLocalCAN}, {implementation-record-element=WPC_WU_R_Diag, system-signal=SystemSignal_BCAN_WPC_WU_01_500ms_WPC_WU_R_Diag}, {implementation-record-element=WPC_WU_R_IGNFallingTimer, system-signal=SystemSignal_BCAN_WPC_WU_01_500ms_WPC_WU_R_IGNFallingTimer}, {implementation-record-element=WPC_WU_01_500ms_E2EReserved, system-signal=SystemSignal_BCAN_WPC_WU_01_500ms_WPC_WU_01_500ms_E2EReserved}]}
        sender-receiver-to-signal-group-mapping={communication-direction=IN, data-element=App_CAN_RX.RootSwCompositionPrototype.Gr_MsgGr_E2E_BCAN_PDC_FD_15_300ms.MsgGr_E2E_BCAN_PDC_FD_15_300ms, signal-group=MsgGr_E2E_BCAN_PDC_FD_15_300ms, type-mapping=sender-rec-record-type-mapping=record-element-mappings=[{implementation-record-element=PDC_ResetPreWrngForOthers, system-signal=SystemSignal_BCAN_PDC_FD_15_300ms_PDC_ResetPreWrngForOthers}, {implementation-record-element=PDC_ResetReqForOthers, system-signal=SystemSignal_BCAN_PDC_FD_15_300ms_PDC_ResetReqForOthers}, {implementation-record-element=PDC_ResetFuncOpt, system-signal=SystemSignal_BCAN_PDC_FD_15_300ms_PDC_ResetFuncOpt}, {implementation-record-element=PDC_FD_15_300ms_E2EReserved, system-signal=SystemSignal_BCAN_PDC_FD_15_300ms_PDC_FD_15_300ms_E2EReserved}]}
    system mapping SwMappings
      sw-mappings:
        swc to ecu mapping SwMapping0: ecu-instance=WPC
          component:
            RootSwCompositionPrototype.App_ADC
            RootSwCompositionPrototype.App_CAN_RX
            RootSwCompositionPrototype.App_CAN_TX
            RootSwCompositionPrototype.App_DTC
            RootSwCompositionPrototype.App_Diag
            RootSwCompositionPrototype.App_Model
            RootSwCompositionPrototype.App_NFC
            RootSwCompositionPrototype.App_NvM
            RootSwCompositionPrototype.App_PWM
            RootSwCompositionPrototype.App_Repro
            RootSwCompositionPrototype.App_Secure
            RootSwCompositionPrototype.App_UART
            RootSwCompositionPrototype.App_Uds
            RootSwCompositionPrototype.App_WCT
            RootSwCompositionPrototype.App_WDT
            RootSwCompositionPrototype.SWC_AppMode
            RootSwCompositionPrototype.SWC_DiagnosticService
            RootSwCompositionPrototype.SWC_WdgMTest
            RootSwCompositionPrototype.CDD_Router_SwComponentType
            RootSwCompositionPrototype.IoHwAb
            RootSwCompositionPrototype.BswM
            RootSwCompositionPrototype.CanTp
            RootSwCompositionPrototype.ComM
            RootSwCompositionPrototype.Csm
            RootSwCompositionPrototype.CtrlRam
            RootSwCompositionPrototype.Dcm
            RootSwCompositionPrototype.Dem
            RootSwCompositionPrototype.Det
            RootSwCompositionPrototype.EcuM
            RootSwCompositionPrototype.Fota
            RootSwCompositionPrototype.KeyM
            RootSwCompositionPrototype.Nml
            RootSwCompositionPrototype.NvM
            RootSwCompositionPrototype.Os_Master
            RootSwCompositionPrototype.WdgM
    system mapping PncMappings
      pnc-mappings:
        pnc-group=[ISignalIPduGroupRx_WPC_LCAN_PNC32, ISignalIPduGroupTx_WPC_LCAN_PNC32, ISignalIPduGroupTx_WPC_BCAN_PNC32, ISignalIPduGroupRx_WPC_BCAN_PNC32], pnc-identifier=32
        pnc-group=[ISignalIPduGroupRx_WPC_LCAN_PNC159, ISignalIPduGroupTx_WPC_LCAN_PNC159], pnc-identifier=159
        pnc-group=[ISignalIPduGroupTx_WPC_BCAN_PNC141, ISignalIPduGroupRx_WPC_BCAN_PNC141], pnc-identifier=141
        pnc-group=[ISignalIPduGroupTx_WPC_BCAN_PNC153, ISignalIPduGroupRx_WPC_BCAN_PNC153], pnc-identifier=153
    root-software-compositions:
      root sw composition prototype RootSwCompositionPrototype: software-composition=EcuComposition
  ecu instance WPC: associated-com-i-pdu-group=[ISignalIPduGroupTx_WPC_LCAN_PNC32, ISignalIPduGroupRx_WPC_LCAN_PNC32, ISignalIPduGroupTx_WPC_LCAN_PNC159, ISignalIPduGroupRx_WPC_LCAN_PNC159, ISignalIPduGroupTx_WPC_BCAN_PNC32, ISignalIPduGroupRx_WPC_BCAN_PNC32, ISignalIPduGroupTx_WPC_BCAN_PNC141, ISignalIPduGroupRx_WPC_BCAN_PNC141, ISignalIPduGroupTx_WPC_BCAN_PNC153, ISignalIPduGroupRx_WPC_BCAN_PNC153]
    can communication controller WPC_LCAN
    can communication controller WPC_BCAN
    can communication connector Conn_WPC_LCAN: comm-controller=WPC_LCAN, pnc-wakeup-data-mask=18446744073709551615
    can communication connector Conn_WPC_BCAN: comm-controller=WPC_BCAN, pnc-wakeup-data-mask=18446744073709551615
  composition sw component type EcuComposition
    35 x component:
      App_ADC: type=App_ADC
      App_CAN_RX: type=App_CAN_RX
      App_CAN_TX: type=App_CAN_TX
      App_DTC: type=App_DTC
      App_Diag: type=App_Diag
      App_Model: type=App_Model
      App_NFC: type=App_NFC
      App_NvM: type=App_NvM
      App_PWM: type=App_PWM
      App_Repro: type=App_Repro
      App_Secure: type=App_Secure
      App_UART: type=App_UART
      App_Uds: type=App_Uds
      App_WCT: type=App_WCT
      App_WDT: type=App_WDT
      SWC_AppMode: type=SWC_AppMode
      SWC_DiagnosticService: type=SWC_DiagnosticService
      SWC_WdgMTest: type=SWC_WdgMTest
      CDD_Router_SwComponentType: type=CDD_Router_SwComponentType
      IoHwAb: type=IoHwAb
      BswM: type=BswM
      CanTp: type=CanTp
      ComM: type=ComM
      Csm: type=Csm
      CtrlRam: type=CtrlRam
      Dcm: type=Dcm
      Dem: type=Dem
      Det: type=Det
      EcuM: type=EcuM
      Fota: type=Fota
      KeyM: type=KeyM
      Nml: type=Nml
      NvM: type=NvM
      Os_Master: type=Os_Master
      WdgM: type=WdgM
    connect SWC_DiagnosticService.CallbackDCMRequestServices -> Dcm.CallbackDCMRequestServices_ECU1
    connect SWC_DiagnosticService.CallbackNotification_SignatureVerify -> Csm.SignatureVerify_RSASSA_PKCS1_v1_5_CallbackNotification
    connect Csm.CsmJob_RandomGenerate_L10 -> SWC_DiagnosticService.HaeHsmRandomGenerate_L10_RandomGenerate_L10
    connect Csm.CsmJob_RandomGenerate_L9 -> SWC_DiagnosticService.HaeHsmRandomGenerate_L9_CsmRandomGenerateConfig
    connect Csm.CsmJob_SignatureVerify_RSASSA_PKCS1_v1_5 -> SWC_DiagnosticService.CsmSignatureVerify_RSASSA_PKCS1_v1_5
    connect Csm.CsmKey_CryptoKey_OEUK -> SWC_DiagnosticService.CsmKeyManagement_CryptoKey_OEUK
    connect Dcm.DCMServices -> SWC_DiagnosticService.DCM_Services
    connect Dem.EventInfo_CANSM_E_BUS_OFF_BCAN -> App_DTC.R_EventInfo_CANSM_E_BUS_OFF_BCAN
    connect Dem.EventInfo_CANSM_E_BUS_OFF_LCAN -> App_DTC.R_EventInfo_CANSM_E_BUS_OFF_LCAN
    connect Dem.EventInfo_DemEventParameter_ECU_Internal_ERR -> App_DTC.R_EventInfo_DemEventParameter_ECU_Internal_ERR
    connect Dem.EventInfo_DemEventParameter_Fan_Fault -> App_DTC.R_EventInfo_DemEventParameter_Fan_Fault
    connect Dem.EventInfo_DemEventParameter_Temp_Snsr_Fault -> App_DTC.R_EventInfo_DemEventParameter_Temp_Snsr_Fault
    connect Dem.Event_DemEventParameter_ECU_Internal_ERR -> App_DTC.R_Event_DemEventParameter_ECU_Internal_ERR
    connect Dem.Event_DemEventParameter_Fan_Fault -> App_DTC.R_Event_DemEventParameter_Fan_Fault
    connect Dem.Event_DemEventParameter_Temp_Snsr_Fault -> App_DTC.R_Event_DemEventParameter_Temp_Snsr_Fault
    connect Dem.OpCycle_DemOperationCycle_IGN -> App_DTC.R_OpCycle_DemOperationCycle_IGN
    connect Dem.OpCycle_DemOperationCycle_PWR -> App_DTC.R_OpCycle_DemOperationCycle_PWR
    connect App_ADC.P_ADC -> App_CAN_RX.R_ADC
    connect App_ADC.P_ADC -> App_CAN_TX.R_ADC
    connect App_ADC.P_ADC -> App_DTC.R_ADC
    connect App_ADC.P_ADC -> App_Diag.R_ADC
    connect App_ADC.P_ADC -> App_Model.R_ADC
    connect App_ADC.P_ADC -> App_NFC.R_ADC
    connect App_ADC.P_ADC -> App_PWM.R_ADC
    connect App_ADC.P_ADC -> App_Repro.R_ADC
    connect App_ADC.P_ADC -> App_UART.R_ADC
    connect App_ADC.P_ADC -> App_Uds.R_ADC
    connect App_ADC.P_ADC -> App_WCT.R_ADC
    connect App_ADC.P_ADC -> App_WDT.R_ADC
    connect App_ADC.P_ADC -> SWC_AppMode.R_ADC
    connect IoHwAb.P_AmberIND1 -> App_PWM.R_AmberIND1
    connect IoHwAb.P_AmberIND2 -> App_PWM.R_AmberIND2
    connect App_CAN_RX.P_CAN_RX -> App_DTC.R_CAN_RX
    connect App_CAN_RX.P_CAN_RX -> App_Diag.R_CAN_RX
    connect App_CAN_RX.P_CAN_RX -> App_Model.R_CAN_RX
    connect App_CAN_RX.P_CAN_RX -> App_NFC.R_CAN_RX
    connect App_CAN_RX.P_CAN_RX -> App_NvM.R_CAN_RX
    connect App_CAN_RX.P_CAN_RX -> App_Uds.R_CAN_RX
    connect App_CAN_RX.P_CAN_RX -> App_WCT.R_CAN_RX
    connect App_CAN_RX.P_CAN_RX -> App_WDT.R_CAN_RX
    connect App_DTC.P_CBInitEvt_DemEventParameter_ECU_Internal_ERR -> Dem.CBInitEvt_DemEventParameter_ECU_Internal_ERR
    connect App_DTC.P_CBInitEvt_DemEventParameter_Fan_Fault -> Dem.CBInitEvt_DemEventParameter_Fan_Fault
    connect App_DTC.P_CBInitEvt_DemEventParameter_Temp_Snsr_Fault -> Dem.CBInitEvt_DemEventParameter_Temp_Snsr_Fault
    connect SWC_AppMode.P_CS_Mode -> App_ADC.R_CS_Mode
    connect SWC_AppMode.P_CS_Mode -> App_CAN_RX.R_CS_Mode
    connect SWC_AppMode.P_CS_Mode -> App_CAN_TX.R_CS_Mode
    connect SWC_AppMode.P_CS_Mode -> App_DTC.R_CS_Mode
    connect SWC_AppMode.P_CS_Mode -> App_Diag.R_CS_Mode
    connect SWC_AppMode.P_CS_Mode -> App_Model.R_CS_Mode
    connect SWC_AppMode.P_CS_Mode -> App_NFC.R_CS_Mode
    connect SWC_AppMode.P_CS_Mode -> App_NvM.R_CS_Mode
    connect SWC_AppMode.P_CS_Mode -> App_PWM.R_CS_Mode
    connect SWC_AppMode.P_CS_Mode -> App_Repro.R_CS_Mode
    connect SWC_AppMode.P_CS_Mode -> App_UART.R_CS_Mode
    connect SWC_AppMode.P_CS_Mode -> App_Uds.R_CS_Mode
    connect SWC_AppMode.P_CS_Mode -> App_WCT.R_CS_Mode
    connect SWC_AppMode.P_CS_Mode -> App_WDT.R_CS_Mode
    connect App_DTC.P_DTC -> App_CAN_TX.R_DTC
    connect App_DTC.P_DTC -> App_PWM.R_DTC
    connect App_DTC.P_DTC -> App_WCT.R_DTC
    connect App_Uds.P_Uds -> App_Diag.R_Uds
    connect App_Uds.P_Uds -> App_Model.R_Uds
    connect App_Uds.P_Uds -> App_NFC.R_Uds
    connect App_Uds.P_Uds -> App_Repro.R_Uds
    connect App_Uds.P_Uds -> App_UART.R_Uds
    connect App_Uds.P_Uds -> App_WCT.R_Uds
    connect App_Uds.P_Uds -> App_WDT.R_Uds
    connect App_Uds.P_Uds -> SWC_AppMode.R_Uds
    connect App_Diag.P_Diag -> App_PWM.R_Diag
    connect App_Diag.P_Diag -> App_WCT.R_Diag
    connect IoHwAb.P_FAN1_PULSE -> App_DTC.R_FAN1_PULSE
    connect IoHwAb.P_FAN2_PULSE -> App_DTC.R_FAN2_PULSE
    connect IoHwAb.P_FANPWM1 -> App_PWM.R_FANPWM1
    connect IoHwAb.P_FANPWM2 -> App_PWM.R_FANPWM2
    connect IoHwAb.P_GreenIND1 -> App_PWM.R_GreenIND1
    connect IoHwAb.P_GreenIND2 -> App_PWM.R_GreenIND2
    connect IoHwAb.P_IGN1_ADC -> App_ADC.R_IGN1_ADC
    connect SWC_AppMode.P_Mode -> App_CAN_RX.R_Mode
    connect SWC_AppMode.P_Mode -> App_CAN_TX.R_Mode
    connect SWC_AppMode.P_Mode -> App_Model.R_Mode
    connect SWC_AppMode.P_Mode -> App_NFC.R_Mode
    connect SWC_AppMode.P_Mode -> App_UART.R_Mode
    connect SWC_AppMode.P_Mode -> App_WCT.R_Mode
    connect App_Model.P_Model -> App_CAN_TX.R_Model
    connect App_Model.P_Model -> App_DTC.R_Model
    connect App_Model.P_Model -> App_NFC.R_Model
    connect App_Model.P_Model -> App_NvM.R_Model
    connect App_Model.P_Model -> App_PWM.R_Model
    connect App_Model.P_Model -> App_Repro.R_Model
    connect App_Model.P_Model -> App_UART.R_Model
    connect App_Model.P_Model -> App_Uds.R_Model
    connect App_Model.P_Model -> App_WCT.R_Model
    connect App_Model.P_Model -> SWC_AppMode.R_Model
    connect IoHwAb.P_NFC1_IRQ -> App_NFC.R_NFC1_IRQ
    connect IoHwAb.P_NFC1_WAKEUP -> App_NFC.R_NFC1_WAKEUP
    connect IoHwAb.P_NFC2_IRQ -> App_NFC.R_NFC2_IRQ
    connect IoHwAb.P_NFC2_WAKEUP -> App_NFC.R_NFC2_WAKEUP
    connect App_NFC.P_NFC -> App_CAN_TX.R_NFC
    connect App_NFC.P_NFC -> App_Model.R_NFC
    connect App_NFC.P_NFC -> App_NvM.R_NFC
    connect App_NFC.P_NFC -> App_Uds.R_NFC
    connect App_NFC.P_NFC -> App_WCT.R_NFC
    connect App_NFC.P_NFC -> SWC_AppMode.R_NFC
    connect App_NvM.P_NvM -> App_CAN_RX.R_NvM
    connect App_NvM.P_NvM -> App_CAN_TX.R_NvM
    connect App_NvM.P_NvM -> App_DTC.R_NvM
    connect App_NvM.P_NvM -> App_Model.R_NvM
    connect App_NvM.P_NvM -> App_NFC.R_NvM
    connect App_NvM.P_NvM -> App_PWM.R_NvM
    connect App_NvM.P_NvM -> App_Repro.R_NvM
    connect App_NvM.P_NvM -> App_UART.R_NvM
    connect App_NvM.P_NvM -> App_Uds.R_NvM
    connect App_NvM.P_NvM -> App_WCT.R_NvM
    connect App_NvM.P_NvM -> App_WDT.R_NvM
    connect App_NvM.P_NvM -> SWC_AppMode.R_NvM
    connect App_PWM.P_PWM -> App_Uds.R_PWM
    connect App_PWM.P_PWM -> App_WCT.R_PWM
    connect App_Repro.P_Repro -> App_CAN_TX.R_Repro
    connect App_Repro.P_Repro -> App_NvM.R_Repro
    connect App_Repro.P_Repro -> App_UART.R_Repro
    connect App_Repro.P_Repro -> App_Uds.R_Repro
    connect App_Repro.P_Repro -> App_WCT.R_Repro
    connect App_Repro.P_Repro -> SWC_AppMode.R_Repro
    connect App_UART.P_UART -> App_CAN_TX.R_UART
    connect App_UART.P_UART -> App_DTC.R_UART
    connect App_UART.P_UART -> App_Model.R_UART
    connect App_UART.P_UART -> App_PWM.R_UART
    connect App_UART.P_UART -> App_Repro.R_UART
    connect App_UART.P_UART -> App_Uds.R_UART
    connect App_UART.P_UART -> App_WCT.R_UART
    connect App_UART.P_UART -> SWC_AppMode.R_UART
    connect App_Uds.P_Uds -> App_CAN_TX.R_Uds
    connect App_Uds.P_Uds -> App_DTC.R_Uds
    connect App_Uds.P_Uds -> App_NvM.R_Uds
    connect App_Uds.P_Uds -> App_PWM.R_Uds
    connect IoHwAb.P_VBAT_ADC -> App_ADC.R_VBAT_ADC
    connect IoHwAb.P_VBAT_CTRL -> App_ADC.R_VBAT_CTRL
    connect IoHwAb.P_VBAT_SW_CTRL -> App_WCT.R_VBAT_SW_CTRL
    connect IoHwAb.P_VCC33_CTRL -> App_WCT.R_VCC33_CTRL
    connect App_WCT.P_WCT -> App_CAN_TX.R_WCT
    connect App_WCT.P_WCT -> App_Diag.R_WCT
    connect App_WCT.P_WCT -> App_Model.R_WCT
    connect App_WCT.P_WCT -> App_NFC.R_WCT
    connect App_WCT.P_WCT -> App_PWM.R_WCT
    connect App_WCT.P_WCT -> App_Repro.R_WCT
    connect App_WCT.P_WCT -> App_UART.R_WCT
    connect App_WCT.P_WCT -> App_Uds.R_WCT
    connect App_WCT.P_WCT -> SWC_AppMode.R_WCT
    connect App_WDT.P_WDT -> App_CAN_RX.R_WDT
    connect App_WDT.P_WDT -> App_CAN_TX.R_WDT
    connect App_WDT.P_WDT -> App_NvM.R_WDT
    connect App_WDT.P_WDT -> SWC_AppMode.R_WDT
    connect IoHwAb.P_WDT_CLEAR_PULSE -> App_WDT.R_WDT_CLEAR_PULSE
    connect IoHwAb.P_WDT_EN -> App_WDT.R_WDT_EN
    connect SWC_DiagnosticService.SecurityAccess_L10 -> Dcm.SecurityAccess_L10
    connect SWC_DiagnosticService.SecurityAccess_L9 -> Dcm.SecurityAccess_L9
    connect SWC_DiagnosticService.ServiceRequestSupplierNotification_DcmDslServiceRequestSupplierNotification0 -> Dcm.ServiceRequestSupplierNotification_DcmDslServiceRequestSupplierNotification0
    connect Dem.StorageCond_DemStorageCondition -> App_DTC.R_StorageCond_DemStorageCondition
    connect Fota.Swap_ServiceRequestNotification -> Dcm.ServiceRequestSupplierNotification_DcmDslServiceRequestSupplierNotification1
    connect App_Uds.TriggerInterface_BG -> App_Secure.TriggerInterface_BG
    connect WdgM.WdgM_API_P -> SWC_WdgMTest.WdgM_API_R
    connect WdgM.alive_SE_Init -> SWC_WdgMTest.SE_Init
    connect WdgM.alive_SE_WdgMTest -> SWC_WdgMTest.SE_WdgMTest
    connect WdgM.globalMode -> SWC_WdgMTest.globalMode
    connect SWC_AppMode.modeRequestPort_ComMMode_PNC141 -> BswM.modeRequestPort_ComMMode_PNC141
    connect SWC_AppMode.modeRequestPort_ComMMode_PNC153 -> BswM.modeRequestPort_ComMMode_PNC153
    connect SWC_AppMode.modeRequestPort_ComMMode_PNC159 -> BswM.modeRequestPort_ComMMode_PNC159
    connect SWC_AppMode.modeRequestPort_ComMMode_PNC32 -> BswM.modeRequestPort_ComMMode_PNC32
    connect BswM.modeSwitchPort_CanSMBORState_BCAN -> SWC_AppMode.modeNotificationPort_CanSMBORState_BCAN
    connect BswM.modeSwitchPort_CanSMBORState_LCAN -> SWC_AppMode.modeNotificationPort_CanSMBORState_LCAN
    connect BswM.modeSwitchPort_CanSMState_BCAN -> SWC_AppMode.modeNotificationPort_CanSMState_BCAN
    connect BswM.modeSwitchPort_CanSMState_LCAN -> SWC_AppMode.modeNotificationPort_CanSMState_LCAN
    connect BswM.modeSwitchPort_ComMMode_BCAN -> SWC_AppMode.modeNotificationPort_ComMMode_BCAN
    connect BswM.modeSwitchPort_ComMMode_LCAN -> SWC_AppMode.modeNotificationPort_ComMMode_LCAN
    connect BswM.modeSwitchPort_ComMMode_PNC141 -> SWC_AppMode.modeNotificationPort_ComMMode_PNC141
    connect BswM.modeSwitchPort_ComMMode_PNC153 -> SWC_AppMode.modeNotificationPort_ComMMode_PNC153
    connect BswM.modeSwitchPort_ComMMode_PNC159 -> SWC_AppMode.modeNotificationPort_ComMMode_PNC159
    connect BswM.modeSwitchPort_ComMMode_PNC32 -> SWC_AppMode.modeNotificationPort_ComMMode_PNC32
    connect BswM.modeSwitchPort_DcmApplicationUpdated -> SWC_DiagnosticService.modeNotificationPort_ApplicationUpdated
    connect BswM.modeSwitchPort_DcmCommunicationControl_0 -> SWC_DiagnosticService.DcmCommunicationControl_0
    connect BswM.modeSwitchPort_DcmDiagnosticSessionControl -> SWC_DiagnosticService.modeNotificationPort_SessionControl
    connect BswM.modeSwitchPort_EcuMode -> SWC_AppMode.modeNotificationPort_EcuMode
    connect BswM.modeSwitchPort_InitState -> SWC_AppMode.modeNotificationPort_InitState
    connect BswM.modeSwitchPort_PduGroupRx_BCAN_PNC141 -> SWC_AppMode.modeNotificationPort_PduGroupRx_BCAN_PNC141
    connect BswM.modeSwitchPort_PduGroupRx_BCAN_PNC153 -> SWC_AppMode.modeNotificationPort_PduGroupRx_BCAN_PNC153
    connect BswM.modeSwitchPort_PduGroupRx_BCAN_PNC32 -> SWC_AppMode.modeNotificationPort_PduGroupRx_BCAN_PNC32
    connect BswM.modeSwitchPort_PduGroupRx_LCAN_PNC159 -> SWC_AppMode.modeNotificationPort_PduGroupRx_LCAN_PNC159
    connect BswM.modeSwitchPort_PduGroupRx_LCAN_PNC32 -> SWC_AppMode.modeNotificationPort_PduGroupRx_LCAN_PNC32
    connect BswM.modeSwitchPort_PduGroupTx_BCAN_PNC141 -> SWC_AppMode.modeNotificationPort_PduGroupTx_BCAN_PNC141
    connect BswM.modeSwitchPort_PduGroupTx_BCAN_PNC153 -> SWC_AppMode.modeNotificationPort_PduGroupTx_BCAN_PNC153
    connect BswM.modeSwitchPort_PduGroupTx_BCAN_PNC32 -> SWC_AppMode.modeNotificationPort_PduGroupTx_BCAN_PNC32
    connect BswM.modeSwitchPort_PduGroupTx_LCAN_PNC159 -> SWC_AppMode.modeNotificationPort_PduGroupTx_LCAN_PNC159
    connect BswM.modeSwitchPort_PduGroupTx_LCAN_PNC32 -> SWC_AppMode.modeNotificationPort_PduGroupTx_LCAN_PNC32
    connect BswM.modeSwitchPort_WakeupEvent -> SWC_AppMode.modeNotificationPort_WakeupEvent
    connect EcuM.staterequest -> App_WDT.EcuM_StateRequest
    connect EcuM.staterequest -> Fota.Fota_StateRequest
    connect EcuM.staterequest -> SWC_AppMode.clientPort_StateRequest
