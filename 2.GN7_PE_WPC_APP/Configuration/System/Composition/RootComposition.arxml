AUTOSAR XML (schema 4-1-2)
package /AUTOSAR
  composition sw component type CSWC_RootComposition
    18 x component:
      SWC_WdgMTest: type=SWC_WdgMTest
      SWC_AppMode: type=SWC_AppMode
      SWC_DiagnosticService: type=SWC_DiagnosticService
      App_Diag: type=App_Diag
      App_Model: type=App_Model
      App_NFC: type=App_NFC
      App_Repro: type=App_Repro
      App_Secure: type=App_Secure
      App_UART: type=App_UART
      App_WCT: type=App_WCT
      App_WDT: type=App_WDT
      App_DTC: type=App_DTC
      App_Uds: type=App_Uds
      App_ADC: type=App_ADC
      App_CAN_RX: type=App_CAN_RX
      App_CAN_TX: type=App_CAN_TX
      App_NvM: type=App_NvM
      App_PWM: type=App_PWM
    connect App_Diag.P_Diag -> App_WCT.R_Diag
    connect App_Model.P_Model -> App_NFC.R_Model
    connect App_Model.P_Model -> App_Repro.R_Model
    connect App_Model.P_Model -> App_UART.R_Model
    connect App_Model.P_Model -> App_WCT.R_Model
    connect App_NFC.P_NFC -> App_Model.R_NFC
    connect App_NFC.P_NFC -> App_WCT.R_NFC
    connect App_Repro.P_Repro -> App_UART.R_Repro
    connect App_Repro.P_Repro -> App_WCT.R_Repro
    connect App_UART.P_UART -> App_Model.R_UART
    connect App_UART.P_UART -> App_Repro.R_UART
    connect App_UART.P_UART -> App_WCT.R_UART
    connect App_WCT.P_WCT -> App_Diag.R_WCT
    connect App_WCT.P_WCT -> App_Model.R_WCT
    connect App_WCT.P_WCT -> App_NFC.R_WCT
    connect App_WCT.P_WCT -> App_Repro.R_WCT
    connect App_WCT.P_WCT -> App_UART.R_WCT
    connect SWC_AppMode.P_CS_Mode -> App_Diag.R_CS_Mode
    connect SWC_AppMode.P_CS_Mode -> App_Model.R_CS_Mode
    connect SWC_AppMode.P_CS_Mode -> App_NFC.R_CS_Mode
    connect SWC_AppMode.P_CS_Mode -> App_Repro.R_CS_Mode
    connect SWC_AppMode.P_CS_Mode -> App_UART.R_CS_Mode
    connect SWC_AppMode.P_CS_Mode -> App_WCT.R_CS_Mode
    connect SWC_AppMode.P_CS_Mode -> App_WDT.R_CS_Mode
    connect SWC_AppMode.P_Mode -> App_Model.R_Mode
    connect SWC_AppMode.P_Mode -> App_NFC.R_Mode
    connect SWC_AppMode.P_Mode -> App_UART.R_Mode
    connect SWC_AppMode.P_Mode -> App_WCT.R_Mode
    connect App_Model.P_Model -> SWC_AppMode.R_Model
    connect App_NFC.P_NFC -> SWC_AppMode.R_NFC
    connect App_WCT.P_WCT -> SWC_AppMode.R_WCT
    connect SWC_AppMode.P_CS_Mode -> App_DTC.R_CS_Mode
    connect App_DTC.P_DTC -> App_WCT.R_DTC
    connect App_Model.P_Model -> App_DTC.R_Model
    connect App_UART.P_UART -> App_DTC.R_UART
    connect SWC_AppMode.P_CS_Mode -> App_Uds.R_CS_Mode
    connect App_Uds.P_Uds -> App_Diag.R_Uds
    connect App_Uds.P_Uds -> App_Model.R_Uds
    connect App_Uds.P_Uds -> App_NFC.R_Uds
    connect App_Uds.P_Uds -> App_Repro.R_Uds
    connect App_Uds.P_Uds -> App_UART.R_Uds
    connect App_Uds.P_Uds -> App_WCT.R_Uds
    connect App_Uds.P_Uds -> App_WDT.R_Uds
    connect App_Uds.P_Uds -> SWC_AppMode.R_Uds
    connect App_Model.P_Model -> App_Uds.R_Model
    connect App_NFC.P_NFC -> App_Uds.R_NFC
    connect App_Repro.P_Repro -> App_Uds.R_Repro
    connect App_UART.P_UART -> App_Uds.R_UART
    connect App_WCT.P_WCT -> App_Uds.R_WCT
    connect App_Uds.TriggerInterface_BG -> App_Secure.TriggerInterface_BG
    connect App_ADC.P_ADC -> App_CAN_RX.R_ADC
    connect App_ADC.P_ADC -> App_CAN_TX.R_ADC
    connect App_ADC.P_ADC -> App_DTC.R_ADC
    connect App_ADC.P_ADC -> App_Diag.R_ADC
    connect App_ADC.P_ADC -> App_Model.R_ADC
    connect App_ADC.P_ADC -> App_NFC.R_ADC
    connect App_ADC.P_ADC -> App_PWM.R_ADC
    connect App_ADC.P_ADC -> App_Repro.R_ADC
    connect App_ADC.P_ADC -> App_UART.R_ADC
    connect App_ADC.P_ADC -> App_Uds.R_ADC
    connect App_ADC.P_ADC -> App_WCT.R_ADC
    connect App_ADC.P_ADC -> SWC_AppMode.R_ADC
    connect App_CAN_RX.P_CAN_RX -> App_Model.R_CAN_RX
    connect App_CAN_RX.P_CAN_RX -> App_NFC.R_CAN_RX
    connect App_CAN_RX.P_CAN_RX -> App_NvM.R_CAN_RX
    connect App_CAN_RX.P_CAN_RX -> App_Uds.R_CAN_RX
    connect App_CAN_RX.P_CAN_RX -> App_WCT.R_CAN_RX
    connect App_CAN_RX.P_CAN_RX -> App_WDT.R_CAN_RX
    connect SWC_AppMode.P_CS_Mode -> App_ADC.R_CS_Mode
    connect SWC_AppMode.P_CS_Mode -> App_CAN_RX.R_CS_Mode
    connect SWC_AppMode.P_CS_Mode -> App_CAN_TX.R_CS_Mode
    connect SWC_AppMode.P_CS_Mode -> App_NvM.R_CS_Mode
    connect SWC_AppMode.P_CS_Mode -> App_PWM.R_CS_Mode
    connect App_DTC.P_DTC -> App_CAN_TX.R_DTC
    connect App_DTC.P_DTC -> App_PWM.R_DTC
    connect App_Diag.P_Diag -> App_PWM.R_Diag
    connect SWC_AppMode.P_Mode -> App_CAN_RX.R_Mode
    connect SWC_AppMode.P_Mode -> App_CAN_TX.R_Mode
    connect App_Model.P_Model -> App_CAN_TX.R_Model
    connect App_Model.P_Model -> App_NvM.R_Model
    connect App_Model.P_Model -> App_PWM.R_Model
    connect App_NFC.P_NFC -> App_CAN_TX.R_NFC
    connect App_NvM.P_NvM -> App_CAN_RX.R_NvM
    connect App_NvM.P_NvM -> App_CAN_TX.R_NvM
    connect App_NvM.P_NvM -> App_Model.R_NvM
    connect App_NvM.P_NvM -> App_Uds.R_NvM
    connect App_PWM.P_PWM -> App_Uds.R_PWM
    connect App_PWM.P_PWM -> App_WCT.R_PWM
    connect App_Repro.P_Repro -> App_CAN_TX.R_Repro
    connect App_UART.P_UART -> App_CAN_TX.R_UART
    connect App_UART.P_UART -> App_PWM.R_UART
    connect App_Uds.P_Uds -> App_CAN_TX.R_Uds
    connect App_Uds.P_Uds -> App_NvM.R_Uds
    connect App_Uds.P_Uds -> App_PWM.R_Uds
    connect App_WCT.P_WCT -> App_CAN_TX.R_WCT
    connect App_WCT.P_WCT -> App_PWM.R_WCT
    connect App_CAN_RX.P_CAN_RX -> App_Diag.R_CAN_RX
    connect App_NvM.P_NvM -> App_WDT.R_NvM
    connect App_WDT.P_WDT -> App_CAN_RX.R_WDT
    connect App_WDT.P_WDT -> App_CAN_TX.R_WDT
    connect App_WDT.P_WDT -> App_NvM.R_WDT
    connect App_NFC.P_NFC -> App_NvM.R_NFC
    connect App_NvM.P_NvM -> App_NFC.R_NvM
    connect App_ADC.P_ADC -> App_WDT.R_ADC
    connect App_WDT.P_WDT -> SWC_AppMode.R_WDT
    connect App_Repro.P_Repro -> SWC_AppMode.R_Repro
    connect App_CAN_RX.P_CAN_RX -> App_DTC.R_CAN_RX
    connect App_NvM.P_NvM -> App_Repro.R_NvM
    connect App_Repro.P_Repro -> App_NvM.R_Repro
    connect App_Uds.P_Uds -> App_DTC.R_Uds
    connect App_NvM.P_NvM -> App_DTC.R_NvM
    connect App_NvM.P_NvM -> App_PWM.R_NvM
    connect App_NvM.P_NvM -> App_UART.R_NvM
    connect App_NvM.P_NvM -> SWC_AppMode.R_NvM
    connect App_NvM.P_NvM -> App_WCT.R_NvM
    connect App_UART.P_UART -> SWC_AppMode.R_UART
