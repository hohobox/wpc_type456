AUTOSAR XML (schema 4-3-0)
package /DataTransformation/XF_LCAN
  data transformation set XfSetTx_LCAN_P5
    data transformation XfTx_LCAN_P5: execute-despite-data-unavailability=true, transformer-chain=[XfSetTx_LCAN_P5/XfTechTx_ComXf_P5, XfSetTx_LCAN_P5/XfTechTx_E2EXf_P5]
    transformation technology XfTechTx_ComXf_P5: buffer-properties=header-length=0, has-internal-state=false, needs-original-data=false, protocol=COMBased, transformer-class=SERIALIZER, version=1.0.0
    transformation technology XfTechTx_E2EXf_P5:
      buffer-properties={header-length=0, in-place=false}
      has-internal-state=false
      needs-original-data=false
      protocol=E2E
      end-to-end-transformation-description{max-delta-counter=10, max-error-state-init=0, max-error-state-invalid=0, max-error-state-valid=0, min-ok-state-init=1, min-ok-state-invalid=1, min-ok-state-valid=1, offset=0, profile-name=PROFILE_05, upper-header-bits-to-shift=0, window-size=1}
      transformer-class=SAFETY
      version=1.0.0
  data transformation set XfSetRx_LCAN_P5
    data transformation XfRx_LCAN_P5: execute-despite-data-unavailability=true, transformer-chain=[XfSetRx_LCAN_P5/XfTechRx_ComXf_P5, XfSetRx_LCAN_P5/XfTechRx_E2EXf_P5]
    transformation technology XfTechRx_ComXf_P5: buffer-properties=header-length=0, has-internal-state=false, needs-original-data=false, protocol=COMBased, transformer-class=SERIALIZER, version=1.0.0
    transformation technology XfTechRx_E2EXf_P5:
      buffer-properties={header-length=0, in-place=false}
      has-internal-state=false
      needs-original-data=false
      protocol=E2E
      end-to-end-transformation-description{max-delta-counter=10, max-error-state-init=0, max-error-state-invalid=0, max-error-state-valid=0, min-ok-state-init=1, min-ok-state-invalid=1, min-ok-state-valid=1, offset=0, profile-name=PROFILE_05, upper-header-bits-to-shift=0, window-size=1}
      transformer-class=SAFETY
      version=1.0.0
package /DataTransformation/XF_BCAN
  data transformation set XfSetTx_BCAN_P5
    data transformation XfTx_BCAN_P5: execute-despite-data-unavailability=true, transformer-chain=[XfSetTx_BCAN_P5/XfTechTx_ComXf_P5, XfSetTx_BCAN_P5/XfTechTx_E2EXf_P5]
    transformation technology XfTechTx_ComXf_P5: buffer-properties=header-length=0, has-internal-state=false, needs-original-data=false, protocol=COMBased, transformer-class=SERIALIZER, version=1.0.0
    transformation technology XfTechTx_E2EXf_P5:
      buffer-properties={header-length=0, in-place=false}
      has-internal-state=false
      needs-original-data=false
      protocol=E2E
      end-to-end-transformation-description{max-delta-counter=10, max-error-state-init=0, max-error-state-invalid=0, max-error-state-valid=0, min-ok-state-init=1, min-ok-state-invalid=1, min-ok-state-valid=1, offset=0, profile-name=PROFILE_05, upper-header-bits-to-shift=0, window-size=1}
      transformer-class=SAFETY
      version=1.0.0
  data transformation set XfSetRx_BCAN_P5
    data transformation XfRx_BCAN_P5: execute-despite-data-unavailability=true, transformer-chain=[XfSetRx_BCAN_P5/XfTechRx_ComXf_P5, XfSetRx_BCAN_P5/XfTechRx_E2EXf_P5]
    transformation technology XfTechRx_ComXf_P5: buffer-properties=header-length=0, has-internal-state=false, needs-original-data=false, protocol=COMBased, transformer-class=SERIALIZER, version=1.0.0
    transformation technology XfTechRx_E2EXf_P5:
      buffer-properties={header-length=0, in-place=false}
      has-internal-state=false
      needs-original-data=false
      protocol=E2E
      end-to-end-transformation-description{max-delta-counter=10, max-error-state-init=0, max-error-state-invalid=0, max-error-state-valid=0, min-ok-state-init=1, min-ok-state-invalid=1, min-ok-state-valid=1, offset=0, profile-name=PROFILE_05, upper-header-bits-to-shift=0, window-size=1}
      transformer-class=SAFETY
      version=1.0.0
