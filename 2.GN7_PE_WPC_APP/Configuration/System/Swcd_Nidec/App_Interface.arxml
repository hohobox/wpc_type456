AUTOSAR XML (schema 4-3-0)
package /App_Interface/ApplicationDataTypes
  app type ADT_uint8: category=VALUE, range phys 0..255
  app type ADT_uint16: category=VALUE, range phys 0..65535
  4 x application array data type, all with category=ARRAY:
    ADT_u8x32
      element ADT_uint8: category=VALUE, type=ADT_uint8, array-size-semantics=FIXED-SIZE, max-number-of-elements=32
    ADT_u16x32
      element ADT_uint16: category=VALUE, type=ADT_uint16, array-size-semantics=FIXED-SIZE, max-number-of-elements=32
    ADT_u8_Arr38
      element ADT_uint8: category=VALUE, type=ADT_uint8, array-size-semantics=FIXED-SIZE, max-number-of-elements=38
    ADT_u8_Arr10
      element ADT_uint8: category=VALUE, type=ADT_uint8, array-size-semantics=FIXED-SIZE, max-number-of-elements=10
  app type ADT_sint16: category=VALUE, range phys 0..32767
  app type ADT_uint32: category=VALUE, range phys 0..4294967295
  app type ADT_ENUM_WPCStatus: category=VALUE, compu-method=ENUM_WPCStatus_def
package /App_Interface/CompuMethods
  compu method ENUM_WPCStatus_def: 0=WPCStatus_OFF, 1=WPCStatus_WPC, 2=WPCStatus_NotUsed, 3=WPCStatus_NFC, 4=WPCStatus_LPCD, 5=WPCStatus_PICC
package /App_Interface/DataTypeMappings
  data type mapping set DataTypeMappingSet_WPC
    data-type-maps:
      application-data-type=ADT_uint8, implementation-data-type=IDT_u8
      application-data-type=ADT_u16x32, implementation-data-type=IDT_u16x32
      application-data-type=ADT_u8x32, implementation-data-type=IDT_u8x32
      application-data-type=ADT_uint16, implementation-data-type=IDT_u16
      application-data-type=ADT_ENUM_WPCStatus, implementation-data-type=IDT_ENUM_WPCStatus
package /App_Interface/ImplementationDataTypes
  52 x impl type:
    IDT_Structure: category=STRUCTURE
      element IDT_u8x32: array-size-semantics=FIXED-SIZE, implementation-data-type=IDT_u8x32
      element IDT_u16x32: array-size-semantics=FIXED-SIZE, implementation-data-type=IDT_u16x32
    IDT_u8x32: category=ARRAY
      element SubElement0: category=VALUE, array-size=32, array-size-semantics=FIXED-SIZE, base-type=uint8
    IDT_u16x32: category=ARRAY
      element SubElement0: category=VALUE, array-size=32, array-size-semantics=FIXED-SIZE, base-type=uint16
    IDT_uint8: implementation-data-type=uint8
    IDT_uint16: implementation-data-type=uint16
    IDT_NFC_Device: category=STRUCTURE
      8 x element, all with category=VALUE, array-size-semantics=FIXED-SIZE, base-type=uint8:
        NFC_Status
        NFC_LPConditionFlag
        NFCDetection
        NFCReset
        NfcOnThePad
        LPCD_Wakeup
        CardProtectionResult
        MultiCardDetectionState
    IDT_Repro_STR: category=STRUCTURE
      12 x element, all with array-size-semantics=FIXED-SIZE:
        ReproPercent: category=VALUE, base-type=uint8
        Repro_LPConditionFlag: category=VALUE, base-type=uint8
        Repro_Status: category=VALUE, base-type=uint8
        ReproRequest: category=VALUE, base-type=uint8
        ReproVersionVerifyReq: category=VALUE, base-type=uint8
        ReproErrCode: category=VALUE, base-type=uint8
        m_WctSourceVer: implementation-data-type=IDT_u8_Arr3
        ReproFlashStatus: category=VALUE, base-type=uint8
        WctTargetVer: implementation-data-type=IDT_u8_Arr3
        m_WctReproRequest: category=VALUE, base-type=uint8
        WctVerCheck: category=VALUE, base-type=uint8
        WCT_DiagReproStop: category=VALUE, base-type=uint8
    IDT_WCT_Device: category=STRUCTURE
      6 x element, all with category=VALUE, array-size-semantics=FIXED-SIZE, base-type=uint8:
        WCT_Status
        UartTxCmd
        CardProtectionReq
        ChargingOnthePad
        WCT_LPConditionFlag
        ObjectOnthePad
    IDT_ADC_STR: category=STRUCTURE
      6 x element, all with category=VALUE, array-size-semantics=FIXED-SIZE, base-type=uint8:
        IGN1_IN
        BatCanStateFault
        BatSysStateFault
        BATVolt_Convert
        IGN1Volt_Convert
        PDC_LOW_BAT
    IDT_BCAN_RX: category=STRUCTURE
      49 x element, all with category=VALUE, array-size-semantics=FIXED-SIZE:
        C_LFAnt_SrchSta: base-type=uint8
        C_Warn_DrvDrSwSta: base-type=uint8
        C_RheoStatLevel: base-type=uint8
        C_CLU_DtntOutSta: base-type=uint8
        C_WPCOnOffNvalueSet: base-type=uint8
        C_CF_Gway_WPCNValueSet: base-type=uint8
        C_CF_Gway_WPCAnimationNvalueSet: base-type=uint8
        C_USM_WpcSetReq: base-type=uint8
        C_USMReset: base-type=uint8
        C_CF_AVN_CluUSMReset: base-type=uint8
        C_USM_StaRst1Req: base-type=uint8
        C_IAU_ProfileIDRVal: base-type=uint8
        C_CF_AVN_ProfileIDRValue: base-type=uint8
        C_VCU_EvDrvRdySta: base-type=uint8
        C_HEV_EngOpSta: base-type=uint8
        C_CLU_AutoBrightSta: base-type=uint8
        C_CLU_ClusterUSM: base-type=uint8
        C_Lamp_IntTailLmpOnReq: base-type=uint8
        C_INDAnimationOption: base-type=uint8
        C_WPCIndUSMState: base-type=uint8
        C_WPCIndCmdState: base-type=uint8
        C_AutoBrightLevel: base-type=uint8
        C_CLU_DisSpdVal_KPH: base-type=uint16
        m_AutoBrightSta: base-type=uint8
        C_BCM_SmkOptTyp: base-type=uint8
        C_Warn_AsstDrSwSta: base-type=uint8
        C_Warn_RrLftDrSwSta: base-type=uint8
        C_Warn_RrRtDrSwSta: base-type=uint8
        C_ENG_EngSta: base-type=uint8
        C_HCU_HevRdySta: base-type=uint8
        C_Warn_RrLftDrSwSta_SBCM: base-type=uint8
        C_Warn_AsstDrSwSta_SBCM: base-type=uint8
        C_Warn_DrvDrSwSta_SBCM: base-type=uint8
        C_Warn_RrRtDrSwSta_SBCM: base-type=uint8
        C_RWPC_IndSyncVal: base-type=uint8
        C_WPC2_IndSyncVal: base-type=uint8
        C_CF_Gway_WPC2_NValueSet: base-type=uint8
        C_Latch_TypeOption_DRV: base-type=uint8
        C_PDC_ResetPreWrngForOthers: base-type=uint8
        C_PDC_ResetReqForOthers: base-type=uint8
        C_WPC2OnOffNvalueSet: base-type=uint8
        C_USM_Wpc2SetReq: base-type=uint8
        PDC_15_300_RevComplete: base-type=uint8
        C_WPC_IndSyncVal: base-type=uint8
        C_RWPC_OnOffNValueSet: base-type=uint8
        C_RWPC_AnimationNvalueSet: base-type=uint8
        C_VCU_GearPosSta: base-type=uint8
        C_PDC_ResetFuncOpt: base-type=uint8
        C_USM_FANSpeedSet: base-type=uint8
    IDT_LCAN_RX: category=STRUCTURE
      11 x element, all with category=VALUE, array-size-semantics=FIXED-SIZE, base-type=uint8:
        LC_WPC_IAUWPCNFCcmd
        LC_WPC2_IAUWPCNFCcmd
        LC_IAU_Status
        LC_DeviceOnWPC
        LC_OwnerKey_Reg_Status
        LC_OwnerPairingAdvertisingReq
        LC_CCU_ForcedPowerOffReq
        LC_IAU_DKOwnerSwapOption
        LC_IAU_SharedPhnRegStat
        LC_PDC_ResetPreWrngForOthers
        LC_PDC_ResetReqForOthers
    IDT_NvM_STR: category=STRUCTURE
      30 x element, all with array-size-semantics=FIXED-SIZE:
        Device: category=ARRAY
          element SubElement0: array-size=2, implementation-data-type=IDT_NvM_Device
        m_AutoBrightSta: category=VALUE, base-type=uint8
        INDContType: category=VALUE, base-type=uint8
        LedDutyTableOption: category=VALUE, base-type=uint8
        RheostatOption: category=VALUE, base-type=uint8
        IndUSMOption: category=VALUE, base-type=uint8
        m_PDCReset: category=VALUE, base-type=uint8
        WPC_TYPE: category=VALUE, base-type=uint8
        m_ANT_Calibration: category=VALUE, base-type=uint8
        m_B0BADisableCnt: category=VALUE, base-type=uint8
        m_WctReproRequest: category=VALUE, base-type=uint8
        m_Flag{2..6}: category=VALUE, base-type=uint8
        m_ECU_Info: implementation-data-type=IDT_u8_Arr17
        m_SerialNum: implementation-data-type=IDT_u8_Arr15
        m_QRCode: implementation-data-type=IDT_u8_Arr21
        m_Array{1..3}: implementation-data-type=IDT_u8_Arr8
        NvMBlk_Array_Complete: implementation-data-type=IDT_u8_Arr6
        DeviceMaxCnt: category=VALUE, base-type=uint8
        NvMBlk_1B_Complete: implementation-data-type=IDT_u8_Arr20
        NfcOption: category=VALUE, base-type=uint8
        EVOption: category=VALUE, base-type=uint8
        ProfileOption: category=VALUE, base-type=uint8
        WPC_NAME: category=VALUE, base-type=uint8
        VehicleCode: category=VALUE, base-type=uint8
    IDT_Uds_STR: category=STRUCTURE
      15 x element, all with array-size-semantics=FIXED-SIZE:
        Uds_LPConditionFlag: category=VALUE, base-type=uint8
        m_NFCOption: category=VALUE, base-type=uint8
        DiagAmberBlink: category=VALUE, base-type=uint8
        DiagGreenBlink: category=VALUE, base-type=uint8
        DiagFanRotate: category=VALUE, base-type=uint8
        DiagDvp1Start: category=VALUE, base-type=uint8
        WCT_DiagReproStart: category=VALUE, base-type=uint8
        WdtDisable_ConfigLock: category=VALUE, base-type=uint8
        WdtDisable_ProgramSession: category=VALUE, base-type=uint8
        DvpTuneData: implementation-data-type=IDT_u8_Arr10
        m_B0BADisableCnt: category=VALUE, base-type=uint8
        m_ECU_Info: implementation-data-type=IDT_u8_Arr17
        m_SerialNum: implementation-data-type=IDT_u8_Arr15
        m_QRCode: implementation-data-type=IDT_u8_Arr21
        TestPresent: category=VALUE, base-type=uint8
    IDT_u8_Arr17: category=ARRAY
      element SubElement: array-size=17, array-size-semantics=FIXED-SIZE, implementation-data-type=IDT_u8
    IDT_u8_Arr10: category=ARRAY
      element SubElement: array-size=10, array-size-semantics=FIXED-SIZE, implementation-data-type=IDT_u8
    IDT_u8_Arr21: category=ARRAY
      element SubElement: array-size=21, array-size-semantics=FIXED-SIZE, implementation-data-type=IDT_u8
    IDT_u8_Arr42: category=ARRAY
      element SubElement: array-size=42, array-size-semantics=FIXED-SIZE, implementation-data-type=IDT_u8
    IDT_u8_Arr7: category=ARRAY
      element SubElement: array-size=7, array-size-semantics=FIXED-SIZE, implementation-data-type=IDT_u8
    IDT_u8_Arr8: category=ARRAY
      element SubElement: array-size=8, array-size-semantics=FIXED-SIZE, implementation-data-type=IDT_u8
    IDT_u8_Arr38: category=ARRAY
      element SubElement: array-size=38, array-size-semantics=FIXED-SIZE, implementation-data-type=IDT_u8
    IDT_u8: category=VALUE, base-type=uint8
    IDT_u16: category=VALUE, base-type=uint16
    IDT_s16: category=VALUE, base-type=sint16
    IDT_UART_STR: category=STRUCTURE
      11 x element, all with array-size-semantics=FIXED-SIZE:
        Device_WCT: category=ARRAY
          element SubElement0: array-size=2, implementation-data-type=IDT_UART_Device
        Device_DVP: category=ARRAY
          element SubElement0: array-size=2, implementation-data-type=IDT_UART_DVP
        UART_LPConditionFlag: category=VALUE, base-type=uint8
        WctUartCommReady: category=VALUE, base-type=uint8
        WctUartRxTimeout: category=VALUE, base-type=uint8
        UART_Status: category=VALUE, base-type=uint8
        WctErrorState: category=VALUE, base-type=uint16
        AutoCalibrated: category=VALUE, base-type=uint8
        WctSourceVer: implementation-data-type=IDT_u8_Arr3
        WctAppError_MSB: category=VALUE, base-type=uint8
        WctAppError_LSB: category=VALUE, base-type=uint8
    IDT_UART_DVP: category=STRUCTURE
      18 x element, all with category=VALUE, array-size-semantics=FIXED-SIZE:
        swPowerLossDetectionThreshold: base-type=sint16
        swNormalizedParasiticLoss: base-type=sint16
        swParasiticLoss: base-type=sint16
        swSFCPowerLossThresholdInOperationMode: base-type=sint16
        dwActiveFreq: base-type=uint32
        swBPPLPPowerLossThresholdInOperationMode: base-type=sint16
        wMeasuredQFactor: base-type=uint16
        dwRxReportedPower: base-type=uint32
        byPowerPacketType: base-type=uint8
        byQFactor: base-type=uint8
        bPLCFlag: base-type=uint8
        wRetryMeasuredQFactor: base-type=uint16
        wGuaranteedPowerHalfWatt: base-type=uint16
        wMaximumPowerHalfWatt: base-type=uint16
        ChargingRate: base-type=uint8
        sdwTxPowerInCalibMode2: base-type=sint16
        Qi_Ver: base-type=uint8
        AutoCalibErr: base-type=uint8
    IDT_UART_Device: category=STRUCTURE
      18 x element, all with category=VALUE, array-size-semantics=FIXED-SIZE:
        ChargingCurrent_Convert: base-type=uint8
        ChargingCurrent: base-type=uint16
        ChargingVolt_Convert: base-type=uint8
        ChargingPower_Convert: base-type=uint8
        ActiveCoilID: base-type=uint8
        DeviceState: base-type=uint8
        PhoneLeft: base-type=uint8
        CoilTempDegree: base-type=sint16
        TempSnsrError: base-type=uint8
        RxChargingStatus: base-type=uint8
        TxChargingErrors: base-type=uint8
        CS100: base-type=uint8
        TxChargingStatus: base-type=uint8
        ChargingMode: base-type=uint8
        AuthState: base-type=uint8
        ObjectDetection: base-type=uint8
        ManufactureID: base-type=uint16
        RxChargingErrors: base-type=uint8
    IDT_Diag_STR: category=STRUCTURE
      6 x element, all with category=VALUE, array-size-semantics=FIXED-SIZE:
        GreenIND{1..3}_OUT: base-type=uint16
        AmberIND_OUT: base-type=uint16
        FAN_PWM: base-type=uint16
        Diag_Status: base-type=uint8
    IDT_Model: category=STRUCTURE
      39 x element, all with category=VALUE, array-size-semantics=FIXED-SIZE:
        WPCWarning: base-type=uint8
        WPCRValue: base-type=uint8
        PhoneWarningCheck_Timer: base-type=uint16
        WPCStatus: base-type=uint8
        FAN_PWM: base-type=uint16
        FANDutyRatioSta: base-type=uint8
        ChargingEnable: base-type=uint8
        TempSensorFault: base-type=uint8
        BlinkState: base-type=uint8
        LFState: base-type=uint8
        AmberIND_OUT: base-type=uint16
        GreenIND{1..3}_OUT: base-type=uint16
        PhnLeftChk_Enable: base-type=uint8
        WPCMode_LPConditionFlag: base-type=uint8
        NFCMode_LPConditionFlag: base-type=uint8
        WPCMain_LPConditionFlag: base-type=uint8
        SMKLF_LPConditionFlag: base-type=uint8
        TempSnsrError_LPConditionFlag: base-type=uint8
        OverTempDetect_LPConditionFlag: base-type=uint8
        OverCurrent_LPConditionFlag: base-type=uint8
        FAN_LPConditionFlag: base-type=uint8
        TemperatureFault: base-type=uint8
        CurrentFault: base-type=uint8
        m_ProfileGuestWPCUSM: base-type=uint8
        m_ProfileOneWPCUSM: base-type=uint8
        m_ProfileTwoWPCUSM: base-type=uint8
        m_ProfileThreeWPCUSM: base-type=uint8
        m_RWPCUSM: base-type=uint8
        USM_LPConditionFlag: base-type=uint8
        WPCIndUSMState: base-type=uint8
        WPCIndSyncVal: base-type=uint8
        RWPCIndSyncVal: base-type=uint8
        m_ProfileGuestFanUSM: base-type=uint8
        m_ProfileOneFanUSM: base-type=uint8
        m_ProfileTwoFanUSM: base-type=uint8
        m_ProfileThreeFanUSM: base-type=uint8
        m_RWPCFanUSM: base-type=uint8
    IDT_Mode_STR: category=STRUCTURE
      19 x element, all with category=VALUE, array-size-semantics=FIXED-SIZE, base-type=uint8:
        ComMMode_BCAN
        ComMMode_LCAN
        CanSMBORState_BCAN
        CanSMBORState_LCAN
        PduGroupTx_LCAN_PNC159
        PduGroupRx_LCAN_PNC159
        PduGroupTx_BCAN_PNC141
        PduGroupRx_BCAN_PNC141
        PduGroupTx_BCAN_PNC153
        PduGroupRx_BCAN_PNC153
        LCAN_ComMModePNC159
        BCAN_ComMModePNC141
        BCAN_ComMModePNC153
        PduGroupTx_BCAN_PNC32
        PduGroupRx_BCAN_PNC32
        BCAN_ComMModePNC32
        PduGroupTx_LCAN_PNC32
        PduGroupRx_LCAN_PNC32
        LCAN_ComMModePNC32
    IDT_PWM_Device: category=STRUCTURE
      6 x element, all with category=VALUE, array-size-semantics=FIXED-SIZE, base-type=uint16:
        AMBER_PWM_DUTY
        GREEN{1..3}_PWM_DUTY
        FAN_PWM_DUTY
        FAN_PWM_DUTY_DIAG
    IDT_DTC_Device: category=STRUCTURE
      element TempSnsrFaultDTC: category=VALUE, array-size-semantics=FIXED-SIZE, base-type=uint8
      element FanFaultDTC: category=VALUE, array-size-semantics=FIXED-SIZE, base-type=uint8
      element FanFault: category=VALUE, array-size-semantics=FIXED-SIZE, base-type=uint8
    IDT_u8_Arr256: category=ARRAY
      element SubElement: array-size=256, array-size-semantics=FIXED-SIZE, implementation-data-type=IDT_u8
    IDT_ENUM_WPCStatus: category=VALUE, base-type=void, compu-method=ENUM_WPCStatus_def, range raw 0..6
      5 x element, all with array-size-semantics=FIXED-SIZE:
        SubElement{0..3}: category=VALUE, compu-method=ENUM_WPCStatus_def
        SubElement4: category=TYPE_REFERENCE
    IDT_WCT_STR: category=STRUCTURE
      4 x element, all with array-size-semantics=FIXED-SIZE:
        Device: category=ARRAY
          element SubElement0: array-size=2, implementation-data-type=IDT_WCT_Device
        VCRM: category=ARRAY
          element SubElement0: array-size=2, implementation-data-type=IDT_WCT_VCRM
        NormalUartStart: category=VALUE, base-type=uint8
        ReproUartStart: category=VALUE, base-type=uint8
    IDT_DTC_STR: category=STRUCTURE
      4 x element, all with array-size-semantics=FIXED-SIZE:
        Device: category=ARRAY
          element SubElement0: array-size=2, implementation-data-type=IDT_DTC_Device
        WctIcErrorDTC: category=VALUE, base-type=uint8
        BcanBusOffDTC: category=VALUE, base-type=uint8
        LcanBusOffDTC: category=VALUE, base-type=uint8
    IDT_Model_STR: category=STRUCTURE
      element Device: category=ARRAY, array-size-semantics=FIXED-SIZE
        element SubElement0: array-size=2, implementation-data-type=IDT_Model
    IDT_NFC_STR: category=STRUCTURE
      element Device: category=ARRAY, array-size-semantics=FIXED-SIZE
        element SubElement0: array-size=2, implementation-data-type=IDT_NFC_Device
      element m_ANT_Calibration: category=VALUE, array-size-semantics=FIXED-SIZE, base-type=uint8
    IDT_NvM_Device: category=STRUCTURE
      10 x element, all with category=VALUE, array-size-semantics=FIXED-SIZE, base-type=uint8:
        m_ProfileGuestWPCUSM
        m_ProfileOneWPCUSM
        m_ProfileTwoWPCUSM
        m_ProfileThreeWPCUSM
        m_RWPCUSM
        m_ProfileGuestFanUSM
        m_ProfileOneFanUSM
        m_ProfileTwoFanUSM
        m_ProfileThreeFanUSM
        m_RWPCFanUSM
    IDT_PWM_STR: category=STRUCTURE
      4 x element, all with array-size-semantics=FIXED-SIZE:
        Device: category=ARRAY
          element SubElement0: array-size=2, implementation-data-type=IDT_PWM_Device
        GreenDiagEnable: category=VALUE, base-type=uint8
        AmberDiagEnable: category=VALUE, base-type=uint8
        FanDiagEnable: category=VALUE, base-type=uint8
    IDT_CAN_RX_STR: category=STRUCTURE
      element BCAN: array-size-semantics=FIXED-SIZE, implementation-data-type=IDT_BCAN_RX
      element LCAN: array-size-semantics=FIXED-SIZE, implementation-data-type=IDT_LCAN_RX
    IDT_u32_Arr10: category=ARRAY
      element SubElement: array-size=10, array-size-semantics=FIXED-SIZE, implementation-data-type=uint32
    IDT_WCT_VCRM: category=STRUCTURE
      13 x element, all with category=VALUE, array-size-semantics=FIXED-SIZE:
        PhnUsingTime: base-type=uint8
        PhnChargingCompleteCnt: base-type=uint8
        EPPChargingCnt: base-type=uint8
        MPPChargingCnt: base-type=uint8
        DigitalKeyAuth: base-type=uint8
        DigitalKeyDevice: base-type=uint8
        PhnChargingErrCnt: base-type=uint8
        ThermalSnsrMaxTemp: base-type=sint16
        CANBusOffDTC: base-type=uint8
        LocalCANBusOffDTC: base-type=uint8
        TempSnsrFltDTC: base-type=uint8
        FANFltDTC: base-type=uint8
        InternalECUErrDTC: base-type=uint8
    IDT_u8_Arr3: category=ARRAY
      element SubElement: array-size=3, array-size-semantics=FIXED-SIZE, implementation-data-type=IDT_u8
    IDT_WDT_STR: category=STRUCTURE
      element m_PDCReset: category=VALUE, array-size-semantics=FIXED-SIZE, base-type=uint8
      element WPC_ResetOpSta: category=VALUE, array-size-semantics=FIXED-SIZE, base-type=uint8
      element WDT_LPConditionFlag: category=VALUE, array-size-semantics=FIXED-SIZE, base-type=uint8
    IDT_Log_STR: category=STRUCTURE
      element Reserved: category=VALUE, array-size-semantics=FIXED-SIZE, base-type=uint8
    IDT_u8_Arr11: category=ARRAY
      element SubElement: array-size=11, array-size-semantics=FIXED-SIZE, implementation-data-type=IDT_u8
    IDT_u8_Arr2: category=ARRAY
      element SubElement: array-size=2, array-size-semantics=FIXED-SIZE, implementation-data-type=IDT_u8
    IDT_u8_Arr15: category=ARRAY
      element SubElement: array-size=15, array-size-semantics=FIXED-SIZE, implementation-data-type=IDT_u8
    IDT_u8_Arr4: category=ARRAY
      element SubElement: array-size=4, array-size-semantics=FIXED-SIZE, implementation-data-type=IDT_u8
    IDT_u8_Arr16: category=ARRAY
      element SubElement: array-size=16, array-size-semantics=FIXED-SIZE, implementation-data-type=IDT_u8
    IDT_u8_Arr6: category=ARRAY
      element SubElement: array-size=6, array-size-semantics=FIXED-SIZE, implementation-data-type=IDT_u8
    IDT_u8_Arr20: category=ARRAY
      element SubElement: array-size=20, array-size-semantics=FIXED-SIZE, implementation-data-type=IDT_u8
