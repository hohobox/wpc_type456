AUTOSAR XML (schema 4-0-3)
package /CDD_DataLog
  bsw module description DataLog: module-id=2048, provided-entrys=DataLog_MainFunction
    5 x bsw module dependency:
      BswModuleDependency_NvM: target-module-id=20
      BswModuleDependency_Dcm: target-module-id=53
      BswModuleDependency_ComM: target-module-id=12
      BswModuleDependency_EcuM: target-module-id=10
      BswModuleDependency_BswM: target-module-id=42
    required-mode-groups:
      mode declaration group prototype DataLog_EM_R: type=EcuMode
    bsw internal behavior BswInternalBehavior_DataLog: bsw-mode-receiver-policy{enhanced-mode-api=true, required-mode-group=DataLog_EM_R, supports-asynchronous-mode-switch=true}
      exclusive area DATA_PROTECTION
      bsw schedulable entity BswSE_DataLog_MainFunction: can-enter-exclusive-area=DATA_PROTECTION, implemented-entry=DataLog_MainFunction
      bsw timing event BswTE_DataLog_MainFunction: context-limitation=BswDistinguishedPartition_DataLog, starts-on-event=BswSE_DataLog_MainFunction, period=0.1
        disabled-in-mode:
          DataLog_EM_R.ECUM_STATE_STARTUP_ONE
          DataLog_EM_R.ECUM_STATE_STARTUP_TWO
          DataLog_EM_R.ECUM_STATE_STARTUP_THREE
      bsw distinguished partition BswDistinguishedPartition_DataLog
  bsw implementation BswImplementation_DataLog: sw-version=2.0.0, vendor-id=76, ar-release-version=4.0.3, behavior=BswInternalBehavior_DataLog
  bsw module entry DataLog_MainFunction: is-reentrant=false, is-synchronous=false, call-type=SCHEDULED, execution-context=TASK, sw-service-impl-policy=STANDARD
