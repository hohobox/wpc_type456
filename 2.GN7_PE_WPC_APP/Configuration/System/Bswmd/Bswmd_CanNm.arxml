AUTOSAR XML (schema 4-0-3)
package /ArPackage_CanNm
  bsw module description CanNm: module-id=31
    bsw internal behavior BswInternalBehavior_0
      exclusive area INTERNAL_STATUS
      exclusive area RX_USER_DATA
      exclusive area TX_USER_DATA
      bsw schedulable entity BswSE_CanNm_MainFunction: can-enter-exclusive-area=[INTERNAL_STATUS, RX_USER_DATA, TX_USER_DATA], implemented-entry=CanNm_MainFunction
      bsw timing event BswTE_CanNm_MainFunction: starts-on-event=BswSE_CanNm_MainFunction, period=0.01
      bsw distinguished partition BswDistinguishedPartition_CanNm
  bsw implementation BswImplementation_CanNm: sw-version=2.5.1, vendor-id=76, ar-release-version=4.0.3, behavior=BswInternalBehavior_0
  bsw module entry CanNm_MainFunction: is-reentrant=false, is-synchronous=false, call-type=SCHEDULED, execution-context=TASK, sw-service-impl-policy=STANDARD
