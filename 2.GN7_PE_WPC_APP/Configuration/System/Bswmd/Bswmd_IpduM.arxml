AUTOSAR XML (schema 4-0-3)
package /Bsw_IpduM
  bsw implementation BswImplementation_IpduM: sw-version=2.1.1, vendor-id=39, ar-release-version=4.0.3, behavior=BswInternalBehavior_0
  bsw module description IpduM: module-id=52
    bsw internal behavior BswInternalBehavior_0
      exclusive area DEST_DATA_PROTECTION_AREA
      exclusive area TX_STATUS_PROTECTION_AREA
      exclusive area TX_CONFIRMATION_PROTECTION_AREA
      bsw schedulable entity BswSchedulableEntity_0: can-enter-exclusive-area=[DEST_DATA_PROTECTION_AREA, TX_STATUS_PROTECTION_AREA, TX_CONFIRMATION_PROTECTION_AREA], implemented-entry=IpduM_MainFunction
      bsw timing event BswTE_IpduM_MainFunction: starts-on-event=BswSchedulableEntity_0, period=0.005
  bsw module entry IpduM_MainFunction: service-id=16, is-reentrant=false, is-synchronous=false, call-type=SCHEDULED, execution-context=TASK, sw-service-impl-policy=STANDARD
