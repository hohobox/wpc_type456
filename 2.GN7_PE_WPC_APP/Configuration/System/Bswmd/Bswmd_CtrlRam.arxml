AUTOSAR XML (schema 4-0-3)
package /Bsw_CtrlRam
  bsw implementation BswImplementation_CtrlRam: programming-language=C, sw-version=1.0.8, vendor-id=76, ar-release-version=4.0.3, behavior=BswInternalBehavior_CtrlRam
  bsw module description CtrlRam: module-id=253
    required-mode-groups:
      mode declaration group prototype CtrlRam_EM_R: type=EcuMode
    bsw internal behavior BswInternalBehavior_CtrlRam: bsw-mode-receiver-policy{enhanced-mode-api=false, required-mode-group=CtrlRam_EM_R, supports-asynchronous-mode-switch=true}
      exclusive area WRITE_PROTECTION
      exclusive area SECURITY_CHECK_PROTECTION
      exclusive area STRUCT_WRITE_PROTECTION
      bsw schedulable entity BswSE_CtrlRam_MainFunction: can-enter-exclusive-area=[WRITE_PROTECTION, SECURITY_CHECK_PROTECTION, STRUCT_WRITE_PROTECTION], accessed-mode-groups=CtrlRam_EM_R, implemented-entry=CtrlRam_MainFunction
      bsw timing event BswTimingEvent_CtrlRam: starts-on-event=BswSE_CtrlRam_MainFunction, period=0.1
        disabled-in-mode:
          CtrlRam_EM_R.ECUM_STATE_STARTUP_ONE
          CtrlRam_EM_R.ECUM_STATE_STARTUP_TWO
          CtrlRam_EM_R.ECUM_STATE_STARTUP_THREE
  bsw module entry CtrlRam_MainFunction: is-reentrant=false, is-synchronous=false, call-type=SCHEDULED, execution-context=TASK, sw-service-impl-policy=STANDARD
