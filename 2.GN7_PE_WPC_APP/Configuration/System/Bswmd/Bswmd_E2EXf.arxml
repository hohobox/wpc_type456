AUTOSAR XML (schema 4-2-1)
package /ArPackage_E2EXf
  bsw implementation BswImplementation_E2EXf: sw-version=1.1.9, vendor-id=76, ar-release-version=4.2.2, behavior=BswInternalBehavior_E2EXf
  bsw module description E2EXf: module-id=176
    bsw internal behavior BswInternalBehavior_E2EXf
      8 x bsw called entity:
        BswCalledEntity_1: implemented-entry=E2EXf_App_CAN_TX_Gr_MsgGr_E2E_BCAN_WPC_FD_01_200ms_MsgGr_E2E_BCAN_WPC_FD_01_200ms
        BswCalledEntity_2: implemented-entry=E2EXf_App_CAN_TX_Gr_MsgGr_E2E_BCAN_WPC_FD_VCRM_01_00ms_MsgGr_E2E_BCAN_WPC_FD_VCRM_01_00ms
        BswCalledEntity_3: implemented-entry=E2EXf_App_CAN_TX_Gr_MsgGr_E2E_LCAN_L_WPC_FD_01_00ms_MsgGr_E2E_LCAN_L_WPC_FD_01_00ms
        BswCalledEntity_4: implemented-entry=E2EXf_App_CAN_TX_Gr_MsgGr_E2E_LCAN_L_WPC_FD_20_200ms_MsgGr_E2E_LCAN_L_WPC_FD_20_200ms
        BswCalledEntity_5: implemented-entry=E2EXf_Inv_Com_ComISignalGroup_MsgGr_E2E_LCAN_PDC_FD_15_300ms
        BswCalledEntity_6: implemented-entry=E2EXf_Inv_App_CAN_RX_Gr_MsgGr_E2E_BCAN_PDC_FD_15_300ms_MsgGr_E2E_BCAN_PDC_FD_15_300ms
        BswCalledEntity_7: implemented-entry=E2EXf_App_CAN_TX_Gr_MsgGr_E2E_BCAN_WPC2_FD_01_200ms_MsgGr_E2E_BCAN_WPC2_FD_01_200ms
        BswCalledEntity_8: implemented-entry=E2EXf_Com_ComISignalGroup_MsgGr_E2E_BCAN_WPC_WU_01_500ms
      bsw distinguished partition BswDistinguishedPartition_E2EXf
  8 x bsw module entry, all with is-reentrant=true, is-synchronous=true, call-type=REGULAR, execution-context=TASK, sw-service-impl-policy=STANDARD:
    E2EXf_App_CAN_TX_Gr_MsgGr_E2E_BCAN_WPC_FD_01_200ms_MsgGr_E2E_BCAN_WPC_FD_01_200ms: service-id=3
    E2EXf_App_CAN_TX_Gr_MsgGr_E2E_BCAN_WPC_FD_VCRM_01_00ms_MsgGr_E2E_BCAN_WPC_FD_VCRM_01_00ms: service-id=3
    E2EXf_App_CAN_TX_Gr_MsgGr_E2E_LCAN_L_WPC_FD_01_00ms_MsgGr_E2E_LCAN_L_WPC_FD_01_00ms: service-id=3
    E2EXf_App_CAN_TX_Gr_MsgGr_E2E_LCAN_L_WPC_FD_20_200ms_MsgGr_E2E_LCAN_L_WPC_FD_20_200ms: service-id=3
    E2EXf_Inv_Com_ComISignalGroup_MsgGr_E2E_LCAN_PDC_FD_15_300ms: service-id=4
    E2EXf_Inv_App_CAN_RX_Gr_MsgGr_E2E_BCAN_PDC_FD_15_300ms_MsgGr_E2E_BCAN_PDC_FD_15_300ms: service-id=4
    E2EXf_App_CAN_TX_Gr_MsgGr_E2E_BCAN_WPC2_FD_01_200ms_MsgGr_E2E_BCAN_WPC2_FD_01_200ms: service-id=3
    E2EXf_Com_ComISignalGroup_MsgGr_E2E_BCAN_WPC_WU_01_500ms: service-id=3
