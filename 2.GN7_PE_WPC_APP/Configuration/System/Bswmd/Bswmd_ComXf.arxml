AUTOSAR XML (schema 4-3-0)
package /ArPackage_Xfrm
  bsw implementation BswImplementation_ComXf: programming-language=C, sw-version=1.0.13, used-code-generator=1.0.6, vendor-id=76, ar-release-version=4.3.0, behavior=BswInternalBehavior_ComXf
  bsw module description ComXf: module-id=175
    bsw internal behavior BswInternalBehavior_ComXf
      8 x bsw called entity:
        BswCalledEntity_1: implemented-entry=ComXf_App_CAN_TX_Gr_MsgGr_E2E_BCAN_WPC_FD_01_200ms_MsgGr_E2E_BCAN_WPC_FD_01_200ms
        BswCalledEntity_2: implemented-entry=ComXf_App_CAN_TX_Gr_MsgGr_E2E_BCAN_WPC_FD_VCRM_01_00ms_MsgGr_E2E_BCAN_WPC_FD_VCRM_01_00ms
        BswCalledEntity_3: implemented-entry=ComXf_App_CAN_TX_Gr_MsgGr_E2E_LCAN_L_WPC_FD_01_00ms_MsgGr_E2E_LCAN_L_WPC_FD_01_00ms
        BswCalledEntity_4: implemented-entry=ComXf_App_CAN_TX_Gr_MsgGr_E2E_LCAN_L_WPC_FD_20_200ms_MsgGr_E2E_LCAN_L_WPC_FD_20_200ms
        BswCalledEntity_5: implemented-entry=ComXf_Inv_Com_ComISignalGroup_MsgGr_E2E_LCAN_PDC_FD_15_300ms
        BswCalledEntity_6: implemented-entry=ComXf_Inv_App_CAN_RX_Gr_MsgGr_E2E_BCAN_PDC_FD_15_300ms_MsgGr_E2E_BCAN_PDC_FD_15_300ms
        BswCalledEntity_7: implemented-entry=ComXf_App_CAN_TX_Gr_MsgGr_E2E_BCAN_WPC2_FD_01_200ms_MsgGr_E2E_BCAN_WPC2_FD_01_200ms
        BswCalledEntity_8: implemented-entry=ComXf_Com_ComISignalGroup_MsgGr_E2E_BCAN_WPC_WU_01_500ms
      bsw distinguished partition BswDistinguishedPartition_ComXf
  8 x bsw module entry, all with is-reentrant=true, is-synchronous=true, call-type=REGULAR, execution-context=TASK, sw-service-impl-policy=STANDARD:
    ComXf_App_CAN_TX_Gr_MsgGr_E2E_BCAN_WPC_FD_01_200ms_MsgGr_E2E_BCAN_WPC_FD_01_200ms: service-id=3
    ComXf_App_CAN_TX_Gr_MsgGr_E2E_BCAN_WPC_FD_VCRM_01_00ms_MsgGr_E2E_BCAN_WPC_FD_VCRM_01_00ms: service-id=3
    ComXf_App_CAN_TX_Gr_MsgGr_E2E_LCAN_L_WPC_FD_01_00ms_MsgGr_E2E_LCAN_L_WPC_FD_01_00ms: service-id=3
    ComXf_App_CAN_TX_Gr_MsgGr_E2E_LCAN_L_WPC_FD_20_200ms_MsgGr_E2E_LCAN_L_WPC_FD_20_200ms: service-id=3
    ComXf_Inv_Com_ComISignalGroup_MsgGr_E2E_LCAN_PDC_FD_15_300ms: service-id=4
    ComXf_Inv_App_CAN_RX_Gr_MsgGr_E2E_BCAN_PDC_FD_15_300ms_MsgGr_E2E_BCAN_PDC_FD_15_300ms: service-id=4
    ComXf_App_CAN_TX_Gr_MsgGr_E2E_BCAN_WPC2_FD_01_200ms_MsgGr_E2E_BCAN_WPC2_FD_01_200ms: service-id=3
    ComXf_Com_ComISignalGroup_MsgGr_E2E_BCAN_WPC_WU_01_500ms: service-id=3
