AUTOSAR XML (schema 4-0-3)
package /Bsw_ComM
  bsw implementation BswImplementation_ComM: sw-version=1.11.3, swc-bsw-mapping=SwcBswMapping_ComM, vendor-id=76, ar-release-version=4.0.3, behavior=BswIB_ComM
  bsw module description ComM: module-id=12
    required-mode-groups:
      mode declaration group prototype modeNotificationPort_EcuMode: type=EcuMode
    bsw internal behavior BswIB_ComM
      8 x exclusive area:
        INHIBIT_CNT_PROTECTION
        REQ_MODECNT_PROTECTION
        CURRENT_MODE_PROTECTION
        DCM_DIAGNOSTIC_PROTECTION
        ECUM_WAKEUP_IND
        NM_INDICATION_PROTECTION
        PNC_PREPARE_TIMER
        PNC_WAKEUP_IND
      bsw called entity BswCE_ComM_GetCurrentComMode: implemented-entry=ComM_GetCurrentComMode
      bsw called entity BswCE_ComM_GetRequestedComMode: implemented-entry=ComM_GetRequestedComMode
      bsw called entity BswCE_ComM_RequestComMode: implemented-entry=ComM_RequestComMode
      bsw schedulable entity BswSE_ComM_MainFunction_0: can-enter-exclusive-area=[INHIBIT_CNT_PROTECTION, REQ_MODECNT_PROTECTION, CURRENT_MODE_PROTECTION, DCM_DIAGNOSTIC_PROTECTION, ECUM_WAKEUP_IND, NM_INDICATION_PROTECTION, PNC_PREPARE_TIMER, PNC_WAKEUP_IND], implemented-entry=ComM_MainFunction_0
      bsw schedulable entity BswSE_ComM_MainFunction_1: can-enter-exclusive-area=[INHIBIT_CNT_PROTECTION, REQ_MODECNT_PROTECTION, CURRENT_MODE_PROTECTION, DCM_DIAGNOSTIC_PROTECTION, ECUM_WAKEUP_IND, NM_INDICATION_PROTECTION, PNC_PREPARE_TIMER, PNC_WAKEUP_IND], implemented-entry=ComM_MainFunction_1
      bsw timing event BswTE_ComM_MainFunction0: disabled-in-mode=modeNotificationPort_EcuMode.ECUM_STATE_SHUTDOWN, starts-on-event=BswSE_ComM_MainFunction_0, period=0.005
      bsw timing event BswTE_ComM_MainFunction1: disabled-in-mode=modeNotificationPort_EcuMode.ECUM_STATE_SHUTDOWN, starts-on-event=BswSE_ComM_MainFunction_1, period=0.005
      bsw distinguished partition BswDistinguishedPartition_ComM
  bsw module entry ComM_RequestComMode: service-id=5, is-reentrant=true, is-synchronous=false, call-type=REGULAR, execution-context=TASK, sw-service-impl-policy=STANDARD
    sw service arg User: direction=IN
    sw service arg ComMode: direction=IN
  bsw module entry ComM_GetRequestedComMode: service-id=7, is-reentrant=true, is-synchronous=false, call-type=REGULAR, execution-context=TASK, sw-service-impl-policy=STANDARD
    sw service arg User: direction=IN
    sw service arg ComMode: direction=OUT
  bsw module entry ComM_GetCurrentComMode: service-id=8, is-reentrant=true, is-synchronous=false, call-type=REGULAR, execution-context=TASK, sw-service-impl-policy=STANDARD
    sw service arg User: direction=IN
    sw service arg ComMode: direction=OUT
  swc bsw mapping SwcBswMapping_ComM: bsw-behavior=BswIB_ComM, swc-behavior=SwcIB_ComM
    runnable-mappings:
      bsw-entity=BswCE_ComM_RequestComMode, swc-runnable=RequestComMode
      bsw-entity=BswCE_ComM_GetCurrentComMode, swc-runnable=GetCurrentComMode
      bsw-entity=BswCE_ComM_GetRequestedComMode, swc-runnable=GetRequestedComMode
  bsw module entry ComM_MainFunction_0: service-id=96, is-reentrant=false, is-synchronous=false, call-type=SCHEDULED, execution-context=TASK, sw-service-impl-policy=STANDARD
  bsw module entry ComM_MainFunction_1: service-id=96, is-reentrant=false, is-synchronous=false, call-type=SCHEDULED, execution-context=TASK, sw-service-impl-policy=STANDARD
