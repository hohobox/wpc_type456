AUTOSAR XML (schema 4-0-3)
package /Bsw_RomTst
  bsw implementation BswImplementation_RomTst: programming-language=C, sw-version=1.4.4, vendor-id=76, ar-release-version=4.0.3, behavior=BswInternalBehavior_RomTst
  bsw module description RomTst: module-id=272
    bsw internal behavior BswInternalBehavior_RomTst
      bsw internal triggering point BITP_RomTst: sw-impl-policy=QUEUED
      bsw schedulable entity BSE_RomTst: implemented-entry=RomTst_MainFunction
      bsw schedulable entity BSE_RomTst_ActivateRomTstTask: activation-points=BITP_RomTst, implemented-entry=RomTst_ActivateRomTst_Task
      bsw internal trigger occurred event BITOE_RomTst: starts-on-event=BSE_RomTst, event-source=BITP_RomTst
      bsw distinguished partition BswDistinguishedPartition_RomTst
  bsw module entry RomTst_MainFunction: service-id=4, is-reentrant=true, is-synchronous=true, call-type=SCHEDULED, execution-context=TASK, sw-service-impl-policy=STANDARD
  bsw module entry RomTst_ActivateRomTst_Task: service-id=9, is-reentrant=false, is-synchronous=true, call-type=SCHEDULED, execution-context=TASK, sw-service-impl-policy=STANDARD
