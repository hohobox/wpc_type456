AUTOSAR XML (schema 4-0-3)
package /Bsw_MemIf
  bsw implementation BswImplementation_MemIf: sw-version=1.3.8, vendor-id=76, ar-release-version=4.0.3, behavior=BswInternalBehavior_MemIf
  bsw module description MemIf: module-id=22
    bsw internal behavior BswInternalBehavior_MemIf
