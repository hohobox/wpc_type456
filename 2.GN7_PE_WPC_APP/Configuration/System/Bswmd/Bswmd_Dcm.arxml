AUTOSAR XML (schema 4-0-3)
package /ARPackage_Dcm/EcuConfiuration
  bsw implementation BswImplementation_Dcm: sw-version=2.16.0, swc-bsw-mapping=SwcBswMapping_Dcm, vendor-id=76, ar-release-version=4.0.3, behavior=InternalBehavior_Dcm
  bsw module description Dcm: module-id=0x35
    provided-mode-groups:
      6 x mode declaration group prototype:
        DcmDiagnosticSessionControl: type=DcmDiagnosticSessionControl
        DcmEcuReset: type=DcmEcuReset
        DcmModeRapidPowerShutDown: type=DcmModeRapidPowerShutDown
        DcmControlDTCSetting: type=DcmControlDTCSetting
        DcmApplicationUpdated: type=DcmApplicationUpdated
        DcmCommunicationControl_0: type=DcmCommunicationControl
    required-mode-groups:
      mode declaration group prototype Dcm_EM_R: type=EcuMode
    bsw internal behavior InternalBehavior_Dcm: data-type-mapping=[DcmDiagnosticSessionControl, DcmEcuReset, DcmModeRapidPowerShutDown, DcmCommunicationControl, DcmControlDTCSetting, DcmApplicationUpdated, EcuModeMap], bsw-mode-receiver-policy{enhanced-mode-api=true, required-mode-group=Dcm_EM_R, supports-asynchronous-mode-switch=true}
      6 x exclusive area:
        SIGNAL_DATA_PROTECTION_AREA
        ProtclProtection
        RxPduIdProtection
        RxLengthProtection
        TimerProtection
        DATA_UPDATE
      bsw schedulable entity BswSE_Dcm_MainFunction: can-enter-exclusive-area=[SIGNAL_DATA_PROTECTION_AREA, ProtclProtection, RxPduIdProtection, RxLengthProtection, TimerProtection, DATA_UPDATE], implemented-entry=Dcm_MainFunction
        managed-mode-groups:
          DcmDiagnosticSessionControl
          DcmEcuReset
          DcmModeRapidPowerShutDown
          DcmControlDTCSetting
          DcmApplicationUpdated
          DcmCommunicationControl_0
      bsw timing event BswTE_Dcm_MainFunction: starts-on-event=BswSE_Dcm_MainFunction, period=0.01
        disabled-in-mode:
          Dcm_EM_R.ECUM_STATE_STARTUP_ONE
          Dcm_EM_R.ECUM_STATE_STARTUP_TWO
          Dcm_EM_R.ECUM_STATE_STARTUP_THREE
          Dcm_EM_R.ECUM_STATE_SHUTDOWN
      mode-sender-policys:
        enhanced-mode-api=false, provided-mode-group=DcmEcuReset, queue-length=1
        enhanced-mode-api=false, provided-mode-group=DcmDiagnosticSessionControl, queue-length=1
        enhanced-mode-api=false, provided-mode-group=DcmControlDTCSetting, queue-length=1
        enhanced-mode-api=false, provided-mode-group=DcmModeRapidPowerShutDown, queue-length=1
        enhanced-mode-api=false, provided-mode-group=DcmApplicationUpdated, queue-length=1
        enhanced-mode-api=false, provided-mode-group=DcmCommunicationControl_0, queue-length=1
      bsw-service-dependency assigned-entry-roles=role-based-bsw-module-entry-assignment=Dcm_MainFunction:
        service-needs:
          bsw mgr needs BswMgrNeeds
      bsw distinguished partition BswDistinguishedPartition_Dcm
  bsw module entry Dcm_MainFunction: service-id=0x25, is-reentrant=false, is-synchronous=false, call-type=SCHEDULED, execution-context=TASK, sw-service-impl-policy=STANDARD
package /ARPackage_Dcm/ModeDeclarationGroup
  6 x mode declaration group:
    DcmControlDTCSetting: initial-mode=ENABLEDTCSETTING
      mode ENABLEDTCSETTING: value=1
      mode DISABLEDTCSETTING: value=2
    DcmDiagnosticSessionControl: category=EXPLICIT_ORDER, initial-mode=DCM_DEFAULT_SESSION, on-transition-value=0
      8 x mode:
        DCM_DEFAULT_SESSION: value=1
        DCM_PROGRAMMING_SESSION: value=2
        DCM_EXTENDED_DIAGNOSTIC_SESSION: value=3
        DCM_SAFETY_SYSTEM_DIAGNOSTIC_SESSION: value=4
        DCM_ECU_PROGRAMMING_MODE: value=5
        DCM_EXTENDED_DIAGNOSTIC_MODE: value=16
        DCM_QUIESCENT_CURRENT_DIAGNOSTIC_MODE_START: value=80
        DCM_SLEEP_MODE_START_REQUEST: value=81
    DcmEcuReset: category=EXPLICIT_ORDER, initial-mode=NONE, on-transition-value=255
      7 x mode:
        NONE: value=0
        HARD: value=1
        KEYONOFF: value=2
        SOFT: value=3
        JUMPTOBOOTLOADER: value=4
        JUMPTOSYSSUPPLIERBOOTLOADER: value=5
        EXECUTE: value=6
    DcmModeRapidPowerShutDown: initial-mode=ENABLE_RAPIDPOWERSHUTDOWN, on-transition-value=255
      mode ENABLE_RAPIDPOWERSHUTDOWN: value=0
      mode DISABLE_RAPIDPOWERSHUTDOWN: value=1
    DcmCommunicationControl: initial-mode=DCM_ENABLE_RX_TX_NORM_NM, on-transition-value=0
      12 x mode:
        DCM_ENABLE_RX_TX_NORM: value=0
        DCM_ENABLE_RX_DISABLE_TX_NORM: value=1
        DCM_DISABLE_RX_ENABLE_TX_NORM: value=2
        DCM_DISABLE_RX_TX_NORMAL: value=3
        DCM_ENABLE_RX_TX_NM: value=4
        DCM_ENABLE_RX_DISABLE_TX_NM: value=5
        DCM_DISABLE_RX_DISABLE_TX_NM: value=6
        DCM_DISABLE_RX_TX_NM: value=7
        DCM_ENABLE_RX_TX_NORM_NM: value=8
        DCM_ENABLE_RX_DISABLE_TX_NORM_NM: value=9
        DCM_DISABLE_RX_ENABLE_TX_NORM_NM: value=10
        DCM_DISABLE_RX_TX_NORM_NM: value=11
    DcmApplicationUpdated: category=EXPLICIT_ORDER, initial-mode=APP_NOT_UPDATED, on-transition-value=255
      mode APP_NOT_UPDATED: value=0
      mode APP_UPDATED: value=1
package /ARPackage_Dcm/DataTypeMappingSet
  6 x data type mapping set:
    DcmCommunicationControl: mode-request-type-map{implementation-data-type=uint8, mode-group=DcmCommunicationControl}
    DcmControlDTCSetting: mode-request-type-map{implementation-data-type=uint8, mode-group=DcmControlDTCSetting}
    DcmDiagnosticSessionControl: mode-request-type-map{implementation-data-type=uint8, mode-group=DcmDiagnosticSessionControl}
    DcmEcuReset: mode-request-type-map{implementation-data-type=uint8, mode-group=DcmEcuReset}
    DcmModeRapidPowerShutDown: mode-request-type-map{implementation-data-type=uint8, mode-group=DcmModeRapidPowerShutDown}
    DcmApplicationUpdated: mode-request-type-map{implementation-data-type=uint8, mode-group=DcmApplicationUpdated}
package /ARPackage_Dcm/ModeSwitchInterface
  6 x mode switch interface:
    DcmDiagnosticSessionControl: is-service=true
      mode group DcmDiagnosticSessionControl: type=DcmDiagnosticSessionControl
    DcmEcuReset: is-service=true
      mode group DcmEcuReset: type=DcmEcuReset
    DcmModeRapidPowerShutDown: is-service=true
      mode group DcmModeRapidPowerShutDown: type=DcmModeRapidPowerShutDown
    DcmControlDTCSetting: service-kind=DIAGNOSTIC-EVENT-MANAGER
      mode group DcmControlDTCSetting: type=DcmControlDTCSetting
    DcmApplicationUpdated: is-service=true
      mode group DcmApplicationUpdated: type=DcmApplicationUpdated
    DcmCommunicationControl_0: is-service=true, service-kind=DIAGNOSTIC-COMMUNICATION-MANAGER
      mode group DcmCommunicationControl_0: type=DcmCommunicationControl
package /ARPackage_Dcm/BaseTypes
  base type AUTOSAR_uint64: category=FIXED_LENGTH, base-type-size=64, base-type-encoding=NONE, mem-alignment=64, byte-order=little-endian, native-declaration=unsigned long long  # uint32
