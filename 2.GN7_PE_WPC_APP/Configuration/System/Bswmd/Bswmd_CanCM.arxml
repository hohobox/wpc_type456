AUTOSAR XML (schema 4-0-3)
package /ArPackage_CanCM
  bsw module description CanCM: module-id=502
    required-mode-groups:
      mode declaration group prototype CanCM_EM_R: type=EcuMode
    bsw internal behavior BswInternalBehavior_CanCM: data-type-mapping=EcuModeMap, bsw-mode-receiver-policy{enhanced-mode-api=true, required-mode-group=CanCM_EM_R, supports-asynchronous-mode-switch=true}
      exclusive area MAIN_PROTECTION
      bsw schedulable entity BswSE_CanCM_MainFunction: can-enter-exclusive-area=MAIN_PROTECTION, accessed-mode-groups=CanCM_EM_R, implemented-entry=CanCM_MainFunction
      bsw timing event BswTE_CanCM_MainFunction: disabled-in-mode=[CanCM_EM_R.ECUM_STATE_STARTUP_ONE, CanCM_EM_R.ECUM_STATE_STARTUP_TWO], starts-on-event=BswSE_CanCM_MainFunction, period=0.005
      bsw distinguished partition BswDistinguishedPartition_CanCM
  bsw implementation BswImplementation_CanCM: sw-version=1.5.21, vendor-id=76, ar-release-version=4.0.3, behavior=BswInternalBehavior_CanCM
  bsw module entry CanCM_MainFunction: is-reentrant=false, is-synchronous=false, call-type=SCHEDULED, execution-context=TASK, sw-service-impl-policy=STANDARD
