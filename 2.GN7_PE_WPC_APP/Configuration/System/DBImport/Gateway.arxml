AUTOSAR XML (schema 4-0-1)
package /Gateway
  4 x gateway:
    Gateway0
    Gateway_1_Diag: ecu=CCU
    Gateway_N_To_1_Routing: ecu=CCU
    Gateway_1_To_N_Routing: ecu=CCU
