AUTOSAR XML (schema 4-0-3)
package /AUTOSAR
  module config IoHwAb: implementation-config-variant=VARIANT-PRE-COMPILE, module-description=BswImplementation_IoHwAb
    IoHwAbConfig: IoHwAbUseDigitalDirect=1, IoHwAbUseGpt=1, IoHwAbUseAnalogInputDirect=1, IoHwAbUseOcu=0, IoHwAbUseIOManager=1, IoHwAbUsePwm=1, IoHwAbUseIcu=0
      IoHwAbAnalogInputDirect
        VBAT_ADC (IoHwAbAnalogInputDirectLogical): IoHwAbAdcGroupRef=IoHwAbAdcGroup_U0C16
        IGN1_ADC (IoHwAbAnalogInputDirectLogical): IoHwAbAdcGroupRef=IoHwAbAdcGroup_U0C17
      IoHwAbDemEventParameterRefs:
        IOHWAB_E_WRONG_STATE = IOHWAB_E_WRONG_STATE
        IOHWAB_E_WRONG_SETTING = IOHWAB_E_WRONG_SETTING
        IOHWAB_E_WRONG_PARAM = IOHWAB_E_WRONG_PARAM
        IOHWAB_E_SETUP_FAIL = IOHWAB_E_SETUP_FAIL
        IOHWAB_E_PROC_FAIL = IOHWAB_E_PROC_FAIL
        IOHWAB_E_BUSY = IOHWAB_E_BUSY
      IoHwAbDigitalDirect
        19 x IoHwAbDigitalDirectLogical:
          WDT_CLEAR_PULSE: IoHwAbPortPinChRef=IoHwAbPortPinCh_PortPin_P011_0
          WDT_EN: IoHwAbPortPinChRef=IoHwAbPortPinCh_PortPin_P011_1
          VBAT_CTRL: IoHwAbPortPinChRef=IoHwAbPortPinCh_PortPin_P013_4
          VBAT_SW_CTRL: IoHwAbPortPinChRef=IoHwAbPortPinCh_PortPin_P013_5
          VCC33_CTRL: IoHwAbPortPinChRef=IoHwAbPortPinCh_PortPin_P013_6
          NFC1_WAKEUP: IoHwAbPortPinChRef=IoHwAbPortPinCh_PortPin_P014_0
          NFC1_IRQ: IoHwAbPortPinChRef=IoHwAbPortPinCh_PortPin_P014_1
          NFC2_WAKEUP: IoHwAbPortPinChRef=IoHwAbPortPinCh_PortPin_P006_5
          NFC2_IRQ: IoHwAbPortPinChRef=IoHwAbPortPinCh_PortPin_P008_0
          BCAN_EN: IoHwAbPortPinChRef=IoHwAbPortPinCh_PortPin_P005_3
          BCAN_STB: IoHwAbPortPinChRef=IoHwAbPortPinCh_PortPin_P006_1
          BCAN_RX: IoHwAbPortPinChRef=IoHwAbPortPinCh_PortPin_P006_3
          BCAN_ERR: IoHwAbPortPinChRef=IoHwAbPortPinCh_PortPin_P006_0
          LCAN_EN: IoHwAbPortPinChRef=IoHwAbPortPinCh_PortPin_P018_5
          LCAN_STB: IoHwAbPortPinChRef=IoHwAbPortPinCh_PortPin_P018_7
          LCAN_RX: IoHwAbPortPinChRef=IoHwAbPortPinCh_PortPin_P019_1
          LCAN_ERR: IoHwAbPortPinChRef=IoHwAbPortPinCh_PortPin_P018_6
          FAN1_PULSE: IoHwAbPortPinChRef=IoHwAbPortPinCh_PortPin_P012_0
          FAN2_PULSE: IoHwAbPortPinChRef=IoHwAbPortPinCh_PortPin_P012_2
      IoHwAbGpt
        IoHwAbGptLogical_GptTest (IoHwAbGptLogical): IoHwAbGptCallbackViaRte=1, IoHwAbHwGptChRef=GptChannelConfiguration_GptTest
      IoHwAbIOManager:
        IoHwAbUseLowPowerFlag = 0
        IoHwAbUsePmModule = 0
        IoHwAbUseAnalogInput = 1
        IoHwAbUseDigitalInput = 1
        IoHwAbUseDigitalOutput = 0
        IoHwAbUseInputSupplySwitch = 0
        IoHwAbUseVoltageMonitoring = 0
        IoHwAbMultipleActivationDelay = 200
        IoHwAbTaskFG1Ref = OsTask_BSW_FG1_IOManager
        IoHwAbTaskFG2Ref = OsTask_BSW_FG2_IOManager
        IoHwAbAnalogInput
        IoHwAbIOMTimer: IoHwAbGptChRef=GptChannelConfiguration_IOManager
        IoHwAbInputSupplySwitch
      IoHwAbPwm
        6 x IoHwAbPwmLogical, all with IoHwAbPwmCallbackViaRte=0:
          FANPWM1: IoHwAbHwPwmChRef=PwmChannel_FANPWM1_Port12_1
          FANPWM2: IoHwAbHwPwmChRef=PwmChannel_FANPWM2_Port12_3
          AmberIND1: IoHwAbHwPwmChRef=PwmChannel_AmberIND1_Port0_0
          AmberIND2: IoHwAbHwPwmChRef=PwmChannel_AmberIND2_Port2_1
          GreenIND1: IoHwAbHwPwmChRef=PwmChannel_GreenIND1_Port0_1
          GreenIND2: IoHwAbHwPwmChRef=PwmChannel_GreenIND2_Port2_2
    IoHwAbGeneral: IoHwAbDevErrorDetect=1, IoHwAbVersionInfoApi=0, IoHwAbMcalVendorVersion=CYPRESS_CYT2B9XX
      IoHwAbAdcSetting: IoHwAbAdcReadDirectMaxDelay=10000
        IoHwAbAdcAllGroups: IoHwAbHwAdcAllGroupRef=AdcGroup_U2All
        IoHwAbAdcGroups
          IoHwAbAdcGroup_U0C16 (IoHwAbAdcGroup): IoHwAbHwAdcGroupRef=AdcGroup_U0C16
          IoHwAbAdcGroup_U0C17 (IoHwAbAdcGroup): IoHwAbHwAdcGroupRef=AdcGroup_U0C17
      IoHwAbPortPinChs
        21 x IoHwAbPortPinCh:
          IoHwAbPortPinCh_PortPin_P006_3: IoHwAbPolarity=HighActive, IoHwAbHwDioChRef=DioChannel_P006_3, IoHwAbHwPortPinRef=PortPin_P006_3
          IoHwAbPortPinCh_PortPin_P019_1: IoHwAbPolarity=HighActive, IoHwAbHwDioChRef=DioChannel_P019_1, IoHwAbHwPortPinRef=PortPin_P019_1
          IoHwAbPortPinCh_PortPin_P005_3: IoHwAbPolarity=HighActive, IoHwAbHwDioChRef=DioChannel_P005_3, IoHwAbHwPortPinRef=PortPin_P005_3
          IoHwAbPortPinCh_PortPin_P006_0: IoHwAbPolarity=HighActive, IoHwAbHwDioChRef=DioChannel_P006_0, IoHwAbHwPortPinRef=PortPin_P006_0
          IoHwAbPortPinCh_PortPin_P006_1: IoHwAbPolarity=HighActive, IoHwAbHwDioChRef=DioChannel_P006_1, IoHwAbHwPortPinRef=PortPin_P006_1
          IoHwAbPortPinCh_PortPin_P006_5: IoHwAbPolarity=HighActive, IoHwAbHwDioChRef=DioChannel_P006_5, IoHwAbHwPortPinRef=PortPin_P006_5
          IoHwAbPortPinCh_PortPin_P008_0: IoHwAbPolarity=HighActive, IoHwAbHwDioChRef=DioChannel_P008_0, IoHwAbHwPortPinRef=PortPin_P008_0
          IoHwAbPortPinCh_PortPin_P011_0: IoHwAbPolarity=HighActive, IoHwAbHwDioChRef=DioChannel_P011_0, IoHwAbHwPortPinRef=PortPin_P011_0
          IoHwAbPortPinCh_PortPin_P011_1: IoHwAbPolarity=LowActive, IoHwAbHwDioChRef=DioChannel_P011_1, IoHwAbHwPortPinRef=PortPin_P011_1
          IoHwAbPortPinCh_PortPin_P011_2: IoHwAbPolarity=LowActive, IoHwAbHwDioChRef=DioChannel_P011_2, IoHwAbHwPortPinRef=PortPin_P011_2
          IoHwAbPortPinCh_PortPin_P012_0: IoHwAbPolarity=HighActive, IoHwAbHwDioChRef=DioChannel_P012_0, IoHwAbHwPortPinRef=PortPin_P012_0
          IoHwAbPortPinCh_PortPin_P012_2: IoHwAbPolarity=HighActive, IoHwAbHwDioChRef=DioChannel_P012_2, IoHwAbHwPortPinRef=PortPin_P012_2
          IoHwAbPortPinCh_PortPin_P013_4: IoHwAbPolarity=HighActive, IoHwAbHwDioChRef=DioChannel_P013_4, IoHwAbHwPortPinRef=PortPin_P013_4
          IoHwAbPortPinCh_PortPin_P013_5: IoHwAbPolarity=HighActive, IoHwAbHwDioChRef=DioChannel_P013_5, IoHwAbHwPortPinRef=PortPin_P013_5
          IoHwAbPortPinCh_PortPin_P013_6: IoHwAbPolarity=LowActive, IoHwAbHwDioChRef=DioChannel_P013_6, IoHwAbHwPortPinRef=PortPin_P013_6
          IoHwAbPortPinCh_PortPin_P013_7: IoHwAbPolarity=LowActive, IoHwAbHwDioChRef=DioChannel_P013_7, IoHwAbHwPortPinRef=PortPin_P013_7
          IoHwAbPortPinCh_PortPin_P014_0: IoHwAbPolarity=HighActive, IoHwAbHwDioChRef=DioChannel_P014_0, IoHwAbHwPortPinRef=PortPin_P014_0
          IoHwAbPortPinCh_PortPin_P014_1: IoHwAbPolarity=HighActive, IoHwAbHwDioChRef=DioChannel_P014_1, IoHwAbHwPortPinRef=PortPin_P014_1
          IoHwAbPortPinCh_PortPin_P018_{5..7}: IoHwAbPolarity=HighActive, IoHwAbHwDioChRef=DioChannel_P018_{5..7}, IoHwAbHwPortPinRef=PortPin_P018_{5..7}
      IoHwAbPrefixConfig
