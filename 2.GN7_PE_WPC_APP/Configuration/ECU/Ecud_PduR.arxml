AUTOSAR XML (schema 4-0-3)
package /AUTOSAR
  module config PduR: implementation-config-variant=VARIANT-PRE-COMPILE, module-description=BswImplementation_PduR
    PduRGeneral: PduRDevErrorDetect=1, PduRVersionInfoApi=0, PduRZeroCostOperation=0, PduRRxInterruptBased=0, PduRTxInterruptBased=0, PduRSharedGatewayIfBuffer=0
    PduRRoutingTables: PduRConfigurationId=0
      PduRRoutingTable: category=TOOL_CONFIGURED, PduRIsMinimumRouting=0
        45 x PduRRoutingPath, all with category=TOOL_CONFIGURED:
          IN_BCAN_VCU_01_10ms_RoutingPath
            PduR_BCAN_VCU_01_10ms_DestPdu (PduRDestPdu): category=TOOL_CONFIGURED, PduRDestPduHandleId=0, PduRTransmissionConfirmation=1, PduRDestPduRef=Pdu_ISignalIPdu_BCAN_VCU_01_10ms
            PduR_BCAN_VCU_01_10ms_SrcPdu (PduRSrcPdu): category=TOOL_CONFIGURED, PduRSourcePduHandleId=0, PduRSrcPduRef=Pdu_ISignalIPdu_BCAN_VCU_01_10ms
          IN_BCAN_BDC_FD_SMK_02_200ms_RoutingPath
            PduR_BCAN_BDC_FD_SMK_02_200ms_DestPdu (PduRDestPdu): category=TOOL_CONFIGURED, PduRDestPduHandleId=1, PduRTransmissionConfirmation=1, PduRDestPduRef=Pdu_ISignalIPdu_BCAN_BDC_FD_SMK_02_200ms
            PduR_BCAN_BDC_FD_SMK_02_200ms_SrcPdu (PduRSrcPdu): category=TOOL_CONFIGURED, PduRSourcePduHandleId=1, PduRSrcPduRef=Pdu_ISignalIPdu_BCAN_BDC_FD_SMK_02_200ms
          IN_BCAN_CLU_05_00ms_RoutingPath
            PduR_BCAN_CLU_05_00ms_DestPdu (PduRDestPdu): category=TOOL_CONFIGURED, PduRDestPduHandleId=2, PduRTransmissionConfirmation=1, PduRDestPduRef=Pdu_ISignalIPdu_BCAN_CLU_05_00ms
            PduR_BCAN_CLU_05_00ms_SrcPdu (PduRSrcPdu): category=TOOL_CONFIGURED, PduRSourcePduHandleId=2, PduRSrcPduRef=Pdu_ISignalIPdu_BCAN_CLU_05_00ms
          IN_BCAN_CLU_09_00ms_RoutingPath
            PduR_BCAN_CLU_09_00ms_DestPdu (PduRDestPdu): category=TOOL_CONFIGURED, PduRDestPduHandleId=3, PduRTransmissionConfirmation=1, PduRDestPduRef=Pdu_ISignalIPdu_BCAN_CLU_09_00ms
            PduR_BCAN_CLU_09_00ms_SrcPdu (PduRSrcPdu): category=TOOL_CONFIGURED, PduRSourcePduHandleId=3, PduRSrcPduRef=Pdu_ISignalIPdu_BCAN_CLU_09_00ms
          IN_BCAN_HCU_03_10ms_RoutingPath
            PduR_BCAN_HCU_03_10ms_DestPdu (PduRDestPdu): category=TOOL_CONFIGURED, PduRDestPduHandleId=4, PduRTransmissionConfirmation=1, PduRDestPduRef=Pdu_ISignalIPdu_BCAN_HCU_03_10ms
            PduR_BCAN_HCU_03_10ms_SrcPdu (PduRSrcPdu): category=TOOL_CONFIGURED, PduRSourcePduHandleId=4, PduRSrcPduRef=Pdu_ISignalIPdu_BCAN_HCU_03_10ms
          IN_BCAN_HU_USM_02_00ms_RoutingPath
            PduR_BCAN_HU_USM_02_00ms_DestPdu (PduRDestPdu): category=TOOL_CONFIGURED, PduRDestPduHandleId=5, PduRTransmissionConfirmation=1, PduRDestPduRef=Pdu_ISignalIPdu_BCAN_HU_USM_02_00ms
            PduR_BCAN_HU_USM_02_00ms_SrcPdu (PduRSrcPdu): category=TOOL_CONFIGURED, PduRSourcePduHandleId=5, PduRSrcPduRef=Pdu_ISignalIPdu_BCAN_HU_USM_02_00ms
          IN_BCAN_HU_USM_01_00ms_RoutingPath
            PduR_BCAN_HU_USM_01_00ms_DestPdu (PduRDestPdu): category=TOOL_CONFIGURED, PduRDestPduHandleId=6, PduRTransmissionConfirmation=1, PduRDestPduRef=Pdu_ISignalIPdu_BCAN_HU_USM_01_00ms
            PduR_BCAN_HU_USM_01_00ms_SrcPdu (PduRSrcPdu): category=TOOL_CONFIGURED, PduRSourcePduHandleId=6, PduRSrcPduRef=Pdu_ISignalIPdu_BCAN_HU_USM_01_00ms
          IN_BCAN_HU_USM_05_00ms_RoutingPath
            PduR_BCAN_HU_USM_05_00ms_DestPdu (PduRDestPdu): category=TOOL_CONFIGURED, PduRDestPduHandleId=7, PduRTransmissionConfirmation=1, PduRDestPduRef=Pdu_ISignalIPdu_BCAN_HU_USM_05_00ms
            PduR_BCAN_HU_USM_05_00ms_SrcPdu (PduRSrcPdu): category=TOOL_CONFIGURED, PduRSourcePduHandleId=7, PduRSrcPduRef=Pdu_ISignalIPdu_BCAN_HU_USM_05_00ms
          IN_BCAN_SBCM_RR_FD_01_200ms_RoutingPath
            PduR_BCAN_SBCM_RR_FD_01_200ms_DestPdu (PduRDestPdu): category=TOOL_CONFIGURED, PduRDestPduHandleId=8, PduRTransmissionConfirmation=1, PduRDestPduRef=Pdu_ISignalIPdu_BCAN_SBCM_RR_FD_01_200ms
            PduR_BCAN_SBCM_RR_FD_01_200ms_SrcPdu (PduRSrcPdu): category=TOOL_CONFIGURED, PduRSourcePduHandleId=8, PduRSrcPduRef=Pdu_ISignalIPdu_BCAN_SBCM_RR_FD_01_200ms
          IN_BCAN_SBCM_RL_FD_01_200ms_RoutingPath
            PduR_BCAN_SBCM_RL_FD_01_200ms_DestPdu (PduRDestPdu): category=TOOL_CONFIGURED, PduRDestPduHandleId=9, PduRTransmissionConfirmation=1, PduRDestPduRef=Pdu_ISignalIPdu_BCAN_SBCM_RL_FD_01_200ms
            PduR_BCAN_SBCM_RL_FD_01_200ms_SrcPdu (PduRSrcPdu): category=TOOL_CONFIGURED, PduRSourcePduHandleId=9, PduRSrcPduRef=Pdu_ISignalIPdu_BCAN_SBCM_RL_FD_01_200ms
          IN_BCAN_EMS_02_10ms_RoutingPath
            PduR_BCAN_EMS_02_10ms_DestPdu (PduRDestPdu): category=TOOL_CONFIGURED, PduRDestPduHandleId=10, PduRTransmissionConfirmation=1, PduRDestPduRef=Pdu_ISignalIPdu_BCAN_EMS_02_10ms
            PduR_BCAN_EMS_02_10ms_SrcPdu (PduRSrcPdu): category=TOOL_CONFIGURED, PduRSourcePduHandleId=10, PduRSrcPduRef=Pdu_ISignalIPdu_BCAN_EMS_02_10ms
          IN_BCAN_EMS_07_10ms_RoutingPath
            PduR_BCAN_EMS_07_10ms_DestPdu (PduRDestPdu): category=TOOL_CONFIGURED, PduRDestPduHandleId=11, PduRTransmissionConfirmation=1, PduRDestPduRef=Pdu_ISignalIPdu_BCAN_EMS_07_10ms
            PduR_BCAN_EMS_07_10ms_SrcPdu (PduRSrcPdu): category=TOOL_CONFIGURED, PduRSourcePduHandleId=11, PduRSrcPduRef=Pdu_ISignalIPdu_BCAN_EMS_07_10ms
          IN_BCAN_SBCM_DRV_FD_01_200ms_RoutingPath
            PduR_BCAN_SBCM_DRV_FD_01_200ms_DestPdu (PduRDestPdu): category=TOOL_CONFIGURED, PduRDestPduHandleId=12, PduRTransmissionConfirmation=1, PduRDestPduRef=Pdu_ISignalIPdu_BCAN_SBCM_DRV_FD_01_200ms
            PduR_BCAN_SBCM_DRV_FD_01_200ms_SrcPdu (PduRSrcPdu): category=TOOL_CONFIGURED, PduRSourcePduHandleId=12, PduRSrcPduRef=Pdu_ISignalIPdu_BCAN_SBCM_DRV_FD_01_200ms
          IN_BCAN_SBCM_AST_FD_01_200ms_RoutingPath
            PduR_BCAN_SBCM_AST_FD_01_200ms_DestPdu (PduRDestPdu): category=TOOL_CONFIGURED, PduRDestPduHandleId=13, PduRTransmissionConfirmation=1, PduRDestPduRef=Pdu_ISignalIPdu_BCAN_SBCM_AST_FD_01_200ms
            PduR_BCAN_SBCM_AST_FD_01_200ms_SrcPdu (PduRSrcPdu): category=TOOL_CONFIGURED, PduRSourcePduHandleId=13, PduRSrcPduRef=Pdu_ISignalIPdu_BCAN_SBCM_AST_FD_01_200ms
          IN_BCAN_CLU_20_200ms_RoutingPath
            PduR_BCAN_CLU_20_200ms_DestPdu (PduRDestPdu): category=TOOL_CONFIGURED, PduRDestPduHandleId=14, PduRTransmissionConfirmation=1, PduRDestPduRef=Pdu_ISignalIPdu_BCAN_CLU_20_200ms
            PduR_BCAN_CLU_20_200ms_SrcPdu (PduRSrcPdu): category=TOOL_CONFIGURED, PduRSourcePduHandleId=14, PduRSrcPduRef=Pdu_ISignalIPdu_BCAN_CLU_20_200ms
          IN_BCAN_RWPC_FD_01_200ms_RoutingPath
            PduR_BCAN_RWPC_FD_01_200ms_DestPdu (PduRDestPdu): category=TOOL_CONFIGURED, PduRDestPduHandleId=15, PduRTransmissionConfirmation=1, PduRDestPduRef=Pdu_ISignalIPdu_BCAN_RWPC_FD_01_200ms
            PduR_BCAN_RWPC_FD_01_200ms_SrcPdu (PduRSrcPdu): category=TOOL_CONFIGURED, PduRSourcePduHandleId=15, PduRSrcPduRef=Pdu_ISignalIPdu_BCAN_RWPC_FD_01_200ms
          IN_BCAN_HU_GW_03_200ms_RoutingPath
            PduR_BCAN_HU_GW_03_200ms_DestPdu (PduRDestPdu): category=TOOL_CONFIGURED, PduRDestPduHandleId=16, PduRTransmissionConfirmation=1, PduRDestPduRef=Pdu_ISignalIPdu_BCAN_HU_GW_03_200ms
            PduR_BCAN_HU_GW_03_200ms_SrcPdu (PduRSrcPdu): category=TOOL_CONFIGURED, PduRSourcePduHandleId=16, PduRSrcPduRef=Pdu_ISignalIPdu_BCAN_HU_GW_03_200ms
          IN_BCAN_GST_WPC_RoutingPath
            PduR_DcmIPdu_BCAN_GST_WPC_DestPdu (PduRDestPdu): category=TOOL_CONFIGURED, PduRDestPduHandleId=0, PduRTransmissionConfirmation=1, PduRDestPduRef=Pdu_DcmIPdu_BCAN_GST_WPC
            PduR_DcmIPdu_BCAN_GST_WPC_SrcPdu (PduRSrcPdu): category=TOOL_CONFIGURED, PduRSourcePduHandleId=0, PduRSrcPduRef=Pdu_DcmIPdu_BCAN_GST_WPC
          IN_BCAN_IAU_FD_04_200ms_RoutingPath
            PduR_BCAN_IAU_FD_04_200ms_DestPdu (PduRDestPdu): category=TOOL_CONFIGURED, PduRDestPduHandleId=17, PduRTransmissionConfirmation=1, PduRDestPduRef=Pdu_ISignalIPdu_BCAN_IAU_FD_04_200ms
            PduR_BCAN_IAU_FD_04_200ms_SrcPdu (PduRSrcPdu): category=TOOL_CONFIGURED, PduRSourcePduHandleId=17, PduRSrcPduRef=Pdu_ISignalIPdu_BCAN_IAU_FD_04_200ms
          IN_BCAN_GST_ALL_RoutingPath
            PduR_DcmIPdu_BCAN_GST_ALL_DestPdu (PduRDestPdu): category=TOOL_CONFIGURED, PduRDestPduHandleId=1, PduRTransmissionConfirmation=1, PduRDestPduRef=Pdu_DcmIPdu_BCAN_GST_ALL
            PduR_DcmIPdu_BCAN_GST_ALL_SrcPdu (PduRSrcPdu): category=TOOL_CONFIGURED, PduRSourcePduHandleId=1, PduRSrcPduRef=Pdu_DcmIPdu_BCAN_GST_ALL
          IN_BCAN_CLU_01_20ms_RoutingPath
            PduR_BCAN_CLU_01_20ms_DestPdu (PduRDestPdu): category=TOOL_CONFIGURED, PduRDestPduHandleId=18, PduRTransmissionConfirmation=1, PduRDestPduRef=Pdu_ISignalIPdu_BCAN_CLU_01_20ms
            PduR_BCAN_CLU_01_20ms_SrcPdu (PduRSrcPdu): category=TOOL_CONFIGURED, PduRSourcePduHandleId=18, PduRSrcPduRef=Pdu_ISignalIPdu_BCAN_CLU_01_20ms
          IN_BCAN_PDC_FD_03_200ms_RoutingPath
            PduR_BCAN_PDC_FD_03_200ms_DestPdu (PduRDestPdu): category=TOOL_CONFIGURED, PduRDestPduHandleId=19, PduRTransmissionConfirmation=1, PduRDestPduRef=Pdu_ISignalIPdu_BCAN_PDC_FD_03_200ms
            PduR_BCAN_PDC_FD_03_200ms_SrcPdu (PduRSrcPdu): category=TOOL_CONFIGURED, PduRSourcePduHandleId=19, PduRSrcPduRef=Pdu_ISignalIPdu_BCAN_PDC_FD_03_200ms
          IN_BCAN_BDC_FD_02_200ms_RoutingPath
            PduR_BCAN_BDC_FD_02_200ms_DestPdu (PduRDestPdu): category=TOOL_CONFIGURED, PduRDestPduHandleId=20, PduRTransmissionConfirmation=1, PduRDestPduRef=Pdu_ISignalIPdu_BCAN_BDC_FD_02_200ms
            PduR_BCAN_BDC_FD_02_200ms_SrcPdu (PduRSrcPdu): category=TOOL_CONFIGURED, PduRSourcePduHandleId=20, PduRSrcPduRef=Pdu_ISignalIPdu_BCAN_BDC_FD_02_200ms
          IN_BCAN_BDC_FD_05_200ms_RoutingPath
            PduR_BCAN_BDC_FD_05_200ms_DestPdu (PduRDestPdu): category=TOOL_CONFIGURED, PduRDestPduHandleId=21, PduRTransmissionConfirmation=1, PduRDestPduRef=Pdu_ISignalIPdu_BCAN_BDC_FD_05_200ms
            PduR_BCAN_BDC_FD_05_200ms_SrcPdu (PduRSrcPdu): category=TOOL_CONFIGURED, PduRSourcePduHandleId=21, PduRSrcPduRef=Pdu_ISignalIPdu_BCAN_BDC_FD_05_200ms
          IN_LCAN_L_BDC_FD_IAU_01_00ms_RoutingPath
            PduR_LCAN_L_BDC_FD_IAU_01_00ms_DestPdu (PduRDestPdu): category=TOOL_CONFIGURED, PduRDestPduHandleId=22, PduRTransmissionConfirmation=1, PduRDestPduRef=Pdu_ISignalIPdu_LCAN_L_BDC_FD_IAU_01_00ms
            PduR_LCAN_L_BDC_FD_IAU_01_00ms_SrcPdu (PduRSrcPdu): category=TOOL_CONFIGURED, PduRSourcePduHandleId=22, PduRSrcPduRef=Pdu_ISignalIPdu_LCAN_L_BDC_FD_IAU_01_00ms
          IN_LCAN_L_BDC_FD_IAU_10_200ms_RoutingPath
            PduR_LCAN_L_BDC_FD_IAU_10_200ms_DestPdu (PduRDestPdu): category=TOOL_CONFIGURED, PduRDestPduHandleId=23, PduRTransmissionConfirmation=1, PduRDestPduRef=Pdu_ISignalIPdu_LCAN_L_BDC_FD_IAU_10_200ms
            PduR_LCAN_L_BDC_FD_IAU_10_200ms_SrcPdu (PduRSrcPdu): category=TOOL_CONFIGURED, PduRSourcePduHandleId=23, PduRSrcPduRef=Pdu_ISignalIPdu_LCAN_L_BDC_FD_IAU_10_200ms
          IN_LCAN_IAU_FD_05_200ms_RoutingPath
            PduR_LCAN_IAU_FD_05_200ms_DestPdu (PduRDestPdu): category=TOOL_CONFIGURED, PduRDestPduHandleId=24, PduRTransmissionConfirmation=1, PduRDestPduRef=Pdu_ISignalIPdu_LCAN_IAU_FD_05_200ms
            PduR_LCAN_IAU_FD_05_200ms_SrcPdu (PduRSrcPdu): category=TOOL_CONFIGURED, PduRSourcePduHandleId=24, PduRSrcPduRef=Pdu_ISignalIPdu_LCAN_IAU_FD_05_200ms
          IN_LCAN_IAU_FD_04_200ms_RoutingPath
            PduR_LCAN_IAU_FD_04_200ms_DestPdu (PduRDestPdu): category=TOOL_CONFIGURED, PduRDestPduHandleId=25, PduRTransmissionConfirmation=1, PduRDestPduRef=Pdu_ISignalIPdu_LCAN_IAU_FD_04_200ms
            PduR_LCAN_IAU_FD_04_200ms_SrcPdu (PduRSrcPdu): category=TOOL_CONFIGURED, PduRSourcePduHandleId=25, PduRSrcPduRef=Pdu_ISignalIPdu_LCAN_IAU_FD_04_200ms
          IN_LCAN_CCU_01_00ms_RoutingPath
            PduR_LCAN_CCU_01_00ms_DestPdu (PduRDestPdu): category=TOOL_CONFIGURED, PduRDestPduHandleId=26, PduRTransmissionConfirmation=1, PduRDestPduRef=Pdu_ISignalIPdu_LCAN_CCU_01_00ms
            PduR_LCAN_CCU_01_00ms_SrcPdu (PduRSrcPdu): category=TOOL_CONFIGURED, PduRSourcePduHandleId=26, PduRSrcPduRef=Pdu_ISignalIPdu_LCAN_CCU_01_00ms
          IN_LCAN_L_TP_BDC_FD_L_WPC_FD_RoutingPath
            PduR_LCAN_L_TP_BDC_FD_L_WPC_FD_DestPdu (PduRDestPdu): category=TOOL_CONFIGURED, PduRDestPduHandleId=2, PduRTransmissionConfirmation=1, PduRDestPduRef=Pdu_ISignalIPdu_LCAN_L_TP_BDC_FD_L_WPC_FD
            PduR_LCAN_L_TP_BDC_FD_L_WPC_FD_SrcPdu (PduRSrcPdu): category=TOOL_CONFIGURED, PduRSourcePduHandleId=2, PduRSrcPduRef=Pdu_ISignalIPdu_LCAN_L_TP_BDC_FD_L_WPC_FD
          IN_ComMPdu_Rx_EIRA_CanNm_RoutingPath
            PduR_Rx_EIRA_CanNm_DestPdu (PduRDestPdu): category=TOOL_CONFIGURED, PduRTransmissionConfirmation=1, PduRDestPduHandleId=27, PduRDestPduRef=Pdu_ComMPdu_Rx_EIRA_CanNm
            PduR_Rx_EIRA_CanNm_SrcPdu (PduRSrcPdu): category=TOOL_CONFIGURED, PduRSourcePduHandleId=27, PduRSrcPduRef=Pdu_ComMPdu_Rx_EIRA_CanNm
          OUT_BCAN_WPC_FD_VCRM_01_00ms_RoutingPath
            PduR_BCAN_WPC_FD_VCRM_01_00ms_DestPdu (PduRDestPdu): category=TOOL_CONFIGURED, PduRDestPduHandleId=0, PduRTransmissionConfirmation=1, PduRDestPduRef=Pdu_ISignalIPdu_BCAN_WPC_FD_VCRM_01_00ms
            PduR_BCAN_WPC_FD_VCRM_01_00ms_SrcPdu (PduRSrcPdu): category=TOOL_CONFIGURED, PduRSourcePduHandleId=0, PduRSrcPduRef=Pdu_ISignalIPdu_BCAN_WPC_FD_VCRM_01_00ms
          OUT_BCAN_WPC_GST_RoutingPath
            PduR_DcmIPdu_BCAN_WPC_GST_DestPdu (PduRDestPdu): category=TOOL_CONFIGURED, PduRDestPduHandleId=0, PduRTransmissionConfirmation=1, PduRDestPduRef=Pdu_DcmIPdu_BCAN_WPC_GST
            PduR_DcmIPdu_BCAN_WPC_GST_SrcPdu (PduRSrcPdu): category=TOOL_CONFIGURED, PduRSourcePduHandleId=1, PduRSrcPduRef=Pdu_DcmIPdu_BCAN_WPC_GST
          OUT_BCAN_WPC_FD_01_200ms_RoutingPath
            PduR_BCAN_WPC_FD_01_200ms_DestPdu (PduRDestPdu): category=TOOL_CONFIGURED, PduRDestPduHandleId=1, PduRTransmissionConfirmation=1, PduRDestPduRef=Pdu_ISignalIPdu_BCAN_WPC_FD_01_200ms
            PduR_BCAN_WPC_FD_01_200ms_SrcPdu (PduRSrcPdu): category=TOOL_CONFIGURED, PduRSourcePduHandleId=2, PduRSrcPduRef=Pdu_ISignalIPdu_BCAN_WPC_FD_01_200ms
          OUT_LCAN_L_WPC_FD_01_00ms_RoutingPath
            PduR_LCAN_L_WPC_FD_01_00ms_DestPdu (PduRDestPdu): category=TOOL_CONFIGURED, PduRDestPduHandleId=2, PduRTransmissionConfirmation=1, PduRDestPduRef=Pdu_ISignalIPdu_LCAN_L_WPC_FD_01_00ms
            PduR_LCAN_L_WPC_FD_01_00ms_SrcPdu (PduRSrcPdu): category=TOOL_CONFIGURED, PduRSourcePduHandleId=3, PduRSrcPduRef=Pdu_ISignalIPdu_LCAN_L_WPC_FD_01_00ms
          OUT_LCAN_L_WPC_FD_20_200ms_RoutingPath
            PduR_LCAN_L_WPC_FD_20_200ms_DestPdu (PduRDestPdu): category=TOOL_CONFIGURED, PduRDestPduHandleId=3, PduRTransmissionConfirmation=1, PduRDestPduRef=Pdu_ISignalIPdu_LCAN_L_WPC_FD_20_200ms
            PduR_LCAN_L_WPC_FD_20_200ms_SrcPdu (PduRSrcPdu): category=TOOL_CONFIGURED, PduRSourcePduHandleId=4, PduRSrcPduRef=Pdu_ISignalIPdu_LCAN_L_WPC_FD_20_200ms
          OUT_LCAN_L_TP_L_WPC_FD_BDC_FD_RoutingPath
            PduR_LCAN_L_TP_L_WPC_FD_BDC_FD_DestPdu (PduRDestPdu): category=TOOL_CONFIGURED, PduRDestPduHandleId=1, PduRTransmissionConfirmation=1, PduRDestPduRef=Pdu_ISignalIPdu_LCAN_L_TP_L_WPC_FD_BDC_FD
            PduR_LCAN_L_TP_L_WPC_FD_BDC_FD_SrcPdu (PduRSrcPdu): category=TOOL_CONFIGURED, PduRSourcePduHandleId=5, PduRSrcPduRef=Pdu_ISignalIPdu_LCAN_L_TP_L_WPC_FD_BDC_FD
          OUT_ComMPdu_Tx_PncVector_BCAN_RoutingPath
            PduR_Tx_PncVector_BCAN_DestPdu (PduRDestPdu): category=TOOL_CONFIGURED, PduRTransmissionConfirmation=1, PduRDestPduHandleId=4, PduRDestPduRef=Pdu_ComMPdu_Tx_PncVector_BCAN
            PduR_Tx_PncVector_BCAN_SrcPdu (PduRSrcPdu): category=TOOL_CONFIGURED, PduRSourcePduHandleId=6, PduRSrcPduRef=Pdu_ComMPdu_Tx_PncVector_BCAN
          IN_LCAN_PDC_FD_15_300ms_RoutingPath
            PduR_LCAN_PDC_FD_15_300ms_DestPdu (PduRDestPdu): category=TOOL_CONFIGURED, PduRDestPduHandleId=28, PduRTransmissionConfirmation=1, PduRDestPduRef=Pdu_ISignalIPdu_LCAN_PDC_FD_15_300ms
            PduR_LCAN_PDC_FD_15_300ms_SrcPdu (PduRSrcPdu): category=TOOL_CONFIGURED, PduRSourcePduHandleId=28, PduRSrcPduRef=Pdu_ISignalIPdu_LCAN_PDC_FD_15_300ms
          OUT_ComMPdu_Tx_PncVector_LCAN_RoutingPath
            PduR_Tx_PncVector_LCAN_DestPdu (PduRDestPdu): category=TOOL_CONFIGURED, PduRTransmissionConfirmation=1, PduRDestPduHandleId=5, PduRDestPduRef=Pdu_ComMPdu_Tx_PncVector_LCAN
            PduR_Tx_PncVector_LCAN_SrcPdu (PduRSrcPdu): category=TOOL_CONFIGURED, PduRSourcePduHandleId=7, PduRSrcPduRef=Pdu_ComMPdu_Tx_PncVector_LCAN
          IN_BCAN_PDC_FD_15_300ms_RoutingPath
            PduR_BCAN_PDC_FD_15_300ms_DestPdu (PduRDestPdu): category=TOOL_CONFIGURED, PduRDestPduHandleId=29, PduRTransmissionConfirmation=1, PduRDestPduRef=Pdu_ISignalIPdu_BCAN_PDC_FD_15_300ms
            PduR_BCAN_PDC_FD_15_300ms_SrcPdu (PduRSrcPdu): category=TOOL_CONFIGURED, PduRSourcePduHandleId=29, PduRSrcPduRef=Pdu_ISignalIPdu_BCAN_PDC_FD_15_300ms
          IN_BCAN_HU_USM_04_00ms_RoutingPath
            PduR_BCAN_HU_USM_04_00ms_DestPdu (PduRDestPdu): category=TOOL_CONFIGURED, PduRDestPduHandleId=30, PduRTransmissionConfirmation=1, PduRDestPduRef=Pdu_ISignalIPdu_BCAN_HU_USM_04_00ms
            PduR_BCAN_HU_USM_04_00ms_SrcPdu (PduRSrcPdu): category=TOOL_CONFIGURED, PduRSourcePduHandleId=30, PduRSrcPduRef=Pdu_ISignalIPdu_BCAN_HU_USM_04_00ms
          OUT_BCAN_WPC2_FD_01_200ms_RoutingPath
            PduR_BCAN_WPC2_FD_01_200ms_DestPdu (PduRDestPdu): category=TOOL_CONFIGURED, PduRDestPduHandleId=6, PduRTransmissionConfirmation=1, PduRDestPduRef=Pdu_ISignalIPdu_BCAN_WPC2_FD_01_200ms
            PduR_BCAN_WPC2_FD_01_200ms_SrcPdu (PduRSrcPdu): category=TOOL_CONFIGURED, PduRSourcePduHandleId=8, PduRSrcPduRef=Pdu_ISignalIPdu_BCAN_WPC2_FD_01_200ms
          OUT_BCAN_WPCmsgDvp1_RoutingPath
            PduR_BCAN_WPCmsgDvp1_DestPdu (PduRDestPdu): category=TOOL_CONFIGURED, PduRDestPduHandleId=7, PduRTransmissionConfirmation=1, PduRDestPduRef=Pdu_ISignalIPdu_BCAN_WPCmsgDvp1
            PduR_BCAN_WPCmsgDvp1_SrcPdu (PduRSrcPdu): category=TOOL_CONFIGURED, PduRSourcePduHandleId=9, PduRSrcPduRef=Pdu_ISignalIPdu_BCAN_WPCmsgDvp1
          OUT_BCAN_WPC_WU_01_500ms_RoutingPath
            PduR_BCAN_WPC_WU_01_500ms_SrcPdu (PduRSrcPdu): category=TOOL_CONFIGURED, PduRSourcePduHandleId=10, PduRSrcPduRef=Pdu_ISignalIPdu_BCAN_WPC_WU_01_500ms
            PduR_BCAN_WPC_WU_01_500ms_DestPdu (PduRDestPdu): category=TOOL_CONFIGURED, PduRDestPduHandleId=8, PduRTransmissionConfirmation=1, PduRDestPduRef=Pdu_ISignalIPdu_BCAN_WPC_WU_01_500ms
      PduRRoutingPathGroup0 (PduRRoutingPathGroup): PduRIsEnabledAtInit=1, PduRRoutingPathGroupId=0
    10 x PduRBswModules, all with PduRChangeParameterRequestApi=0, PduRRetransmission=0, PduRTxConfirmation=1, PduRUseTag=0:
      PduRBswModules_CanIf: PduRCancelReceive=0, PduRCancelTransmit=0, PduRCommunicationInterface=1, PduRLowerModule=1, PduRTransportProtocol=0, PduRTriggertransmit=0, PduRUpperModule=0, PduRBswModuleRef=CanIf
      PduRBswModules_Com: PduRCancelReceive=0, PduRCancelTransmit=1, PduRCommunicationInterface=1, PduRLowerModule=0, PduRTransportProtocol=1, PduRTriggertransmit=1, PduRUpperModule=1, PduRBswModuleRef=Com
      PduRBswModules_Dcm: PduRCancelReceive=1, PduRCancelTransmit=1, PduRCommunicationInterface=0, PduRLowerModule=0, PduRTransportProtocol=1, PduRTriggertransmit=0, PduRUpperModule=1, PduRBswModuleRef=Dcm
      PduRBswModules_CDD_RouterIF: PduRCancelReceive=1, PduRCancelTransmit=1, PduRCommunicationInterface=1, PduRLowerModule=1, PduRTransportProtocol=0, PduRTriggertransmit=0, PduRUpperModule=0, PduRBswModuleRef=CDD_RouterIF
      PduRBswModules_CDD_RouterTP: PduRCancelReceive=1, PduRCancelTransmit=1, PduRCommunicationInterface=0, PduRLowerModule=1, PduRTransportProtocol=1, PduRTriggertransmit=0, PduRUpperModule=0, PduRBswModuleRef=CDD_RouterTP
      PduRBswModules_IpduM: PduRCancelReceive=0, PduRCancelTransmit=0, PduRCommunicationInterface=1, PduRLowerModule=1, PduRTransportProtocol=0, PduRTriggertransmit=0, PduRUpperModule=1, PduRBswModuleRef=IpduM
      PduRBswModules_CanNm: PduRCancelReceive=0, PduRCancelTransmit=0, PduRCommunicationInterface=1, PduRLowerModule=1, PduRTransportProtocol=0, PduRTriggertransmit=1, PduRUpperModule=0, PduRBswModuleRef=CanNm
      PduRBswModules_CanTp: PduRCancelReceive=1, PduRCancelTransmit=1, PduRCommunicationInterface=0, PduRLowerModule=1, PduRTransportProtocol=1, PduRTriggertransmit=0, PduRUpperModule=0, PduRBswModuleRef=CanTp
      PduRBswModules_CDD_IPC_TP: PduRCancelReceive=0, PduRCancelTransmit=0, PduRCommunicationInterface=0, PduRLowerModule=1, PduRTransportProtocol=1, PduRTriggertransmit=0, PduRUpperModule=0, PduRBswModuleRef=CDD_IPC_TP
      PduRBswModules_CDD_IPC_IF: PduRCancelReceive=0, PduRCancelTransmit=0, PduRCommunicationInterface=1, PduRLowerModule=1, PduRTransportProtocol=0, PduRTriggertransmit=0, PduRUpperModule=0, PduRBswModuleRef=CDD_IPC_IF
