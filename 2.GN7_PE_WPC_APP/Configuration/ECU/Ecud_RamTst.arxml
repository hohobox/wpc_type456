AUTOSAR XML (schema 4-0-3)
package /AUTOSAR
  module config RamTst: implementation-config-variant=VARIANT-PRE-COMPILE, module-description=BswImplementation_RamTst
    RamTstCommon:
      RamTstAllowApi = 0
      RamTstChangeNumOfTestedCellsApi = 0
      RamTstDevErrorDetect = 1
      RamTstGetAlgParamsApi = 1
      RamTstGetExecutionStatusApi = 1
      RamTstGetTestAlgorithmApi = 1
      RamTstGetTestResultApi = 1
      RamTstGetTestResultPerBlockApi = 1
      RamTstGetVersionInfoApi = 0
      RamTstResumeApi = 0
      RamTstRunFullTestApi = 1
      RamTstRunPartialTestApi = 1
      RamTstSelectAlgParamsApi = 1
      RamTstStopApi = 1
      RamTstSuspendApi = 0
      RamTstParityBit = EVEN_PARITY
      RamTstCrcAlgorithm = RAMTST_CRC_8
      RamTstChkTransitionOneToZero = 1
      RamTstGetNumberOfTestedCellsApi = 0
      RamTstAlgorithms:
        RamTstAbrahamTestSelected = 0
        RamTstCheckerboardTestSelected = 0
        RamTstGalpatTestSelected = 0
        RamTstMarchTestSelected = 0
        RamTstTranspGalpatTestSelected = 0
        RamTstWalkPathTestSelected = 0
        RamTstLowCoverageTestSelected = 0
        RamTstMediumCoverageTestSelected = 1
        RamTstHighCoverageTestSelected = 0
      RamTstConfigParams:
        RamTstDefaultAlgParamsId = 1
        RamTstMinNumberOfTestedCells = 1
        RamTstNumberOfAlgParamSets = 1
        RamTstTestCompletedNotification = NULL_PTR
        RamTstTestErrorNotification = NULL_PTR
        AlgParams_MED (RamTstAlgParams):
          RamTstAlgParamsId = 1
          RamTstAlgorithmCoverage = RAMTST_ALGORITHM_COVERAGE_MEDIUM
          RamTstExtNumberOfTestedCells = 5
          RamTstMaxNumberOfTestedCells = 4
          RamTstNumberOfBlocks = 2
          RamTstNumberOfTestedCells = 1
          RamTstBlockParams_0 (RamTstBlockParams): RamTstBlockId=1, RamTstStartAddress=0x0803FFA0, RamTstEndAddress=0x0803FFA7, RamTstFillPattern=0, RamTstTestPolicy=RAMTEST_NON_DESTRUCTIVE
          RamTstBlockParams_1 (RamTstBlockParams): RamTstBlockId=2, RamTstStartAddress=0x0803FFB0, RamTstEndAddress=0x0803FFB7, RamTstFillPattern=0, RamTstTestPolicy=RAMTEST_NON_DESTRUCTIVE
    RamTstDemEventParameterRefs: RAMTST_E_RAM_FAILURE=RAMTST_E_RAM_FAILURE
    RamTstPublishedInformation: RamTstCellSize=32
