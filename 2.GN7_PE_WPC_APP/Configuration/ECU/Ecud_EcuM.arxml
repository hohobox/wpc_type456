AUTOSAR XML (schema 4-0-3)
package /AUTOSAR
  module config EcuM: implementation-config-variant=VARIANT-PRE-COMPILE, module-description=BswImplementation_EcuM
    EcuMConfiguration
      EcuMCommonConfiguration: category=TOOL_CONFIGURED, EcuMConfigConsistencyHash=123456789, EcuMDefaultAppMode=OsAppMode0
        EcuMCalloutUserIncludeFiles:
          EcuMCalloutUserIncludeFile = Wdg_76_Acw.h
          EcuMCalloutUserIncludeFile = ComXf.h
          EcuMCalloutUserIncludeFile = E2EXf.h
          EcuMCalloutUserIncludeFile = RomTst.h
          EcuMCalloutUserIncludeFile = WdgStack_Callout.h
          EcuMCalloutUserIncludeFile = Fota.h
          EcuMCalloutUserIncludeFile = Mem_76_Pfls.h
          EcuMCalloutUserIncludeFile = Mem_Integration.h
        EcuMDefaultShutdownTarget: EcuMDefaultState=EcuMStateSleep, EcuMDefaultResetModeRef=ECUM_RESET_UNDEFINED, EcuMDefaultSleepModeRef=ECUM_SLEEP_MODE
        EcuMDemEventParameterRefs:
          ECUM_E_IMPROPER_CALLER = ECUM_E_IMPROPER_CALLER
          ECUM_E_CONFIGURATION_DATA_INCONSISTENT = ECUM_E_CONFIGURATION_DATA_INCONSISTENT
          ECUM_E_RAM_CHECK_FAILED = ECUM_E_RAM_CHECK_FAILED
        EcuMDriverInitListOne
          33 x EcuMDriverInitItem, all with EcuMModuleUsed=1:
            Mcu_Init: EcuMModuleID=Mcu, EcuMModuleParameter=POSTBUILD_PTR, EcuMModuleService=Init, EcuMDriverInitItemIndex=0, EcuMModulePostBuildPtr=&Mcu_Config, EcuMModuleRef=Mcu
            Port_Init: EcuMModuleID=Port, EcuMModuleParameter=POSTBUILD_PTR, EcuMModuleService=Init, EcuMDriverInitItemIndex=1, EcuMModulePostBuildPtr=&Port_Config, EcuMModuleRef=Port
            Adc_Init: EcuMModuleID=Adc, EcuMModuleParameter=POSTBUILD_PTR, EcuMModuleService=Init, EcuMDriverInitItemIndex=2, EcuMModulePostBuildPtr=&Adc_Config, EcuMModuleRef=Adc
            Gpt_Init: EcuMModuleID=Gpt, EcuMModuleParameter=POSTBUILD_PTR, EcuMModuleService=Init, EcuMDriverInitItemIndex=3, EcuMModulePostBuildPtr=&Gpt_Config, EcuMModuleRef=Gpt
            Pwm_Init: EcuMModuleID=Pwm, EcuMModuleParameter=POSTBUILD_PTR, EcuMModuleService=Init, EcuMDriverInitItemIndex=4, EcuMModulePostBuildPtr=&Pwm_Config, EcuMModuleRef=Pwm
            Icu_Init: EcuMModuleID=Icu, EcuMModuleParameter=POSTBUILD_PTR, EcuMModuleService=Init, EcuMDriverInitItemIndex=5, EcuMModulePostBuildPtr=&Icu_Config, EcuMModuleRef=Icu
            Spi_Init: EcuMModuleID=Spi, EcuMModuleParameter=NULL_PTR, EcuMModuleService=Init, EcuMDriverInitItemIndex=6, EcuMModuleRef=Spi
            CanTrcv_Init: EcuMModuleID=CanTrcv, EcuMModuleParameter=NULL_PTR, EcuMModuleService=Init, EcuMDriverInitItemIndex=7, EcuMModuleRef=CanTrcv
            Can_Init: EcuMModuleID=Can, EcuMModuleParameter=POSTBUILD_PTR, EcuMModuleService=Init, EcuMDriverInitItemIndex=8, EcuMModulePostBuildPtr=&CanConfigSet, EcuMModuleRef=Can
            IoHwAb_Init: EcuMModuleID=IoHwAb, EcuMModuleParameter=VOID, EcuMModuleService=Init, EcuMDriverInitItemIndex=9, EcuMModuleRef=IoHwAb
            CanIf_Init: EcuMModuleID=CanIf, EcuMModuleParameter=NULL_PTR, EcuMModuleService=Init, EcuMDriverInitItemIndex=10, EcuMModuleRef=CanIf
            CanSM_Init: EcuMModuleID=CanSM, EcuMModuleParameter=NULL_PTR, EcuMModuleService=Init, EcuMDriverInitItemIndex=11, EcuMModuleRef=CanSM
            CanTp_Init: EcuMModuleID=CanTp, EcuMModuleParameter=NULL_PTR, EcuMModuleService=Init, EcuMDriverInitItemIndex=12, EcuMModuleRef=CanTp
            PduR_Init: EcuMModuleID=PduR, EcuMModuleParameter=NULL_PTR, EcuMModuleService=Init, EcuMDriverInitItemIndex=13, EcuMModuleRef=PduR
            Com_Init: EcuMModuleID=Com, EcuMModuleParameter=NULL_PTR, EcuMModuleService=Init, EcuMDriverInitItemIndex=14, EcuMModuleRef=Com
            ComM_Init: EcuMModuleID=ComM, EcuMModuleParameter=VOID, EcuMModuleService=Init, EcuMDriverInitItemIndex=15, EcuMModuleRef=ComM
            Nm_Init: EcuMModuleID=Nm, EcuMModuleParameter=VOID, EcuMModuleService=Init, EcuMDriverInitItemIndex=16, EcuMModuleRef=Nm
            CanNm_Init: EcuMModuleID=CanNm, EcuMModuleParameter=NULL_PTR, EcuMModuleService=Init, EcuMDriverInitItemIndex=17, EcuMModuleRef=CanNm
            CanCM_Init: EcuMModuleID=CanCM, EcuMModuleParameter=VOID, EcuMModuleService=Init, EcuMDriverInitItemIndex=18, EcuMModuleRef=CanCM
            IpduM_Init: EcuMModuleID=IpduM, EcuMModuleParameter=NULL_PTR, EcuMModuleService=Init, EcuMDriverInitItemIndex=19, EcuMModuleRef=IpduM
            RamTst_Init: EcuMModuleID=RamTst, EcuMModuleParameter=VOID, EcuMModuleService=Init, EcuMDriverInitItemIndex=20, EcuMModuleRef=RamTst
            Wdg_Init: EcuMModuleID=Wdg_66_IA, EcuMModuleParameter=POSTBUILD_PTR, EcuMModuleService=Init, EcuMDriverInitItemIndex=21, EcuMModulePostBuildPtr=&Wdg_66_IA_Config, EcuMModuleRef=Wdg
            Wdg_76_Init: EcuMModuleID=Wdg_76_Acw, EcuMModuleParameter=NULL_PTR, EcuMModuleService=Init, EcuMDriverInitItemIndex=22, EcuMModuleRef=Wdg_76_Acw
            WdgM_Init: EcuMModuleID=WdgM, EcuMModuleParameter=NULL_PTR, EcuMModuleService=Init, EcuMDriverInitItemIndex=23, EcuMModuleRef=WdgM
            Csm_Init: EcuMModuleID=Csm, EcuMModuleParameter=NULL_PTR, EcuMModuleService=Init, EcuMDriverInitItemIndex=24, EcuMModuleRef=Csm
            CtrlRam_Init: EcuMModuleID=CtrlRam, EcuMModuleParameter=VOID, EcuMModuleService=Init, EcuMDriverInitItemIndex=25, EcuMModuleRef=CtrlRam
            E2EXf_Init: EcuMModuleID=E2EXf, EcuMModuleParameter=NULL_PTR, EcuMModuleService=Init, EcuMDriverInitItemIndex=26, EcuMModuleRef=E2EXf
            ComXf_Init: EcuMModuleID=ComXf, EcuMModuleParameter=NULL_PTR, EcuMModuleService=Init, EcuMDriverInitItemIndex=27, EcuMModuleRef=ComXf
            RomTst_Init: EcuMModuleID=RomTst, EcuMModuleParameter=VOID, EcuMModuleService=Init, EcuMDriverInitItemIndex=28, EcuMModuleRef=RomTst
            Dem_PreInit2: EcuMModuleID=Dem, EcuMModuleParameter=NULL_PTR, EcuMModuleService=PreInit2, EcuMDriverInitItemIndex=29, EcuMModuleRef=Dem
            CryIf_Init: EcuMDriverInitItemIndex=30, EcuMModuleID=CryIf, EcuMModuleParameter=NULL_PTR, EcuMModuleService=Init, EcuMModuleRef=CryIf
            Mem_76_Pfls_Init: EcuMDriverInitItemIndex=31, EcuMModuleID=Mem_76_Pfls, EcuMModuleParameter=NULL_PTR, EcuMModuleService=Init, EcuMModuleRef=Mem_76_Pfls
            Mem_Driver_Init: EcuMModuleID=Mem_Driver, EcuMModuleParameter=VOID, EcuMModuleService=Init, EcuMDriverInitItemIndex=32
        EcuMDriverInitListZero
          3 x EcuMDriverInitItem, all with EcuMModuleUsed=1:
            Det_Init: EcuMModuleID=Det, EcuMModuleParameter=VOID, EcuMModuleService=Init, EcuMDriverInitItemIndex=0, EcuMModuleRef=Det
            Dem_PreInit: EcuMModuleID=Dem, EcuMModuleParameter=NULL_PTR, EcuMModuleService=PreInit, EcuMDriverInitItemIndex=1, EcuMModuleRef=Dem
            Fota_Init: EcuMDriverInitItemIndex=2, EcuMModuleID=Fota, EcuMModuleParameter=VOID, EcuMModuleService=Init, EcuMModuleRef=Fota
        ECUM_SLEEP_MODE (EcuMSleepMode):
          EcuMSleepModeId = 0
          EcuMSleepModeSuspend = 1
          EcuMWakeupSourceMask = ECUM_WKSOURCE_GPT
          EcuMSleepModeMcuModeRef = McuModeSettingConf_DEEPSLEEP
          EcuMWakeupSourceMask = ECUM_WKSOURCE_BCAN_RX
          EcuMWakeupSourceMask = ECUM_WKSOURCE_BCAN_RX_POLL
          EcuMWakeupSourceMask = ECUM_WKSOURCE_LCAN_RX
          EcuMWakeupSourceMask = ECUM_WKSOURCE_LCAN_RX_POLL
          EcuMWakeupSourceMask = ECUM_WKSOURCE_IGN1
        11 x EcuMWakeupSource, all with EcuMWakeupSourcePolling=0, EcuMResetReasonRef=MCU_RESET_UNDEFINED:
          ECUM_WKSOURCE_POWER: category=TOOL_CONFIGURED, EcuMWakeupSourceId=0
          ECUM_WKSOURCE_RESET: category=TOOL_CONFIGURED, EcuMWakeupSourceId=1
          ECUM_WKSOURCE_INTERNAL_RESET: category=TOOL_CONFIGURED, EcuMWakeupSourceId=2
          ECUM_WKSOURCE_INTERNAL_WDG: category=TOOL_CONFIGURED, EcuMWakeupSourceId=3
          ECUM_WKSOURCE_EXTERNAL_WDG: category=TOOL_CONFIGURED, EcuMWakeupSourceId=4
          ECUM_WKSOURCE_GPT: category=TOOL_CONFIGURED, EcuMWakeupSourceId=5
          ECUM_WKSOURCE_BCAN_RX: EcuMWakeupSourceId=6, EcuMComMChannelRef=ComMChannel_BCAN
          ECUM_WKSOURCE_BCAN_RX_POLL: EcuMWakeupSourceId=7, EcuMComMChannelRef=ComMChannel_BCAN
          ECUM_WKSOURCE_IGN1: EcuMWakeupSourceId=8
          ECUM_WKSOURCE_LCAN_RX: EcuMWakeupSourceId=9, EcuMComMChannelRef=ComMChannel_LCAN
          ECUM_WKSOURCE_LCAN_RX_POLL: EcuMWakeupSourceId=10, EcuMComMChannelRef=ComMChannel_LCAN
      EcuMFlexConfiguration: category=TOOL_CONFIGURED, EcuMNormalMcuClockRef=McuClockSettingConfig_0_Active
        EcuMGoDownAllowedUsers: EcuMGoDownAllowedUserRef=ECUM_USER_BSWM
        EcuMSetClockAllowedUsers: EcuMSetClockAllowedUserRef=ECUM_USER_APP
        ECUM_USER_APP (EcuMFlexUserConfig): EcuMFlexUser=0
        ECUM_USER_BSWM (EcuMFlexUserConfig): EcuMFlexUser=42
        9 x EcuMResetMode:
          ECUM_RESET_MCU: category=TOOL_CONFIGURED, EcuMResetModeId=0
          ECUM_RESET_WDG: category=TOOL_CONFIGURED, EcuMResetModeId=1
          ECUM_RESET_IO: category=TOOL_CONFIGURED, EcuMResetModeId=2
          ECUM_RESET_HARD: category=TOOL_CONFIGURED, EcuMResetModeId=3
          ECUM_RESET_SOFT: category=TOOL_CONFIGURED, EcuMResetModeId=4
          ECUM_RESET_APP: EcuMResetModeId=5
          ECUM_RESET_DCM: EcuMResetModeId=6
          ECUM_RESET_UNDEFINED: EcuMResetModeId=7
          ECUM_RESET_XCP: EcuMResetModeId=8
        4 x EcuMShutdownCause, all with category=TOOL_CONFIGURED:
          ECUM_CAUSE_UNKNOWN: EcuMShutdownCauseId=0
          ECUM_CAUSE_ECU_STATE: EcuMShutdownCauseId=1
          ECUM_CAUSE_WDGM: EcuMShutdownCauseId=2
          ECUM_CAUSE_DCM: EcuMShutdownCauseId=3
    EcuMFlexGeneral:
      EcuMEnableDefBehaviour = 0
      EcuMResetLoopDetection = 0
      EcuMPmEnabled = 0
      EcuMAlarmClockPresent = 0
      EcuMLpTransitionCalloutEnabled = 1
      EcuMLoopCountMax = 2000000
      EcuMAlarmWakeupSource = ECUM_WKSOURCE_GPT
    EcuMGeneral: EcuMMainFunctionPeriod=0.01, EcuMVersionInfoApi=0, EcuMIncludeDet=1, EcuMDevErrorDetect=1
