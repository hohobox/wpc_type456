AUTOSAR XML (schema 4-0-3)
package /AUTOSAR
  module config EcuC: implementation-config-variant=VARIANT-POST-BUILD
    EcucPduCollection: PduIdTypeEnum=UINT8, PduLengthTypeEnum=UINT16
      95 x Pdu, all with category=TOOL_CONFIGURED:
        Pdu_ISignalIPdu_BCAN_BDC_FD_02_200ms: PduLength=32, SysTPduToFrameMappingRef=PduToFrame_BCAN_BDC_FD_02_200ms
        Pdu_ISignalIPdu_BCAN_BDC_FD_05_200ms: PduLength=32, SysTPduToFrameMappingRef=PduToFrame_BCAN_BDC_FD_05_200ms
        Pdu_ISignalIPdu_BCAN_BDC_FD_SMK_02_200ms: PduLength=32, SysTPduToFrameMappingRef=PduToFrame_BCAN_BDC_FD_SMK_02_200ms
        Pdu_ISignalIPdu_BCAN_CLU_01_20ms: PduLength=16, SysTPduToFrameMappingRef=PduToFrame_BCAN_CLU_01_20ms
        Pdu_ISignalIPdu_BCAN_CLU_05_00ms: PduLength=8, SysTPduToFrameMappingRef=PduToFrame_BCAN_CLU_05_00ms
        Pdu_ISignalIPdu_BCAN_CLU_09_00ms: PduLength=8, SysTPduToFrameMappingRef=PduToFrame_BCAN_CLU_09_00ms
        Pdu_ISignalIPdu_BCAN_CLU_20_200ms: PduLength=16, SysTPduToFrameMappingRef=PduToFrame_BCAN_CLU_20_200ms
        Pdu_ISignalIPdu_BCAN_EMS_02_10ms: PduLength=32, SysTPduToFrameMappingRef=PduToFrame_BCAN_EMS_02_10ms
        Pdu_ISignalIPdu_BCAN_EMS_07_10ms: PduLength=32, SysTPduToFrameMappingRef=PduToFrame_BCAN_EMS_07_10ms
        Pdu_DcmIPdu_BCAN_GST_ALL: PduLength=8, SysTPduToFrameMappingRef=PduToFrame_BCAN_GST_ALL
        Pdu_NPdu_BCAN_GST_ALL: PduLength=8, SysTPduToFrameMappingRef=MapNPdu_BCAN_GST_ALL
        Pdu_DcmIPdu_BCAN_GST_WPC: PduLength=8, SysTPduToFrameMappingRef=PduToFrame_BCAN_GST_WPC
        Pdu_NPdu_BCAN_GST_WPC: PduLength=8, SysTPduToFrameMappingRef=MapNPdu_BCAN_GST_WPC
        Pdu_ISignalIPdu_BCAN_HCU_03_10ms: PduLength=32, SysTPduToFrameMappingRef=PduToFrame_BCAN_HCU_03_10ms
        Pdu_ISignalIPdu_BCAN_HU_GW_03_200ms: PduLength=24, SysTPduToFrameMappingRef=PduToFrame_BCAN_HU_GW_03_200ms
        Pdu_ISignalIPdu_BCAN_HU_USM_01_00ms: PduLength=32, SysTPduToFrameMappingRef=PduToFrame_BCAN_HU_USM_01_00ms
        Pdu_ISignalIPdu_BCAN_HU_USM_02_00ms: PduLength=32, SysTPduToFrameMappingRef=PduToFrame_BCAN_HU_USM_02_00ms
        Pdu_ISignalIPdu_BCAN_HU_USM_05_00ms: PduLength=32, SysTPduToFrameMappingRef=PduToFrame_BCAN_HU_USM_05_00ms
        Pdu_ISignalIPdu_BCAN_IAU_FD_04_200ms: PduLength=32, SysTPduToFrameMappingRef=PduToFrame_BCAN_IAU_FD_04_200ms
        Pdu_NmPdu_BCAN_NM_ARS_FD: PduLength=32, SysTPduToFrameMappingRef=PduToFrame_BCAN_NM_ARS_FD
        Pdu_NmPdu_BCAN_NM_ATS_FD: PduLength=32, SysTPduToFrameMappingRef=PduToFrame_BCAN_NM_ATS_FD
        Pdu_NmPdu_BCAN_NM_BLTN_CAM_FD: PduLength=32, SysTPduToFrameMappingRef=PduToFrame_BCAN_NM_BLTN_CAM_FD
        Pdu_NmPdu_BCAN_NM_CGW_CCU: PduLength=32, SysTPduToFrameMappingRef=PduToFrame_BCAN_NM_CGW_CCU
        Pdu_NmPdu_BCAN_NM_FCS_FD: PduLength=32, SysTPduToFrameMappingRef=PduToFrame_BCAN_NM_FCS_FD
        Pdu_NmPdu_BCAN_NM_GW_PSU_3RD_FD: PduLength=32, SysTPduToFrameMappingRef=PduToFrame_BCAN_NM_GW_PSU_3RD_FD
        Pdu_NmPdu_BCAN_NM_GW_PSU_AST_FD: PduLength=32, SysTPduToFrameMappingRef=PduToFrame_BCAN_NM_GW_PSU_AST_FD
        Pdu_NmPdu_BCAN_NM_GW_PSU_DRV_FD: PduLength=32, SysTPduToFrameMappingRef=PduToFrame_BCAN_NM_GW_PSU_DRV_FD
        Pdu_NmPdu_BCAN_NM_GW_PSU_RL_FD: PduLength=32, SysTPduToFrameMappingRef=PduToFrame_BCAN_NM_GW_PSU_RL_FD
        Pdu_NmPdu_BCAN_NM_GW_PSU_RR_FD: PduLength=32, SysTPduToFrameMappingRef=PduToFrame_BCAN_NM_GW_PSU_RR_FD
        Pdu_NmPdu_BCAN_NM_GW_SAU_DRV_FD: PduLength=32, SysTPduToFrameMappingRef=PduToFrame_BCAN_NM_GW_SAU_DRV_FD
        Pdu_NmPdu_BCAN_NM_OHCL_FD: PduLength=32, SysTPduToFrameMappingRef=PduToFrame_BCAN_NM_OHCL_FD
        Pdu_NmPdu_BCAN_NM_PSB_FD: PduLength=32, SysTPduToFrameMappingRef=PduToFrame_BCAN_NM_PSB_FD
        Pdu_NmPdu_BCAN_NM_RCM_FD: PduLength=32, SysTPduToFrameMappingRef=PduToFrame_BCAN_NM_RCM_FD
        Pdu_NmPdu_BCAN_NM_RCS_FD: PduLength=32, SysTPduToFrameMappingRef=PduToFrame_BCAN_NM_RCS_FD
        Pdu_NmPdu_BCAN_NM_RWPC_FD: PduLength=32, SysTPduToFrameMappingRef=PduToFrame_BCAN_NM_RWPC_FD
        Pdu_NmPdu_BCAN_NM_SCM_FD: PduLength=32, SysTPduToFrameMappingRef=PduToFrame_BCAN_NM_SCM_FD
        Pdu_NmPdu_BCAN_NM_SGU_FD: PduLength=32, SysTPduToFrameMappingRef=PduToFrame_BCAN_NM_SGU_FD
        Pdu_NmPdu_BCAN_NM_SHVU_3RD_FD: PduLength=32, SysTPduToFrameMappingRef=PduToFrame_BCAN_NM_SHVU_3RD_FD
        Pdu_NmPdu_BCAN_NM_SHVU_FRNT_FD: PduLength=32, SysTPduToFrameMappingRef=PduToFrame_BCAN_NM_SHVU_FRNT_FD
        Pdu_NmPdu_BCAN_NM_SHVU_REAR_FD: PduLength=32, SysTPduToFrameMappingRef=PduToFrame_BCAN_NM_SHVU_REAR_FD
        Pdu_NmPdu_BCAN_NM_SHVU_RL_FD: PduLength=32, SysTPduToFrameMappingRef=PduToFrame_BCAN_NM_SHVU_RL_FD
        Pdu_NmPdu_BCAN_NM_SHVU_RR_FD: PduLength=32, SysTPduToFrameMappingRef=PduToFrame_BCAN_NM_SHVU_RR_FD
        Pdu_NmPdu_BCAN_NM_WPC2_FD: PduLength=32, SysTPduToFrameMappingRef=PduToFrame_BCAN_NM_WPC2_FD
        Pdu_NmPdu_BCAN_NM_WPC_FD: PduLength=32, SysTPduToFrameMappingRef=PduToFrame_BCAN_NM_WPC_FD
        Pdu_ISignalIPdu_BCAN_PDC_FD_03_200ms: PduLength=16, SysTPduToFrameMappingRef=PduToFrame_BCAN_PDC_FD_03_200ms
        Pdu_ISignalIPdu_BCAN_RWPC_FD_01_200ms: PduLength=16, SysTPduToFrameMappingRef=PduToFrame_BCAN_RWPC_FD_01_200ms
        Pdu_ISignalIPdu_BCAN_SBCM_AST_FD_01_200ms: PduLength=32, SysTPduToFrameMappingRef=PduToFrame_BCAN_SBCM_AST_FD_01_200ms
        Pdu_ISignalIPdu_BCAN_SBCM_DRV_FD_01_200ms: PduLength=32, SysTPduToFrameMappingRef=PduToFrame_BCAN_SBCM_DRV_FD_01_200ms
        Pdu_ISignalIPdu_BCAN_SBCM_RL_FD_01_200ms: PduLength=24, SysTPduToFrameMappingRef=PduToFrame_BCAN_SBCM_RL_FD_01_200ms
        Pdu_ISignalIPdu_BCAN_SBCM_RR_FD_01_200ms: PduLength=24, SysTPduToFrameMappingRef=PduToFrame_BCAN_SBCM_RR_FD_01_200ms
        Pdu_ISignalIPdu_BCAN_VCU_01_10ms: PduLength=32, SysTPduToFrameMappingRef=PduToFrame_BCAN_VCU_01_10ms
        Pdu_ISignalIPdu_BCAN_WPC2_FD_01_200ms: PduLength=16, SysTPduToFrameMappingRef=PduToFrame_BCAN_WPC2_FD_01_200ms
        Pdu_ISignalIPdu_BCAN_WPC_FD_01_200ms: PduLength=16, SysTPduToFrameMappingRef=PduToFrame_BCAN_WPC_FD_01_200ms
        Pdu_ISignalIPdu_BCAN_WPC_FD_VCRM_01_00ms: PduLength=16, SysTPduToFrameMappingRef=PduToFrame_BCAN_WPC_FD_VCRM_01_00ms
        Pdu_DcmIPdu_BCAN_WPC_GST: PduLength=64, SysTPduToFrameMappingRef=PduToFrame_BCAN_WPC_GST
        Pdu_NPdu_BCAN_WPC_GST: PduLength=8, SysTPduToFrameMappingRef=MapNPdu_BCAN_WPC_GST
        Pdu_ISignalIPdu_LCAN_CCU_01_00ms: PduLength=8, SysTPduToFrameMappingRef=PduToFrame_LCAN_CCU_01_00ms
        Pdu_ISignalIPdu_LCAN_IAU_FD_04_200ms: PduLength=32, SysTPduToFrameMappingRef=PduToFrame_LCAN_IAU_FD_04_200ms
        Pdu_ISignalIPdu_LCAN_IAU_FD_05_200ms: PduLength=32, SysTPduToFrameMappingRef=PduToFrame_LCAN_IAU_FD_05_200ms
        Pdu_ISignalIPdu_LCAN_L_BDC_FD_IAU_01_00ms: PduLength=8, SysTPduToFrameMappingRef=PduToFrame_LCAN_L_BDC_FD_IAU_01_00ms
        Pdu_ISignalIPdu_LCAN_L_BDC_FD_IAU_10_200ms: PduLength=8, SysTPduToFrameMappingRef=PduToFrame_LCAN_L_BDC_FD_IAU_10_200ms
        Pdu_ISignalIPdu_LCAN_L_TP_BDC_FD_L_WPC_FD: PduLength=512, SysTPduToFrameMappingRef=PduToFrame_LCAN_L_TP_BDC_FD_L_WPC_FD
        Pdu_NPdu_LCAN_L_TP_BDC_FD_L_WPC_FD: PduLength=8, SysTPduToFrameMappingRef=MapNPdu_LCAN_L_TP_BDC_FD_L_WPC_FD
        Pdu_ISignalIPdu_LCAN_L_TP_L_WPC_FD_BDC_FD: PduLength=512, SysTPduToFrameMappingRef=PduToFrame_LCAN_L_TP_L_WPC_FD_BDC_FD
        Pdu_NPdu_LCAN_L_TP_L_WPC_FD_BDC_FD: PduLength=32, SysTPduToFrameMappingRef=MapNPdu_LCAN_L_TP_L_WPC_FD_BDC_FD
        Pdu_ISignalIPdu_LCAN_L_WPC_FD_01_00ms: PduLength=8, SysTPduToFrameMappingRef=PduToFrame_LCAN_L_WPC_FD_01_00ms
        Pdu_ISignalIPdu_LCAN_L_WPC_FD_20_200ms: PduLength=8, SysTPduToFrameMappingRef=PduToFrame_LCAN_L_WPC_FD_20_200ms
        Pdu_NmPdu_LCAN_NM_GW_BDC_FD: PduLength=32, SysTPduToFrameMappingRef=PduToFrame_LCAN_NM_GW_BDC_FD
        Pdu_NmPdu_LCAN_NM_L_DHL_FD: PduLength=32, SysTPduToFrameMappingRef=PduToFrame_LCAN_NM_L_DHL_FD
        Pdu_NmPdu_LCAN_NM_L_DHRL_FD: PduLength=32, SysTPduToFrameMappingRef=PduToFrame_LCAN_NM_L_DHRL_FD
        Pdu_NmPdu_LCAN_NM_L_DHRR_FD: PduLength=32, SysTPduToFrameMappingRef=PduToFrame_LCAN_NM_L_DHRR_FD
        Pdu_NmPdu_LCAN_NM_L_DHR_FD: PduLength=32, SysTPduToFrameMappingRef=PduToFrame_LCAN_NM_L_DHR_FD
        Pdu_NmPdu_LCAN_NM_L_SAL_FD: PduLength=32, SysTPduToFrameMappingRef=PduToFrame_LCAN_NM_L_SAL_FD
        Pdu_NmPdu_LCAN_NM_L_UWB_BLE_MST_FD: PduLength=32, SysTPduToFrameMappingRef=PduToFrame_LCAN_NM_L_UWB_BLE_MST_FD
        Pdu_NmPdu_LCAN_NM_L_UWB_BLE_SLV_FD: PduLength=32, SysTPduToFrameMappingRef=PduToFrame_LCAN_NM_L_UWB_BLE_SLV_FD
        Pdu_NmPdu_LCAN_NM_L_UWB_FL_FD: PduLength=32, SysTPduToFrameMappingRef=PduToFrame_LCAN_NM_L_UWB_FL_FD
        Pdu_NmPdu_LCAN_NM_L_UWB_FRNK_FD: PduLength=32, SysTPduToFrameMappingRef=PduToFrame_LCAN_NM_L_UWB_FRNK_FD
        Pdu_NmPdu_LCAN_NM_L_UWB_FR_FD: PduLength=32, SysTPduToFrameMappingRef=PduToFrame_LCAN_NM_L_UWB_FR_FD
        Pdu_NmPdu_LCAN_NM_L_UWB_RL_FD: PduLength=32, SysTPduToFrameMappingRef=PduToFrame_LCAN_NM_L_UWB_RL_FD
        Pdu_NmPdu_LCAN_NM_L_UWB_RR_FD: PduLength=32, SysTPduToFrameMappingRef=PduToFrame_LCAN_NM_L_UWB_RR_FD
        Pdu_NmPdu_LCAN_NM_L_UWB_TRNK_FD: PduLength=32, SysTPduToFrameMappingRef=PduToFrame_LCAN_NM_L_UWB_TRNK_FD
        Pdu_NmPdu_LCAN_NM_L_WPC_FD: PduLength=32, SysTPduToFrameMappingRef=PduToFrame_LCAN_NM_L_WPC_FD
        Pdu_ComMPdu_Rx_EIRA_CanNm: PduLength=28
        Pdu_ComMPdu_Tx_PncVector_BCAN: PduLength=28
        Pdu_NmPdu_LCAN_NM_L_TPMS_FD: PduLength=32, SysTPduToFrameMappingRef=PduToFrame_LCAN_NM_L_TPMS_FD
        Pdu_ISignalIPdu_LCAN_PDC_FD_15_300ms: PduLength=32, SysTPduToFrameMappingRef=PduToFrame_LCAN_PDC_FD_15_300ms
        Pdu_ComMPdu_Tx_PncVector_LCAN: PduLength=28
        Pdu_ISignalIPdu_BCAN_HU_USM_04_00ms: PduLength=32, SysTPduToFrameMappingRef=PduToFrame_BCAN_HU_USM_04_00ms
        Pdu_NmPdu_BCAN_NM_DCM_FD: PduLength=32, SysTPduToFrameMappingRef=PduToFrame_BCAN_NM_DCM_FD
        Pdu_NmPdu_BCAN_NM_SHVU_CCS_FD: PduLength=32, SysTPduToFrameMappingRef=PduToFrame_BCAN_NM_SHVU_CCS_FD
        Pdu_ISignalIPdu_BCAN_PDC_FD_15_300ms: PduLength=32, SysTPduToFrameMappingRef=PduToFrame_BCAN_PDC_FD_15_300ms
        Pdu_ISignalIPdu_BCAN_WPCmsgDvp1: PduLength=64, SysTPduToFrameMappingRef=PduToFrame_BCAN_WPCmsgDvp1
        Pdu_NmPdu_LCAN_NM_CGW_CCU: PduLength=32, SysTPduToFrameMappingRef=PduToFrame_LCAN_NM_CGW_CCU
        Pdu_NmPdu_BCAN_NM_FLLR_FD: PduLength=32, SysTPduToFrameMappingRef=PduToFrame_BCAN_NM_FLLR_FD
        Pdu_ISignalIPdu_BCAN_WPC_WU_01_500ms: PduLength=16, SysTPduToFrameMappingRef=PduToFrame_BCAN_WPC_WU_01_500ms
