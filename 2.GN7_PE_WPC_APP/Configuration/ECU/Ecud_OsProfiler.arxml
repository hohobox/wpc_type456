AUTOSAR XML (schema 4-0-3)
package /AUTRON
  module config OsProfiler: implementation-config-variant=VARIANT-PRE-COMPILE, module-description=BswImplementation_OsProfiler
    OsProfilerGlobalConfig:
      ProfileEventCount = 20
      TimeIndexPeriod = 0.005
      EnableTimeIndex = 0
      EnableOsProfiler = 1
      EnableProfileIsr = 0
      NumberOfCores = 1
      UpwardDirectionCount = 1
      TargetOperatingSystem = AUTRON_COMMON
    4 x OsProfilerPeriodTaskConfig:
      OsTask_ASW_FG1_100ms: PeriodTaskRef=OsTask_ASW_FG1_100ms
      OsTask_ASW_FG1_10ms: PeriodTaskRef=OsTask_ASW_FG1_10ms
      OsTask_BSW_FG1_10ms: PeriodTaskRef=OsTask_BSW_FG1_10ms
      OsTask_BSW_FG1_100ms: PeriodTaskRef=OsTask_BSW_FG1_100ms
    OsProfilerSpecificTargetConfig
    OsProfilerCommonTargetConfig: StmMaxTick=-1, StmAddress=1077477384, StmFrequency=1
