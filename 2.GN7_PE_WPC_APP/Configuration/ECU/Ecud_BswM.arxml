[part 1 of 2: package /AUTOSAR]
AUTOSAR XML (schema 4-0-3)
package /AUTOSAR
  module config BswM: implementation-config-variant=VARIANT-PRE-COMPILE, module-description=BswImplementation_BswM
    BswMGeneral:
      BswMMainFunctionPeriod = 0.01
      BswMComMEnabled = 1
      BswMCanSMEnabled = 1
      BswMDcmEnabled = 1
      BswMLinSMEnabled = 0
      BswMEcuMEnabled = 1
      BswMNvMEnabled = 1
      BswMWdgMEnabled = 1
      BswMSchMEnabled = 1
      BswMGenericRequestEnabled = 1
      BswMJ1939NmEnabled = 0
      BswMDevErrorDetect = 1
      BswMEthSMEnabled = 0
      BswMFrSMEnabled = 0
      BswMLinTPEnabled = 0
      BswMJ1939DcmEnabled = 0
      BswMVersionInfoApi = 0
      BswMUserIncludeFiles:
        category = TOOL_CONFIGURED
        BswMUserIncludeFile = CanCM.h
        BswMUserIncludeFile = Com.h
        BswMUserIncludeFile = ComM.h
        BswMUserIncludeFile = Dem.h
        BswMUserIncludeFile = EcuM.h
        BswMUserIncludeFile = Mem_Integration.h
        BswMUserIncludeFile = Nml.h
        BswMUserIncludeFile = RamTst.h
        BswMUserIncludeFile = RomTst.h
        BswMUserIncludeFile = Rte_Main.h
        BswMUserIncludeFile = WdgM.h
        BswMUserIncludeFile = IoHwAb.h
        BswMUserIncludeFile = App_HSM_Hae.h
        BswMUserIncludeFile = KeyM.h
        BswMUserIncludeFile = Crypto_76_HaeModule.h
    BswMConfig
      BswMArbitration: category=TOOL_CONFIGURED
        47 x BswMModeRequestPort, all with category=TOOL_CONFIGURED, BswMRequestProcessing=BSWM_IMMEDIATE:
          MRP_IMM_BswModeNotification_modeNotificationPort_DcmCommunicationControl_0
            BswMModeRequestSource: category=TOOL_CONFIGURED
              BswMBswModeNotification: category=TOOL_CONFIGURED, BswMBswModeDeclarationGroupPrototypeRef=modeNotificationPort_DcmCommunicationControl_0
            BswMModeInitValue: category=TOOL_CONFIGURED
              BswMSwcModeInitValue: category=TOOL_CONFIGURED, BswMSwcModeInitValueRef=DCM_ENABLE_RX_TX_NORM_NM
          MRP_IMM_BswModeNotification_modeNotificationPort_DcmControlDTCSetting
            BswMModeRequestSource: category=TOOL_CONFIGURED
              BswMBswModeNotification: category=TOOL_CONFIGURED, BswMBswModeDeclarationGroupPrototypeRef=modeNotificationPort_DcmControlDTCSetting
            BswMModeInitValue: category=TOOL_CONFIGURED
              BswMSwcModeInitValue: category=TOOL_CONFIGURED, BswMSwcModeInitValueRef=ENABLEDTCSETTING
          MRP_IMM_BswModeNotification_modeNotificationPort_DcmDiagnosticSessionControl
            BswMModeRequestSource: category=TOOL_CONFIGURED
              BswMBswModeNotification: category=TOOL_CONFIGURED, BswMBswModeDeclarationGroupPrototypeRef=modeNotificationPort_DcmDiagnosticSessionControl
            BswMModeInitValue: category=TOOL_CONFIGURED
              BswMSwcModeInitValue: category=TOOL_CONFIGURED, BswMSwcModeInitValueRef=DCM_DEFAULT_SESSION
          MRP_IMM_BswModeNotification_modeNotificationPort_DcmEcuReset
            BswMModeRequestSource: category=TOOL_CONFIGURED
              BswMBswModeNotification: category=TOOL_CONFIGURED, BswMBswModeDeclarationGroupPrototypeRef=modeNotificationPort_DcmEcuReset
            BswMModeInitValue: category=TOOL_CONFIGURED
              BswMSwcModeInitValue: category=TOOL_CONFIGURED, BswMSwcModeInitValueRef=NONE
          MRP_IMM_BswModeNotification_modeNotificationPort_DcmModeRapidPowerShutDown
            BswMModeRequestSource: category=TOOL_CONFIGURED
              BswMBswModeNotification: category=TOOL_CONFIGURED, BswMBswModeDeclarationGroupPrototypeRef=modeNotificationPort_DcmModeRapidPowerShutDown
            BswMModeInitValue: category=TOOL_CONFIGURED
              BswMSwcModeInitValue: category=TOOL_CONFIGURED, BswMSwcModeInitValueRef=ENABLE_RAPIDPOWERSHUTDOWN
          MRP_IMM_CanSMIndication_BCAN
            BswMModeRequestSource: category=TOOL_CONFIGURED
              BswMCanSMIndication: category=TOOL_CONFIGURED, BswMCanSMChannelRef=ComMChannel_BCAN
            BswMModeInitValue: category=TOOL_CONFIGURED
              BswMBswModeInitValue: category=TOOL_CONFIGURED, BswMBswModeInitValueMode=CANSM_BSWM_NO_COMMUNICATION
          MRP_IMM_CanSMIndication_LCAN
            BswMModeRequestSource: category=TOOL_CONFIGURED
              BswMCanSMIndication: category=TOOL_CONFIGURED, BswMCanSMChannelRef=ComMChannel_LCAN
            BswMModeInitValue: category=TOOL_CONFIGURED
              BswMBswModeInitValue: category=TOOL_CONFIGURED, BswMBswModeInitValueMode=CANSM_BSWM_NO_COMMUNICATION
          MRP_IMM_ComMIndication_BCAN
            BswMModeRequestSource: category=TOOL_CONFIGURED
              BswMComMIndication: category=TOOL_CONFIGURED, BswMComMChannelRef=ComMChannel_BCAN
            BswMModeInitValue: category=TOOL_CONFIGURED
              BswMBswModeInitValue: category=TOOL_CONFIGURED, BswMBswModeInitValueMode=COMM_NO_COMMUNICATION
          MRP_IMM_ComMIndication_LCAN
            BswMModeRequestSource: category=TOOL_CONFIGURED
              BswMComMIndication: category=TOOL_CONFIGURED, BswMComMChannelRef=ComMChannel_LCAN
            BswMModeInitValue: category=TOOL_CONFIGURED
              BswMBswModeInitValue: category=TOOL_CONFIGURED, BswMBswModeInitValueMode=COMM_NO_COMMUNICATION
          MRP_IMM_ComMPncIndication_PNC141
            BswMModeRequestSource: category=TOOL_CONFIGURED
              BswMComMPncRequest: category=TOOL_CONFIGURED, BswMComMPncRef=ComMPnc_PNC141
            BswMModeInitValue: category=TOOL_CONFIGURED
              BswMBswModeInitValue: category=TOOL_CONFIGURED, BswMBswModeInitValueMode=PNC_NO_COMMUNICATION
          MRP_IMM_ComMPncIndication_PNC153
            BswMModeRequestSource: category=TOOL_CONFIGURED
              BswMComMPncRequest: category=TOOL_CONFIGURED, BswMComMPncRef=ComMPnc_PNC153
            BswMModeInitValue: category=TOOL_CONFIGURED
              BswMBswModeInitValue: category=TOOL_CONFIGURED, BswMBswModeInitValueMode=PNC_NO_COMMUNICATION
          MRP_IMM_ComMPncIndication_PNC159
            BswMModeRequestSource: category=TOOL_CONFIGURED
              BswMComMPncRequest: category=TOOL_CONFIGURED, BswMComMPncRef=ComMPnc_PNC159
            BswMModeInitValue: category=TOOL_CONFIGURED
              BswMBswModeInitValue: category=TOOL_CONFIGURED, BswMBswModeInitValueMode=PNC_NO_COMMUNICATION
          MRP_IMM_ComMPncIndication_PNC32
            BswMModeRequestSource: category=TOOL_CONFIGURED
              BswMComMPncRequest: category=TOOL_CONFIGURED, BswMComMPncRef=ComMPnc_PNC32
            BswMModeInitValue: category=TOOL_CONFIGURED
              BswMBswModeInitValue: category=TOOL_CONFIGURED, BswMBswModeInitValueMode=PNC_NO_COMMUNICATION
          MRP_IMM_ComMPncRequest_PNC141
            BswMModeRequestSource: category=TOOL_CONFIGURED
              BswMComMPncRequest: category=TOOL_CONFIGURED, BswMComMPncRef=ComMPnc_PNC141
            BswMModeInitValue: category=TOOL_CONFIGURED
              BswMBswModeInitValue: category=TOOL_CONFIGURED, BswMBswModeInitValueMode=PNC_NO_COMMUNICATION
          MRP_IMM_ComMPncRequest_PNC153
            BswMModeRequestSource: category=TOOL_CONFIGURED
              BswMComMPncRequest: category=TOOL_CONFIGURED, BswMComMPncRef=ComMPnc_PNC153
            BswMModeInitValue: category=TOOL_CONFIGURED
              BswMBswModeInitValue: category=TOOL_CONFIGURED, BswMBswModeInitValueMode=PNC_NO_COMMUNICATION
          MRP_IMM_ComMPncRequest_PNC159
            BswMModeRequestSource: category=TOOL_CONFIGURED
              BswMComMPncRequest: category=TOOL_CONFIGURED, BswMComMPncRef=ComMPnc_PNC159
            BswMModeInitValue: category=TOOL_CONFIGURED
              BswMBswModeInitValue: category=TOOL_CONFIGURED, BswMBswModeInitValueMode=PNC_NO_COMMUNICATION
          MRP_IMM_ComMPncRequest_PNC32
            BswMModeRequestSource: category=TOOL_CONFIGURED
              BswMComMPncRequest: category=TOOL_CONFIGURED, BswMComMPncRef=ComMPnc_PNC32
            BswMModeInitValue: category=TOOL_CONFIGURED
              BswMBswModeInitValue: category=TOOL_CONFIGURED, BswMBswModeInitValueMode=PNC_NO_COMMUNICATION
          MRP_IMM_DcmApplicationUpdatedIndication
            BswMModeRequestSource: category=TOOL_CONFIGURED
              BswMDcmApplicationUpdatedIndication: category=TOOL_CONFIGURED
            BswMModeInitValue: category=TOOL_CONFIGURED
              BswMSwcModeInitValue: category=TOOL_CONFIGURED, BswMSwcModeInitValueRef=APP_NOT_UPDATED
          MRP_IMM_DcmComModeRequest_BCAN
            BswMModeRequestSource: category=TOOL_CONFIGURED
              BswMDcmComModeRequest: category=TOOL_CONFIGURED, BswMDcmComMChannelRef=ComMChannel_BCAN
            BswMModeInitValue: category=TOOL_CONFIGURED
              BswMBswModeInitValue: category=TOOL_CONFIGURED, BswMBswModeInitValueMode=DCM_ENABLE_RX_TX_NORM_NM
          MRP_IMM_EcuMIndication
            BswMModeRequestSource: category=TOOL_CONFIGURED
              BswMEcuMIndication: category=TOOL_CONFIGURED
            BswMModeInitValue: category=TOOL_CONFIGURED
              BswMBswModeInitValue: category=TOOL_CONFIGURED, BswMBswModeInitValueMode=ECUM_STATE_STARTUP_ONE
          MRP_IMM_EcuMWakeupSource_BCAN_RX
            BswMModeRequestSource: category=TOOL_CONFIGURED
              BswMEcuMWakeupSource: category=TOOL_CONFIGURED, BswMEcuMWakeupSrcRef=ECUM_WKSOURCE_BCAN_RX
            BswMModeInitValue: category=TOOL_CONFIGURED
              BswMBswModeInitValue: category=TOOL_CONFIGURED, BswMBswModeInitValueMode=ECUM_WKSTATUS_NONE
          MRP_IMM_EcuMWakeupSource_BCAN_RX_POLL
            BswMModeRequestSource: category=TOOL_CONFIGURED
              BswMEcuMWakeupSource: category=TOOL_CONFIGURED, BswMEcuMWakeupSrcRef=ECUM_WKSOURCE_BCAN_RX_POLL
            BswMModeInitValue: category=TOOL_CONFIGURED
              BswMBswModeInitValue: category=TOOL_CONFIGURED, BswMBswModeInitValueMode=ECUM_WKSTATUS_NONE
          MRP_IMM_EcuMWakeupSource_IGN1
            BswMModeRequestSource: category=TOOL_CONFIGURED
              BswMEcuMWakeupSource: category=TOOL_CONFIGURED, BswMEcuMWakeupSrcRef=ECUM_WKSOURCE_IGN1
            BswMModeInitValue: category=TOOL_CONFIGURED
              BswMBswModeInitValue: category=TOOL_CONFIGURED, BswMBswModeInitValueMode=ECUM_WKSTATUS_NONE
          MRP_IMM_EcuMWakeupSource_LCAN_RX
            BswMModeRequestSource: category=TOOL_CONFIGURED
              BswMEcuMWakeupSource: category=TOOL_CONFIGURED, BswMEcuMWakeupSrcRef=ECUM_WKSOURCE_LCAN_RX
            BswMModeInitValue: category=TOOL_CONFIGURED
              BswMBswModeInitValue: category=TOOL_CONFIGURED, BswMBswModeInitValueMode=ECUM_WKSTATUS_NONE
          MRP_IMM_EcuMWakeupSource_LCAN_RX_POLL
            BswMModeRequestSource: category=TOOL_CONFIGURED
              BswMEcuMWakeupSource: category=TOOL_CONFIGURED, BswMEcuMWakeupSrcRef=ECUM_WKSOURCE_LCAN_RX_POLL
            BswMModeInitValue: category=TOOL_CONFIGURED
              BswMBswModeInitValue: category=TOOL_CONFIGURED, BswMBswModeInitValueMode=ECUM_WKSTATUS_NONE
          MRP_IMM_GenericRequest_CanCMRxDm_BCAN
            BswMModeRequestSource: category=TOOL_CONFIGURED
              BswMGenericRequest: category=TOOL_CONFIGURED, BswMModeRequesterId=241, BswMRequestedModeMax=2
            BswMModeInitValue: category=TOOL_CONFIGURED
              BswMBswModeInitValue: category=TOOL_CONFIGURED, BswMBswModeInitValueMode=CANCM_COMM_STAT_RX_DISABLED
          MRP_IMM_GenericRequest_CanCMRxDm_LCAN
            BswMModeRequestSource: category=TOOL_CONFIGURED
              BswMGenericRequest: category=TOOL_CONFIGURED, BswMModeRequesterId=497, BswMRequestedModeMax=2
            BswMModeInitValue: category=TOOL_CONFIGURED
              BswMBswModeInitValue: category=TOOL_CONFIGURED, BswMBswModeInitValueMode=CANCM_COMM_STAT_RX_DISABLED
          MRP_IMM_GenericRequest_CanCMTx_BCAN
            BswMModeRequestSource: category=TOOL_CONFIGURED
              BswMGenericRequest: category=TOOL_CONFIGURED, BswMModeRequesterId=240, BswMRequestedModeMax=1
            BswMModeInitValue: category=TOOL_CONFIGURED
              BswMBswModeInitValue: category=TOOL_CONFIGURED, BswMBswModeInitValueMode=CANCM_COMM_STAT_TX_DISABLED
          MRP_IMM_GenericRequest_CanCMTx_LCAN
            BswMModeRequestSource: category=TOOL_CONFIGURED
              BswMGenericRequest: category=TOOL_CONFIGURED, BswMModeRequesterId=496, BswMRequestedModeMax=1
            BswMModeInitValue: category=TOOL_CONFIGURED
              BswMBswModeInitValue: category=TOOL_CONFIGURED, BswMBswModeInitValueMode=CANCM_COMM_STAT_TX_DISABLED
          MRP_IMM_GenericRequest_CanCMVol_BCAN
            BswMModeRequestSource: category=TOOL_CONFIGURED
              BswMGenericRequest: category=TOOL_CONFIGURED, BswMModeRequesterId=242, BswMRequestedModeMax=3
            BswMModeInitValue: category=TOOL_CONFIGURED
              BswMBswModeInitValue: category=TOOL_CONFIGURED, BswMBswModeInitValueMode=CANCM_VOL_MODE_NORMAL
          MRP_IMM_GenericRequest_CanCMVol_LCAN
            BswMModeRequestSource: category=TOOL_CONFIGURED
              BswMGenericRequest: category=TOOL_CONFIGURED, BswMModeRequesterId=498, BswMRequestedModeMax=3
            BswMModeInitValue: category=TOOL_CONFIGURED
              BswMBswModeInitValue: category=TOOL_CONFIGURED, BswMBswModeInitValueMode=CANCM_VOL_MODE_NORMAL
          MRP_IMM_GenericRequest_CanSMBOR_BCAN
            BswMModeRequestSource: category=TOOL_CONFIGURED
              BswMGenericRequest: category=TOOL_CONFIGURED, BswMModeRequesterId=140, BswMRequestedModeMax=1
            BswMModeInitValue: category=TOOL_CONFIGURED
              BswMBswModeInitValue: category=TOOL_CONFIGURED, BswMBswModeInitValueMode=CANSM_BSWM_BOR_COMPLETE
          MRP_IMM_GenericRequest_CanSMBOR_LCAN
            BswMModeRequestSource: category=TOOL_CONFIGURED
              BswMGenericRequest: category=TOOL_CONFIGURED, BswMModeRequesterId=396, BswMRequestedModeMax=1
            BswMModeInitValue: category=TOOL_CONFIGURED
              BswMBswModeInitValue: category=TOOL_CONFIGURED, BswMBswModeInitValueMode=CANSM_BSWM_BOR_COMPLETE
          MRP_IMM_GenericRequest_EcuMRequest
            BswMModeRequestSource: category=TOOL_CONFIGURED
              BswMGenericRequest: category=TOOL_CONFIGURED, BswMModeRequesterId=101, BswMRequestedModeMax=4
            BswMModeInitValue: category=TOOL_CONFIGURED
              BswMBswModeInitValue: category=TOOL_CONFIGURED, BswMBswModeInitValueMode=ECUM_REQUEST_RUN
          MRP_IMM_GenericRequest_EcuMResetMode
            BswMModeRequestSource: category=TOOL_CONFIGURED
              BswMGenericRequest: category=TOOL_CONFIGURED, BswMModeRequesterId=554, BswMRequestedModeMax=3
            BswMModeInitValue: category=TOOL_CONFIGURED
              BswMBswModeInitValue: category=TOOL_CONFIGURED, BswMBswModeInitValueMode=ECUM_RESET_MCU
          MRP_IMM_GenericRequest_EcuModeTransition
            BswMModeRequestSource: category=TOOL_CONFIGURED
              BswMGenericRequest: category=TOOL_CONFIGURED, BswMModeRequesterId=121, BswMRequestedModeMax=2
            BswMModeInitValue: category=TOOL_CONFIGURED
              BswMBswModeInitValue: category=TOOL_CONFIGURED, BswMBswModeInitValueMode=BSWM_ECUMODETRANSITION_END
          MRP_IMM_GenericRequest_EcuState
            BswMModeRequestSource: category=TOOL_CONFIGURED
              BswMGenericRequest: category=TOOL_CONFIGURED, BswMModeRequesterId=42, BswMRequestedModeMax=400
            BswMModeInitValue: category=TOOL_CONFIGURED
              BswMBswModeInitValue: category=TOOL_CONFIGURED, BswMBswModeInitValueMode=BSWM_ECUSTATE_READY
          MRP_IMM_GenericRequest_NvMLowPower
            BswMModeRequestSource: category=TOOL_CONFIGURED
              BswMGenericRequest: category=TOOL_CONFIGURED, BswMModeRequesterId=20, BswMRequestedModeMax=1
            BswMModeInitValue: category=TOOL_CONFIGURED
              BswMBswModeInitValue: category=TOOL_CONFIGURED, BswMBswModeInitValueMode=NVM_LOWPOWER_ALLOW
          MRP_IMM_GenericRequest_RamTstLowPower
            BswMModeRequestSource: category=TOOL_CONFIGURED
              BswMGenericRequest: category=TOOL_CONFIGURED, BswMModeRequesterId=93, BswMRequestedModeMax=1
            BswMModeInitValue: category=TOOL_CONFIGURED
              BswMBswModeInitValue: category=TOOL_CONFIGURED, BswMBswModeInitValueMode=RAMTST_LOWPOWER_ALLOW
          MRP_IMM_GenericRequest_RomTstLowPower
            BswMModeRequestSource: category=TOOL_CONFIGURED
              BswMGenericRequest: category=TOOL_CONFIGURED, BswMModeRequesterId=104, BswMRequestedModeMax=1
            BswMModeInitValue: category=TOOL_CONFIGURED
              BswMBswModeInitValue: category=TOOL_CONFIGURED, BswMBswModeInitValueMode=ROMTST_LOWPOWER_ALLOW
          MRP_IMM_GenericRequest_ShutdownTarget
            BswMModeRequestSource: category=TOOL_CONFIGURED
              BswMGenericRequest: category=TOOL_CONFIGURED, BswMModeRequesterId=298, BswMRequestedModeMax=3
            BswMModeInitValue: category=TOOL_CONFIGURED
              BswMBswModeInitValue: category=TOOL_CONFIGURED, BswMBswModeInitValueMode=BSWM_SHUTDOWNTARGET_RUN
          MRP_IMM_NvMJobModeIndication_ReadAll
            BswMModeRequestSource: category=TOOL_CONFIGURED
              BswMNvMJobModeIndication: category=TOOL_CONFIGURED, BswMNvmService=NvmReadAll
            BswMModeInitValue: category=TOOL_CONFIGURED
              BswMBswModeInitValue: category=TOOL_CONFIGURED, BswMBswModeInitValueMode=NVM_MAXVALUE
          MRP_IMM_NvMJobModeIndication_WriteAll
            BswMModeRequestSource: category=TOOL_CONFIGURED
              BswMNvMJobModeIndication: category=TOOL_CONFIGURED, BswMNvmService=NvmWriteAll
            BswMModeInitValue: category=TOOL_CONFIGURED
              BswMBswModeInitValue: category=TOOL_CONFIGURED, BswMBswModeInitValueMode=NVM_MAXVALUE
          MRP_IMM_SwcModeRequest_ComMMode_PNC141
            BswMModeRequestSource: category=TOOL_CONFIGURED
              BswMSwcModeRequest: category=TOOL_CONFIGURED, BswMSwcModeRequestVariableDataPrototypeRef=ComMMode_PNC141
          MRP_IMM_SwcModeRequest_ComMMode_PNC153
            BswMModeRequestSource: category=TOOL_CONFIGURED
              BswMSwcModeRequest: category=TOOL_CONFIGURED, BswMSwcModeRequestVariableDataPrototypeRef=ComMMode_PNC153
          MRP_IMM_SwcModeRequest_ComMMode_PNC159
            BswMModeRequestSource: category=TOOL_CONFIGURED
              BswMSwcModeRequest: category=TOOL_CONFIGURED, BswMSwcModeRequestVariableDataPrototypeRef=ComMMode_PNC159
          MRP_IMM_SwcModeRequest_ComMMode_PNC32
            BswMModeRequestSource: category=TOOL_CONFIGURED
              BswMSwcModeRequest: category=TOOL_CONFIGURED, BswMSwcModeRequestVariableDataPrototypeRef=ComMMode_PNC32
        177 x BswMModeCondition, all with category=TOOL_CONFIGURED:
          MC_IMM_BswModeNotification_modeNotificationPort_DcmCommunicationControl_0_EQ_DCM_DISABLE_RX_DISABLE_TX_NM: BswMConditionType=BSWM_EQUALS, BswMConditionMode=MRP_IMM_BswModeNotification_modeNotificationPort_DcmCommunicationControl_0
            BswMConditionValue: category=TOOL_CONFIGURED
              BswMModeDeclaration: category=TOOL_CONFIGURED, BswMModeValueRef=DCM_DISABLE_RX_DISABLE_TX_NM
          MC_IMM_BswModeNotification_modeNotificationPort_DcmCommunicationControl_0_EQ_DCM_DISABLE_RX_ENABLE_TX_NORM: BswMConditionType=BSWM_EQUALS, BswMConditionMode=MRP_IMM_BswModeNotification_modeNotificationPort_DcmCommunicationControl_0
            BswMConditionValue: category=TOOL_CONFIGURED
              BswMModeDeclaration: category=TOOL_CONFIGURED, BswMModeValueRef=DCM_DISABLE_RX_ENABLE_TX_NORM
          MC_IMM_BswModeNotification_modeNotificationPort_DcmCommunicationControl_0_EQ_DCM_DISABLE_RX_ENABLE_TX_NORM_NM: BswMConditionType=BSWM_EQUALS, BswMConditionMode=MRP_IMM_BswModeNotification_modeNotificationPort_DcmCommunicationControl_0
            BswMConditionValue: category=TOOL_CONFIGURED
              BswMModeDeclaration: category=TOOL_CONFIGURED, BswMModeValueRef=DCM_DISABLE_RX_ENABLE_TX_NORM_NM
          MC_IMM_BswModeNotification_modeNotificationPort_DcmCommunicationControl_0_EQ_DCM_DISABLE_RX_TX_NM: BswMConditionType=BSWM_EQUALS, BswMConditionMode=MRP_IMM_BswModeNotification_modeNotificationPort_DcmCommunicationControl_0
            BswMConditionValue: category=TOOL_CONFIGURED
              BswMModeDeclaration: category=TOOL_CONFIGURED, BswMModeValueRef=DCM_DISABLE_RX_TX_NM
          MC_IMM_BswModeNotification_modeNotificationPort_DcmCommunicationControl_0_EQ_DCM_DISABLE_RX_TX_NORMAL: BswMConditionType=BSWM_EQUALS, BswMConditionMode=MRP_IMM_BswModeNotification_modeNotificationPort_DcmCommunicationControl_0
            BswMConditionValue: category=TOOL_CONFIGURED
              BswMModeDeclaration: category=TOOL_CONFIGURED, BswMModeValueRef=DCM_DISABLE_RX_TX_NORMAL
          MC_IMM_BswModeNotification_modeNotificationPort_DcmCommunicationControl_0_EQ_DCM_DISABLE_RX_TX_NORM_NM: BswMConditionType=BSWM_EQUALS, BswMConditionMode=MRP_IMM_BswModeNotification_modeNotificationPort_DcmCommunicationControl_0
            BswMConditionValue: category=TOOL_CONFIGURED
              BswMModeDeclaration: category=TOOL_CONFIGURED, BswMModeValueRef=DCM_DISABLE_RX_TX_NORM_NM
          MC_IMM_BswModeNotification_modeNotificationPort_DcmCommunicationControl_0_EQ_DCM_ENABLE_RX_DISABLE_TX_NM: BswMConditionType=BSWM_EQUALS, BswMConditionMode=MRP_IMM_BswModeNotification_modeNotificationPort_DcmCommunicationControl_0
            BswMConditionValue: category=TOOL_CONFIGURED
              BswMModeDeclaration: category=TOOL_CONFIGURED, BswMModeValueRef=DCM_ENABLE_RX_DISABLE_TX_NM
          MC_IMM_BswModeNotification_modeNotificationPort_DcmCommunicationControl_0_EQ_DCM_ENABLE_RX_DISABLE_TX_NORM: BswMConditionType=BSWM_EQUALS, BswMConditionMode=MRP_IMM_BswModeNotification_modeNotificationPort_DcmCommunicationControl_0
            BswMConditionValue: category=TOOL_CONFIGURED
              BswMModeDeclaration: category=TOOL_CONFIGURED, BswMModeValueRef=DCM_ENABLE_RX_DISABLE_TX_NORM
          MC_IMM_BswModeNotification_modeNotificationPort_DcmCommunicationControl_0_EQ_DCM_ENABLE_RX_DISABLE_TX_NORM_NM: BswMConditionType=BSWM_EQUALS, BswMConditionMode=MRP_IMM_BswModeNotification_modeNotificationPort_DcmCommunicationControl_0
            BswMConditionValue: category=TOOL_CONFIGURED
              BswMModeDeclaration: category=TOOL_CONFIGURED, BswMModeValueRef=DCM_ENABLE_RX_DISABLE_TX_NORM_NM
          MC_IMM_BswModeNotification_modeNotificationPort_DcmCommunicationControl_0_EQ_DCM_ENABLE_RX_TX_NM: BswMConditionType=BSWM_EQUALS, BswMConditionMode=MRP_IMM_BswModeNotification_modeNotificationPort_DcmCommunicationControl_0
            BswMConditionValue: category=TOOL_CONFIGURED
              BswMModeDeclaration: category=TOOL_CONFIGURED, BswMModeValueRef=DCM_ENABLE_RX_TX_NM
          MC_IMM_BswModeNotification_modeNotificationPort_DcmCommunicationControl_0_EQ_DCM_ENABLE_RX_TX_NORM: BswMConditionType=BSWM_EQUALS, BswMConditionMode=MRP_IMM_BswModeNotification_modeNotificationPort_DcmCommunicationControl_0
            BswMConditionValue: category=TOOL_CONFIGURED
              BswMModeDeclaration: category=TOOL_CONFIGURED, BswMModeValueRef=DCM_ENABLE_RX_TX_NORM
          MC_IMM_BswModeNotification_modeNotificationPort_DcmCommunicationControl_0_EQ_DCM_ENABLE_RX_TX_NORM_NM: BswMConditionType=BSWM_EQUALS, BswMConditionMode=MRP_IMM_BswModeNotification_modeNotificationPort_DcmCommunicationControl_0
            BswMConditionValue: category=TOOL_CONFIGURED
              BswMModeDeclaration: category=TOOL_CONFIGURED, BswMModeValueRef=DCM_ENABLE_RX_TX_NORM_NM
          MC_IMM_BswModeNotification_modeNotificationPort_DcmControlDTCSetting_EQ_DISABLEDTCSETTING: BswMConditionType=BSWM_EQUALS, BswMConditionMode=MRP_IMM_BswModeNotification_modeNotificationPort_DcmControlDTCSetting
            BswMConditionValue: category=TOOL_CONFIGURED
              BswMModeDeclaration: category=TOOL_CONFIGURED, BswMModeValueRef=DISABLEDTCSETTING
          MC_IMM_BswModeNotification_modeNotificationPort_DcmControlDTCSetting_EQ_ENABLEDTCSETTING: BswMConditionType=BSWM_EQUALS, BswMConditionMode=MRP_IMM_BswModeNotification_modeNotificationPort_DcmControlDTCSetting
            BswMConditionValue: category=TOOL_CONFIGURED
              BswMModeDeclaration: category=TOOL_CONFIGURED, BswMModeValueRef=ENABLEDTCSETTING
          MC_IMM_BswModeNotification_modeNotificationPort_DcmDiagnosticSessionControl_EQ_DCM_DEFAULT_SESSION: BswMConditionType=BSWM_EQUALS, BswMConditionMode=MRP_IMM_BswModeNotification_modeNotificationPort_DcmDiagnosticSessionControl
            BswMConditionValue: category=TOOL_CONFIGURED
              BswMModeDeclaration: category=TOOL_CONFIGURED, BswMModeValueRef=DCM_DEFAULT_SESSION
          MC_IMM_BswModeNotification_modeNotificationPort_DcmDiagnosticSessionControl_EQ_DCM_ECU_PROGRAMMING_MODE: BswMConditionType=BSWM_EQUALS, BswMConditionMode=MRP_IMM_BswModeNotification_modeNotificationPort_DcmDiagnosticSessionControl
            BswMConditionValue: category=TOOL_CONFIGURED
              BswMModeDeclaration: category=TOOL_CONFIGURED, BswMModeValueRef=DCM_ECU_PROGRAMMING_MODE
          MC_IMM_BswModeNotification_modeNotificationPort_DcmDiagnosticSessionControl_EQ_DCM_EXTENDED_DIAGNOSTIC_MODE: BswMConditionType=BSWM_EQUALS, BswMConditionMode=MRP_IMM_BswModeNotification_modeNotificationPort_DcmDiagnosticSessionControl
            BswMConditionValue: category=TOOL_CONFIGURED
              BswMModeDeclaration: category=TOOL_CONFIGURED, BswMModeValueRef=DCM_EXTENDED_DIAGNOSTIC_MODE
          MC_IMM_BswModeNotification_modeNotificationPort_DcmDiagnosticSessionControl_EQ_DCM_EXTENDED_DIAGNOSTIC_SESSION: BswMConditionType=BSWM_EQUALS, BswMConditionMode=MRP_IMM_BswModeNotification_modeNotificationPort_DcmDiagnosticSessionControl
            BswMConditionValue: category=TOOL_CONFIGURED
              BswMModeDeclaration: category=TOOL_CONFIGURED, BswMModeValueRef=DCM_EXTENDED_DIAGNOSTIC_SESSION
          MC_IMM_BswModeNotification_modeNotificationPort_DcmDiagnosticSessionControl_EQ_DCM_PROGRAMMING_SESSION: BswMConditionType=BSWM_EQUALS, BswMConditionMode=MRP_IMM_BswModeNotification_modeNotificationPort_DcmDiagnosticSessionControl
            BswMConditionValue: category=TOOL_CONFIGURED
              BswMModeDeclaration: category=TOOL_CONFIGURED, BswMModeValueRef=DCM_PROGRAMMING_SESSION
          MC_IMM_BswModeNotification_modeNotificationPort_DcmDiagnosticSessionControl_EQ_DCM_QUIESCENT_CURRENT_DIAGNOSTIC_MODE_START: BswMConditionType=BSWM_EQUALS, BswMConditionMode=MRP_IMM_BswModeNotification_modeNotificationPort_DcmDiagnosticSessionControl
            BswMConditionValue: category=TOOL_CONFIGURED
              BswMModeDeclaration: category=TOOL_CONFIGURED, BswMModeValueRef=DCM_QUIESCENT_CURRENT_DIAGNOSTIC_MODE_START
          MC_IMM_BswModeNotification_modeNotificationPort_DcmDiagnosticSessionControl_EQ_DCM_SAFETY_SYSTEM_DIAGNOSTIC_SESSION: BswMConditionType=BSWM_EQUALS, BswMConditionMode=MRP_IMM_BswModeNotification_modeNotificationPort_DcmDiagnosticSessionControl
            BswMConditionValue: category=TOOL_CONFIGURED
              BswMModeDeclaration: category=TOOL_CONFIGURED, BswMModeValueRef=DCM_SAFETY_SYSTEM_DIAGNOSTIC_SESSION
          MC_IMM_BswModeNotification_modeNotificationPort_DcmDiagnosticSessionControl_EQ_DCM_SLEEP_MODE_START_REQUEST: BswMConditionType=BSWM_EQUALS, BswMConditionMode=MRP_IMM_BswModeNotification_modeNotificationPort_DcmDiagnosticSessionControl
            BswMConditionValue: category=TOOL_CONFIGURED
              BswMModeDeclaration: category=TOOL_CONFIGURED, BswMModeValueRef=DCM_SLEEP_MODE_START_REQUEST
          MC_IMM_BswModeNotification_modeNotificationPort_DcmEcuReset_EQ_EXECUTE: BswMConditionType=BSWM_EQUALS, BswMConditionMode=MRP_IMM_BswModeNotification_modeNotificationPort_DcmEcuReset
            BswMConditionValue: category=TOOL_CONFIGURED
              BswMModeDeclaration: category=TOOL_CONFIGURED, BswMModeValueRef=EXECUTE
          MC_IMM_BswModeNotification_modeNotificationPort_DcmEcuReset_EQ_HARD: BswMConditionType=BSWM_EQUALS, BswMConditionMode=MRP_IMM_BswModeNotification_modeNotificationPort_DcmEcuReset
            BswMConditionValue: category=TOOL_CONFIGURED
              BswMModeDeclaration: category=TOOL_CONFIGURED, BswMModeValueRef=HARD
          MC_IMM_BswModeNotification_modeNotificationPort_DcmEcuReset_EQ_SOFT: BswMConditionType=BSWM_EQUALS, BswMConditionMode=MRP_IMM_BswModeNotification_modeNotificationPort_DcmEcuReset
            BswMConditionValue: category=TOOL_CONFIGURED
              BswMModeDeclaration: category=TOOL_CONFIGURED, BswMModeValueRef=SOFT
          MC_IMM_BswModeNotification_modeNotificationPort_DcmModeRapidPowerShutDown_EQ_DISABLE_RAPIDPOWERSHUTDOWN: BswMConditionType=BSWM_EQUALS, BswMConditionMode=MRP_IMM_BswModeNotification_modeNotificationPort_DcmModeRapidPowerShutDown
            BswMConditionValue: category=TOOL_CONFIGURED
              BswMModeDeclaration: category=TOOL_CONFIGURED, BswMModeValueRef=DISABLE_RAPIDPOWERSHUTDOWN
          MC_IMM_BswModeNotification_modeNotificationPort_DcmModeRapidPowerShutDown_EQ_ENABLE_RAPIDPOWERSHUTDOWN: BswMConditionType=BSWM_EQUALS, BswMConditionMode=MRP_IMM_BswModeNotification_modeNotificationPort_DcmModeRapidPowerShutDown
            BswMConditionValue: category=TOOL_CONFIGURED
              BswMModeDeclaration: category=TOOL_CONFIGURED, BswMModeValueRef=ENABLE_RAPIDPOWERSHUTDOWN
          MC_IMM_CanSMIndication_BCAN_EN_BUS_OFF: BswMConditionType=BSWM_EQUALS_NOT, BswMConditionMode=MRP_IMM_CanSMIndication_BCAN
            BswMConditionValue: category=TOOL_CONFIGURED
              BswMBswMode: category=TOOL_CONFIGURED, BswMBswRequestedMode=CANSM_BSWM_BUS_OFF
          MC_IMM_CanSMIndication_BCAN_EQ_BUS_OFF: BswMConditionType=BSWM_EQUALS, BswMConditionMode=MRP_IMM_CanSMIndication_BCAN
            BswMConditionValue: category=TOOL_CONFIGURED
              BswMBswMode: category=TOOL_CONFIGURED, BswMBswRequestedMode=CANSM_BSWM_BUS_OFF
          MC_IMM_CanSMIndication_BCAN_EQ_CHANGE_BAUDRATE: BswMConditionType=BSWM_EQUALS, BswMConditionMode=MRP_IMM_CanSMIndication_BCAN
            BswMConditionValue: category=TOOL_CONFIGURED
              BswMBswMode: category=TOOL_CONFIGURED, BswMBswRequestedMode=CANSM_BSWM_CHANGE_BAUDRATE
          MC_IMM_CanSMIndication_BCAN_EQ_FULL_COM: BswMConditionType=BSWM_EQUALS, BswMConditionMode=MRP_IMM_CanSMIndication_BCAN
            BswMConditionValue: category=TOOL_CONFIGURED
              BswMBswMode: category=TOOL_CONFIGURED, BswMBswRequestedMode=CANSM_BSWM_FULL_COMMUNICATION
          MC_IMM_CanSMIndication_BCAN_EQ_NO_COM: BswMConditionType=BSWM_EQUALS, BswMConditionMode=MRP_IMM_CanSMIndication_BCAN
            BswMConditionValue: category=TOOL_CONFIGURED
              BswMBswMode: category=TOOL_CONFIGURED, BswMBswRequestedMode=CANSM_BSWM_NO_COMMUNICATION
          MC_IMM_CanSMIndication_BCAN_EQ_SILENT_COM: BswMConditionType=BSWM_EQUALS, BswMConditionMode=MRP_IMM_CanSMIndication_BCAN
            BswMConditionValue: category=TOOL_CONFIGURED
              BswMBswMode: category=TOOL_CONFIGURED, BswMBswRequestedMode=CANSM_BSWM_SILENT_COMMUNICATION
          MC_IMM_CanSMIndication_LCAN_EN_BUS_OFF: BswMConditionType=BSWM_EQUALS_NOT, BswMConditionMode=MRP_IMM_CanSMIndication_LCAN
            BswMConditionValue: category=TOOL_CONFIGURED
              BswMBswMode: category=TOOL_CONFIGURED, BswMBswRequestedMode=CANSM_BSWM_BUS_OFF
          MC_IMM_CanSMIndication_LCAN_EQ_BUS_OFF: BswMConditionType=BSWM_EQUALS, BswMConditionMode=MRP_IMM_CanSMIndication_LCAN
            BswMConditionValue: category=TOOL_CONFIGURED
              BswMBswMode: category=TOOL_CONFIGURED, BswMBswRequestedMode=CANSM_BSWM_BUS_OFF
          MC_IMM_CanSMIndication_LCAN_EQ_CHANGE_BAUDRATE: BswMConditionType=BSWM_EQUALS, BswMConditionMode=MRP_IMM_CanSMIndication_LCAN
            BswMConditionValue: category=TOOL_CONFIGURED
              BswMBswMode: category=TOOL_CONFIGURED, BswMBswRequestedMode=CANSM_BSWM_CHANGE_BAUDRATE
          MC_IMM_CanSMIndication_LCAN_EQ_FULL_COM: BswMConditionType=BSWM_EQUALS, BswMConditionMode=MRP_IMM_CanSMIndication_LCAN
            BswMConditionValue: category=TOOL_CONFIGURED
              BswMBswMode: category=TOOL_CONFIGURED, BswMBswRequestedMode=CANSM_BSWM_FULL_COMMUNICATION
          MC_IMM_CanSMIndication_LCAN_EQ_NO_COM: BswMConditionType=BSWM_EQUALS, BswMConditionMode=MRP_IMM_CanSMIndication_LCAN
            BswMConditionValue: category=TOOL_CONFIGURED
              BswMBswMode: category=TOOL_CONFIGURED, BswMBswRequestedMode=CANSM_BSWM_NO_COMMUNICATION
          MC_IMM_CanSMIndication_LCAN_EQ_SILENT_COM: BswMConditionType=BSWM_EQUALS, BswMConditionMode=MRP_IMM_CanSMIndication_LCAN
            BswMConditionValue: category=TOOL_CONFIGURED
              BswMBswMode: category=TOOL_CONFIGURED, BswMBswRequestedMode=CANSM_BSWM_SILENT_COMMUNICATION
          MC_IMM_ComMIndication_BCAN_EN_FULL_COM: BswMConditionType=BSWM_EQUALS_NOT, BswMConditionMode=MRP_IMM_ComMIndication_BCAN
            BswMConditionValue: category=TOOL_CONFIGURED
              BswMBswMode: category=TOOL_CONFIGURED, BswMBswRequestedMode=COMM_FULL_COMMUNICATION
          MC_IMM_ComMIndication_BCAN_EQ_FULL_COM: BswMConditionType=BSWM_EQUALS, BswMConditionMode=MRP_IMM_ComMIndication_BCAN
            BswMConditionValue: category=TOOL_CONFIGURED
              BswMBswMode: category=TOOL_CONFIGURED, BswMBswRequestedMode=COMM_FULL_COMMUNICATION
          MC_IMM_ComMIndication_BCAN_EQ_NO_COM: BswMConditionType=BSWM_EQUALS, BswMConditionMode=MRP_IMM_ComMIndication_BCAN
            BswMConditionValue: category=TOOL_CONFIGURED
              BswMBswMode: category=TOOL_CONFIGURED, BswMBswRequestedMode=COMM_NO_COMMUNICATION
          MC_IMM_ComMIndication_BCAN_EQ_SILENT_COM: BswMConditionType=BSWM_EQUALS, BswMConditionMode=MRP_IMM_ComMIndication_BCAN
            BswMConditionValue: category=TOOL_CONFIGURED
              BswMBswMode: category=TOOL_CONFIGURED, BswMBswRequestedMode=COMM_SILENT_COMMUNICATION
          MC_IMM_ComMIndication_LCAN_EN_FULL_COM: BswMConditionType=BSWM_EQUALS_NOT, BswMConditionMode=MRP_IMM_ComMIndication_LCAN
            BswMConditionValue: category=TOOL_CONFIGURED
              BswMBswMode: category=TOOL_CONFIGURED, BswMBswRequestedMode=COMM_FULL_COMMUNICATION
          MC_IMM_ComMIndication_LCAN_EQ_FULL_COM: BswMConditionType=BSWM_EQUALS, BswMConditionMode=MRP_IMM_ComMIndication_LCAN
            BswMConditionValue: category=TOOL_CONFIGURED
              BswMBswMode: category=TOOL_CONFIGURED, BswMBswRequestedMode=COMM_FULL_COMMUNICATION
          MC_IMM_ComMIndication_LCAN_EQ_NO_COM: BswMConditionType=BSWM_EQUALS, BswMConditionMode=MRP_IMM_ComMIndication_LCAN
            BswMConditionValue: category=TOOL_CONFIGURED
              BswMBswMode: category=TOOL_CONFIGURED, BswMBswRequestedMode=COMM_NO_COMMUNICATION
          MC_IMM_ComMIndication_LCAN_EQ_SILENT_COM: BswMConditionType=BSWM_EQUALS, BswMConditionMode=MRP_IMM_ComMIndication_LCAN
            BswMConditionValue: category=TOOL_CONFIGURED
              BswMBswMode: category=TOOL_CONFIGURED, BswMBswRequestedMode=COMM_SILENT_COMMUNICATION
          MC_IMM_ComMPncIndication_PNC141_EQ_PNC_FULL_COMMUNICATION: BswMConditionType=BSWM_EQUALS, BswMConditionMode=MRP_IMM_ComMPncIndication_PNC141
            BswMConditionValue: category=TOOL_CONFIGURED
              BswMBswMode: category=TOOL_CONFIGURED, BswMBswRequestedMode=PNC_FULL_COMMUNICATION
          MC_IMM_ComMPncIndication_PNC141_EQ_PNC_NO_COMMUNICATION: BswMConditionType=BSWM_EQUALS, BswMConditionMode=MRP_IMM_ComMPncIndication_PNC141
            BswMConditionValue: category=TOOL_CONFIGURED
              BswMBswMode: category=TOOL_CONFIGURED, BswMBswRequestedMode=PNC_NO_COMMUNICATION
          MC_IMM_ComMPncIndication_PNC141_EQ_PNC_PREPARE_SLEEP: BswMConditionType=BSWM_EQUALS, BswMConditionMode=MRP_IMM_ComMPncIndication_PNC141
            BswMConditionValue: category=TOOL_CONFIGURED
              BswMBswMode: category=TOOL_CONFIGURED, BswMBswRequestedMode=PNC_PREPARE_SLEEP
          MC_IMM_ComMPncIndication_PNC141_EQ_PNC_READY_SLEEP: BswMConditionType=BSWM_EQUALS, BswMConditionMode=MRP_IMM_ComMPncIndication_PNC141
            BswMConditionValue: category=TOOL_CONFIGURED
              BswMBswMode: category=TOOL_CONFIGURED, BswMBswRequestedMode=PNC_READY_SLEEP
          MC_IMM_ComMPncIndication_PNC141_EQ_PNC_REQUESTED: BswMConditionType=BSWM_EQUALS, BswMConditionMode=MRP_IMM_ComMPncIndication_PNC141
            BswMConditionValue: category=TOOL_CONFIGURED
              BswMBswMode: category=TOOL_CONFIGURED, BswMBswRequestedMode=PNC_REQUESTED
          MC_IMM_ComMPncIndication_PNC153_EQ_PNC_FULL_COMMUNICATION: BswMConditionType=BSWM_EQUALS, BswMConditionMode=MRP_IMM_ComMPncIndication_PNC153
            BswMConditionValue: category=TOOL_CONFIGURED
              BswMBswMode: category=TOOL_CONFIGURED, BswMBswRequestedMode=PNC_FULL_COMMUNICATION
          MC_IMM_ComMPncIndication_PNC153_EQ_PNC_NO_COMMUNICATION: BswMConditionType=BSWM_EQUALS, BswMConditionMode=MRP_IMM_ComMPncIndication_PNC153
            BswMConditionValue: category=TOOL_CONFIGURED
              BswMBswMode: category=TOOL_CONFIGURED, BswMBswRequestedMode=PNC_NO_COMMUNICATION
          MC_IMM_ComMPncIndication_PNC153_EQ_PNC_PREPARE_SLEEP: BswMConditionType=BSWM_EQUALS, BswMConditionMode=MRP_IMM_ComMPncIndication_PNC153
            BswMConditionValue: category=TOOL_CONFIGURED
              BswMBswMode: category=TOOL_CONFIGURED, BswMBswRequestedMode=PNC_PREPARE_SLEEP
          MC_IMM_ComMPncIndication_PNC153_EQ_PNC_READY_SLEEP: BswMConditionType=BSWM_EQUALS, BswMConditionMode=MRP_IMM_ComMPncIndication_PNC153
            BswMConditionValue: category=TOOL_CONFIGURED
              BswMBswMode: category=TOOL_CONFIGURED, BswMBswRequestedMode=PNC_READY_SLEEP
          MC_IMM_ComMPncIndication_PNC153_EQ_PNC_REQUESTED: BswMConditionType=BSWM_EQUALS, BswMConditionMode=MRP_IMM_ComMPncIndication_PNC153
            BswMConditionValue: category=TOOL_CONFIGURED
              BswMBswMode: category=TOOL_CONFIGURED, BswMBswRequestedMode=PNC_REQUESTED
          MC_IMM_ComMPncIndication_PNC159_EQ_PNC_FULL_COMMUNICATION: BswMConditionType=BSWM_EQUALS, BswMConditionMode=MRP_IMM_ComMPncIndication_PNC159
            BswMConditionValue: category=TOOL_CONFIGURED
              BswMBswMode: category=TOOL_CONFIGURED, BswMBswRequestedMode=PNC_FULL_COMMUNICATION
          MC_IMM_ComMPncIndication_PNC159_EQ_PNC_NO_COMMUNICATION: BswMConditionType=BSWM_EQUALS, BswMConditionMode=MRP_IMM_ComMPncIndication_PNC159
            BswMConditionValue: category=TOOL_CONFIGURED
              BswMBswMode: category=TOOL_CONFIGURED, BswMBswRequestedMode=PNC_NO_COMMUNICATION
          MC_IMM_ComMPncIndication_PNC159_EQ_PNC_PREPARE_SLEEP: BswMConditionType=BSWM_EQUALS, BswMConditionMode=MRP_IMM_ComMPncIndication_PNC159
            BswMConditionValue: category=TOOL_CONFIGURED
              BswMBswMode: category=TOOL_CONFIGURED, BswMBswRequestedMode=PNC_PREPARE_SLEEP
          MC_IMM_ComMPncIndication_PNC159_EQ_PNC_READY_SLEEP: BswMConditionType=BSWM_EQUALS, BswMConditionMode=MRP_IMM_ComMPncIndication_PNC159
            BswMConditionValue: category=TOOL_CONFIGURED
              BswMBswMode: category=TOOL_CONFIGURED, BswMBswRequestedMode=PNC_READY_SLEEP
          MC_IMM_ComMPncIndication_PNC159_EQ_PNC_REQUESTED: BswMConditionType=BSWM_EQUALS, BswMConditionMode=MRP_IMM_ComMPncIndication_PNC159
            BswMConditionValue: category=TOOL_CONFIGURED
              BswMBswMode: category=TOOL_CONFIGURED, BswMBswRequestedMode=PNC_REQUESTED
          MC_IMM_ComMPncIndication_PNC32_EQ_PNC_FULL_COMMUNICATION: BswMConditionType=BSWM_EQUALS, BswMConditionMode=MRP_IMM_ComMPncIndication_PNC32
            BswMConditionValue: category=TOOL_CONFIGURED
              BswMBswMode: category=TOOL_CONFIGURED, BswMBswRequestedMode=PNC_FULL_COMMUNICATION
          MC_IMM_ComMPncIndication_PNC32_EQ_PNC_NO_COMMUNICATION: BswMConditionType=BSWM_EQUALS, BswMConditionMode=MRP_IMM_ComMPncIndication_PNC32
            BswMConditionValue: category=TOOL_CONFIGURED
              BswMBswMode: category=TOOL_CONFIGURED, BswMBswRequestedMode=PNC_NO_COMMUNICATION
          MC_IMM_ComMPncIndication_PNC32_EQ_PNC_PREPARE_SLEEP: BswMConditionType=BSWM_EQUALS, BswMConditionMode=MRP_IMM_ComMPncIndication_PNC32
            BswMConditionValue: category=TOOL_CONFIGURED
              BswMBswMode: category=TOOL_CONFIGURED, BswMBswRequestedMode=PNC_PREPARE_SLEEP
          MC_IMM_ComMPncIndication_PNC32_EQ_PNC_READY_SLEEP: BswMConditionType=BSWM_EQUALS, BswMConditionMode=MRP_IMM_ComMPncIndication_PNC32
            BswMConditionValue: category=TOOL_CONFIGURED
              BswMBswMode: category=TOOL_CONFIGURED, BswMBswRequestedMode=PNC_READY_SLEEP
          MC_IMM_ComMPncIndication_PNC32_EQ_PNC_REQUESTED: BswMConditionType=BSWM_EQUALS, BswMConditionMode=MRP_IMM_ComMPncIndication_PNC32
            BswMConditionValue: category=TOOL_CONFIGURED
              BswMBswMode: category=TOOL_CONFIGURED, BswMBswRequestedMode=PNC_REQUESTED
          MC_IMM_ComMPncRequest_PNC141_EN_READY_SLEEP: BswMConditionType=BSWM_EQUALS_NOT, BswMConditionMode=MRP_IMM_ComMPncRequest_PNC141
            BswMConditionValue: category=TOOL_CONFIGURED
              BswMBswMode: category=TOOL_CONFIGURED, BswMBswRequestedMode=PNC_READY_SLEEP
          MC_IMM_ComMPncRequest_PNC141_EN_REQUESTED: BswMConditionType=BSWM_EQUALS_NOT, BswMConditionMode=MRP_IMM_ComMPncRequest_PNC141
            BswMConditionValue: category=TOOL_CONFIGURED
              BswMBswMode: category=TOOL_CONFIGURED, BswMBswRequestedMode=PNC_REQUESTED
          MC_IMM_ComMPncRequest_PNC141_EQ_NO_COM: BswMConditionType=BSWM_EQUALS, BswMConditionMode=MRP_IMM_ComMPncRequest_PNC141
            BswMConditionValue: category=TOOL_CONFIGURED
              BswMBswMode: category=TOOL_CONFIGURED, BswMBswRequestedMode=PNC_NO_COMMUNICATION
          MC_IMM_ComMPncRequest_PNC141_EQ_READY_SLEEP: BswMConditionType=BSWM_EQUALS, BswMConditionMode=MRP_IMM_ComMPncRequest_PNC141
            BswMConditionValue: category=TOOL_CONFIGURED
              BswMBswMode: category=TOOL_CONFIGURED, BswMBswRequestedMode=PNC_READY_SLEEP
          MC_IMM_ComMPncRequest_PNC141_EQ_REQUESTED: BswMConditionType=BSWM_EQUALS, BswMConditionMode=MRP_IMM_ComMPncRequest_PNC141
            BswMConditionValue: category=TOOL_CONFIGURED
              BswMBswMode: category=TOOL_CONFIGURED, BswMBswRequestedMode=PNC_REQUESTED
          MC_IMM_ComMPncRequest_PNC153_EN_READY_SLEEP: BswMConditionType=BSWM_EQUALS_NOT, BswMConditionMode=MRP_IMM_ComMPncRequest_PNC153
            BswMConditionValue: category=TOOL_CONFIGURED
              BswMBswMode: category=TOOL_CONFIGURED, BswMBswRequestedMode=PNC_READY_SLEEP
          MC_IMM_ComMPncRequest_PNC153_EN_REQUESTED: BswMConditionType=BSWM_EQUALS_NOT, BswMConditionMode=MRP_IMM_ComMPncRequest_PNC153
            BswMConditionValue: category=TOOL_CONFIGURED
              BswMBswMode: category=TOOL_CONFIGURED, BswMBswRequestedMode=PNC_REQUESTED
          MC_IMM_ComMPncRequest_PNC153_EQ_NO_COM: BswMConditionType=BSWM_EQUALS, BswMConditionMode=MRP_IMM_ComMPncRequest_PNC153
            BswMConditionValue: category=TOOL_CONFIGURED
              BswMBswMode: category=TOOL_CONFIGURED, BswMBswRequestedMode=PNC_NO_COMMUNICATION
          MC_IMM_ComMPncRequest_PNC153_EQ_READY_SLEEP: BswMConditionType=BSWM_EQUALS, BswMConditionMode=MRP_IMM_ComMPncRequest_PNC153
            BswMConditionValue: category=TOOL_CONFIGURED
              BswMBswMode: category=TOOL_CONFIGURED, BswMBswRequestedMode=PNC_READY_SLEEP
          MC_IMM_ComMPncRequest_PNC153_EQ_REQUESTED: BswMConditionType=BSWM_EQUALS, BswMConditionMode=MRP_IMM_ComMPncRequest_PNC153
            BswMConditionValue: category=TOOL_CONFIGURED
              BswMBswMode: category=TOOL_CONFIGURED, BswMBswRequestedMode=PNC_REQUESTED
          MC_IMM_ComMPncRequest_PNC159_EN_READY_SLEEP: BswMConditionType=BSWM_EQUALS_NOT, BswMConditionMode=MRP_IMM_ComMPncRequest_PNC159
            BswMConditionValue: category=TOOL_CONFIGURED
              BswMBswMode: category=TOOL_CONFIGURED, BswMBswRequestedMode=PNC_READY_SLEEP
          MC_IMM_ComMPncRequest_PNC159_EN_REQUESTED: BswMConditionType=BSWM_EQUALS_NOT, BswMConditionMode=MRP_IMM_ComMPncRequest_PNC159
            BswMConditionValue: category=TOOL_CONFIGURED
              BswMBswMode: category=TOOL_CONFIGURED, BswMBswRequestedMode=PNC_REQUESTED
          MC_IMM_ComMPncRequest_PNC159_EQ_NO_COM: BswMConditionType=BSWM_EQUALS, BswMConditionMode=MRP_IMM_ComMPncRequest_PNC159
            BswMConditionValue: category=TOOL_CONFIGURED
              BswMBswMode: category=TOOL_CONFIGURED, BswMBswRequestedMode=PNC_NO_COMMUNICATION
          MC_IMM_ComMPncRequest_PNC159_EQ_READY_SLEEP: BswMConditionType=BSWM_EQUALS, BswMConditionMode=MRP_IMM_ComMPncRequest_PNC159
            BswMConditionValue: category=TOOL_CONFIGURED
              BswMBswMode: category=TOOL_CONFIGURED, BswMBswRequestedMode=PNC_READY_SLEEP
          MC_IMM_ComMPncRequest_PNC159_EQ_REQUESTED: BswMConditionType=BSWM_EQUALS, BswMConditionMode=MRP_IMM_ComMPncRequest_PNC159
            BswMConditionValue: category=TOOL_CONFIGURED
              BswMBswMode: category=TOOL_CONFIGURED, BswMBswRequestedMode=PNC_REQUESTED
          MC_IMM_ComMPncRequest_PNC32_EN_READY_SLEEP: BswMConditionType=BSWM_EQUALS_NOT, BswMConditionMode=MRP_IMM_ComMPncRequest_PNC32
            BswMConditionValue: category=TOOL_CONFIGURED
              BswMBswMode: category=TOOL_CONFIGURED, BswMBswRequestedMode=PNC_READY_SLEEP
          MC_IMM_ComMPncRequest_PNC32_EN_REQUESTED: BswMConditionType=BSWM_EQUALS_NOT, BswMConditionMode=MRP_IMM_ComMPncRequest_PNC32
            BswMConditionValue: category=TOOL_CONFIGURED
              BswMBswMode: category=TOOL_CONFIGURED, BswMBswRequestedMode=PNC_REQUESTED
          MC_IMM_ComMPncRequest_PNC32_EQ_NO_COM: BswMConditionType=BSWM_EQUALS, BswMConditionMode=MRP_IMM_ComMPncRequest_PNC32
            BswMConditionValue: category=TOOL_CONFIGURED
              BswMBswMode: category=TOOL_CONFIGURED, BswMBswRequestedMode=PNC_NO_COMMUNICATION
          MC_IMM_ComMPncRequest_PNC32_EQ_READY_SLEEP: BswMConditionType=BSWM_EQUALS, BswMConditionMode=MRP_IMM_ComMPncRequest_PNC32
            BswMConditionValue: category=TOOL_CONFIGURED
              BswMBswMode: category=TOOL_CONFIGURED, BswMBswRequestedMode=PNC_READY_SLEEP
          MC_IMM_ComMPncRequest_PNC32_EQ_REQUESTED: BswMConditionType=BSWM_EQUALS, BswMConditionMode=MRP_IMM_ComMPncRequest_PNC32
            BswMConditionValue: category=TOOL_CONFIGURED
              BswMBswMode: category=TOOL_CONFIGURED, BswMBswRequestedMode=PNC_REQUESTED
          MC_IMM_DcmApplicationUpdatedIndication_EQ_APP_NOT_UPDATED: BswMConditionType=BSWM_EQUALS, BswMConditionMode=MRP_IMM_DcmApplicationUpdatedIndication
            BswMConditionValue: category=TOOL_CONFIGURED
              BswMModeDeclaration: category=TOOL_CONFIGURED, BswMModeValueRef=APP_NOT_UPDATED
          MC_IMM_DcmApplicationUpdatedIndication_EQ_APP_UPDATED: BswMConditionType=BSWM_EQUALS, BswMConditionMode=MRP_IMM_DcmApplicationUpdatedIndication
            BswMConditionValue: category=TOOL_CONFIGURED
              BswMModeDeclaration: category=TOOL_CONFIGURED, BswMModeValueRef=APP_UPDATED
          MC_IMM_DcmComModeRequest_BCAN_EQ_DISABLE_RX_ENABLE_TX_NM: BswMConditionType=BSWM_EQUALS, BswMConditionMode=MRP_IMM_DcmComModeRequest_BCAN
            BswMConditionValue: category=TOOL_CONFIGURED
              BswMBswMode: category=TOOL_CONFIGURED, BswMBswRequestedMode=DCM_DISABLE_RX_ENABLE_TX_NM
          MC_IMM_DcmComModeRequest_BCAN_EQ_DISABLE_RX_ENABLE_TX_NORM: BswMConditionType=BSWM_EQUALS, BswMConditionMode=MRP_IMM_DcmComModeRequest_BCAN
            BswMConditionValue: category=TOOL_CONFIGURED
              BswMBswMode: category=TOOL_CONFIGURED, BswMBswRequestedMode=DCM_DISABLE_RX_ENABLE_TX_NORM
          MC_IMM_DcmComModeRequest_BCAN_EQ_DISABLE_RX_ENABLE_TX_NORM_NM: BswMConditionType=BSWM_EQUALS, BswMConditionMode=MRP_IMM_DcmComModeRequest_BCAN
            BswMConditionValue: category=TOOL_CONFIGURED
              BswMBswMode: category=TOOL_CONFIGURED, BswMBswRequestedMode=DCM_DISABLE_RX_ENABLE_TX_NORM_NM
          MC_IMM_DcmComModeRequest_BCAN_EQ_DISABLE_RX_TX_NM: BswMConditionType=BSWM_EQUALS, BswMConditionMode=MRP_IMM_DcmComModeRequest_BCAN
            BswMConditionValue: category=TOOL_CONFIGURED
              BswMBswMode: category=TOOL_CONFIGURED, BswMBswRequestedMode=DCM_DISABLE_RX_TX_NM
          MC_IMM_DcmComModeRequest_BCAN_EQ_DISABLE_RX_TX_NORM: BswMConditionType=BSWM_EQUALS, BswMConditionMode=MRP_IMM_DcmComModeRequest_BCAN
            BswMConditionValue: category=TOOL_CONFIGURED
              BswMBswMode: category=TOOL_CONFIGURED, BswMBswRequestedMode=DCM_DISABLE_RX_TX_NORM
          MC_IMM_DcmComModeRequest_BCAN_EQ_DISABLE_RX_TX_NORM_NM: BswMConditionType=BSWM_EQUALS, BswMConditionMode=MRP_IMM_DcmComModeRequest_BCAN
            BswMConditionValue: category=TOOL_CONFIGURED
              BswMBswMode: category=TOOL_CONFIGURED, BswMBswRequestedMode=DCM_DISABLE_RX_TX_NORM_NM
          MC_IMM_DcmComModeRequest_BCAN_EQ_ENABLE_RX_DISABLE_TX_NM: BswMConditionType=BSWM_EQUALS, BswMConditionMode=MRP_IMM_DcmComModeRequest_BCAN
            BswMConditionValue: category=TOOL_CONFIGURED
              BswMBswMode: category=TOOL_CONFIGURED, BswMBswRequestedMode=DCM_ENABLE_RX_DISABLE_TX_NM
          MC_IMM_DcmComModeRequest_BCAN_EQ_ENABLE_RX_DISABLE_TX_NORM: BswMConditionType=BSWM_EQUALS, BswMConditionMode=MRP_IMM_DcmComModeRequest_BCAN
            BswMConditionValue: category=TOOL_CONFIGURED
              BswMBswMode: category=TOOL_CONFIGURED, BswMBswRequestedMode=DCM_ENABLE_RX_DISABLE_TX_NORM
          MC_IMM_DcmComModeRequest_BCAN_EQ_ENABLE_RX_DISABLE_TX_NORM_NM: BswMConditionType=BSWM_EQUALS, BswMConditionMode=MRP_IMM_DcmComModeRequest_BCAN
            BswMConditionValue: category=TOOL_CONFIGURED
              BswMBswMode: category=TOOL_CONFIGURED, BswMBswRequestedMode=DCM_ENABLE_RX_DISABLE_TX_NORM_NM
          MC_IMM_DcmComModeRequest_BCAN_EQ_ENABLE_RX_TX_NM: BswMConditionType=BSWM_EQUALS, BswMConditionMode=MRP_IMM_DcmComModeRequest_BCAN
            BswMConditionValue: category=TOOL_CONFIGURED
              BswMBswMode: category=TOOL_CONFIGURED, BswMBswRequestedMode=DCM_ENABLE_RX_TX_NM
          MC_IMM_DcmComModeRequest_BCAN_EQ_ENABLE_RX_TX_NORM: BswMConditionType=BSWM_EQUALS, BswMConditionMode=MRP_IMM_DcmComModeRequest_BCAN
            BswMConditionValue: category=TOOL_CONFIGURED
              BswMBswMode: category=TOOL_CONFIGURED, BswMBswRequestedMode=DCM_ENABLE_RX_TX_NORM
          MC_IMM_DcmComModeRequest_BCAN_EQ_ENABLE_RX_TX_NORM_NM: BswMConditionType=BSWM_EQUALS, BswMConditionMode=MRP_IMM_DcmComModeRequest_BCAN
            BswMConditionValue: category=TOOL_CONFIGURED
              BswMBswMode: category=TOOL_CONFIGURED, BswMBswRequestedMode=DCM_ENABLE_RX_TX_NORM_NM
          MC_IMM_EcuMIndication_EQ_STARTUP_TWO: BswMConditionType=BSWM_EQUALS, BswMConditionMode=MRP_IMM_EcuMIndication
            BswMConditionValue: category=TOOL_CONFIGURED
              BswMBswMode: category=TOOL_CONFIGURED, BswMBswRequestedMode=ECUM_STATE_STARTUP_TWO
          MC_IMM_EcuMWakeupSource_BCAN_RX_EQ_VALIDATED: BswMConditionType=BSWM_EQUALS, BswMConditionMode=MRP_IMM_EcuMWakeupSource_BCAN_RX
            BswMConditionValue: category=TOOL_CONFIGURED
              BswMBswMode: category=TOOL_CONFIGURED, BswMBswRequestedMode=ECUM_WKSTATUS_VALIDATED
          MC_IMM_EcuMWakeupSource_BCAN_RX_POLL_EQ_VALIDATED: BswMConditionType=BSWM_EQUALS, BswMConditionMode=MRP_IMM_EcuMWakeupSource_BCAN_RX_POLL
            BswMConditionValue: category=TOOL_CONFIGURED
              BswMBswMode: category=TOOL_CONFIGURED, BswMBswRequestedMode=ECUM_WKSTATUS_VALIDATED
          MC_IMM_EcuMWakeupSource_IGN1_EQ_VALIDATED: BswMConditionType=BSWM_EQUALS, BswMConditionMode=MRP_IMM_EcuMWakeupSource_IGN1
            BswMConditionValue: category=TOOL_CONFIGURED
              BswMBswMode: category=TOOL_CONFIGURED, BswMBswRequestedMode=ECUM_WKSTATUS_VALIDATED
          MC_IMM_EcuMWakeupSource_LCAN_RX_EQ_VALIDATED: BswMConditionType=BSWM_EQUALS, BswMConditionMode=MRP_IMM_EcuMWakeupSource_LCAN_RX
            BswMConditionValue: category=TOOL_CONFIGURED
              BswMBswMode: category=TOOL_CONFIGURED, BswMBswRequestedMode=ECUM_WKSTATUS_VALIDATED
          MC_IMM_EcuMWakeupSource_LCAN_RX_POLL_EQ_VALIDATED: BswMConditionType=BSWM_EQUALS, BswMConditionMode=MRP_IMM_EcuMWakeupSource_LCAN_RX_POLL
            BswMConditionValue: category=TOOL_CONFIGURED
              BswMBswMode: category=TOOL_CONFIGURED, BswMBswRequestedMode=ECUM_WKSTATUS_VALIDATED
          MC_IMM_GenericRequest_CanCMRxDm_BCAN_EQ_DISABLE_RX: BswMConditionType=BSWM_EQUALS, BswMConditionMode=MRP_IMM_GenericRequest_CanCMRxDm_BCAN
            BswMConditionValue: category=TOOL_CONFIGURED
              BswMBswMode: category=TOOL_CONFIGURED, BswMBswRequestedMode=CANCM_COMM_STAT_RX_DISABLED
          MC_IMM_GenericRequest_CanCMRxDm_BCAN_EQ_ENABLE_RX_DISABLE_DM: BswMConditionType=BSWM_EQUALS, BswMConditionMode=MRP_IMM_GenericRequest_CanCMRxDm_BCAN
            BswMConditionValue: category=TOOL_CONFIGURED
              BswMBswMode: category=TOOL_CONFIGURED, BswMBswRequestedMode=CANCM_COMM_STAT_RX_ENABLED_DM_DISABLED
          MC_IMM_GenericRequest_CanCMRxDm_BCAN_EQ_ENABLE_RX_ENABLE_DM: BswMConditionType=BSWM_EQUALS, BswMConditionMode=MRP_IMM_GenericRequest_CanCMRxDm_BCAN
            BswMConditionValue: category=TOOL_CONFIGURED
              BswMBswMode: category=TOOL_CONFIGURED, BswMBswRequestedMode=CANCM_COMM_STAT_RX_ENABLED_DM_ENABLED
          MC_IMM_GenericRequest_CanCMRxDm_LCAN_EQ_DISABLE_RX: BswMConditionType=BSWM_EQUALS, BswMConditionMode=MRP_IMM_GenericRequest_CanCMRxDm_LCAN
            BswMConditionValue: category=TOOL_CONFIGURED
              BswMBswMode: category=TOOL_CONFIGURED, BswMBswRequestedMode=CANCM_COMM_STAT_RX_DISABLED
          MC_IMM_GenericRequest_CanCMRxDm_LCAN_EQ_ENABLE_RX_DISABLE_DM: BswMConditionType=BSWM_EQUALS, BswMConditionMode=MRP_IMM_GenericRequest_CanCMRxDm_LCAN
            BswMConditionValue: category=TOOL_CONFIGURED
              BswMBswMode: category=TOOL_CONFIGURED, BswMBswRequestedMode=CANCM_COMM_STAT_RX_ENABLED_DM_DISABLED
          MC_IMM_GenericRequest_CanCMRxDm_LCAN_EQ_ENABLE_RX_ENABLE_DM: BswMConditionType=BSWM_EQUALS, BswMConditionMode=MRP_IMM_GenericRequest_CanCMRxDm_LCAN
            BswMConditionValue: category=TOOL_CONFIGURED
              BswMBswMode: category=TOOL_CONFIGURED, BswMBswRequestedMode=CANCM_COMM_STAT_RX_ENABLED_DM_ENABLED
          MC_IMM_GenericRequest_CanCMTx_BCAN_EQ_DISABLE: BswMConditionType=BSWM_EQUALS, BswMConditionMode=MRP_IMM_GenericRequest_CanCMTx_BCAN
            BswMConditionValue: category=TOOL_CONFIGURED
              BswMBswMode: category=TOOL_CONFIGURED, BswMBswRequestedMode=CANCM_COMM_STAT_TX_DISABLED
          MC_IMM_GenericRequest_CanCMTx_BCAN_EQ_ENABLE: BswMConditionType=BSWM_EQUALS, BswMConditionMode=MRP_IMM_GenericRequest_CanCMTx_BCAN
            BswMConditionValue: category=TOOL_CONFIGURED
              BswMBswMode: category=TOOL_CONFIGURED, BswMBswRequestedMode=CANCM_COMM_STAT_TX_ENABLED
          MC_IMM_GenericRequest_CanCMTx_LCAN_EQ_DISABLE: BswMConditionType=BSWM_EQUALS, BswMConditionMode=MRP_IMM_GenericRequest_CanCMTx_LCAN
            BswMConditionValue: category=TOOL_CONFIGURED
              BswMBswMode: category=TOOL_CONFIGURED, BswMBswRequestedMode=CANCM_COMM_STAT_TX_DISABLED
          MC_IMM_GenericRequest_CanCMTx_LCAN_EQ_ENABLE: BswMConditionType=BSWM_EQUALS, BswMConditionMode=MRP_IMM_GenericRequest_CanCMTx_LCAN
            BswMConditionValue: category=TOOL_CONFIGURED
              BswMBswMode: category=TOOL_CONFIGURED, BswMBswRequestedMode=CANCM_COMM_STAT_TX_ENABLED
          MC_IMM_GenericRequest_CanCMVol_BCAN_EQ_ABNORMAL: BswMConditionType=BSWM_EQUALS, BswMConditionMode=MRP_IMM_GenericRequest_CanCMVol_BCAN
            BswMConditionValue: category=TOOL_CONFIGURED
              BswMBswMode: category=TOOL_CONFIGURED, BswMBswRequestedMode=CANCM_VOL_MODE_ABNORMAL
          MC_IMM_GenericRequest_CanCMVol_BCAN_EQ_CRITICAL: BswMConditionType=BSWM_EQUALS, BswMConditionMode=MRP_IMM_GenericRequest_CanCMVol_BCAN
            BswMConditionValue: category=TOOL_CONFIGURED
              BswMBswMode: category=TOOL_CONFIGURED, BswMBswRequestedMode=CANCM_VOL_MODE_CRITICAL
          MC_IMM_GenericRequest_CanCMVol_BCAN_EQ_NORMAL: BswMConditionType=BSWM_EQUALS, BswMConditionMode=MRP_IMM_GenericRequest_CanCMVol_BCAN
            BswMConditionValue: category=TOOL_CONFIGURED
              BswMBswMode: category=TOOL_CONFIGURED, BswMBswRequestedMode=CANCM_VOL_MODE_NORMAL
          MC_IMM_GenericRequest_CanCMVol_LCAN_EQ_ABNORMAL: BswMConditionType=BSWM_EQUALS, BswMConditionMode=MRP_IMM_GenericRequest_CanCMVol_LCAN
            BswMConditionValue: category=TOOL_CONFIGURED
              BswMBswMode: category=TOOL_CONFIGURED, BswMBswRequestedMode=CANCM_VOL_MODE_ABNORMAL
          MC_IMM_GenericRequest_CanCMVol_LCAN_EQ_CRITICAL: BswMConditionType=BSWM_EQUALS, BswMConditionMode=MRP_IMM_GenericRequest_CanCMVol_LCAN
            BswMConditionValue: category=TOOL_CONFIGURED
              BswMBswMode: category=TOOL_CONFIGURED, BswMBswRequestedMode=CANCM_VOL_MODE_CRITICAL
          MC_IMM_GenericRequest_CanCMVol_LCAN_EQ_NORMAL: BswMConditionType=BSWM_EQUALS, BswMConditionMode=MRP_IMM_GenericRequest_CanCMVol_LCAN
            BswMConditionValue: category=TOOL_CONFIGURED
              BswMBswMode: category=TOOL_CONFIGURED, BswMBswRequestedMode=CANCM_VOL_MODE_NORMAL
          MC_IMM_GenericRequest_CanSMBOR_BCAN_EQ_COMPLETE: BswMConditionType=BSWM_EQUALS, BswMConditionMode=MRP_IMM_GenericRequest_CanSMBOR_BCAN
            BswMConditionValue: category=TOOL_CONFIGURED
              BswMBswMode: category=TOOL_CONFIGURED, BswMBswRequestedMode=CANSM_BSWM_BOR_COMPLETE
          MC_IMM_GenericRequest_CanSMBOR_BCAN_EQ_START: BswMConditionType=BSWM_EQUALS, BswMConditionMode=MRP_IMM_GenericRequest_CanSMBOR_BCAN
            BswMConditionValue: category=TOOL_CONFIGURED
              BswMBswMode: category=TOOL_CONFIGURED, BswMBswRequestedMode=CANSM_BSWM_BOR_START
          MC_IMM_GenericRequest_CanSMBOR_LCAN_EQ_COMPLETE: BswMConditionType=BSWM_EQUALS, BswMConditionMode=MRP_IMM_GenericRequest_CanSMBOR_LCAN
            BswMConditionValue: category=TOOL_CONFIGURED
              BswMBswMode: category=TOOL_CONFIGURED, BswMBswRequestedMode=CANSM_BSWM_BOR_COMPLETE
          MC_IMM_GenericRequest_CanSMBOR_LCAN_EQ_START: BswMConditionType=BSWM_EQUALS, BswMConditionMode=MRP_IMM_GenericRequest_CanSMBOR_LCAN
            BswMConditionValue: category=TOOL_CONFIGURED
              BswMBswMode: category=TOOL_CONFIGURED, BswMBswRequestedMode=CANSM_BSWM_BOR_START
          MC_IMM_GenericRequest_EcuMRequest_EQ_OFF: BswMConditionType=BSWM_EQUALS, BswMConditionMode=MRP_IMM_GenericRequest_EcuMRequest
            BswMConditionValue: category=TOOL_CONFIGURED
              BswMBswMode: category=TOOL_CONFIGURED, BswMBswRequestedMode=ECUM_REQUEST_OFF
          MC_IMM_GenericRequest_EcuMRequest_EQ_RESET: BswMConditionType=BSWM_EQUALS, BswMConditionMode=MRP_IMM_GenericRequest_EcuMRequest
            BswMConditionValue: category=TOOL_CONFIGURED
              BswMBswMode: category=TOOL_CONFIGURED, BswMBswRequestedMode=ECUM_REQUEST_RESET
          MC_IMM_GenericRequest_EcuMRequest_EQ_RUN: BswMConditionType=BSWM_EQUALS, BswMConditionMode=MRP_IMM_GenericRequest_EcuMRequest
            BswMConditionValue: category=TOOL_CONFIGURED
              BswMBswMode: category=TOOL_CONFIGURED, BswMBswRequestedMode=ECUM_REQUEST_RUN
          MC_IMM_GenericRequest_EcuMRequest_EQ_SLEEP: BswMConditionType=BSWM_EQUALS, BswMConditionMode=MRP_IMM_GenericRequest_EcuMRequest
            BswMConditionValue: category=TOOL_CONFIGURED
              BswMBswMode: category=TOOL_CONFIGURED, BswMBswRequestedMode=ECUM_REQUEST_SLEEP
          MC_IMM_GenericRequest_EcuMResetMode_EQ_ECUM_RESET_HARD: BswMConditionType=BSWM_EQUALS, BswMConditionMode=MRP_IMM_GenericRequest_EcuMResetMode
            BswMConditionValue: category=TOOL_CONFIGURED
              BswMBswMode: category=TOOL_CONFIGURED, BswMBswRequestedMode=ECUM_RESET_HARD
          MC_IMM_GenericRequest_EcuMResetMode_EQ_ECUM_RESET_SOFT: BswMConditionType=BSWM_EQUALS, BswMConditionMode=MRP_IMM_GenericRequest_EcuMResetMode
            BswMConditionValue: category=TOOL_CONFIGURED
              BswMBswMode: category=TOOL_CONFIGURED, BswMBswRequestedMode=ECUM_RESET_SOFT
          MC_IMM_GenericRequest_EcuModeTransition_EQ_END: BswMConditionType=BSWM_EQUALS, BswMConditionMode=MRP_IMM_GenericRequest_EcuModeTransition
            BswMConditionValue: category=TOOL_CONFIGURED
              BswMBswMode: category=TOOL_CONFIGURED, BswMBswRequestedMode=BSWM_ECUMODETRANSITION_END
          MC_IMM_GenericRequest_EcuState_EQ_ENTRY_OFF: BswMConditionType=BSWM_EQUALS, BswMConditionMode=MRP_IMM_GenericRequest_EcuState
            BswMConditionValue: category=TOOL_CONFIGURED
              BswMBswMode: category=TOOL_CONFIGURED, BswMBswRequestedMode=BSWM_ECUSTATE_ENTRY_OFF
          MC_IMM_GenericRequest_EcuState_EQ_ENTRY_RESET: BswMConditionType=BSWM_EQUALS, BswMConditionMode=MRP_IMM_GenericRequest_EcuState
            BswMConditionValue: category=TOOL_CONFIGURED
              BswMBswMode: category=TOOL_CONFIGURED, BswMBswRequestedMode=BSWM_ECUSTATE_ENTRY_RESET
          MC_IMM_GenericRequest_EcuState_EQ_ENTRY_RUN: BswMConditionType=BSWM_EQUALS, BswMConditionMode=MRP_IMM_GenericRequest_EcuState
            BswMConditionValue: category=TOOL_CONFIGURED
              BswMBswMode: category=TOOL_CONFIGURED, BswMBswRequestedMode=BSWM_ECUSTATE_ENTRY_RUN
          MC_IMM_GenericRequest_EcuState_EQ_ENTRY_SHUTDOWN: BswMConditionType=BSWM_EQUALS, BswMConditionMode=MRP_IMM_GenericRequest_EcuState
            BswMConditionValue: category=TOOL_CONFIGURED
              BswMBswMode: category=TOOL_CONFIGURED, BswMBswRequestedMode=BSWM_ECUSTATE_ENTRY_SHUTDOWN
          MC_IMM_GenericRequest_EcuState_EQ_ENTRY_SLEEP: BswMConditionType=BSWM_EQUALS, BswMConditionMode=MRP_IMM_GenericRequest_EcuState
            BswMConditionValue: category=TOOL_CONFIGURED
              BswMBswMode: category=TOOL_CONFIGURED, BswMBswRequestedMode=BSWM_ECUSTATE_ENTRY_SLEEP
          MC_IMM_GenericRequest_EcuState_EQ_ENTRY_STARTUP_THREE: BswMConditionType=BSWM_EQUALS, BswMConditionMode=MRP_IMM_GenericRequest_EcuState
            BswMConditionValue: category=TOOL_CONFIGURED
              BswMBswMode: category=TOOL_CONFIGURED, BswMBswRequestedMode=BSWM_ECUSTATE_ENTRY_STARTUP_THREE
          MC_IMM_GenericRequest_EcuState_EQ_ENTRY_STARTUP_TWO: BswMConditionType=BSWM_EQUALS, BswMConditionMode=MRP_IMM_GenericRequest_EcuState
            BswMConditionValue: category=TOOL_CONFIGURED
              BswMBswMode: category=TOOL_CONFIGURED, BswMBswRequestedMode=BSWM_ECUSTATE_ENTRY_STARTUP_TWO
          MC_IMM_GenericRequest_EcuState_EQ_EXIT_RUN: BswMConditionType=BSWM_EQUALS, BswMConditionMode=MRP_IMM_GenericRequest_EcuState
            BswMConditionValue: category=TOOL_CONFIGURED
              BswMBswMode: category=TOOL_CONFIGURED, BswMBswRequestedMode=BSWM_ECUSTATE_EXIT_RUN
          MC_IMM_GenericRequest_EcuState_EQ_EXIT_SHUTDOWN: BswMConditionType=BSWM_EQUALS, BswMConditionMode=MRP_IMM_GenericRequest_EcuState
            BswMConditionValue: category=TOOL_CONFIGURED
              BswMBswMode: category=TOOL_CONFIGURED, BswMBswRequestedMode=BSWM_ECUSTATE_EXIT_SHUTDOWN
          MC_IMM_GenericRequest_EcuState_EQ_EXIT_SLEEP: BswMConditionType=BSWM_EQUALS, BswMConditionMode=MRP_IMM_GenericRequest_EcuState
            BswMConditionValue: category=TOOL_CONFIGURED
              BswMBswMode: category=TOOL_CONFIGURED, BswMBswRequestedMode=BSWM_ECUSTATE_EXIT_SLEEP
          MC_IMM_GenericRequest_EcuState_EQ_EXIT_STARTUP_THREE: BswMConditionType=BSWM_EQUALS, BswMConditionMode=MRP_IMM_GenericRequest_EcuState
            BswMConditionValue: category=TOOL_CONFIGURED
              BswMBswMode: category=TOOL_CONFIGURED, BswMBswRequestedMode=BSWM_ECUSTATE_EXIT_STARTUP_THREE
          MC_IMM_GenericRequest_EcuState_EQ_EXIT_STARTUP_TWO: BswMConditionType=BSWM_EQUALS, BswMConditionMode=MRP_IMM_GenericRequest_EcuState
            BswMConditionValue: category=TOOL_CONFIGURED
              BswMBswMode: category=TOOL_CONFIGURED, BswMBswRequestedMode=BSWM_ECUSTATE_EXIT_STARTUP_TWO
          MC_IMM_GenericRequest_NvMLowPower_EQ_ALLOW: BswMConditionType=BSWM_EQUALS, BswMConditionMode=MRP_IMM_GenericRequest_NvMLowPower
            BswMConditionValue: category=TOOL_CONFIGURED
              BswMBswMode: category=TOOL_CONFIGURED, BswMBswRequestedMode=NVM_LOWPOWER_ALLOW
          MC_IMM_GenericRequest_RamTstLowPower_EQ_ALLOW: BswMConditionType=BSWM_EQUALS, BswMConditionMode=MRP_IMM_GenericRequest_RamTstLowPower
            BswMConditionValue: category=TOOL_CONFIGURED
              BswMBswMode: category=TOOL_CONFIGURED, BswMBswRequestedMode=RAMTST_LOWPOWER_ALLOW
          MC_IMM_GenericRequest_RomTstLowPower_EQ_ALLOW: BswMConditionType=BSWM_EQUALS, BswMConditionMode=MRP_IMM_GenericRequest_RomTstLowPower
            BswMConditionValue: category=TOOL_CONFIGURED
              BswMBswMode: category=TOOL_CONFIGURED, BswMBswRequestedMode=ROMTST_LOWPOWER_ALLOW
          MC_IMM_GenericRequest_ShutdownTarget_EQ_OFF: BswMConditionType=BSWM_EQUALS, BswMConditionMode=MRP_IMM_GenericRequest_ShutdownTarget
            BswMConditionValue: category=TOOL_CONFIGURED
              BswMBswMode: category=TOOL_CONFIGURED, BswMBswRequestedMode=BSWM_SHUTDOWNTARGET_OFF
          MC_IMM_GenericRequest_ShutdownTarget_EQ_RESET: BswMConditionType=BSWM_EQUALS, BswMConditionMode=MRP_IMM_GenericRequest_ShutdownTarget
            BswMConditionValue: category=TOOL_CONFIGURED
              BswMBswMode: category=TOOL_CONFIGURED, BswMBswRequestedMode=BSWM_SHUTDOWNTARGET_RESET
          MC_IMM_GenericRequest_ShutdownTarget_EQ_RUN: BswMConditionType=BSWM_EQUALS, BswMConditionMode=MRP_IMM_GenericRequest_ShutdownTarget
            BswMConditionValue: category=TOOL_CONFIGURED
              BswMBswMode: category=TOOL_CONFIGURED, BswMBswRequestedMode=BSWM_SHUTDOWNTARGET_RUN
          MC_IMM_GenericRequest_ShutdownTarget_EQ_SLEEP: BswMConditionType=BSWM_EQUALS, BswMConditionMode=MRP_IMM_GenericRequest_ShutdownTarget
            BswMConditionValue: category=TOOL_CONFIGURED
              BswMBswMode: category=TOOL_CONFIGURED, BswMBswRequestedMode=BSWM_SHUTDOWNTARGET_SLEEP
          MC_IMM_NvMJobModeIndication_ReadAll_EQ_BLOCK_SKIPPED: BswMConditionType=BSWM_EQUALS, BswMConditionMode=MRP_IMM_NvMJobModeIndication_ReadAll
            BswMConditionValue: category=TOOL_CONFIGURED
              BswMBswMode: category=TOOL_CONFIGURED, BswMBswRequestedMode=NVM_REQ_BLOCK_SKIPPED
          MC_IMM_NvMJobModeIndication_ReadAll_EQ_CANCELED: BswMConditionType=BSWM_EQUALS, BswMConditionMode=MRP_IMM_NvMJobModeIndication_ReadAll
            BswMConditionValue: category=TOOL_CONFIGURED
              BswMBswMode: category=TOOL_CONFIGURED, BswMBswRequestedMode=NVM_REQ_CANCELED
          MC_IMM_NvMJobModeIndication_ReadAll_EQ_INTEGRITY_FAILED: BswMConditionType=BSWM_EQUALS, BswMConditionMode=MRP_IMM_NvMJobModeIndication_ReadAll
            BswMConditionValue: category=TOOL_CONFIGURED
              BswMBswMode: category=TOOL_CONFIGURED, BswMBswRequestedMode=NVM_REQ_INTEGRITY_FAILED
          MC_IMM_NvMJobModeIndication_ReadAll_EQ_NOT_OK: BswMConditionType=BSWM_EQUALS, BswMConditionMode=MRP_IMM_NvMJobModeIndication_ReadAll
            BswMConditionValue: category=TOOL_CONFIGURED
              BswMBswMode: category=TOOL_CONFIGURED, BswMBswRequestedMode=NVM_REQ_NOT_OK
          MC_IMM_NvMJobModeIndication_ReadAll_EQ_NV_INVALIDATED: BswMConditionType=BSWM_EQUALS, BswMConditionMode=MRP_IMM_NvMJobModeIndication_ReadAll
            BswMConditionValue: category=TOOL_CONFIGURED
              BswMBswMode: category=TOOL_CONFIGURED, BswMBswRequestedMode=NVM_REQ_NV_INVALIDATED
          MC_IMM_NvMJobModeIndication_ReadAll_EQ_OK: BswMConditionType=BSWM_EQUALS, BswMConditionMode=MRP_IMM_NvMJobModeIndication_ReadAll
            BswMConditionValue: category=TOOL_CONFIGURED
              BswMBswMode: category=TOOL_CONFIGURED, BswMBswRequestedMode=NVM_REQ_OK
          MC_IMM_NvMJobModeIndication_ReadAll_EQ_REDUNDANCY_FAILED: BswMConditionType=BSWM_EQUALS, BswMConditionMode=MRP_IMM_NvMJobModeIndication_ReadAll
            BswMConditionValue: category=TOOL_CONFIGURED
              BswMBswMode: category=TOOL_CONFIGURED, BswMBswRequestedMode=NVM_REQ_REDUNDANCY_FAILED
          MC_IMM_NvMJobModeIndication_ReadAll_EQ_RESTORED_FROM_ROM: BswMConditionType=BSWM_EQUALS, BswMConditionMode=MRP_IMM_NvMJobModeIndication_ReadAll
            BswMConditionValue: category=TOOL_CONFIGURED
              BswMBswMode: category=TOOL_CONFIGURED, BswMBswRequestedMode=NVM_REQ_RESTORED_FROM_ROM
          MC_IMM_NvMJobModeIndication_WriteAll_EQ_BLOCK_SKIPPED: BswMConditionType=BSWM_EQUALS, BswMConditionMode=MRP_IMM_NvMJobModeIndication_WriteAll
            BswMConditionValue: category=TOOL_CONFIGURED
              BswMBswMode: category=TOOL_CONFIGURED, BswMBswRequestedMode=NVM_REQ_BLOCK_SKIPPED
          MC_IMM_NvMJobModeIndication_WriteAll_EQ_CANCELED: BswMConditionType=BSWM_EQUALS, BswMConditionMode=MRP_IMM_NvMJobModeIndication_WriteAll
            BswMConditionValue: category=TOOL_CONFIGURED
              BswMBswMode: category=TOOL_CONFIGURED, BswMBswRequestedMode=NVM_REQ_CANCELED
          MC_IMM_NvMJobModeIndication_WriteAll_EQ_INTEGRITY_FAILED: BswMConditionType=BSWM_EQUALS, BswMConditionMode=MRP_IMM_NvMJobModeIndication_WriteAll
            BswMConditionValue: category=TOOL_CONFIGURED
              BswMBswMode: category=TOOL_CONFIGURED, BswMBswRequestedMode=NVM_REQ_INTEGRITY_FAILED
          MC_IMM_NvMJobModeIndication_WriteAll_EQ_NOT_OK: BswMConditionType=BSWM_EQUALS, BswMConditionMode=MRP_IMM_NvMJobModeIndication_WriteAll
            BswMConditionValue: category=TOOL_CONFIGURED
              BswMBswMode: category=TOOL_CONFIGURED, BswMBswRequestedMode=NVM_REQ_NOT_OK
          MC_IMM_NvMJobModeIndication_WriteAll_EQ_NV_INVALIDATED: BswMConditionType=BSWM_EQUALS, BswMConditionMode=MRP_IMM_NvMJobModeIndication_WriteAll
            BswMConditionValue: category=TOOL_CONFIGURED
              BswMBswMode: category=TOOL_CONFIGURED, BswMBswRequestedMode=NVM_REQ_NV_INVALIDATED
          MC_IMM_NvMJobModeIndication_WriteAll_EQ_OK: BswMConditionType=BSWM_EQUALS, BswMConditionMode=MRP_IMM_NvMJobModeIndication_WriteAll
            BswMConditionValue: category=TOOL_CONFIGURED
              BswMBswMode: category=TOOL_CONFIGURED, BswMBswRequestedMode=NVM_REQ_OK
          MC_IMM_NvMJobModeIndication_WriteAll_EQ_REDUNDANCY_FAILED: BswMConditionType=BSWM_EQUALS, BswMConditionMode=MRP_IMM_NvMJobModeIndication_WriteAll
            BswMConditionValue: category=TOOL_CONFIGURED
              BswMBswMode: category=TOOL_CONFIGURED, BswMBswRequestedMode=NVM_REQ_REDUNDANCY_FAILED
          MC_IMM_NvMJobModeIndication_WriteAll_EQ_RESTORED_FROM_ROM: BswMConditionType=BSWM_EQUALS, BswMConditionMode=MRP_IMM_NvMJobModeIndication_WriteAll
            BswMConditionValue: category=TOOL_CONFIGURED
              BswMBswMode: category=TOOL_CONFIGURED, BswMBswRequestedMode=NVM_REQ_RESTORED_FROM_ROM
          MC_IMM_SwcModeRequest_ComMMode_PNC141_EQ_COMM_MODE_FULL_COM: BswMConditionType=BSWM_EQUALS, BswMConditionMode=MRP_IMM_SwcModeRequest_ComMMode_PNC141
            BswMConditionValue: category=TOOL_CONFIGURED
              BswMBswMode: category=TOOL_CONFIGURED, BswMBswRequestedMode=COMM_MODE_FULL_COM
          MC_IMM_SwcModeRequest_ComMMode_PNC141_EQ_COMM_MODE_NO_COM: BswMConditionType=BSWM_EQUALS, BswMConditionMode=MRP_IMM_SwcModeRequest_ComMMode_PNC141
            BswMConditionValue: category=TOOL_CONFIGURED
              BswMBswMode: category=TOOL_CONFIGURED, BswMBswRequestedMode=COMM_MODE_NO_COM
          MC_IMM_SwcModeRequest_ComMMode_PNC153_EQ_COMM_MODE_FULL_COM: BswMConditionType=BSWM_EQUALS, BswMConditionMode=MRP_IMM_SwcModeRequest_ComMMode_PNC153
            BswMConditionValue: category=TOOL_CONFIGURED
              BswMBswMode: category=TOOL_CONFIGURED, BswMBswRequestedMode=COMM_MODE_FULL_COM
          MC_IMM_SwcModeRequest_ComMMode_PNC153_EQ_COMM_MODE_NO_COM: BswMConditionType=BSWM_EQUALS, BswMConditionMode=MRP_IMM_SwcModeRequest_ComMMode_PNC153
            BswMConditionValue: category=TOOL_CONFIGURED
              BswMBswMode: category=TOOL_CONFIGURED, BswMBswRequestedMode=COMM_MODE_NO_COM
          MC_IMM_SwcModeRequest_ComMMode_PNC159_EQ_COMM_MODE_FULL_COM: BswMConditionType=BSWM_EQUALS, BswMConditionMode=MRP_IMM_SwcModeRequest_ComMMode_PNC159
            BswMConditionValue: category=TOOL_CONFIGURED
              BswMBswMode: category=TOOL_CONFIGURED, BswMBswRequestedMode=COMM_MODE_FULL_COM
          MC_IMM_SwcModeRequest_ComMMode_PNC159_EQ_COMM_MODE_NO_COM: BswMConditionType=BSWM_EQUALS, BswMConditionMode=MRP_IMM_SwcModeRequest_ComMMode_PNC159
            BswMConditionValue: category=TOOL_CONFIGURED
              BswMBswMode: category=TOOL_CONFIGURED, BswMBswRequestedMode=COMM_MODE_NO_COM
          MC_IMM_SwcModeRequest_ComMMode_PNC32_EQ_COMM_MODE_FULL_COM: BswMConditionType=BSWM_EQUALS, BswMConditionMode=MRP_IMM_SwcModeRequest_ComMMode_PNC32
            BswMConditionValue: category=TOOL_CONFIGURED
              BswMBswMode: category=TOOL_CONFIGURED, BswMBswRequestedMode=COMM_MODE_FULL_COM
          MC_IMM_SwcModeRequest_ComMMode_PNC32_EQ_COMM_MODE_NO_COM: BswMConditionType=BSWM_EQUALS, BswMConditionMode=MRP_IMM_SwcModeRequest_ComMMode_PNC32
            BswMConditionValue: category=TOOL_CONFIGURED
              BswMBswMode: category=TOOL_CONFIGURED, BswMBswRequestedMode=COMM_MODE_NO_COM
        207 x BswMLogicalExpression, all with category=TOOL_CONFIGURED:
          LE_BCAN_CANCM_DISABLE_DM: BswMArgumentRef=MC_IMM_GenericRequest_CanCMRxDm_BCAN_EQ_ENABLE_RX_DISABLE_DM
          LE_BCAN_CANCM_DISABLE_NM: BswMArgumentRef=MC_IMM_GenericRequest_CanCMVol_BCAN_EQ_CRITICAL
          LE_BCAN_CANCM_DISABLE_RX: BswMArgumentRef=MC_IMM_GenericRequest_CanCMRxDm_BCAN_EQ_DISABLE_RX
          LE_BCAN_CANCM_DISABLE_TX: BswMArgumentRef=MC_IMM_GenericRequest_CanCMTx_BCAN_EQ_DISABLE
          LE_BCAN_CANCM_ENABLE_DM: BswMArgumentRef=MC_IMM_GenericRequest_CanCMRxDm_BCAN_EQ_ENABLE_RX_ENABLE_DM
          LE_BCAN_CANCM_ENABLE_NM: BswMLogicalOperator=BSWM_OR, BswMArgumentRef=MC_IMM_GenericRequest_CanCMVol_BCAN_EQ_ABNORMAL, BswMArgumentRef=MC_IMM_GenericRequest_CanCMVol_BCAN_EQ_NORMAL
          LE_BCAN_CANCM_ENABLE_RX: BswMLogicalOperator=BSWM_OR, BswMArgumentRef=MC_IMM_GenericRequest_CanCMRxDm_BCAN_EQ_ENABLE_RX_DISABLE_DM, BswMArgumentRef=MC_IMM_GenericRequest_CanCMRxDm_BCAN_EQ_ENABLE_RX_ENABLE_DM
          LE_BCAN_CANCM_ENABLE_TX: BswMArgumentRef=MC_IMM_GenericRequest_CanCMTx_BCAN_EQ_ENABLE
          LE_BCAN_CANSM_DISABLE_NM: BswMArgumentRef=MC_IMM_CanSMIndication_BCAN_EQ_BUS_OFF
          LE_BCAN_CANSM_ENABLE_NM: BswMArgumentRef=MC_IMM_CanSMIndication_BCAN_EN_BUS_OFF
          LE_BCAN_COMM_DISABLE_DM: BswMArgumentRef=MC_IMM_ComMIndication_BCAN_EN_FULL_COM
          LE_BCAN_COMM_DISABLE_RX: BswMArgumentRef=MC_IMM_ComMIndication_BCAN_EQ_NO_COM
          LE_BCAN_COMM_DISABLE_TX: BswMLogicalOperator=BSWM_OR, BswMArgumentRef=MC_IMM_ComMIndication_BCAN_EQ_NO_COM, BswMArgumentRef=MC_IMM_ComMIndication_BCAN_EQ_SILENT_COM
          LE_BCAN_COMM_ENABLE_DM: BswMArgumentRef=MC_IMM_ComMIndication_BCAN_EQ_FULL_COM
          LE_BCAN_COMM_ENABLE_RX: BswMLogicalOperator=BSWM_OR, BswMArgumentRef=MC_IMM_ComMIndication_BCAN_EQ_FULL_COM, BswMArgumentRef=MC_IMM_ComMIndication_BCAN_EQ_SILENT_COM
          LE_BCAN_COMM_ENABLE_TX: BswMArgumentRef=MC_IMM_ComMIndication_BCAN_EQ_FULL_COM
          LE_BCAN_DCM_DISABLE_NM: BswMLogicalOperator=BSWM_OR, BswMArgumentRef=MC_IMM_DcmComModeRequest_BCAN_EQ_DISABLE_RX_TX_NM, BswMArgumentRef=MC_IMM_DcmComModeRequest_BCAN_EQ_DISABLE_RX_TX_NORM_NM, BswMArgumentRef=MC_IMM_DcmComModeRequest_BCAN_EQ_ENABLE_RX_DISABLE_TX_NM, BswMArgumentRef=MC_IMM_DcmComModeRequest_BCAN_EQ_ENABLE_RX_DISABLE_TX_NORM_NM
          LE_BCAN_DCM_DISABLE_RX: BswMLogicalOperator=BSWM_OR, BswMArgumentRef=MC_IMM_DcmComModeRequest_BCAN_EQ_DISABLE_RX_ENABLE_TX_NORM, BswMArgumentRef=MC_IMM_DcmComModeRequest_BCAN_EQ_DISABLE_RX_ENABLE_TX_NORM_NM, BswMArgumentRef=MC_IMM_DcmComModeRequest_BCAN_EQ_DISABLE_RX_TX_NORM, BswMArgumentRef=MC_IMM_DcmComModeRequest_BCAN_EQ_DISABLE_RX_TX_NORM_NM
          LE_BCAN_DCM_DISABLE_TX: BswMLogicalOperator=BSWM_OR, BswMArgumentRef=MC_IMM_DcmComModeRequest_BCAN_EQ_DISABLE_RX_TX_NORM, BswMArgumentRef=MC_IMM_DcmComModeRequest_BCAN_EQ_DISABLE_RX_TX_NORM_NM, BswMArgumentRef=MC_IMM_DcmComModeRequest_BCAN_EQ_ENABLE_RX_DISABLE_TX_NORM, BswMArgumentRef=MC_IMM_DcmComModeRequest_BCAN_EQ_ENABLE_RX_DISABLE_TX_NORM_NM
          LE_BCAN_DCM_ENABLE_NM: BswMLogicalOperator=BSWM_OR, BswMArgumentRef=MC_IMM_DcmComModeRequest_BCAN_EQ_DISABLE_RX_ENABLE_TX_NM, BswMArgumentRef=MC_IMM_DcmComModeRequest_BCAN_EQ_DISABLE_RX_ENABLE_TX_NORM_NM, BswMArgumentRef=MC_IMM_DcmComModeRequest_BCAN_EQ_ENABLE_RX_TX_NM, BswMArgumentRef=MC_IMM_DcmComModeRequest_BCAN_EQ_ENABLE_RX_TX_NORM_NM
          LE_BCAN_DCM_ENABLE_RX: BswMLogicalOperator=BSWM_OR, BswMArgumentRef=MC_IMM_DcmComModeRequest_BCAN_EQ_ENABLE_RX_DISABLE_TX_NORM, BswMArgumentRef=MC_IMM_DcmComModeRequest_BCAN_EQ_ENABLE_RX_DISABLE_TX_NORM_NM, BswMArgumentRef=MC_IMM_DcmComModeRequest_BCAN_EQ_ENABLE_RX_TX_NORM, BswMArgumentRef=MC_IMM_DcmComModeRequest_BCAN_EQ_ENABLE_RX_TX_NORM_NM
          LE_BCAN_DCM_ENABLE_TX: BswMLogicalOperator=BSWM_OR, BswMArgumentRef=MC_IMM_DcmComModeRequest_BCAN_EQ_DISABLE_RX_ENABLE_TX_NORM, BswMArgumentRef=MC_IMM_DcmComModeRequest_BCAN_EQ_DISABLE_RX_ENABLE_TX_NORM_NM, BswMArgumentRef=MC_IMM_DcmComModeRequest_BCAN_EQ_ENABLE_RX_TX_NORM, BswMArgumentRef=MC_IMM_DcmComModeRequest_BCAN_EQ_ENABLE_RX_TX_NORM_NM
          LE_ComMIndication_ALL_FULL_COM: BswMLogicalOperator=BSWM_AND, BswMArgumentRef=MC_IMM_ComMIndication_BCAN_EQ_FULL_COM, BswMArgumentRef=MC_IMM_ComMIndication_LCAN_EQ_FULL_COM
          LE_ComMIndication_ALL_NO_COM: BswMLogicalOperator=BSWM_AND, BswMArgumentRef=MC_IMM_ComMIndication_BCAN_EQ_NO_COM, BswMArgumentRef=MC_IMM_ComMIndication_LCAN_EQ_NO_COM
          LE_EcuGoDownTypes: BswMLogicalOperator=BSWM_OR, BswMArgumentRef=MC_IMM_GenericRequest_ShutdownTarget_EQ_OFF, BswMArgumentRef=MC_IMM_GenericRequest_ShutdownTarget_EQ_RESET
          LE_EcuResetTypes: BswMLogicalOperator=BSWM_OR, BswMArgumentRef=MC_IMM_BswModeNotification_modeNotificationPort_DcmEcuReset_EQ_EXECUTE, BswMArgumentRef=MC_IMM_GenericRequest_EcuMRequest_EQ_RESET
          LE_EcuSleepAllowed: BswMLogicalOperator=BSWM_AND, BswMArgumentRef=LE_ComMIndication_ALL_NO_COM, BswMArgumentRef=MC_IMM_GenericRequest_NvMLowPower_EQ_ALLOW, BswMArgumentRef=MC_IMM_GenericRequest_RamTstLowPower_EQ_ALLOW, BswMArgumentRef=MC_IMM_GenericRequest_RomTstLowPower_EQ_ALLOW
          LE_LCAN_CANCM_DISABLE_DM: BswMArgumentRef=MC_IMM_GenericRequest_CanCMRxDm_LCAN_EQ_ENABLE_RX_DISABLE_DM
          LE_LCAN_CANCM_DISABLE_NM: BswMArgumentRef=MC_IMM_GenericRequest_CanCMVol_LCAN_EQ_CRITICAL
          LE_LCAN_CANCM_DISABLE_RX: BswMArgumentRef=MC_IMM_GenericRequest_CanCMRxDm_LCAN_EQ_DISABLE_RX
          LE_LCAN_CANCM_DISABLE_TX: BswMArgumentRef=MC_IMM_GenericRequest_CanCMTx_LCAN_EQ_DISABLE
          LE_LCAN_CANCM_ENABLE_DM: BswMArgumentRef=MC_IMM_GenericRequest_CanCMRxDm_LCAN_EQ_ENABLE_RX_ENABLE_DM
          LE_LCAN_CANCM_ENABLE_NM: BswMLogicalOperator=BSWM_OR, BswMArgumentRef=MC_IMM_GenericRequest_CanCMVol_LCAN_EQ_ABNORMAL, BswMArgumentRef=MC_IMM_GenericRequest_CanCMVol_LCAN_EQ_NORMAL
          LE_LCAN_CANCM_ENABLE_RX: BswMLogicalOperator=BSWM_OR, BswMArgumentRef=MC_IMM_GenericRequest_CanCMRxDm_LCAN_EQ_ENABLE_RX_DISABLE_DM, BswMArgumentRef=MC_IMM_GenericRequest_CanCMRxDm_LCAN_EQ_ENABLE_RX_ENABLE_DM
          LE_LCAN_CANCM_ENABLE_TX: BswMArgumentRef=MC_IMM_GenericRequest_CanCMTx_LCAN_EQ_ENABLE
          LE_LCAN_CANSM_DISABLE_NM: BswMArgumentRef=MC_IMM_CanSMIndication_LCAN_EQ_BUS_OFF
          LE_LCAN_CANSM_ENABLE_NM: BswMArgumentRef=MC_IMM_CanSMIndication_LCAN_EN_BUS_OFF
          LE_LCAN_COMM_DISABLE_DM: BswMArgumentRef=MC_IMM_ComMIndication_LCAN_EN_FULL_COM
          LE_LCAN_COMM_DISABLE_RX: BswMArgumentRef=MC_IMM_ComMIndication_LCAN_EQ_NO_COM
          LE_LCAN_COMM_DISABLE_TX: BswMLogicalOperator=BSWM_OR, BswMArgumentRef=MC_IMM_ComMIndication_LCAN_EQ_NO_COM, BswMArgumentRef=MC_IMM_ComMIndication_LCAN_EQ_SILENT_COM
          LE_LCAN_COMM_ENABLE_DM: BswMArgumentRef=MC_IMM_ComMIndication_LCAN_EQ_FULL_COM
          LE_LCAN_COMM_ENABLE_RX: BswMLogicalOperator=BSWM_OR, BswMArgumentRef=MC_IMM_ComMIndication_LCAN_EQ_FULL_COM, BswMArgumentRef=MC_IMM_ComMIndication_LCAN_EQ_SILENT_COM
          LE_LCAN_COMM_ENABLE_TX: BswMArgumentRef=MC_IMM_ComMIndication_LCAN_EQ_FULL_COM
          LE_NvMReadAllCompleted: BswMLogicalOperator=BSWM_OR, BswMArgumentRef=MC_IMM_NvMJobModeIndication_ReadAll_EQ_BLOCK_SKIPPED, BswMArgumentRef=MC_IMM_NvMJobModeIndication_ReadAll_EQ_CANCELED, BswMArgumentRef=MC_IMM_NvMJobModeIndication_ReadAll_EQ_INTEGRITY_FAILED, BswMArgumentRef=MC_IMM_NvMJobModeIndication_ReadAll_EQ_NOT_OK, BswMArgumentRef=MC_IMM_NvMJobModeIndication_ReadAll_EQ_NV_INVALIDATED, BswMArgumentRef=MC_IMM_NvMJobModeIndication_ReadAll_EQ_OK, BswMArgumentRef=MC_IMM_NvMJobModeIndication_ReadAll_EQ_REDUNDANCY_FAILED, BswMArgumentRef=MC_IMM_NvMJobModeIndication_ReadAll_EQ_RESTORED_FROM_ROM
          LE_NvMWriteAllCompleted: BswMLogicalOperator=BSWM_OR, BswMArgumentRef=MC_IMM_NvMJobModeIndication_WriteAll_EQ_BLOCK_SKIPPED, BswMArgumentRef=MC_IMM_NvMJobModeIndication_WriteAll_EQ_CANCELED, BswMArgumentRef=MC_IMM_NvMJobModeIndication_WriteAll_EQ_INTEGRITY_FAILED, BswMArgumentRef=MC_IMM_NvMJobModeIndication_WriteAll_EQ_NOT_OK, BswMArgumentRef=MC_IMM_NvMJobModeIndication_WriteAll_EQ_NV_INVALIDATED, BswMArgumentRef=MC_IMM_NvMJobModeIndication_WriteAll_EQ_OK, BswMArgumentRef=MC_IMM_NvMJobModeIndication_WriteAll_EQ_REDUNDANCY_FAILED, BswMArgumentRef=MC_IMM_NvMJobModeIndication_WriteAll_EQ_RESTORED_FROM_ROM
          LE_PNC141_COMM_DISABLE_DM: BswMLogicalOperator=BSWM_AND, BswMArgumentRef=MC_IMM_ComMPncRequest_PNC141_EN_READY_SLEEP, BswMArgumentRef=MC_IMM_ComMPncRequest_PNC141_EN_REQUESTED
          LE_PNC141_COMM_DISABLE_RX: BswMArgumentRef=MC_IMM_ComMPncRequest_PNC141_EQ_NO_COM
          LE_PNC141_COMM_DISABLE_TX: BswMArgumentRef=MC_IMM_ComMPncRequest_PNC141_EQ_NO_COM
          LE_PNC141_COMM_ENABLE_DM: BswMLogicalOperator=BSWM_OR, BswMArgumentRef=MC_IMM_ComMPncRequest_PNC141_EQ_READY_SLEEP, BswMArgumentRef=MC_IMM_ComMPncRequest_PNC141_EQ_REQUESTED
          LE_PNC141_COMM_ENABLE_RX: BswMLogicalOperator=BSWM_OR, BswMArgumentRef=MC_IMM_ComMPncRequest_PNC141_EQ_READY_SLEEP, BswMArgumentRef=MC_IMM_ComMPncRequest_PNC141_EQ_REQUESTED
          LE_PNC141_COMM_ENABLE_TX: BswMLogicalOperator=BSWM_OR, BswMArgumentRef=MC_IMM_ComMPncRequest_PNC141_EQ_READY_SLEEP, BswMArgumentRef=MC_IMM_ComMPncRequest_PNC141_EQ_REQUESTED
          LE_PNC153_COMM_DISABLE_DM: BswMLogicalOperator=BSWM_AND, BswMArgumentRef=MC_IMM_ComMPncRequest_PNC153_EN_READY_SLEEP, BswMArgumentRef=MC_IMM_ComMPncRequest_PNC153_EN_REQUESTED
          LE_PNC153_COMM_DISABLE_RX: BswMArgumentRef=MC_IMM_ComMPncRequest_PNC153_EQ_NO_COM
          LE_PNC153_COMM_DISABLE_TX: BswMArgumentRef=MC_IMM_ComMPncRequest_PNC153_EQ_NO_COM
          LE_PNC153_COMM_ENABLE_DM: BswMLogicalOperator=BSWM_OR, BswMArgumentRef=MC_IMM_ComMPncRequest_PNC153_EQ_READY_SLEEP, BswMArgumentRef=MC_IMM_ComMPncRequest_PNC153_EQ_REQUESTED
          LE_PNC153_COMM_ENABLE_RX: BswMLogicalOperator=BSWM_OR, BswMArgumentRef=MC_IMM_ComMPncRequest_PNC153_EQ_READY_SLEEP, BswMArgumentRef=MC_IMM_ComMPncRequest_PNC153_EQ_REQUESTED
          LE_PNC153_COMM_ENABLE_TX: BswMLogicalOperator=BSWM_OR, BswMArgumentRef=MC_IMM_ComMPncRequest_PNC153_EQ_READY_SLEEP, BswMArgumentRef=MC_IMM_ComMPncRequest_PNC153_EQ_REQUESTED
          LE_PNC159_COMM_DISABLE_DM: BswMLogicalOperator=BSWM_AND, BswMArgumentRef=MC_IMM_ComMPncRequest_PNC159_EN_READY_SLEEP, BswMArgumentRef=MC_IMM_ComMPncRequest_PNC159_EN_REQUESTED
          LE_PNC159_COMM_DISABLE_RX: BswMArgumentRef=MC_IMM_ComMPncRequest_PNC159_EQ_NO_COM
          LE_PNC159_COMM_DISABLE_TX: BswMArgumentRef=MC_IMM_ComMPncRequest_PNC159_EQ_NO_COM
          LE_PNC159_COMM_ENABLE_DM: BswMLogicalOperator=BSWM_OR, BswMArgumentRef=MC_IMM_ComMPncRequest_PNC159_EQ_READY_SLEEP, BswMArgumentRef=MC_IMM_ComMPncRequest_PNC159_EQ_REQUESTED
          LE_PNC159_COMM_ENABLE_RX: BswMLogicalOperator=BSWM_OR, BswMArgumentRef=MC_IMM_ComMPncRequest_PNC159_EQ_READY_SLEEP, BswMArgumentRef=MC_IMM_ComMPncRequest_PNC159_EQ_REQUESTED
          LE_PNC159_COMM_ENABLE_TX: BswMLogicalOperator=BSWM_OR, BswMArgumentRef=MC_IMM_ComMPncRequest_PNC159_EQ_READY_SLEEP, BswMArgumentRef=MC_IMM_ComMPncRequest_PNC159_EQ_REQUESTED
          LE_PNC32_COMM_DISABLE_DM: BswMLogicalOperator=BSWM_AND, BswMArgumentRef=MC_IMM_ComMPncRequest_PNC32_EN_READY_SLEEP, BswMArgumentRef=MC_IMM_ComMPncRequest_PNC32_EN_REQUESTED
          LE_PNC32_COMM_DISABLE_RX: BswMArgumentRef=MC_IMM_ComMPncRequest_PNC32_EQ_NO_COM
          LE_PNC32_COMM_DISABLE_TX: BswMArgumentRef=MC_IMM_ComMPncRequest_PNC32_EQ_NO_COM
          LE_PNC32_COMM_ENABLE_DM: BswMLogicalOperator=BSWM_OR, BswMArgumentRef=MC_IMM_ComMPncRequest_PNC32_EQ_READY_SLEEP, BswMArgumentRef=MC_IMM_ComMPncRequest_PNC32_EQ_REQUESTED
          LE_PNC32_COMM_ENABLE_RX: BswMLogicalOperator=BSWM_OR, BswMArgumentRef=MC_IMM_ComMPncRequest_PNC32_EQ_READY_SLEEP, BswMArgumentRef=MC_IMM_ComMPncRequest_PNC32_EQ_REQUESTED
          LE_PNC32_COMM_ENABLE_TX: BswMLogicalOperator=BSWM_OR, BswMArgumentRef=MC_IMM_ComMPncRequest_PNC32_EQ_READY_SLEEP, BswMArgumentRef=MC_IMM_ComMPncRequest_PNC32_EQ_REQUESTED
          LE_ShutdownTargetTo_HARD_RESET: BswMLogicalOperator=BSWM_AND, BswMArgumentRef=LE_EcuResetTypes, BswMArgumentRef=MC_IMM_GenericRequest_EcuMResetMode_EQ_ECUM_RESET_HARD, BswMArgumentRef=MC_IMM_GenericRequest_EcuModeTransition_EQ_END, BswMArgumentRef=MC_IMM_GenericRequest_ShutdownTarget_EQ_RUN
          LE_ShutdownTargetTo_SOFT_RESET: BswMLogicalOperator=BSWM_AND, BswMArgumentRef=LE_EcuResetTypes, BswMArgumentRef=MC_IMM_GenericRequest_EcuMResetMode_EQ_ECUM_RESET_SOFT, BswMArgumentRef=MC_IMM_GenericRequest_EcuModeTransition_EQ_END, BswMArgumentRef=MC_IMM_GenericRequest_ShutdownTarget_EQ_RUN
          RuleLE_CanBorNotification_BCAN_COMPLETE: BswMArgumentRef=MC_IMM_GenericRequest_CanSMBOR_BCAN_EQ_COMPLETE
          RuleLE_CanBorNotification_BCAN_START: BswMArgumentRef=MC_IMM_GenericRequest_CanSMBOR_BCAN_EQ_START
          RuleLE_CanBorNotification_LCAN_COMPLETE: BswMArgumentRef=MC_IMM_GenericRequest_CanSMBOR_LCAN_EQ_COMPLETE
          RuleLE_CanBorNotification_LCAN_START: BswMArgumentRef=MC_IMM_GenericRequest_CanSMBOR_LCAN_EQ_START
          RuleLE_CanStateNotification_BCAN_BUS_OFF: BswMArgumentRef=MC_IMM_CanSMIndication_BCAN_EQ_BUS_OFF
          RuleLE_CanStateNotification_BCAN_CHANGE_BAUDRATE: BswMArgumentRef=MC_IMM_CanSMIndication_BCAN_EQ_CHANGE_BAUDRATE
          RuleLE_CanStateNotification_BCAN_FULL_COM: BswMArgumentRef=MC_IMM_CanSMIndication_BCAN_EQ_FULL_COM
          RuleLE_CanStateNotification_BCAN_NO_COM: BswMArgumentRef=MC_IMM_CanSMIndication_BCAN_EQ_NO_COM
          RuleLE_CanStateNotification_BCAN_SILENT_COM: BswMArgumentRef=MC_IMM_CanSMIndication_BCAN_EQ_SILENT_COM
          RuleLE_CanStateNotification_LCAN_BUS_OFF: BswMArgumentRef=MC_IMM_CanSMIndication_LCAN_EQ_BUS_OFF
          RuleLE_CanStateNotification_LCAN_CHANGE_BAUDRATE: BswMArgumentRef=MC_IMM_CanSMIndication_LCAN_EQ_CHANGE_BAUDRATE
          RuleLE_CanStateNotification_LCAN_FULL_COM: BswMArgumentRef=MC_IMM_CanSMIndication_LCAN_EQ_FULL_COM
          RuleLE_CanStateNotification_LCAN_NO_COM: BswMArgumentRef=MC_IMM_CanSMIndication_LCAN_EQ_NO_COM
          RuleLE_CanStateNotification_LCAN_SILENT_COM: BswMArgumentRef=MC_IMM_CanSMIndication_LCAN_EQ_SILENT_COM
          RuleLE_ComControl_BCAN_DISABLE_NM: BswMArgumentRef=LE_BCAN_DCM_DISABLE_NM
          RuleLE_ComControl_BCAN_DISABLE_NM_TimerisNotStopped: BswMLogicalOperator=BSWM_OR, BswMArgumentRef=LE_BCAN_CANCM_DISABLE_NM, BswMArgumentRef=LE_BCAN_CANSM_DISABLE_NM
          RuleLE_ComControl_BCAN_ENABLE_NM: BswMArgumentRef=LE_BCAN_DCM_ENABLE_NM
          RuleLE_ComControl_BCAN_ENABLE_NM_TimerisNotStarted: BswMLogicalOperator=BSWM_AND, BswMArgumentRef=LE_BCAN_CANCM_ENABLE_NM, BswMArgumentRef=LE_BCAN_CANSM_ENABLE_NM
          RuleLE_ComControl_BCAN_PNC141_DISABLE_DM: BswMLogicalOperator=BSWM_OR, BswMArgumentRef=LE_BCAN_CANCM_DISABLE_DM, BswMArgumentRef=LE_BCAN_COMM_DISABLE_DM, BswMArgumentRef=LE_PNC141_COMM_DISABLE_DM
          RuleLE_ComControl_BCAN_PNC141_DISABLE_RX: BswMLogicalOperator=BSWM_OR, BswMArgumentRef=LE_BCAN_CANCM_DISABLE_RX, BswMArgumentRef=LE_BCAN_COMM_DISABLE_RX, BswMArgumentRef=LE_BCAN_DCM_DISABLE_RX, BswMArgumentRef=LE_PNC141_COMM_DISABLE_RX
          RuleLE_ComControl_BCAN_PNC141_DISABLE_TX: BswMLogicalOperator=BSWM_OR, BswMArgumentRef=LE_BCAN_CANCM_DISABLE_TX, BswMArgumentRef=LE_BCAN_COMM_DISABLE_TX, BswMArgumentRef=LE_BCAN_DCM_DISABLE_TX, BswMArgumentRef=LE_PNC141_COMM_DISABLE_TX
          RuleLE_ComControl_BCAN_PNC141_ENABLE_DM: BswMLogicalOperator=BSWM_AND, BswMArgumentRef=LE_BCAN_CANCM_ENABLE_DM, BswMArgumentRef=LE_BCAN_COMM_ENABLE_DM, BswMArgumentRef=LE_PNC141_COMM_ENABLE_DM
          RuleLE_ComControl_BCAN_PNC141_ENABLE_RX: BswMLogicalOperator=BSWM_AND, BswMArgumentRef=LE_BCAN_CANCM_ENABLE_RX, BswMArgumentRef=LE_BCAN_COMM_ENABLE_RX, BswMArgumentRef=LE_BCAN_DCM_ENABLE_RX, BswMArgumentRef=LE_PNC141_COMM_ENABLE_RX
          RuleLE_ComControl_BCAN_PNC141_ENABLE_TX: BswMLogicalOperator=BSWM_AND, BswMArgumentRef=LE_BCAN_CANCM_ENABLE_TX, BswMArgumentRef=LE_BCAN_COMM_ENABLE_TX, BswMArgumentRef=LE_BCAN_DCM_ENABLE_TX, BswMArgumentRef=LE_PNC141_COMM_ENABLE_TX
          RuleLE_ComControl_BCAN_PNC153_DISABLE_DM: BswMLogicalOperator=BSWM_OR, BswMArgumentRef=LE_BCAN_CANCM_DISABLE_DM, BswMArgumentRef=LE_BCAN_COMM_DISABLE_DM, BswMArgumentRef=LE_PNC153_COMM_DISABLE_DM
          RuleLE_ComControl_BCAN_PNC153_DISABLE_RX: BswMLogicalOperator=BSWM_OR, BswMArgumentRef=LE_BCAN_CANCM_DISABLE_RX, BswMArgumentRef=LE_BCAN_COMM_DISABLE_RX, BswMArgumentRef=LE_BCAN_DCM_DISABLE_RX, BswMArgumentRef=LE_PNC153_COMM_DISABLE_RX
          RuleLE_ComControl_BCAN_PNC153_DISABLE_TX: BswMLogicalOperator=BSWM_OR, BswMArgumentRef=LE_BCAN_CANCM_DISABLE_TX, BswMArgumentRef=LE_BCAN_COMM_DISABLE_TX, BswMArgumentRef=LE_BCAN_DCM_DISABLE_TX, BswMArgumentRef=LE_PNC153_COMM_DISABLE_TX
          RuleLE_ComControl_BCAN_PNC153_ENABLE_DM: BswMLogicalOperator=BSWM_AND, BswMArgumentRef=LE_BCAN_CANCM_ENABLE_DM, BswMArgumentRef=LE_BCAN_COMM_ENABLE_DM, BswMArgumentRef=LE_PNC153_COMM_ENABLE_DM
          RuleLE_ComControl_BCAN_PNC153_ENABLE_RX: BswMLogicalOperator=BSWM_AND, BswMArgumentRef=LE_BCAN_CANCM_ENABLE_RX, BswMArgumentRef=LE_BCAN_COMM_ENABLE_RX, BswMArgumentRef=LE_BCAN_DCM_ENABLE_RX, BswMArgumentRef=LE_PNC153_COMM_ENABLE_RX
          RuleLE_ComControl_BCAN_PNC153_ENABLE_TX: BswMLogicalOperator=BSWM_AND, BswMArgumentRef=LE_BCAN_CANCM_ENABLE_TX, BswMArgumentRef=LE_BCAN_COMM_ENABLE_TX, BswMArgumentRef=LE_BCAN_DCM_ENABLE_TX, BswMArgumentRef=LE_PNC153_COMM_ENABLE_TX
          RuleLE_ComControl_BCAN_PNC32_DISABLE_DM: BswMLogicalOperator=BSWM_OR, BswMArgumentRef=LE_BCAN_CANCM_DISABLE_DM, BswMArgumentRef=LE_BCAN_COMM_DISABLE_DM, BswMArgumentRef=LE_PNC32_COMM_DISABLE_DM
          RuleLE_ComControl_BCAN_PNC32_DISABLE_RX: BswMLogicalOperator=BSWM_OR, BswMArgumentRef=LE_BCAN_CANCM_DISABLE_RX, BswMArgumentRef=LE_BCAN_COMM_DISABLE_RX, BswMArgumentRef=LE_BCAN_DCM_DISABLE_RX, BswMArgumentRef=LE_PNC32_COMM_DISABLE_RX
          RuleLE_ComControl_BCAN_PNC32_DISABLE_TX: BswMLogicalOperator=BSWM_OR, BswMArgumentRef=LE_BCAN_CANCM_DISABLE_TX, BswMArgumentRef=LE_BCAN_COMM_DISABLE_TX, BswMArgumentRef=LE_BCAN_DCM_DISABLE_TX, BswMArgumentRef=LE_PNC32_COMM_DISABLE_TX
          RuleLE_ComControl_BCAN_PNC32_ENABLE_DM: BswMLogicalOperator=BSWM_AND, BswMArgumentRef=LE_BCAN_CANCM_ENABLE_DM, BswMArgumentRef=LE_BCAN_COMM_ENABLE_DM, BswMArgumentRef=LE_PNC32_COMM_ENABLE_DM
          RuleLE_ComControl_BCAN_PNC32_ENABLE_RX: BswMLogicalOperator=BSWM_AND, BswMArgumentRef=LE_BCAN_CANCM_ENABLE_RX, BswMArgumentRef=LE_BCAN_COMM_ENABLE_RX, BswMArgumentRef=LE_BCAN_DCM_ENABLE_RX, BswMArgumentRef=LE_PNC32_COMM_ENABLE_RX
          RuleLE_ComControl_BCAN_PNC32_ENABLE_TX: BswMLogicalOperator=BSWM_AND, BswMArgumentRef=LE_BCAN_CANCM_ENABLE_TX, BswMArgumentRef=LE_BCAN_COMM_ENABLE_TX, BswMArgumentRef=LE_BCAN_DCM_ENABLE_TX, BswMArgumentRef=LE_PNC32_COMM_ENABLE_TX
          RuleLE_ComControl_LCAN_DISABLE_NM_TimerisNotStopped: BswMLogicalOperator=BSWM_OR, BswMArgumentRef=LE_LCAN_CANCM_DISABLE_NM, BswMArgumentRef=LE_LCAN_CANSM_DISABLE_NM
          RuleLE_ComControl_LCAN_ENABLE_NM_TimerisNotStarted: BswMLogicalOperator=BSWM_AND, BswMArgumentRef=LE_LCAN_CANCM_ENABLE_NM, BswMArgumentRef=LE_LCAN_CANSM_ENABLE_NM
          RuleLE_ComControl_LCAN_PNC159_DISABLE_DM: BswMLogicalOperator=BSWM_OR, BswMArgumentRef=LE_LCAN_CANCM_DISABLE_DM, BswMArgumentRef=LE_LCAN_COMM_DISABLE_DM, BswMArgumentRef=LE_PNC159_COMM_DISABLE_DM
          RuleLE_ComControl_LCAN_PNC159_DISABLE_RX: BswMLogicalOperator=BSWM_OR, BswMArgumentRef=LE_LCAN_CANCM_DISABLE_RX, BswMArgumentRef=LE_LCAN_COMM_DISABLE_RX, BswMArgumentRef=LE_PNC159_COMM_DISABLE_RX
          RuleLE_ComControl_LCAN_PNC159_DISABLE_TX: BswMLogicalOperator=BSWM_OR, BswMArgumentRef=LE_LCAN_CANCM_DISABLE_TX, BswMArgumentRef=LE_LCAN_COMM_DISABLE_TX, BswMArgumentRef=LE_PNC159_COMM_DISABLE_TX
          RuleLE_ComControl_LCAN_PNC159_ENABLE_DM: BswMLogicalOperator=BSWM_AND, BswMArgumentRef=LE_LCAN_CANCM_ENABLE_DM, BswMArgumentRef=LE_LCAN_COMM_ENABLE_DM, BswMArgumentRef=LE_PNC159_COMM_ENABLE_DM
          RuleLE_ComControl_LCAN_PNC159_ENABLE_RX: BswMLogicalOperator=BSWM_AND, BswMArgumentRef=LE_LCAN_CANCM_ENABLE_RX, BswMArgumentRef=LE_LCAN_COMM_ENABLE_RX, BswMArgumentRef=LE_PNC159_COMM_ENABLE_RX
          RuleLE_ComControl_LCAN_PNC159_ENABLE_TX: BswMLogicalOperator=BSWM_AND, BswMArgumentRef=LE_LCAN_CANCM_ENABLE_TX, BswMArgumentRef=LE_LCAN_COMM_ENABLE_TX, BswMArgumentRef=LE_PNC159_COMM_ENABLE_TX
          RuleLE_ComControl_LCAN_PNC32_DISABLE_DM: BswMLogicalOperator=BSWM_OR, BswMArgumentRef=LE_LCAN_CANCM_DISABLE_DM, BswMArgumentRef=LE_LCAN_COMM_DISABLE_DM, BswMArgumentRef=LE_PNC32_COMM_DISABLE_DM
          RuleLE_ComControl_LCAN_PNC32_DISABLE_RX: BswMLogicalOperator=BSWM_OR, BswMArgumentRef=LE_LCAN_CANCM_DISABLE_RX, BswMArgumentRef=LE_LCAN_COMM_DISABLE_RX, BswMArgumentRef=LE_PNC32_COMM_DISABLE_RX
          RuleLE_ComControl_LCAN_PNC32_DISABLE_TX: BswMLogicalOperator=BSWM_OR, BswMArgumentRef=LE_LCAN_CANCM_DISABLE_TX, BswMArgumentRef=LE_LCAN_COMM_DISABLE_TX, BswMArgumentRef=LE_PNC32_COMM_DISABLE_TX
          RuleLE_ComControl_LCAN_PNC32_ENABLE_DM: BswMLogicalOperator=BSWM_AND, BswMArgumentRef=LE_LCAN_CANCM_ENABLE_DM, BswMArgumentRef=LE_LCAN_COMM_ENABLE_DM, BswMArgumentRef=LE_PNC32_COMM_ENABLE_DM
          RuleLE_ComControl_LCAN_PNC32_ENABLE_RX: BswMLogicalOperator=BSWM_AND, BswMArgumentRef=LE_LCAN_CANCM_ENABLE_RX, BswMArgumentRef=LE_LCAN_COMM_ENABLE_RX, BswMArgumentRef=LE_PNC32_COMM_ENABLE_RX
          RuleLE_ComControl_LCAN_PNC32_ENABLE_TX: BswMLogicalOperator=BSWM_AND, BswMArgumentRef=LE_LCAN_CANCM_ENABLE_TX, BswMArgumentRef=LE_LCAN_COMM_ENABLE_TX, BswMArgumentRef=LE_PNC32_COMM_ENABLE_TX
          RuleLE_ComMModeNotification_PNC141_PNC_FULL_COMMUNICATION: BswMArgumentRef=MC_IMM_ComMPncIndication_PNC141_EQ_PNC_FULL_COMMUNICATION
          RuleLE_ComMModeNotification_PNC141_PNC_NO_COMMUNICATION: BswMArgumentRef=MC_IMM_ComMPncIndication_PNC141_EQ_PNC_NO_COMMUNICATION
          RuleLE_ComMModeNotification_PNC141_PNC_PREPARE_SLEEP: BswMArgumentRef=MC_IMM_ComMPncIndication_PNC141_EQ_PNC_PREPARE_SLEEP
          RuleLE_ComMModeNotification_PNC141_PNC_READY_SLEEP: BswMArgumentRef=MC_IMM_ComMPncIndication_PNC141_EQ_PNC_READY_SLEEP
          RuleLE_ComMModeNotification_PNC141_PNC_REQUESTED: BswMArgumentRef=MC_IMM_ComMPncIndication_PNC141_EQ_PNC_REQUESTED
          RuleLE_ComMModeNotification_PNC153_PNC_FULL_COMMUNICATION: BswMArgumentRef=MC_IMM_ComMPncIndication_PNC153_EQ_PNC_FULL_COMMUNICATION
          RuleLE_ComMModeNotification_PNC153_PNC_NO_COMMUNICATION: BswMArgumentRef=MC_IMM_ComMPncIndication_PNC153_EQ_PNC_NO_COMMUNICATION
          RuleLE_ComMModeNotification_PNC153_PNC_PREPARE_SLEEP: BswMArgumentRef=MC_IMM_ComMPncIndication_PNC153_EQ_PNC_PREPARE_SLEEP
          RuleLE_ComMModeNotification_PNC153_PNC_READY_SLEEP: BswMArgumentRef=MC_IMM_ComMPncIndication_PNC153_EQ_PNC_READY_SLEEP
          RuleLE_ComMModeNotification_PNC153_PNC_REQUESTED: BswMArgumentRef=MC_IMM_ComMPncIndication_PNC153_EQ_PNC_REQUESTED
          RuleLE_ComMModeNotification_PNC159_PNC_FULL_COMMUNICATION: BswMArgumentRef=MC_IMM_ComMPncIndication_PNC159_EQ_PNC_FULL_COMMUNICATION
          RuleLE_ComMModeNotification_PNC159_PNC_NO_COMMUNICATION: BswMArgumentRef=MC_IMM_ComMPncIndication_PNC159_EQ_PNC_NO_COMMUNICATION
          RuleLE_ComMModeNotification_PNC159_PNC_PREPARE_SLEEP: BswMArgumentRef=MC_IMM_ComMPncIndication_PNC159_EQ_PNC_PREPARE_SLEEP
          RuleLE_ComMModeNotification_PNC159_PNC_READY_SLEEP: BswMArgumentRef=MC_IMM_ComMPncIndication_PNC159_EQ_PNC_READY_SLEEP
          RuleLE_ComMModeNotification_PNC159_PNC_REQUESTED: BswMArgumentRef=MC_IMM_ComMPncIndication_PNC159_EQ_PNC_REQUESTED
          RuleLE_ComMModeNotification_PNC32_PNC_FULL_COMMUNICATION: BswMArgumentRef=MC_IMM_ComMPncIndication_PNC32_EQ_PNC_FULL_COMMUNICATION
          RuleLE_ComMModeNotification_PNC32_PNC_NO_COMMUNICATION: BswMArgumentRef=MC_IMM_ComMPncIndication_PNC32_EQ_PNC_NO_COMMUNICATION
          RuleLE_ComMModeNotification_PNC32_PNC_PREPARE_SLEEP: BswMArgumentRef=MC_IMM_ComMPncIndication_PNC32_EQ_PNC_PREPARE_SLEEP
          RuleLE_ComMModeNotification_PNC32_PNC_READY_SLEEP: BswMArgumentRef=MC_IMM_ComMPncIndication_PNC32_EQ_PNC_READY_SLEEP
          RuleLE_ComMModeNotification_PNC32_PNC_REQUESTED: BswMArgumentRef=MC_IMM_ComMPncIndication_PNC32_EQ_PNC_REQUESTED
          RuleLE_ComModeNotification_BCAN_FULL_COM: BswMArgumentRef=MC_IMM_ComMIndication_BCAN_EQ_FULL_COM
          RuleLE_ComModeNotification_BCAN_NO_COM: BswMArgumentRef=MC_IMM_ComMIndication_BCAN_EQ_NO_COM
          RuleLE_ComModeNotification_BCAN_SILENT_COM: BswMArgumentRef=MC_IMM_ComMIndication_BCAN_EQ_SILENT_COM
          RuleLE_ComModeNotification_LCAN_FULL_COM: BswMArgumentRef=MC_IMM_ComMIndication_LCAN_EQ_FULL_COM
          RuleLE_ComModeNotification_LCAN_NO_COM: BswMArgumentRef=MC_IMM_ComMIndication_LCAN_EQ_NO_COM
          RuleLE_ComModeNotification_LCAN_SILENT_COM: BswMArgumentRef=MC_IMM_ComMIndication_LCAN_EQ_SILENT_COM
          RuleLE_ComModeRequest_PNC141_FULL_COM: BswMArgumentRef=MC_IMM_SwcModeRequest_ComMMode_PNC141_EQ_COMM_MODE_FULL_COM
          RuleLE_ComModeRequest_PNC141_NO_COM: BswMArgumentRef=MC_IMM_SwcModeRequest_ComMMode_PNC141_EQ_COMM_MODE_NO_COM
          RuleLE_ComModeRequest_PNC153_FULL_COM: BswMArgumentRef=MC_IMM_SwcModeRequest_ComMMode_PNC153_EQ_COMM_MODE_FULL_COM
          RuleLE_ComModeRequest_PNC153_NO_COM: BswMArgumentRef=MC_IMM_SwcModeRequest_ComMMode_PNC153_EQ_COMM_MODE_NO_COM
          RuleLE_ComModeRequest_PNC159_FULL_COM: BswMArgumentRef=MC_IMM_SwcModeRequest_ComMMode_PNC159_EQ_COMM_MODE_FULL_COM
          RuleLE_ComModeRequest_PNC159_NO_COM: BswMArgumentRef=MC_IMM_SwcModeRequest_ComMMode_PNC159_EQ_COMM_MODE_NO_COM
          RuleLE_ComModeRequest_PNC32_FULL_COM: BswMArgumentRef=MC_IMM_SwcModeRequest_ComMMode_PNC32_EQ_COMM_MODE_FULL_COM
          RuleLE_ComModeRequest_PNC32_NO_COM: BswMArgumentRef=MC_IMM_SwcModeRequest_ComMMode_PNC32_EQ_COMM_MODE_NO_COM
          RuleLE_DcmApplicationUpdatedNotification_APP_NOT_UPDATED: BswMArgumentRef=MC_IMM_DcmApplicationUpdatedIndication_EQ_APP_NOT_UPDATED
          RuleLE_DcmApplicationUpdatedNotification_APP_UPDATED: BswMArgumentRef=MC_IMM_DcmApplicationUpdatedIndication_EQ_APP_UPDATED
          RuleLE_DcmCommunicationControl_0_DCM_DISABLE_RX_DISABLE_TX_NM: BswMArgumentRef=MC_IMM_BswModeNotification_modeNotificationPort_DcmCommunicationControl_0_EQ_DCM_DISABLE_RX_DISABLE_TX_NM
          RuleLE_DcmCommunicationControl_0_DCM_DISABLE_RX_ENABLE_TX_NORM: BswMArgumentRef=MC_IMM_BswModeNotification_modeNotificationPort_DcmCommunicationControl_0_EQ_DCM_DISABLE_RX_ENABLE_TX_NORM
          RuleLE_DcmCommunicationControl_0_DCM_DISABLE_RX_ENABLE_TX_NORM_NM: BswMArgumentRef=MC_IMM_BswModeNotification_modeNotificationPort_DcmCommunicationControl_0_EQ_DCM_DISABLE_RX_ENABLE_TX_NORM_NM
          RuleLE_DcmCommunicationControl_0_DCM_DISABLE_RX_TX_NM: BswMArgumentRef=MC_IMM_BswModeNotification_modeNotificationPort_DcmCommunicationControl_0_EQ_DCM_DISABLE_RX_TX_NM
          RuleLE_DcmCommunicationControl_0_DCM_DISABLE_RX_TX_NORMAL: BswMArgumentRef=MC_IMM_BswModeNotification_modeNotificationPort_DcmCommunicationControl_0_EQ_DCM_DISABLE_RX_TX_NORMAL
          RuleLE_DcmCommunicationControl_0_DCM_DISABLE_RX_TX_NORM_NM: BswMArgumentRef=MC_IMM_BswModeNotification_modeNotificationPort_DcmCommunicationControl_0_EQ_DCM_DISABLE_RX_TX_NORM_NM
          RuleLE_DcmCommunicationControl_0_DCM_ENABLE_RX_DISABLE_TX_NM: BswMArgumentRef=MC_IMM_BswModeNotification_modeNotificationPort_DcmCommunicationControl_0_EQ_DCM_ENABLE_RX_DISABLE_TX_NM
          RuleLE_DcmCommunicationControl_0_DCM_ENABLE_RX_DISABLE_TX_NORM: BswMArgumentRef=MC_IMM_BswModeNotification_modeNotificationPort_DcmCommunicationControl_0_EQ_DCM_ENABLE_RX_DISABLE_TX_NORM
          RuleLE_DcmCommunicationControl_0_DCM_ENABLE_RX_DISABLE_TX_NORM_NM: BswMArgumentRef=MC_IMM_BswModeNotification_modeNotificationPort_DcmCommunicationControl_0_EQ_DCM_ENABLE_RX_DISABLE_TX_NORM_NM
          RuleLE_DcmCommunicationControl_0_DCM_ENABLE_RX_TX_NM: BswMArgumentRef=MC_IMM_BswModeNotification_modeNotificationPort_DcmCommunicationControl_0_EQ_DCM_ENABLE_RX_TX_NM
          RuleLE_DcmCommunicationControl_0_DCM_ENABLE_RX_TX_NORM: BswMArgumentRef=MC_IMM_BswModeNotification_modeNotificationPort_DcmCommunicationControl_0_EQ_DCM_ENABLE_RX_TX_NORM
          RuleLE_DcmCommunicationControl_0_DCM_ENABLE_RX_TX_NORM_NM: BswMArgumentRef=MC_IMM_BswModeNotification_modeNotificationPort_DcmCommunicationControl_0_EQ_DCM_ENABLE_RX_TX_NORM_NM
          RuleLE_DcmControlDTCSetting_DISABLEDTCSETTING: BswMArgumentRef=MC_IMM_BswModeNotification_modeNotificationPort_DcmControlDTCSetting_EQ_DISABLEDTCSETTING
          RuleLE_DcmControlDTCSetting_ENABLEDTCSETTING: BswMArgumentRef=MC_IMM_BswModeNotification_modeNotificationPort_DcmControlDTCSetting_EQ_ENABLEDTCSETTING
          RuleLE_DcmEcuReset_HARD: BswMArgumentRef=MC_IMM_BswModeNotification_modeNotificationPort_DcmEcuReset_EQ_HARD
          RuleLE_DcmEcuReset_SOFT: BswMArgumentRef=MC_IMM_BswModeNotification_modeNotificationPort_DcmEcuReset_EQ_SOFT
          RuleLE_DcmModeRapidPowerShutDown_DISABLE_RAPIDPOWERSHUTDOWN: BswMArgumentRef=MC_IMM_BswModeNotification_modeNotificationPort_DcmModeRapidPowerShutDown_EQ_DISABLE_RAPIDPOWERSHUTDOWN
          RuleLE_DcmModeRapidPowerShutDown_ENABLE_RAPIDPOWERSHUTDOWN: BswMArgumentRef=MC_IMM_BswModeNotification_modeNotificationPort_DcmModeRapidPowerShutDown_EQ_ENABLE_RAPIDPOWERSHUTDOWN
          RuleLE_DiagnosticSessionNotification_DEFAULT_SESSION: BswMArgumentRef=MC_IMM_BswModeNotification_modeNotificationPort_DcmDiagnosticSessionControl_EQ_DCM_DEFAULT_SESSION
          RuleLE_DiagnosticSessionNotification_ECU_PROGRAMMING_MODE: BswMArgumentRef=MC_IMM_BswModeNotification_modeNotificationPort_DcmDiagnosticSessionControl_EQ_DCM_ECU_PROGRAMMING_MODE
          RuleLE_DiagnosticSessionNotification_EXTENDED_DIAGNOSTIC_MODE: BswMArgumentRef=MC_IMM_BswModeNotification_modeNotificationPort_DcmDiagnosticSessionControl_EQ_DCM_EXTENDED_DIAGNOSTIC_MODE
          RuleLE_DiagnosticSessionNotification_EXTENDED_DIAGNOSTIC_SESSION: BswMArgumentRef=MC_IMM_BswModeNotification_modeNotificationPort_DcmDiagnosticSessionControl_EQ_DCM_EXTENDED_DIAGNOSTIC_SESSION
          RuleLE_DiagnosticSessionNotification_PROGRAMMING_SESSION: BswMArgumentRef=MC_IMM_BswModeNotification_modeNotificationPort_DcmDiagnosticSessionControl_EQ_DCM_PROGRAMMING_SESSION
          RuleLE_DiagnosticSessionNotification_QUIESCENT_CURRENT_DIAGNOSTIC_MODE_START: BswMArgumentRef=MC_IMM_BswModeNotification_modeNotificationPort_DcmDiagnosticSessionControl_EQ_DCM_QUIESCENT_CURRENT_DIAGNOSTIC_MODE_START
          RuleLE_DiagnosticSessionNotification_SAFETY_SYSTEM_DIAGNOSTIC_SESSION: BswMArgumentRef=MC_IMM_BswModeNotification_modeNotificationPort_DcmDiagnosticSessionControl_EQ_DCM_SAFETY_SYSTEM_DIAGNOSTIC_SESSION
          RuleLE_DiagnosticSessionNotification_SLEEP_MODE_START_REQUEST: BswMArgumentRef=MC_IMM_BswModeNotification_modeNotificationPort_DcmDiagnosticSessionControl_EQ_DCM_SLEEP_MODE_START_REQUEST
          RuleLE_EcuStateTo_OFF: BswMLogicalOperator=BSWM_AND, BswMArgumentRef=LE_NvMWriteAllCompleted, BswMArgumentRef=MC_IMM_GenericRequest_EcuState_EQ_EXIT_SHUTDOWN, BswMArgumentRef=MC_IMM_GenericRequest_ShutdownTarget_EQ_OFF
          RuleLE_EcuStateTo_RESET: BswMLogicalOperator=BSWM_AND, BswMArgumentRef=LE_NvMWriteAllCompleted, BswMArgumentRef=MC_IMM_GenericRequest_EcuState_EQ_EXIT_SHUTDOWN, BswMArgumentRef=MC_IMM_GenericRequest_ShutdownTarget_EQ_RESET
          RuleLE_EcuStateTo_RUN_From_SLEEP: BswMLogicalOperator=BSWM_AND, BswMArgumentRef=MC_IMM_GenericRequest_EcuState_EQ_EXIT_SLEEP, BswMArgumentRef=MC_IMM_GenericRequest_ShutdownTarget_EQ_RUN
          RuleLE_EcuStateTo_RUN_From_STARTUP: BswMLogicalOperator=BSWM_AND, BswMArgumentRef=MC_IMM_GenericRequest_EcuState_EQ_EXIT_STARTUP_THREE, BswMArgumentRef=MC_IMM_GenericRequest_ShutdownTarget_EQ_RUN
          RuleLE_EcuStateTo_SHUTDOWN: BswMLogicalOperator=BSWM_AND, BswMArgumentRef=LE_EcuGoDownTypes, BswMArgumentRef=MC_IMM_GenericRequest_EcuState_EQ_EXIT_RUN
          RuleLE_EcuStateTo_SLEEP: BswMLogicalOperator=BSWM_AND, BswMArgumentRef=LE_EcuSleepAllowed, BswMArgumentRef=MC_IMM_GenericRequest_EcuState_EQ_EXIT_RUN, BswMArgumentRef=MC_IMM_GenericRequest_ShutdownTarget_EQ_SLEEP
          RuleLE_EcuStateTo_STARTUP_THREE: BswMLogicalOperator=BSWM_AND, BswMArgumentRef=LE_NvMReadAllCompleted, BswMArgumentRef=MC_IMM_GenericRequest_EcuState_EQ_EXIT_STARTUP_TWO
          RuleLE_EcuStateTo_STARTUP_TWO: BswMArgumentRef=MC_IMM_EcuMIndication_EQ_STARTUP_TWO
          RuleLE_EcuState_OFF: BswMArgumentRef=MC_IMM_GenericRequest_EcuState_EQ_ENTRY_OFF
          RuleLE_EcuState_RESET: BswMArgumentRef=MC_IMM_GenericRequest_EcuState_EQ_ENTRY_RESET
          RuleLE_EcuState_RUN: BswMArgumentRef=MC_IMM_GenericRequest_EcuState_EQ_ENTRY_RUN
          RuleLE_EcuState_SHUTDOWN: BswMArgumentRef=MC_IMM_GenericRequest_EcuState_EQ_ENTRY_SHUTDOWN
          RuleLE_EcuState_SLEEP: BswMArgumentRef=MC_IMM_GenericRequest_EcuState_EQ_ENTRY_SLEEP
          RuleLE_EcuState_STARTUP_THREE: BswMArgumentRef=MC_IMM_GenericRequest_EcuState_EQ_ENTRY_STARTUP_THREE
          RuleLE_EcuState_STARTUP_TWO: BswMArgumentRef=MC_IMM_GenericRequest_EcuState_EQ_ENTRY_STARTUP_TWO
          RuleLE_ShutdownTargetTo_OFF: BswMLogicalOperator=BSWM_AND, BswMArgumentRef=MC_IMM_GenericRequest_EcuMRequest_EQ_OFF, BswMArgumentRef=MC_IMM_GenericRequest_EcuModeTransition_EQ_END, BswMArgumentRef=MC_IMM_GenericRequest_ShutdownTarget_EQ_RUN
          RuleLE_ShutdownTargetTo_RESET: BswMLogicalOperator=BSWM_AND, BswMArgumentRef=LE_EcuResetTypes, BswMArgumentRef=MC_IMM_GenericRequest_EcuModeTransition_EQ_END, BswMArgumentRef=MC_IMM_GenericRequest_ShutdownTarget_EQ_RUN
          RuleLE_ShutdownTargetTo_RUN: BswMLogicalOperator=BSWM_AND, BswMArgumentRef=MC_IMM_GenericRequest_EcuMRequest_EQ_RUN, BswMArgumentRef=MC_IMM_GenericRequest_EcuModeTransition_EQ_END, BswMArgumentRef=MC_IMM_GenericRequest_ShutdownTarget_EQ_SLEEP
          RuleLE_ShutdownTargetTo_SLEEP: BswMLogicalOperator=BSWM_AND, BswMArgumentRef=MC_IMM_GenericRequest_EcuMRequest_EQ_SLEEP, BswMArgumentRef=MC_IMM_GenericRequest_EcuModeTransition_EQ_END, BswMArgumentRef=MC_IMM_GenericRequest_ShutdownTarget_EQ_RUN
          RuleLE_WakeupEventNotification_BCAN_RX: BswMArgumentRef=MC_IMM_EcuMWakeupSource_BCAN_RX_EQ_VALIDATED
          RuleLE_WakeupEventNotification_BCAN_RX_POLL: BswMArgumentRef=MC_IMM_EcuMWakeupSource_BCAN_RX_POLL_EQ_VALIDATED
          RuleLE_WakeupEventNotification_IGN1: BswMArgumentRef=MC_IMM_EcuMWakeupSource_IGN1_EQ_VALIDATED
          RuleLE_WakeupEventNotification_LCAN_RX: BswMArgumentRef=MC_IMM_EcuMWakeupSource_LCAN_RX_EQ_VALIDATED
          RuleLE_WakeupEventNotification_LCAN_RX_POLL: BswMArgumentRef=MC_IMM_EcuMWakeupSource_LCAN_RX_POLL_EQ_VALIDATED
        136 x BswMRule, all with category=TOOL_CONFIGURED, BswMNestedExecutionOnly=0:
          Rule_CanBorNotification_BCAN_COMPLETE: BswMRuleInitState=BSWM_TRUE, BswMRuleExpressionRef=RuleLE_CanBorNotification_BCAN_COMPLETE, BswMRuleTrueActionList=TrueAL_CanBorNotification_BCAN_COMPLETE
          Rule_CanBorNotification_BCAN_START: BswMRuleInitState=BSWM_FALSE, BswMRuleExpressionRef=RuleLE_CanBorNotification_BCAN_START, BswMRuleTrueActionList=TrueAL_CanBorNotification_BCAN_START
          Rule_CanBorNotification_LCAN_COMPLETE: BswMRuleInitState=BSWM_TRUE, BswMRuleExpressionRef=RuleLE_CanBorNotification_LCAN_COMPLETE, BswMRuleTrueActionList=TrueAL_CanBorNotification_LCAN_COMPLETE
          Rule_CanBorNotification_LCAN_START: BswMRuleInitState=BSWM_FALSE, BswMRuleExpressionRef=RuleLE_CanBorNotification_LCAN_START, BswMRuleTrueActionList=TrueAL_CanBorNotification_LCAN_START
          Rule_CanStateNotification_BCAN_BUS_OFF: BswMRuleInitState=BSWM_FALSE, BswMRuleExpressionRef=RuleLE_CanStateNotification_BCAN_BUS_OFF, BswMRuleTrueActionList=TrueAL_CanStateNotification_BCAN_BUS_OFF
          Rule_CanStateNotification_BCAN_CHANGE_BAUDRATE: BswMRuleInitState=BSWM_FALSE, BswMRuleExpressionRef=RuleLE_CanStateNotification_BCAN_CHANGE_BAUDRATE, BswMRuleTrueActionList=TrueAL_CanStateNotification_BCAN_CHANGE_BAUDRATE
          Rule_CanStateNotification_BCAN_FULL_COM: BswMRuleInitState=BSWM_FALSE, BswMRuleExpressionRef=RuleLE_CanStateNotification_BCAN_FULL_COM, BswMRuleTrueActionList=TrueAL_CanStateNotification_BCAN_FULL_COM
          Rule_CanStateNotification_BCAN_NO_COM: BswMRuleInitState=BSWM_FALSE, BswMRuleExpressionRef=RuleLE_CanStateNotification_BCAN_NO_COM, BswMRuleTrueActionList=TrueAL_CanStateNotification_BCAN_NO_COM
          Rule_CanStateNotification_BCAN_SILENT_COM: BswMRuleInitState=BSWM_FALSE, BswMRuleExpressionRef=RuleLE_CanStateNotification_BCAN_SILENT_COM, BswMRuleTrueActionList=TrueAL_CanStateNotification_BCAN_SILENT_COM
          Rule_CanStateNotification_LCAN_BUS_OFF: BswMRuleInitState=BSWM_FALSE, BswMRuleExpressionRef=RuleLE_CanStateNotification_LCAN_BUS_OFF, BswMRuleTrueActionList=TrueAL_CanStateNotification_LCAN_BUS_OFF
          Rule_CanStateNotification_LCAN_CHANGE_BAUDRATE: BswMRuleInitState=BSWM_FALSE, BswMRuleExpressionRef=RuleLE_CanStateNotification_LCAN_CHANGE_BAUDRATE, BswMRuleTrueActionList=TrueAL_CanStateNotification_LCAN_CHANGE_BAUDRATE
          Rule_CanStateNotification_LCAN_FULL_COM: BswMRuleInitState=BSWM_FALSE, BswMRuleExpressionRef=RuleLE_CanStateNotification_LCAN_FULL_COM, BswMRuleTrueActionList=TrueAL_CanStateNotification_LCAN_FULL_COM
          Rule_CanStateNotification_LCAN_NO_COM: BswMRuleInitState=BSWM_FALSE, BswMRuleExpressionRef=RuleLE_CanStateNotification_LCAN_NO_COM, BswMRuleTrueActionList=TrueAL_CanStateNotification_LCAN_NO_COM
          Rule_CanStateNotification_LCAN_SILENT_COM: BswMRuleInitState=BSWM_FALSE, BswMRuleExpressionRef=RuleLE_CanStateNotification_LCAN_SILENT_COM, BswMRuleTrueActionList=TrueAL_CanStateNotification_LCAN_SILENT_COM
          Rule_ComControl_BCAN_DISABLE_NM: BswMRuleInitState=BSWM_FALSE, BswMRuleExpressionRef=RuleLE_ComControl_BCAN_DISABLE_NM, BswMRuleTrueActionList=TrueAL_ComControl_BCAN_DISABLE_NM
          Rule_ComControl_BCAN_DISABLE_NM_TimerisNotStopped: BswMRuleInitState=BSWM_FALSE, BswMRuleExpressionRef=RuleLE_ComControl_BCAN_DISABLE_NM_TimerisNotStopped, BswMRuleTrueActionList=TrueAL_ComControl_BCAN_DISABLE_NM_TimerisNotStopped
          Rule_ComControl_BCAN_ENABLE_NM: BswMRuleInitState=BSWM_TRUE, BswMRuleExpressionRef=RuleLE_ComControl_BCAN_ENABLE_NM, BswMRuleTrueActionList=TrueAL_ComControl_BCAN_ENABLE_NM
          Rule_ComControl_BCAN_ENABLE_NM_TimerisNotStarted: BswMRuleInitState=BSWM_TRUE, BswMRuleExpressionRef=RuleLE_ComControl_BCAN_ENABLE_NM_TimerisNotStarted, BswMRuleTrueActionList=TrueAL_ComControl_BCAN_ENABLE_NM_TimerisNotStarted
          Rule_ComControl_BCAN_PNC141_DISABLE_DM: BswMRuleInitState=BSWM_FALSE, BswMRuleExpressionRef=RuleLE_ComControl_BCAN_PNC141_DISABLE_DM, BswMRuleTrueActionList=TrueAL_ComControl_BCAN_PNC141_DISABLE_DM
          Rule_ComControl_BCAN_PNC141_DISABLE_RX: BswMRuleInitState=BSWM_TRUE, BswMRuleExpressionRef=RuleLE_ComControl_BCAN_PNC141_DISABLE_RX, BswMRuleTrueActionList=TrueAL_ComControl_BCAN_PNC141_DISABLE_RX
          Rule_ComControl_BCAN_PNC141_DISABLE_TX: BswMRuleInitState=BSWM_TRUE, BswMRuleExpressionRef=RuleLE_ComControl_BCAN_PNC141_DISABLE_TX, BswMRuleTrueActionList=TrueAL_ComControl_BCAN_PNC141_DISABLE_TX
          Rule_ComControl_BCAN_PNC141_ENABLE_DM: BswMRuleInitState=BSWM_FALSE, BswMRuleExpressionRef=RuleLE_ComControl_BCAN_PNC141_ENABLE_DM, BswMRuleTrueActionList=TrueAL_ComControl_BCAN_PNC141_ENABLE_DM
          Rule_ComControl_BCAN_PNC141_ENABLE_RX: BswMRuleInitState=BSWM_FALSE, BswMRuleExpressionRef=RuleLE_ComControl_BCAN_PNC141_ENABLE_RX, BswMRuleTrueActionList=TrueAL_ComControl_BCAN_PNC141_ENABLE_RX
          Rule_ComControl_BCAN_PNC141_ENABLE_TX: BswMRuleInitState=BSWM_FALSE, BswMRuleExpressionRef=RuleLE_ComControl_BCAN_PNC141_ENABLE_TX, BswMRuleTrueActionList=TrueAL_ComControl_BCAN_PNC141_ENABLE_TX
          Rule_ComControl_BCAN_PNC153_DISABLE_DM: BswMRuleInitState=BSWM_FALSE, BswMRuleExpressionRef=RuleLE_ComControl_BCAN_PNC153_DISABLE_DM, BswMRuleTrueActionList=TrueAL_ComControl_BCAN_PNC153_DISABLE_DM
          Rule_ComControl_BCAN_PNC153_DISABLE_RX: BswMRuleInitState=BSWM_TRUE, BswMRuleExpressionRef=RuleLE_ComControl_BCAN_PNC153_DISABLE_RX, BswMRuleTrueActionList=TrueAL_ComControl_BCAN_PNC153_DISABLE_RX
          Rule_ComControl_BCAN_PNC153_DISABLE_TX: BswMRuleInitState=BSWM_TRUE, BswMRuleExpressionRef=RuleLE_ComControl_BCAN_PNC153_DISABLE_TX, BswMRuleTrueActionList=TrueAL_ComControl_BCAN_PNC153_DISABLE_TX
          Rule_ComControl_BCAN_PNC153_ENABLE_DM: BswMRuleInitState=BSWM_FALSE, BswMRuleExpressionRef=RuleLE_ComControl_BCAN_PNC153_ENABLE_DM, BswMRuleTrueActionList=TrueAL_ComControl_BCAN_PNC153_ENABLE_DM
          Rule_ComControl_BCAN_PNC153_ENABLE_RX: BswMRuleInitState=BSWM_FALSE, BswMRuleExpressionRef=RuleLE_ComControl_BCAN_PNC153_ENABLE_RX, BswMRuleTrueActionList=TrueAL_ComControl_BCAN_PNC153_ENABLE_RX
          Rule_ComControl_BCAN_PNC153_ENABLE_TX: BswMRuleInitState=BSWM_FALSE, BswMRuleExpressionRef=RuleLE_ComControl_BCAN_PNC153_ENABLE_TX, BswMRuleTrueActionList=TrueAL_ComControl_BCAN_PNC153_ENABLE_TX
          Rule_ComControl_BCAN_PNC32_DISABLE_DM: BswMRuleInitState=BSWM_FALSE, BswMRuleExpressionRef=RuleLE_ComControl_BCAN_PNC32_DISABLE_DM, BswMRuleTrueActionList=TrueAL_ComControl_BCAN_PNC32_DISABLE_DM
          Rule_ComControl_BCAN_PNC32_DISABLE_RX: BswMRuleInitState=BSWM_TRUE, BswMRuleExpressionRef=RuleLE_ComControl_BCAN_PNC32_DISABLE_RX, BswMRuleTrueActionList=TrueAL_ComControl_BCAN_PNC32_DISABLE_RX
          Rule_ComControl_BCAN_PNC32_DISABLE_TX: BswMRuleInitState=BSWM_TRUE, BswMRuleExpressionRef=RuleLE_ComControl_BCAN_PNC32_DISABLE_TX, BswMRuleTrueActionList=TrueAL_ComControl_BCAN_PNC32_DISABLE_TX
          Rule_ComControl_BCAN_PNC32_ENABLE_DM: BswMRuleInitState=BSWM_FALSE, BswMRuleExpressionRef=RuleLE_ComControl_BCAN_PNC32_ENABLE_DM, BswMRuleTrueActionList=TrueAL_ComControl_BCAN_PNC32_ENABLE_DM
          Rule_ComControl_BCAN_PNC32_ENABLE_RX: BswMRuleInitState=BSWM_FALSE, BswMRuleExpressionRef=RuleLE_ComControl_BCAN_PNC32_ENABLE_RX, BswMRuleTrueActionList=TrueAL_ComControl_BCAN_PNC32_ENABLE_RX
          Rule_ComControl_BCAN_PNC32_ENABLE_TX: BswMRuleInitState=BSWM_FALSE, BswMRuleExpressionRef=RuleLE_ComControl_BCAN_PNC32_ENABLE_TX, BswMRuleTrueActionList=TrueAL_ComControl_BCAN_PNC32_ENABLE_TX
          Rule_ComControl_LCAN_DISABLE_NM_TimerisNotStopped: BswMRuleInitState=BSWM_FALSE, BswMRuleExpressionRef=RuleLE_ComControl_LCAN_DISABLE_NM_TimerisNotStopped, BswMRuleTrueActionList=TrueAL_ComControl_LCAN_DISABLE_NM_TimerisNotStopped
          Rule_ComControl_LCAN_ENABLE_NM_TimerisNotStarted: BswMRuleInitState=BSWM_TRUE, BswMRuleExpressionRef=RuleLE_ComControl_LCAN_ENABLE_NM_TimerisNotStarted, BswMRuleTrueActionList=TrueAL_ComControl_LCAN_ENABLE_NM_TimerisNotStarted
          Rule_ComControl_LCAN_PNC159_DISABLE_DM: BswMRuleInitState=BSWM_FALSE, BswMRuleExpressionRef=RuleLE_ComControl_LCAN_PNC159_DISABLE_DM, BswMRuleTrueActionList=TrueAL_ComControl_LCAN_PNC159_DISABLE_DM
          Rule_ComControl_LCAN_PNC159_DISABLE_RX: BswMRuleInitState=BSWM_TRUE, BswMRuleExpressionRef=RuleLE_ComControl_LCAN_PNC159_DISABLE_RX, BswMRuleTrueActionList=TrueAL_ComControl_LCAN_PNC159_DISABLE_RX
          Rule_ComControl_LCAN_PNC159_DISABLE_TX: BswMRuleInitState=BSWM_TRUE, BswMRuleExpressionRef=RuleLE_ComControl_LCAN_PNC159_DISABLE_TX, BswMRuleTrueActionList=TrueAL_ComControl_LCAN_PNC159_DISABLE_TX
          Rule_ComControl_LCAN_PNC159_ENABLE_DM: BswMRuleInitState=BSWM_FALSE, BswMRuleExpressionRef=RuleLE_ComControl_LCAN_PNC159_ENABLE_DM, BswMRuleTrueActionList=TrueAL_ComControl_LCAN_PNC159_ENABLE_DM
          Rule_ComControl_LCAN_PNC159_ENABLE_RX: BswMRuleInitState=BSWM_FALSE, BswMRuleExpressionRef=RuleLE_ComControl_LCAN_PNC159_ENABLE_RX, BswMRuleTrueActionList=TrueAL_ComControl_LCAN_PNC159_ENABLE_RX
          Rule_ComControl_LCAN_PNC159_ENABLE_TX: BswMRuleInitState=BSWM_FALSE, BswMRuleExpressionRef=RuleLE_ComControl_LCAN_PNC159_ENABLE_TX, BswMRuleTrueActionList=TrueAL_ComControl_LCAN_PNC159_ENABLE_TX
          Rule_ComControl_LCAN_PNC32_DISABLE_DM: BswMRuleInitState=BSWM_FALSE, BswMRuleExpressionRef=RuleLE_ComControl_LCAN_PNC32_DISABLE_DM, BswMRuleTrueActionList=TrueAL_ComControl_LCAN_PNC32_DISABLE_DM
          Rule_ComControl_LCAN_PNC32_DISABLE_RX: BswMRuleInitState=BSWM_TRUE, BswMRuleExpressionRef=RuleLE_ComControl_LCAN_PNC32_DISABLE_RX, BswMRuleTrueActionList=TrueAL_ComControl_LCAN_PNC32_DISABLE_RX
          Rule_ComControl_LCAN_PNC32_DISABLE_TX: BswMRuleInitState=BSWM_TRUE, BswMRuleExpressionRef=RuleLE_ComControl_LCAN_PNC32_DISABLE_TX, BswMRuleTrueActionList=TrueAL_ComControl_LCAN_PNC32_DISABLE_TX
          Rule_ComControl_LCAN_PNC32_ENABLE_DM: BswMRuleInitState=BSWM_FALSE, BswMRuleExpressionRef=RuleLE_ComControl_LCAN_PNC32_ENABLE_DM, BswMRuleTrueActionList=TrueAL_ComControl_LCAN_PNC32_ENABLE_DM
          Rule_ComControl_LCAN_PNC32_ENABLE_RX: BswMRuleInitState=BSWM_FALSE, BswMRuleExpressionRef=RuleLE_ComControl_LCAN_PNC32_ENABLE_RX, BswMRuleTrueActionList=TrueAL_ComControl_LCAN_PNC32_ENABLE_RX
          Rule_ComControl_LCAN_PNC32_ENABLE_TX: BswMRuleInitState=BSWM_FALSE, BswMRuleExpressionRef=RuleLE_ComControl_LCAN_PNC32_ENABLE_TX, BswMRuleTrueActionList=TrueAL_ComControl_LCAN_PNC32_ENABLE_TX
          Rule_ComMModeNotification_PNC141_PNC_FULL_COMMUNICATION: BswMRuleInitState=BSWM_FALSE, BswMRuleExpressionRef=RuleLE_ComMModeNotification_PNC141_PNC_FULL_COMMUNICATION, BswMRuleTrueActionList=TrueAL_ComMModeNotification_PNC141_PNC_FULL_COMMUNICATION
          Rule_ComMModeNotification_PNC141_PNC_NO_COMMUNICATION: BswMRuleInitState=BSWM_FALSE, BswMRuleExpressionRef=RuleLE_ComMModeNotification_PNC141_PNC_NO_COMMUNICATION, BswMRuleTrueActionList=TrueAL_ComMModeNotification_PNC141_PNC_NO_COMMUNICATION
          Rule_ComMModeNotification_PNC141_PNC_PREPARE_SLEEP: BswMRuleInitState=BSWM_FALSE, BswMRuleExpressionRef=RuleLE_ComMModeNotification_PNC141_PNC_PREPARE_SLEEP, BswMRuleTrueActionList=TrueAL_ComMModeNotification_PNC141_PNC_PREPARE_SLEEP
          Rule_ComMModeNotification_PNC141_PNC_READY_SLEEP: BswMRuleInitState=BSWM_FALSE, BswMRuleExpressionRef=RuleLE_ComMModeNotification_PNC141_PNC_READY_SLEEP, BswMRuleTrueActionList=TrueAL_ComMModeNotification_PNC141_PNC_READY_SLEEP
          Rule_ComMModeNotification_PNC141_PNC_REQUESTED: BswMRuleInitState=BSWM_FALSE, BswMRuleExpressionRef=RuleLE_ComMModeNotification_PNC141_PNC_REQUESTED, BswMRuleTrueActionList=TrueAL_ComMModeNotification_PNC141_PNC_REQUESTED
          Rule_ComMModeNotification_PNC153_PNC_FULL_COMMUNICATION: BswMRuleInitState=BSWM_FALSE, BswMRuleExpressionRef=RuleLE_ComMModeNotification_PNC153_PNC_FULL_COMMUNICATION, BswMRuleTrueActionList=TrueAL_ComMModeNotification_PNC153_PNC_FULL_COMMUNICATION
          Rule_ComMModeNotification_PNC153_PNC_NO_COMMUNICATION: BswMRuleInitState=BSWM_FALSE, BswMRuleExpressionRef=RuleLE_ComMModeNotification_PNC153_PNC_NO_COMMUNICATION, BswMRuleTrueActionList=TrueAL_ComMModeNotification_PNC153_PNC_NO_COMMUNICATION
          Rule_ComMModeNotification_PNC153_PNC_PREPARE_SLEEP: BswMRuleInitState=BSWM_FALSE, BswMRuleExpressionRef=RuleLE_ComMModeNotification_PNC153_PNC_PREPARE_SLEEP, BswMRuleTrueActionList=TrueAL_ComMModeNotification_PNC153_PNC_PREPARE_SLEEP
          Rule_ComMModeNotification_PNC153_PNC_READY_SLEEP: BswMRuleInitState=BSWM_FALSE, BswMRuleExpressionRef=RuleLE_ComMModeNotification_PNC153_PNC_READY_SLEEP, BswMRuleTrueActionList=TrueAL_ComMModeNotification_PNC153_PNC_READY_SLEEP
          Rule_ComMModeNotification_PNC153_PNC_REQUESTED: BswMRuleInitState=BSWM_FALSE, BswMRuleExpressionRef=RuleLE_ComMModeNotification_PNC153_PNC_REQUESTED, BswMRuleTrueActionList=TrueAL_ComMModeNotification_PNC153_PNC_REQUESTED
          Rule_ComMModeNotification_PNC159_PNC_FULL_COMMUNICATION: BswMRuleInitState=BSWM_FALSE, BswMRuleExpressionRef=RuleLE_ComMModeNotification_PNC159_PNC_FULL_COMMUNICATION, BswMRuleTrueActionList=TrueAL_ComMModeNotification_PNC159_PNC_FULL_COMMUNICATION
          Rule_ComMModeNotification_PNC159_PNC_NO_COMMUNICATION: BswMRuleInitState=BSWM_FALSE, BswMRuleExpressionRef=RuleLE_ComMModeNotification_PNC159_PNC_NO_COMMUNICATION, BswMRuleTrueActionList=TrueAL_ComMModeNotification_PNC159_PNC_NO_COMMUNICATION
          Rule_ComMModeNotification_PNC159_PNC_PREPARE_SLEEP: BswMRuleInitState=BSWM_FALSE, BswMRuleExpressionRef=RuleLE_ComMModeNotification_PNC159_PNC_PREPARE_SLEEP, BswMRuleTrueActionList=TrueAL_ComMModeNotification_PNC159_PNC_PREPARE_SLEEP
          Rule_ComMModeNotification_PNC159_PNC_READY_SLEEP: BswMRuleInitState=BSWM_FALSE, BswMRuleExpressionRef=RuleLE_ComMModeNotification_PNC159_PNC_READY_SLEEP, BswMRuleTrueActionList=TrueAL_ComMModeNotification_PNC159_PNC_READY_SLEEP
          Rule_ComMModeNotification_PNC159_PNC_REQUESTED: BswMRuleInitState=BSWM_FALSE, BswMRuleExpressionRef=RuleLE_ComMModeNotification_PNC159_PNC_REQUESTED, BswMRuleTrueActionList=TrueAL_ComMModeNotification_PNC159_PNC_REQUESTED
          Rule_ComMModeNotification_PNC32_PNC_FULL_COMMUNICATION: BswMRuleInitState=BSWM_FALSE, BswMRuleExpressionRef=RuleLE_ComMModeNotification_PNC32_PNC_FULL_COMMUNICATION, BswMRuleTrueActionList=TrueAL_ComMModeNotification_PNC32_PNC_FULL_COMMUNICATION
          Rule_ComMModeNotification_PNC32_PNC_NO_COMMUNICATION: BswMRuleInitState=BSWM_FALSE, BswMRuleExpressionRef=RuleLE_ComMModeNotification_PNC32_PNC_NO_COMMUNICATION, BswMRuleTrueActionList=TrueAL_ComMModeNotification_PNC32_PNC_NO_COMMUNICATION
          Rule_ComMModeNotification_PNC32_PNC_PREPARE_SLEEP: BswMRuleInitState=BSWM_FALSE, BswMRuleExpressionRef=RuleLE_ComMModeNotification_PNC32_PNC_PREPARE_SLEEP, BswMRuleTrueActionList=TrueAL_ComMModeNotification_PNC32_PNC_PREPARE_SLEEP
          Rule_ComMModeNotification_PNC32_PNC_READY_SLEEP: BswMRuleInitState=BSWM_FALSE, BswMRuleExpressionRef=RuleLE_ComMModeNotification_PNC32_PNC_READY_SLEEP, BswMRuleTrueActionList=TrueAL_ComMModeNotification_PNC32_PNC_READY_SLEEP
          Rule_ComMModeNotification_PNC32_PNC_REQUESTED: BswMRuleInitState=BSWM_FALSE, BswMRuleExpressionRef=RuleLE_ComMModeNotification_PNC32_PNC_REQUESTED, BswMRuleTrueActionList=TrueAL_ComMModeNotification_PNC32_PNC_REQUESTED
          Rule_ComModeNotification_BCAN_FULL_COM: BswMRuleInitState=BSWM_FALSE, BswMRuleExpressionRef=RuleLE_ComModeNotification_BCAN_FULL_COM, BswMRuleTrueActionList=TrueAL_ComModeNotification_BCAN_FULL_COM
          Rule_ComModeNotification_BCAN_NO_COM: BswMRuleInitState=BSWM_FALSE, BswMRuleExpressionRef=RuleLE_ComModeNotification_BCAN_NO_COM, BswMRuleTrueActionList=TrueAL_ComModeNotification_BCAN_NO_COM
          Rule_ComModeNotification_BCAN_SILENT_COM: BswMRuleInitState=BSWM_FALSE, BswMRuleExpressionRef=RuleLE_ComModeNotification_BCAN_SILENT_COM, BswMRuleTrueActionList=TrueAL_ComModeNotification_BCAN_SILENT_COM
          Rule_ComModeNotification_LCAN_FULL_COM: BswMRuleInitState=BSWM_FALSE, BswMRuleExpressionRef=RuleLE_ComModeNotification_LCAN_FULL_COM, BswMRuleTrueActionList=TrueAL_ComModeNotification_LCAN_FULL_COM
          Rule_ComModeNotification_LCAN_NO_COM: BswMRuleInitState=BSWM_FALSE, BswMRuleExpressionRef=RuleLE_ComModeNotification_LCAN_NO_COM, BswMRuleTrueActionList=TrueAL_ComModeNotification_LCAN_NO_COM
          Rule_ComModeNotification_LCAN_SILENT_COM: BswMRuleInitState=BSWM_FALSE, BswMRuleExpressionRef=RuleLE_ComModeNotification_LCAN_SILENT_COM, BswMRuleTrueActionList=TrueAL_ComModeNotification_LCAN_SILENT_COM
          Rule_ComModeRequest_PNC141_FULL_COM: BswMRuleInitState=BSWM_FALSE, BswMRuleExpressionRef=RuleLE_ComModeRequest_PNC141_FULL_COM, BswMRuleTrueActionList=TrueAL_ComModeRequest_PNC141_FULL_COM
          Rule_ComModeRequest_PNC141_NO_COM: BswMRuleInitState=BSWM_FALSE, BswMRuleExpressionRef=RuleLE_ComModeRequest_PNC141_NO_COM, BswMRuleTrueActionList=TrueAL_ComModeRequest_PNC141_NO_COM
          Rule_ComModeRequest_PNC153_FULL_COM: BswMRuleInitState=BSWM_FALSE, BswMRuleExpressionRef=RuleLE_ComModeRequest_PNC153_FULL_COM, BswMRuleTrueActionList=TrueAL_ComModeRequest_PNC153_FULL_COM
          Rule_ComModeRequest_PNC153_NO_COM: BswMRuleInitState=BSWM_FALSE, BswMRuleExpressionRef=RuleLE_ComModeRequest_PNC153_NO_COM, BswMRuleTrueActionList=TrueAL_ComModeRequest_PNC153_NO_COM
          Rule_ComModeRequest_PNC159_FULL_COM: BswMRuleInitState=BSWM_FALSE, BswMRuleExpressionRef=RuleLE_ComModeRequest_PNC159_FULL_COM, BswMRuleTrueActionList=TrueAL_ComModeRequest_PNC159_FULL_COM
          Rule_ComModeRequest_PNC159_NO_COM: BswMRuleInitState=BSWM_FALSE, BswMRuleExpressionRef=RuleLE_ComModeRequest_PNC159_NO_COM, BswMRuleTrueActionList=TrueAL_ComModeRequest_PNC159_NO_COM
          Rule_ComModeRequest_PNC32_FULL_COM: BswMRuleInitState=BSWM_FALSE, BswMRuleExpressionRef=RuleLE_ComModeRequest_PNC32_FULL_COM, BswMRuleTrueActionList=TrueAL_ComModeRequest_PNC32_FULL_COM
          Rule_ComModeRequest_PNC32_NO_COM: BswMRuleInitState=BSWM_FALSE, BswMRuleExpressionRef=RuleLE_ComModeRequest_PNC32_NO_COM, BswMRuleTrueActionList=TrueAL_ComModeRequest_PNC32_NO_COM
          Rule_DcmApplicationUpdatedNotification_APP_NOT_UPDATED: BswMRuleInitState=BSWM_FALSE, BswMRuleExpressionRef=RuleLE_DcmApplicationUpdatedNotification_APP_NOT_UPDATED, BswMRuleTrueActionList=TrueAL_DcmApplicationUpdatedNotification_APP_NOT_UPDATED
          Rule_DcmApplicationUpdatedNotification_APP_UPDATED: BswMRuleInitState=BSWM_FALSE, BswMRuleExpressionRef=RuleLE_DcmApplicationUpdatedNotification_APP_UPDATED, BswMRuleTrueActionList=TrueAL_DcmApplicationUpdatedNotification_APP_UPDATED
          Rule_DcmCommunicationControl_0_DCM_DISABLE_RX_DISABLE_TX_NM: BswMRuleInitState=BSWM_FALSE, BswMRuleExpressionRef=RuleLE_DcmCommunicationControl_0_DCM_DISABLE_RX_DISABLE_TX_NM, BswMRuleTrueActionList=TrueAL_DcmCommunicationControl_0_DCM_DISABLE_RX_DISABLE_TX_NM
          Rule_DcmCommunicationControl_0_DCM_DISABLE_RX_ENABLE_TX_NORM: BswMRuleInitState=BSWM_FALSE, BswMRuleExpressionRef=RuleLE_DcmCommunicationControl_0_DCM_DISABLE_RX_ENABLE_TX_NORM, BswMRuleTrueActionList=TrueAL_DcmCommunicationControl_0_DCM_DISABLE_RX_ENABLE_TX_NORM
          Rule_DcmCommunicationControl_0_DCM_DISABLE_RX_ENABLE_TX_NORM_NM: BswMRuleInitState=BSWM_FALSE, BswMRuleExpressionRef=RuleLE_DcmCommunicationControl_0_DCM_DISABLE_RX_ENABLE_TX_NORM_NM, BswMRuleTrueActionList=TrueAL_DcmCommunicationControl_0_DCM_DISABLE_RX_ENABLE_TX_NORM_NM
          Rule_DcmCommunicationControl_0_DCM_DISABLE_RX_TX_NM: BswMRuleInitState=BSWM_FALSE, BswMRuleExpressionRef=RuleLE_DcmCommunicationControl_0_DCM_DISABLE_RX_TX_NM, BswMRuleTrueActionList=TrueAL_DcmCommunicationControl_0_DCM_DISABLE_RX_TX_NM
          Rule_DcmCommunicationControl_0_DCM_DISABLE_RX_TX_NORMAL: BswMRuleInitState=BSWM_FALSE, BswMRuleExpressionRef=RuleLE_DcmCommunicationControl_0_DCM_DISABLE_RX_TX_NORMAL, BswMRuleTrueActionList=TrueAL_DcmCommunicationControl_0_DCM_DISABLE_RX_TX_NORMAL
          Rule_DcmCommunicationControl_0_DCM_DISABLE_RX_TX_NORM_NM: BswMRuleInitState=BSWM_FALSE, BswMRuleExpressionRef=RuleLE_DcmCommunicationControl_0_DCM_DISABLE_RX_TX_NORM_NM, BswMRuleTrueActionList=TrueAL_DcmCommunicationControl_0_DCM_DISABLE_RX_TX_NORM_NM
          Rule_DcmCommunicationControl_0_DCM_ENABLE_RX_DISABLE_TX_NM: BswMRuleInitState=BSWM_FALSE, BswMRuleExpressionRef=RuleLE_DcmCommunicationControl_0_DCM_ENABLE_RX_DISABLE_TX_NM, BswMRuleTrueActionList=TrueAL_DcmCommunicationControl_0_DCM_ENABLE_RX_DISABLE_TX_NM
          Rule_DcmCommunicationControl_0_DCM_ENABLE_RX_DISABLE_TX_NORM: BswMRuleInitState=BSWM_FALSE, BswMRuleExpressionRef=RuleLE_DcmCommunicationControl_0_DCM_ENABLE_RX_DISABLE_TX_NORM, BswMRuleTrueActionList=TrueAL_DcmCommunicationControl_0_DCM_ENABLE_RX_DISABLE_TX_NORM
          Rule_DcmCommunicationControl_0_DCM_ENABLE_RX_DISABLE_TX_NORM_NM: BswMRuleInitState=BSWM_FALSE, BswMRuleExpressionRef=RuleLE_DcmCommunicationControl_0_DCM_ENABLE_RX_DISABLE_TX_NORM_NM, BswMRuleTrueActionList=TrueAL_DcmCommunicationControl_0_DCM_ENABLE_RX_DISABLE_TX_NORM_NM
          Rule_DcmCommunicationControl_0_DCM_ENABLE_RX_TX_NM: BswMRuleInitState=BSWM_FALSE, BswMRuleExpressionRef=RuleLE_DcmCommunicationControl_0_DCM_ENABLE_RX_TX_NM, BswMRuleTrueActionList=TrueAL_DcmCommunicationControl_0_DCM_ENABLE_RX_TX_NM
          Rule_DcmCommunicationControl_0_DCM_ENABLE_RX_TX_NORM: BswMRuleInitState=BSWM_FALSE, BswMRuleExpressionRef=RuleLE_DcmCommunicationControl_0_DCM_ENABLE_RX_TX_NORM, BswMRuleTrueActionList=TrueAL_DcmCommunicationControl_0_DCM_ENABLE_RX_TX_NORM
          Rule_DcmCommunicationControl_0_DCM_ENABLE_RX_TX_NORM_NM: BswMRuleInitState=BSWM_FALSE, BswMRuleExpressionRef=RuleLE_DcmCommunicationControl_0_DCM_ENABLE_RX_TX_NORM_NM, BswMRuleTrueActionList=TrueAL_DcmCommunicationControl_0_DCM_ENABLE_RX_TX_NORM_NM
          Rule_DcmControlDTCSetting_DISABLEDTCSETTING: BswMRuleInitState=BSWM_FALSE, BswMRuleExpressionRef=RuleLE_DcmControlDTCSetting_DISABLEDTCSETTING, BswMRuleTrueActionList=TrueAL_DcmControlDTCSetting_DISABLEDTCSETTING
          Rule_DcmControlDTCSetting_ENABLEDTCSETTING: BswMRuleInitState=BSWM_FALSE, BswMRuleExpressionRef=RuleLE_DcmControlDTCSetting_ENABLEDTCSETTING, BswMRuleTrueActionList=TrueAL_DcmControlDTCSetting_ENABLEDTCSETTING
          Rule_DcmEcuReset_HARD: BswMRuleInitState=BSWM_FALSE, BswMRuleExpressionRef=RuleLE_DcmEcuReset_HARD, BswMRuleTrueActionList=TrueAL_DcmEcuReset_HARD
          Rule_DcmEcuReset_SOFT: BswMRuleInitState=BSWM_FALSE, BswMRuleExpressionRef=RuleLE_DcmEcuReset_SOFT, BswMRuleTrueActionList=TrueAL_DcmEcuReset_SOFT
          Rule_DcmModeRapidPowerShutDown_DISABLE_RAPIDPOWERSHUTDOWN: BswMRuleInitState=BSWM_FALSE, BswMRuleExpressionRef=RuleLE_DcmModeRapidPowerShutDown_DISABLE_RAPIDPOWERSHUTDOWN, BswMRuleTrueActionList=TrueAL_DcmModeRapidPowerShutDown_DISABLE_RAPIDPOWERSHUTDOWN
          Rule_DcmModeRapidPowerShutDown_ENABLE_RAPIDPOWERSHUTDOWN: BswMRuleInitState=BSWM_FALSE, BswMRuleExpressionRef=RuleLE_DcmModeRapidPowerShutDown_ENABLE_RAPIDPOWERSHUTDOWN, BswMRuleTrueActionList=TrueAL_DcmModeRapidPowerShutDown_ENABLE_RAPIDPOWERSHUTDOWN
          Rule_DiagnosticSessionNotification_DEFAULT_SESSION: BswMRuleInitState=BSWM_FALSE, BswMRuleExpressionRef=RuleLE_DiagnosticSessionNotification_DEFAULT_SESSION, BswMRuleTrueActionList=TrueAL_DiagnosticSessionNotification_DEFAULT_SESSION
          Rule_DiagnosticSessionNotification_ECU_PROGRAMMING_MODE: BswMRuleInitState=BSWM_FALSE, BswMRuleExpressionRef=RuleLE_DiagnosticSessionNotification_ECU_PROGRAMMING_MODE, BswMRuleTrueActionList=TrueAL_DiagnosticSessionNotification_ECU_PROGRAMMING_MODE
          Rule_DiagnosticSessionNotification_EXTENDED_DIAGNOSTIC_MODE: BswMRuleInitState=BSWM_FALSE, BswMRuleExpressionRef=RuleLE_DiagnosticSessionNotification_EXTENDED_DIAGNOSTIC_MODE, BswMRuleTrueActionList=TrueAL_DiagnosticSessionNotification_EXTENDED_DIAGNOSTIC_MODE
          Rule_DiagnosticSessionNotification_EXTENDED_DIAGNOSTIC_SESSION: BswMRuleInitState=BSWM_FALSE, BswMRuleExpressionRef=RuleLE_DiagnosticSessionNotification_EXTENDED_DIAGNOSTIC_SESSION, BswMRuleTrueActionList=TrueAL_DiagnosticSessionNotification_EXTENDED_DIAGNOSTIC_SESSION
          Rule_DiagnosticSessionNotification_PROGRAMMING_SESSION: BswMRuleInitState=BSWM_FALSE, BswMRuleExpressionRef=RuleLE_DiagnosticSessionNotification_PROGRAMMING_SESSION, BswMRuleTrueActionList=TrueAL_DiagnosticSessionNotification_PROGRAMMING_SESSION
          Rule_DiagnosticSessionNotification_QUIESCENT_CURRENT_DIAGNOSTIC_MODE_START: BswMRuleInitState=BSWM_FALSE, BswMRuleExpressionRef=RuleLE_DiagnosticSessionNotification_QUIESCENT_CURRENT_DIAGNOSTIC_MODE_START, BswMRuleTrueActionList=TrueAL_DiagnosticSessionNotification_QUIESCENT_CURRENT_DIAGNOSTIC_MODE_START
          Rule_DiagnosticSessionNotification_SAFETY_SYSTEM_DIAGNOSTIC_SESSION: BswMRuleInitState=BSWM_FALSE, BswMRuleExpressionRef=RuleLE_DiagnosticSessionNotification_SAFETY_SYSTEM_DIAGNOSTIC_SESSION, BswMRuleTrueActionList=TrueAL_DiagnosticSessionNotification_SAFETY_SYSTEM_DIAGNOSTIC_SESSION
          Rule_DiagnosticSessionNotification_SLEEP_MODE_START_REQUEST: BswMRuleInitState=BSWM_FALSE, BswMRuleExpressionRef=RuleLE_DiagnosticSessionNotification_SLEEP_MODE_START_REQUEST, BswMRuleTrueActionList=TrueAL_DiagnosticSessionNotification_SLEEP_MODE_START_REQUEST
          Rule_EcuStateTo_OFF: BswMRuleInitState=BSWM_FALSE, BswMRuleExpressionRef=RuleLE_EcuStateTo_OFF, BswMRuleTrueActionList=TrueAL_EcuStateTo_OFF
          Rule_EcuStateTo_RESET: BswMRuleInitState=BSWM_FALSE, BswMRuleExpressionRef=RuleLE_EcuStateTo_RESET, BswMRuleTrueActionList=TrueAL_EcuStateTo_RESET
          Rule_EcuStateTo_RUN_From_SLEEP: BswMRuleInitState=BSWM_FALSE, BswMRuleExpressionRef=RuleLE_EcuStateTo_RUN_From_SLEEP, BswMRuleTrueActionList=TrueAL_EcuStateTo_RUN_From_SLEEP
          Rule_EcuStateTo_RUN_From_STARTUP: BswMRuleInitState=BSWM_FALSE, BswMRuleExpressionRef=RuleLE_EcuStateTo_RUN_From_STARTUP, BswMRuleTrueActionList=TrueAL_EcuStateTo_RUN_From_STARTUP
          Rule_EcuStateTo_SHUTDOWN: BswMRuleInitState=BSWM_FALSE, BswMRuleExpressionRef=RuleLE_EcuStateTo_SHUTDOWN, BswMRuleTrueActionList=TrueAL_EcuStateTo_SHUTDOWN
          Rule_EcuStateTo_SLEEP: BswMRuleInitState=BSWM_FALSE, BswMRuleExpressionRef=RuleLE_EcuStateTo_SLEEP, BswMRuleTrueActionList=TrueAL_EcuStateTo_SLEEP
          Rule_EcuStateTo_STARTUP_THREE: BswMRuleInitState=BSWM_FALSE, BswMRuleExpressionRef=RuleLE_EcuStateTo_STARTUP_THREE, BswMRuleTrueActionList=TrueAL_EcuStateTo_STARTUP_THREE
          Rule_EcuStateTo_STARTUP_TWO: BswMRuleInitState=BSWM_FALSE, BswMRuleExpressionRef=RuleLE_EcuStateTo_STARTUP_TWO, BswMRuleTrueActionList=TrueAL_EcuStateTo_STARTUP_TWO
          Rule_EcuState_OFF: BswMRuleInitState=BSWM_FALSE, BswMRuleExpressionRef=RuleLE_EcuState_OFF, BswMRuleTrueActionList=TrueAL_EcuState_OFF
          Rule_EcuState_RESET: BswMRuleInitState=BSWM_FALSE, BswMRuleExpressionRef=RuleLE_EcuState_RESET, BswMRuleTrueActionList=TrueAL_EcuState_RESET
          Rule_EcuState_RUN: BswMRuleInitState=BSWM_FALSE, BswMRuleExpressionRef=RuleLE_EcuState_RUN, BswMRuleTrueActionList=TrueAL_EcuState_RUN
          Rule_EcuState_SHUTDOWN: BswMRuleInitState=BSWM_FALSE, BswMRuleExpressionRef=RuleLE_EcuState_SHUTDOWN, BswMRuleTrueActionList=TrueAL_EcuState_SHUTDOWN
          Rule_EcuState_SLEEP: BswMRuleInitState=BSWM_FALSE, BswMRuleExpressionRef=RuleLE_EcuState_SLEEP, BswMRuleTrueActionList=TrueAL_EcuState_SLEEP
          Rule_EcuState_STARTUP_THREE: BswMRuleInitState=BSWM_FALSE, BswMRuleExpressionRef=RuleLE_EcuState_STARTUP_THREE, BswMRuleTrueActionList=TrueAL_EcuState_STARTUP_THREE
          Rule_EcuState_STARTUP_TWO: BswMRuleInitState=BSWM_FALSE, BswMRuleExpressionRef=RuleLE_EcuState_STARTUP_TWO, BswMRuleTrueActionList=TrueAL_EcuState_STARTUP_TWO
          Rule_ShutdownTargetTo_OFF: BswMRuleInitState=BSWM_FALSE, BswMRuleExpressionRef=RuleLE_ShutdownTargetTo_OFF, BswMRuleTrueActionList=TrueAL_ShutdownTargetTo_OFF
          Rule_ShutdownTargetTo_RESET: BswMRuleInitState=BSWM_FALSE, BswMRuleExpressionRef=RuleLE_ShutdownTargetTo_RESET, BswMRuleTrueActionList=TrueAL_ShutdownTargetTo_RESET
          Rule_ShutdownTargetTo_RUN: BswMRuleInitState=BSWM_FALSE, BswMRuleExpressionRef=RuleLE_ShutdownTargetTo_RUN, BswMRuleTrueActionList=TrueAL_ShutdownTargetTo_RUN
          Rule_ShutdownTargetTo_SLEEP: BswMRuleInitState=BSWM_FALSE, BswMRuleExpressionRef=RuleLE_ShutdownTargetTo_SLEEP, BswMRuleTrueActionList=TrueAL_ShutdownTargetTo_SLEEP
          Rule_WakeupEventNotification_BCAN_RX: BswMRuleInitState=BSWM_FALSE, BswMRuleExpressionRef=RuleLE_WakeupEventNotification_BCAN_RX, BswMRuleTrueActionList=TrueAL_WakeupEventNotification_BCAN_RX
          Rule_WakeupEventNotification_BCAN_RX_POLL: BswMRuleInitState=BSWM_FALSE, BswMRuleExpressionRef=RuleLE_WakeupEventNotification_BCAN_RX_POLL, BswMRuleTrueActionList=TrueAL_WakeupEventNotification_BCAN_RX_POLL
          Rule_WakeupEventNotification_IGN1: BswMRuleInitState=BSWM_FALSE, BswMRuleExpressionRef=RuleLE_WakeupEventNotification_IGN1, BswMRuleTrueActionList=TrueAL_WakeupEventNotification_IGN1
          Rule_WakeupEventNotification_LCAN_RX: BswMRuleInitState=BSWM_FALSE, BswMRuleExpressionRef=RuleLE_WakeupEventNotification_LCAN_RX, BswMRuleTrueActionList=TrueAL_WakeupEventNotification_LCAN_RX
          Rule_WakeupEventNotification_LCAN_RX_POLL: BswMRuleInitState=BSWM_FALSE, BswMRuleExpressionRef=RuleLE_WakeupEventNotification_LCAN_RX_POLL, BswMRuleTrueActionList=TrueAL_WakeupEventNotification_LCAN_RX_POLL
