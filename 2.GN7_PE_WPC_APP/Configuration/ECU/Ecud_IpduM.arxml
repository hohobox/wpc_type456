AUTOSAR XML (schema 4-1-2)
package /AUTOSAR
  module config IpduM: module-description=BswImplementation_IpduM
    IpduMGeneral: IpduMConfigurationTimeBase=0.005, IpduMStaticPartExists=0, IpduMVersionInfoApi=0, IpduMDevErrorDetect=1, IpduMEnableModule=0
    IpduMPublishedInformation: IpduMRxDirectComInvocation=0
    IpduMConfig
