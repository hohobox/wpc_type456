[part 1 of 2: package /AUTOSAR]
AUTOSAR XML (schema 4-0-3)
package /AUTOSAR
  module config Rte: implementation-config-variant=VARIANT-PRE-COMPILE
    CommonPublishedInformation0 (CommonPublishedInformation): ArReleaseVersion=4.0.3, ModuleId=2, SwVersion=4.11.1, VendorId=76
    RteBswGeneral0 (RteBswGeneral): RteSchMVersionInfoApi=0, RteUseComShadowSignalApi=1
    RteGeneration0 (RteGeneration):
      RteCalibrationSupport = INITIALIZED_RAM
      RteDevErrorDetectUninit = 0
      RteGenerationMode = COMPATIBILITY_MODE
      RteMeasurementSupport = 0
      RteOptimizationMode = RUNTIME
      RteToolChainSignificantCharacters = 100
      RteValueRangeCheckEnabled = 0
      RteVfbTraceEnabled = 0
      RteIocInteractionReturnValue = RTE_IOC
      RteDevErrorDetect = 0
    RteInitializationBehavior0 (RteInitializationBehavior): RteSectionInitializationPolicy=INIT
    RtePostBuildVariantConfiguration
    RteOsInteraction0 (RteOsInteraction): SynchronizedActivateOffset=1, RteSynchronizedOsCounterRef=OsCounter_0
      4 x RteUsedOsActivation, all with AlarmSetMethodIsRelative=1:
        RteUsedOsActivation_BSW_5ms_Com: RteExpectedActivationOffset=0.0025, RteExpectedActivationPosition=1, RteActivationOsAlarmRef=OsAlarm_BSW_5ms_Com
        RteUsedOsActivation_BSW_10ms: RteExpectedActivationOffset=0.005, RteExpectedActivationPosition=2, RteActivationOsAlarmRef=OsAlarm_BSW_10ms
        RteUsedOsActivation_ASW_10ms: RteExpectedActivationOffset=0.00375, RteExpectedActivationPosition=3, RteActivationOsAlarmRef=OsAlarm_ASW_10ms
        RteUsedOsActivation_ASW_100ms: RteExpectedActivationOffset=0.01875, RteExpectedActivationPosition=5, RteActivationOsAlarmRef=OsAlarm_ASW_100ms
    37 x RteBswModuleInstance, all with category=TOOL_CONFIGURED:
      BswInstance_RamTst: RteBswImplementationRef=BswImplementation_RamTst, RteBswModuleConfigurationRef=RamTst
        RAM_PROTECTION (RteBswExclusiveAreaImpl): category=TOOL_CONFIGURED, RteExclusiveAreaImplMechanism=ALL_INTERRUPT_BLOCKING, RteBswExclusiveAreaRef=RAM_PROTECTION
        PATTERN_CHECK_PROTECT (RteBswExclusiveAreaImpl): category=TOOL_CONFIGURED, RteExclusiveAreaImplMechanism=ALL_INTERRUPT_BLOCKING, RteBswExclusiveAreaRef=PATTERN_CHECK_PROTECT
      BswInstance_Mcu: RteBswImplementationRef=McuImplementation, RteBswModuleConfigurationRef=Mcu
        MCU_EXCLUSIVE_AREA_0 (RteBswExclusiveAreaImpl): category=TOOL_CONFIGURED, RteExclusiveAreaImplMechanism=ALL_INTERRUPT_BLOCKING, RteBswExclusiveAreaRef=MCU_EXCLUSIVE_AREA_0
      BswInstance_Wdg: RteBswImplementationRef=WdgImplementation, RteBswModuleConfigurationRef=Wdg
        WDG_EXCLUSIVE_AREA_0 (RteBswExclusiveAreaImpl): category=TOOL_CONFIGURED, RteExclusiveAreaImplMechanism=ALL_INTERRUPT_BLOCKING, RteBswExclusiveAreaRef=WDG_EXCLUSIVE_AREA_0
      BswInstance_CtrlRam: RteBswImplementationRef=BswImplementation_CtrlRam, RteBswModuleConfigurationRef=CtrlRam
        3 x RteBswExclusiveAreaImpl, all with category=TOOL_CONFIGURED, RteExclusiveAreaImplMechanism=ALL_INTERRUPT_BLOCKING:
          WRITE_PROTECTION: RteBswExclusiveAreaRef=WRITE_PROTECTION
          SECURITY_CHECK_PROTECTION: RteBswExclusiveAreaRef=SECURITY_CHECK_PROTECTION
          STRUCT_WRITE_PROTECTION: RteBswExclusiveAreaRef=STRUCT_WRITE_PROTECTION
        BswTimingEvent_CtrlRam (RteBswEventToTaskMapping):
          category = TOOL_CONFIGURED
          RteBswImmediateRestart = 0
          RteBswPositionInTask = 3
          RteBswMappedToTaskRef = OsTask_BSW_FG1_100ms
          RteBswUsedOsAlarmRef = OsAlarm_BSW_100ms
          RteBswEventRef = BswTimingEvent_CtrlRam
        CtrlRam_EM_R (RteBswRequiredModeGroupConnection):
          category = TOOL_CONFIGURED
          RteBswProvidedModeGroupRef = modeSwitchPort_EcuMode
          RteBswRequiredModeGroupRef = CtrlRam_EM_R
          RteBswProvidedModeGrpModInstRef = BswInstance_BswM
      BswInstance_EcuM: RteBswImplementationRef=BswImplementation_EcuM, RteBswModuleConfigurationRef=EcuM
        7 x RteBswExclusiveAreaImpl, all with category=TOOL_CONFIGURED, RteExclusiveAreaImplMechanism=ALL_INTERRUPT_BLOCKING:
          ALARM_TIME_PROTECTION: RteBswExclusiveAreaRef=ALARM_TIME_PROTECTION
          BOOT_TARGET_PROTECTION: RteBswExclusiveAreaRef=BOOT_TARGET_PROTECTION
          SHUTDOWN_CAUSE: RteBswExclusiveAreaRef=SHUTDOWN_CAUSE
          SHUTDOWN_OR_SLEEP_FLAG_PROTECTION: RteBswExclusiveAreaRef=SHUTDOWN_OR_SLEEP_FLAG_PROTECTION
          SHUTDOWN_TARGET_PROTECTION: RteBswExclusiveAreaRef=SHUTDOWN_TARGET_PROTECTION
          STATE_PROTECTION: RteBswExclusiveAreaRef=STATE_PROTECTION
          WAKEUP_STATUS_PROTECTION: RteBswExclusiveAreaRef=WAKEUP_STATUS_PROTECTION
        BswTE_EcuM_MainFunction (RteBswEventToTaskMapping):
          category = TOOL_CONFIGURED
          RteBswImmediateRestart = 0
          RteBswPositionInTask = 2
          RteBswMappedToTaskRef = OsTask_BSW_FG1_10ms
          RteBswUsedOsAlarmRef = OsAlarm_BSW_10ms
          RteBswEventRef = BswTE_EcuM_MainFunction
      BswInstance_Det: RteBswImplementationRef=BswImplementation_Det, RteBswModuleConfigurationRef=Det
        RAM_DATA_PROTECTION (RteBswExclusiveAreaImpl): category=TOOL_CONFIGURED, RteExclusiveAreaImplMechanism=ALL_INTERRUPT_BLOCKING, RteBswExclusiveAreaRef=RAM_DATA_PROTECTION
      BswInstance_Fee: RteBswImplementationRef=FeeImplementation, RteBswModuleConfigurationRef=Fee
        FEE_EXCLUSIVE_AREA_0 (RteBswExclusiveAreaImpl): category=TOOL_CONFIGURED, RteExclusiveAreaImplMechanism=ALL_INTERRUPT_BLOCKING, RteBswExclusiveAreaRef=FEE_EXCLUSIVE_AREA_0
      BswInstance_Nm: RteBswImplementationRef=BswImplementation_Nm, RteBswModuleConfigurationRef=Nm
        UPDATE_NETWORK_STATUS_NW0 (RteBswExclusiveAreaImpl): category=TOOL_CONFIGURED, RteExclusiveAreaImplMechanism=ALL_INTERRUPT_BLOCKING, RteBswExclusiveAreaRef=UPDATE_NETWORK_STATUS_NW0
        UPDATE_NETWORK_STATUS_NW1 (RteBswExclusiveAreaImpl): category=TOOL_CONFIGURED, RteExclusiveAreaImplMechanism=ALL_INTERRUPT_BLOCKING, RteBswExclusiveAreaRef=UPDATE_NETWORK_STATUS_NW1
      BswInstance_CanTp: RteBswImplementationRef=BswImplementation_CanTp, RteBswModuleConfigurationRef=CanTp
        TIMER_PROTECTION (RteBswExclusiveAreaImpl): category=TOOL_CONFIGURED, RteExclusiveAreaImplMechanism=ALL_INTERRUPT_BLOCKING, RteBswExclusiveAreaRef=TIMER_PROTECTION
        BswTE_CanTp_MainFunction (RteBswEventToTaskMapping):
          category = TOOL_CONFIGURED
          RteBswImmediateRestart = 0
          RteBswPositionInTask = 55
          RteBswMappedToTaskRef = OsTask_BSW_FG1_5ms_Com
          RteBswUsedOsAlarmRef = OsAlarm_BSW_5ms_Com
          RteBswEventRef = BswTE_CanTp_MainFunction
      BswInstance_ComM: RteBswImplementationRef=BswImplementation_ComM, RteBswModuleConfigurationRef=ComM
        8 x RteBswExclusiveAreaImpl, all with category=TOOL_CONFIGURED, RteExclusiveAreaImplMechanism=ALL_INTERRUPT_BLOCKING:
          INHIBIT_CNT_PROTECTION: RteBswExclusiveAreaRef=INHIBIT_CNT_PROTECTION
          REQ_MODECNT_PROTECTION: RteBswExclusiveAreaRef=REQ_MODECNT_PROTECTION
          CURRENT_MODE_PROTECTION: RteBswExclusiveAreaRef=CURRENT_MODE_PROTECTION
          DCM_DIAGNOSTIC_PROTECTION: RteBswExclusiveAreaRef=DCM_DIAGNOSTIC_PROTECTION
          ECUM_WAKEUP_IND: RteBswExclusiveAreaRef=ECUM_WAKEUP_IND
          NM_INDICATION_PROTECTION: RteBswExclusiveAreaRef=NM_INDICATION_PROTECTION
          PNC_PREPARE_TIMER: RteBswExclusiveAreaRef=PNC_PREPARE_TIMER
          PNC_WAKEUP_IND: RteBswExclusiveAreaRef=PNC_WAKEUP_IND
        BswTE_ComM_MainFunction0 (RteBswEventToTaskMapping):
          category = TOOL_CONFIGURED
          RteBswImmediateRestart = 0
          RteBswPositionInTask = 1
          RteBswMappedToTaskRef = OsTask_BSW_FG1_5ms_Com
          RteBswUsedOsAlarmRef = OsAlarm_BSW_5ms_Com
          RteBswEventRef = BswTE_ComM_MainFunction0
        BswTE_ComM_MainFunction1 (RteBswEventToTaskMapping):
          category = TOOL_CONFIGURED
          RteBswImmediateRestart = 0
          RteBswPositionInTask = 2
          RteBswMappedToTaskRef = OsTask_BSW_FG1_5ms_Com
          RteBswUsedOsAlarmRef = OsAlarm_BSW_5ms_Com
          RteBswEventRef = BswTE_ComM_MainFunction1
      BswInstance_Com: RteBswImplementationRef=BswImplementation_Com, RteBswModuleConfigurationRef=Com
        21 x RteBswExclusiveAreaImpl, all with category=TOOL_CONFIGURED, RteExclusiveAreaImplMechanism=ALL_INTERRUPT_BLOCKING:
          RX_DM_STS_PROTECTION_AREA: RteBswExclusiveAreaRef=RX_DM_STS_PROTECTION_AREA
          RX_IPDU_STS_PROTECTION_AREA: RteBswExclusiveAreaRef=RX_IPDU_STS_PROTECTION_AREA
          TX_IPDU_STATUS_PROTECTION_AREA: RteBswExclusiveAreaRef=TX_IPDU_STATUS_PROTECTION_AREA
          TX_IPDU_DATA_PROTECTION: RteBswExclusiveAreaRef=TX_IPDU_DATA_PROTECTION
          TX_MDT_PROTECTION_AREA: RteBswExclusiveAreaRef=TX_MDT_PROTECTION_AREA
          RX_IPDU_STATUS_PROTECTION_AREA: RteBswExclusiveAreaRef=RX_IPDU_STATUS_PROTECTION_AREA
          RX_GW_STS_PROTECTION_AREA: RteBswExclusiveAreaRef=RX_GW_STS_PROTECTION_AREA
          SIG_DATA_PROTECTION_AREA: RteBswExclusiveAreaRef=SIG_DATA_PROTECTION_AREA
          RX_SIG_DATA_PROTECTION_AREA: RteBswExclusiveAreaRef=RX_SIG_DATA_PROTECTION_AREA
          RX_IPDU_DATA_PROTECTION_AREA: RteBswExclusiveAreaRef=RX_IPDU_DATA_PROTECTION_AREA
          IPDU_GRP_STS_PROTECTION: RteBswExclusiveAreaRef=IPDU_GRP_STS_PROTECTION
          IPDU_STS_PROTECTION: RteBswExclusiveAreaRef=IPDU_STS_PROTECTION
          RX_EXT_SIG_DATA_PROTECTION_AREA: RteBswExclusiveAreaRef=RX_EXT_SIG_DATA_PROTECTION_AREA
          TX_EXT_SIG_DATA_PROTECTION_AREA: RteBswExclusiveAreaRef=TX_EXT_SIG_DATA_PROTECTION_AREA
          TX_IPDU_BUFFER_PROTECTION_AREA: RteBswExclusiveAreaRef=TX_IPDU_BUFFER_PROTECTION_AREA
          RX_FIFO_PROTECTION_AREA: RteBswExclusiveAreaRef=RX_FIFO_PROTECTION_AREA
          IPDU_GROUP_STATUS_PROTECTION: RteBswExclusiveAreaRef=IPDU_GROUP_STATUS_PROTECTION
          IPDU_COUNTER_PROTECTION: RteBswExclusiveAreaRef=IPDU_COUNTER_PROTECTION
          TX_TMS_STATUS_PROTECTION_AREA: RteBswExclusiveAreaRef=TX_TMS_STATUS_PROTECTION_AREA
          TX_MDT_STS_PROTECTION_AREA: RteBswExclusiveAreaRef=TX_MDT_STS_PROTECTION_AREA
          TX_DM_STS_PROTECTION_AREA: RteBswExclusiveAreaRef=TX_DM_STS_PROTECTION_AREA
        3 x RteBswEventToTaskMapping, all with category=TOOL_CONFIGURED, RteBswImmediateRestart=0, RteBswMappedToTaskRef=OsTask_BSW_FG1_5ms_Com, RteBswUsedOsAlarmRef=OsAlarm_BSW_5ms_Com:
          BswTE_Com_MainFunctionRx: RteBswPositionInTask=35, RteBswEventRef=BswTE_Com_MainFunctionRx
          BswTE_Com_MainFunctionRouteSignals: RteBswPositionInTask=36, RteBswEventRef=BswTE_Com_MainFunctionRouteSignals
          BswTE_Com_MainFunctionTx: RteBswPositionInTask=37, RteBswEventRef=BswTE_Com_MainFunctionTx
      BswInstance_Ocu: RteBswImplementationRef=OcuImplementation, RteBswModuleConfigurationRef=Ocu
        OCU_EXCLUSIVE_AREA_0 (RteBswExclusiveAreaImpl): category=TOOL_CONFIGURED, RteExclusiveAreaImplMechanism=ALL_INTERRUPT_BLOCKING, RteBswExclusiveAreaRef=OCU_EXCLUSIVE_AREA_0
      BswInstance_BswM: RteBswImplementationRef=BswImplementation_BswM, RteBswModuleConfigurationRef=BswM
        3 x RteBswExclusiveAreaImpl, all with category=TOOL_CONFIGURED, RteExclusiveAreaImplMechanism=ALL_INTERRUPT_BLOCKING:
          DATA_PROTECTION: RteBswExclusiveAreaRef=DATA_PROTECTION
          RULEPREVRESULT_PROTECTION: RteBswExclusiveAreaRef=RULEPREVRESULT_PROTECTION
          RULESTATUS_PROTECTION: RteBswExclusiveAreaRef=RULESTATUS_PROTECTION
        32 x RteBswEventToTaskMapping, all with category=TOOL_CONFIGURED, RteBswImmediateRestart=0:
          BMSE_Entry_BswM_Immediate_DcmCommunicationControl_0_modeNotificationPort_DcmCommunicationControl_0_DCM_DISABLE_RX_DISABLE_TX_NM: RteBswPositionInTask=0, RteBswEventRef=BMSE_Entry_BswM_Immediate_DcmCommunicationControl_0_modeNotificationPort_DcmCommunicationControl_0_DCM_DISABLE_RX_DISABLE_TX_NM
          BMSE_Entry_BswM_Immediate_DcmCommunicationControl_0_modeNotificationPort_DcmCommunicationControl_0_DCM_DISABLE_RX_ENABLE_TX_NORM: RteBswPositionInTask=0, RteBswEventRef=BMSE_Entry_BswM_Immediate_DcmCommunicationControl_0_modeNotificationPort_DcmCommunicationControl_0_DCM_DISABLE_RX_ENABLE_TX_NORM
          BMSE_Entry_BswM_Immediate_DcmCommunicationControl_0_modeNotificationPort_DcmCommunicationControl_0_DCM_DISABLE_RX_ENABLE_TX_NORM_NM: RteBswPositionInTask=0, RteBswEventRef=BMSE_Entry_BswM_Immediate_DcmCommunicationControl_0_modeNotificationPort_DcmCommunicationControl_0_DCM_DISABLE_RX_ENABLE_TX_NORM_NM
          BMSE_Entry_BswM_Immediate_DcmCommunicationControl_0_modeNotificationPort_DcmCommunicationControl_0_DCM_DISABLE_RX_TX_NM: RteBswPositionInTask=0, RteBswEventRef=BMSE_Entry_BswM_Immediate_DcmCommunicationControl_0_modeNotificationPort_DcmCommunicationControl_0_DCM_DISABLE_RX_TX_NM
          BMSE_Entry_BswM_Immediate_DcmCommunicationControl_0_modeNotificationPort_DcmCommunicationControl_0_DCM_DISABLE_RX_TX_NORMAL: RteBswPositionInTask=0, RteBswEventRef=BMSE_Entry_BswM_Immediate_DcmCommunicationControl_0_modeNotificationPort_DcmCommunicationControl_0_DCM_DISABLE_RX_TX_NORMAL
          BMSE_Entry_BswM_Immediate_DcmCommunicationControl_0_modeNotificationPort_DcmCommunicationControl_0_DCM_DISABLE_RX_TX_NORM_NM: RteBswPositionInTask=0, RteBswEventRef=BMSE_Entry_BswM_Immediate_DcmCommunicationControl_0_modeNotificationPort_DcmCommunicationControl_0_DCM_DISABLE_RX_TX_NORM_NM
          BMSE_Entry_BswM_Immediate_DcmCommunicationControl_0_modeNotificationPort_DcmCommunicationControl_0_DCM_ENABLE_RX_DISABLE_TX_NM: RteBswPositionInTask=0, RteBswEventRef=BMSE_Entry_BswM_Immediate_DcmCommunicationControl_0_modeNotificationPort_DcmCommunicationControl_0_DCM_ENABLE_RX_DISABLE_TX_NM
          BMSE_Entry_BswM_Immediate_DcmCommunicationControl_0_modeNotificationPort_DcmCommunicationControl_0_DCM_ENABLE_RX_DISABLE_TX_NORM: RteBswPositionInTask=0, RteBswEventRef=BMSE_Entry_BswM_Immediate_DcmCommunicationControl_0_modeNotificationPort_DcmCommunicationControl_0_DCM_ENABLE_RX_DISABLE_TX_NORM
          BMSE_Entry_BswM_Immediate_DcmCommunicationControl_0_modeNotificationPort_DcmCommunicationControl_0_DCM_ENABLE_RX_DISABLE_TX_NORM_NM: RteBswPositionInTask=0, RteBswEventRef=BMSE_Entry_BswM_Immediate_DcmCommunicationControl_0_modeNotificationPort_DcmCommunicationControl_0_DCM_ENABLE_RX_DISABLE_TX_NORM_NM
          BMSE_Entry_BswM_Immediate_DcmCommunicationControl_0_modeNotificationPort_DcmCommunicationControl_0_DCM_ENABLE_RX_TX_NM: RteBswPositionInTask=0, RteBswEventRef=BMSE_Entry_BswM_Immediate_DcmCommunicationControl_0_modeNotificationPort_DcmCommunicationControl_0_DCM_ENABLE_RX_TX_NM
          BMSE_Entry_BswM_Immediate_DcmCommunicationControl_0_modeNotificationPort_DcmCommunicationControl_0_DCM_ENABLE_RX_TX_NORM: RteBswPositionInTask=0, RteBswEventRef=BMSE_Entry_BswM_Immediate_DcmCommunicationControl_0_modeNotificationPort_DcmCommunicationControl_0_DCM_ENABLE_RX_TX_NORM
          BMSE_Entry_BswM_Immediate_DcmCommunicationControl_0_modeNotificationPort_DcmCommunicationControl_0_DCM_ENABLE_RX_TX_NORM_NM: RteBswPositionInTask=0, RteBswEventRef=BMSE_Entry_BswM_Immediate_DcmCommunicationControl_0_modeNotificationPort_DcmCommunicationControl_0_DCM_ENABLE_RX_TX_NORM_NM
          BMSE_Entry_BswM_Immediate_DcmControlDTCSetting_modeNotificationPort_DcmControlDTCSetting_DISABLEDTCSETTING: RteBswPositionInTask=1, RteBswEventRef=BMSE_Entry_BswM_Immediate_DcmControlDTCSetting_modeNotificationPort_DcmControlDTCSetting_DISABLEDTCSETTING
          BMSE_Entry_BswM_Immediate_DcmControlDTCSetting_modeNotificationPort_DcmControlDTCSetting_ENABLEDTCSETTING: RteBswPositionInTask=2, RteBswEventRef=BMSE_Entry_BswM_Immediate_DcmControlDTCSetting_modeNotificationPort_DcmControlDTCSetting_ENABLEDTCSETTING
          BMSE_Entry_BswM_Immediate_DcmDiagnosticSessionControl_modeNotificationPort_DcmDiagnosticSessionControl_DCM_DEFAULT_SESSION: RteBswPositionInTask=3, RteBswEventRef=BMSE_Entry_BswM_Immediate_DcmDiagnosticSessionControl_modeNotificationPort_DcmDiagnosticSessionControl_DCM_DEFAULT_SESSION
          BMSE_Entry_BswM_Immediate_DcmDiagnosticSessionControl_modeNotificationPort_DcmDiagnosticSessionControl_DCM_ECU_PROGRAMMING_MODE: RteBswPositionInTask=4, RteBswEventRef=BMSE_Entry_BswM_Immediate_DcmDiagnosticSessionControl_modeNotificationPort_DcmDiagnosticSessionControl_DCM_ECU_PROGRAMMING_MODE
          BMSE_Entry_BswM_Immediate_DcmDiagnosticSessionControl_modeNotificationPort_DcmDiagnosticSessionControl_DCM_EXTENDED_DIAGNOSTIC_MODE: RteBswPositionInTask=5, RteBswEventRef=BMSE_Entry_BswM_Immediate_DcmDiagnosticSessionControl_modeNotificationPort_DcmDiagnosticSessionControl_DCM_EXTENDED_DIAGNOSTIC_MODE
          BMSE_Entry_BswM_Immediate_DcmDiagnosticSessionControl_modeNotificationPort_DcmDiagnosticSessionControl_DCM_EXTENDED_DIAGNOSTIC_SESSION: RteBswPositionInTask=6, RteBswEventRef=BMSE_Entry_BswM_Immediate_DcmDiagnosticSessionControl_modeNotificationPort_DcmDiagnosticSessionControl_DCM_EXTENDED_DIAGNOSTIC_SESSION
          BMSE_Entry_BswM_Immediate_DcmDiagnosticSessionControl_modeNotificationPort_DcmDiagnosticSessionControl_DCM_PROGRAMMING_SESSION: RteBswPositionInTask=7, RteBswEventRef=BMSE_Entry_BswM_Immediate_DcmDiagnosticSessionControl_modeNotificationPort_DcmDiagnosticSessionControl_DCM_PROGRAMMING_SESSION
          BMSE_Entry_BswM_Immediate_DcmDiagnosticSessionControl_modeNotificationPort_DcmDiagnosticSessionControl_DCM_QUIESCENT_CURRENT_DIAGNOSTIC_MODE_START: RteBswPositionInTask=8, RteBswEventRef=BMSE_Entry_BswM_Immediate_DcmDiagnosticSessionControl_modeNotificationPort_DcmDiagnosticSessionControl_DCM_QUIESCENT_CURRENT_DIAGNOSTIC_MODE_START
          BMSE_Entry_BswM_Immediate_DcmDiagnosticSessionControl_modeNotificationPort_DcmDiagnosticSessionControl_DCM_SAFETY_SYSTEM_DIAGNOSTIC_SESSION: RteBswPositionInTask=9, RteBswEventRef=BMSE_Entry_BswM_Immediate_DcmDiagnosticSessionControl_modeNotificationPort_DcmDiagnosticSessionControl_DCM_SAFETY_SYSTEM_DIAGNOSTIC_SESSION
          BMSE_Entry_BswM_Immediate_DcmDiagnosticSessionControl_modeNotificationPort_DcmDiagnosticSessionControl_DCM_SLEEP_MODE_START_REQUEST: RteBswPositionInTask=10, RteBswEventRef=BMSE_Entry_BswM_Immediate_DcmDiagnosticSessionControl_modeNotificationPort_DcmDiagnosticSessionControl_DCM_SLEEP_MODE_START_REQUEST
          BMSE_Entry_BswM_Immediate_DcmEcuReset_modeNotificationPort_DcmEcuReset_EXECUTE: RteBswPositionInTask=11, RteBswEventRef=BMSE_Entry_BswM_Immediate_DcmEcuReset_modeNotificationPort_DcmEcuReset_EXECUTE
          BMSE_Entry_BswM_Immediate_DcmEcuReset_modeNotificationPort_DcmEcuReset_HARD: RteBswPositionInTask=12, RteBswEventRef=BMSE_Entry_BswM_Immediate_DcmEcuReset_modeNotificationPort_DcmEcuReset_HARD
          BMSE_Entry_BswM_Immediate_DcmEcuReset_modeNotificationPort_DcmEcuReset_JUMPTOBOOTLOADER: RteBswPositionInTask=13, RteBswEventRef=BMSE_Entry_BswM_Immediate_DcmEcuReset_modeNotificationPort_DcmEcuReset_JUMPTOBOOTLOADER
          BMSE_Entry_BswM_Immediate_DcmEcuReset_modeNotificationPort_DcmEcuReset_JUMPTOSYSSUPPLIERBOOTLOADER: RteBswPositionInTask=14, RteBswEventRef=BMSE_Entry_BswM_Immediate_DcmEcuReset_modeNotificationPort_DcmEcuReset_JUMPTOSYSSUPPLIERBOOTLOADER
          BMSE_Entry_BswM_Immediate_DcmEcuReset_modeNotificationPort_DcmEcuReset_KEYONOFF: RteBswPositionInTask=15, RteBswEventRef=BMSE_Entry_BswM_Immediate_DcmEcuReset_modeNotificationPort_DcmEcuReset_KEYONOFF
          BMSE_Entry_BswM_Immediate_DcmEcuReset_modeNotificationPort_DcmEcuReset_NONE: RteBswPositionInTask=16, RteBswEventRef=BMSE_Entry_BswM_Immediate_DcmEcuReset_modeNotificationPort_DcmEcuReset_NONE
          BMSE_Entry_BswM_Immediate_DcmEcuReset_modeNotificationPort_DcmEcuReset_SOFT: RteBswPositionInTask=17, RteBswEventRef=BMSE_Entry_BswM_Immediate_DcmEcuReset_modeNotificationPort_DcmEcuReset_SOFT
          BMSE_Entry_BswM_Immediate_DcmModeRapidPowerShutDown_modeNotificationPort_DcmModeRapidPowerShutDown_DISABLE_RAPIDPOWERSHUTDOWN: RteBswPositionInTask=18, RteBswEventRef=BMSE_Entry_BswM_Immediate_DcmModeRapidPowerShutDown_modeNotificationPort_DcmModeRapidPowerShutDown_DISABLE_RAPIDPOWERSHUTDOWN
          BMSE_Entry_BswM_Immediate_DcmModeRapidPowerShutDown_modeNotificationPort_DcmModeRapidPowerShutDown_ENABLE_RAPIDPOWERSHUTDOWN: RteBswPositionInTask=19, RteBswEventRef=BMSE_Entry_BswM_Immediate_DcmModeRapidPowerShutDown_modeNotificationPort_DcmModeRapidPowerShutDown_ENABLE_RAPIDPOWERSHUTDOWN
          BswTE_BswM_MainFunction: RteBswPositionInTask=4, RteBswMappedToTaskRef=OsTask_BSW_FG1_10ms, RteBswUsedOsAlarmRef=OsAlarm_BSW_10ms, RteBswEventRef=BswTE_BswM_MainFunction
        5 x RteBswRequiredModeGroupConnection, all with category=TOOL_CONFIGURED, RteBswProvidedModeGrpModInstRef=BswInstance_Dcm:
          modeNotificationPort_DcmCommunicationControl_0: RteBswProvidedModeGroupRef=DcmCommunicationControl_0, RteBswRequiredModeGroupRef=modeNotificationPort_DcmCommunicationControl_0
          modeNotificationPort_DcmControlDTCSetting: RteBswProvidedModeGroupRef=DcmControlDTCSetting, RteBswRequiredModeGroupRef=modeNotificationPort_DcmControlDTCSetting
          modeNotificationPort_DcmDiagnosticSessionControl: RteBswProvidedModeGroupRef=DcmDiagnosticSessionControl, RteBswRequiredModeGroupRef=modeNotificationPort_DcmDiagnosticSessionControl
          modeNotificationPort_DcmEcuReset: RteBswProvidedModeGroupRef=DcmEcuReset, RteBswRequiredModeGroupRef=modeNotificationPort_DcmEcuReset
          modeNotificationPort_DcmModeRapidPowerShutDown: RteBswProvidedModeGroupRef=DcmModeRapidPowerShutDown, RteBswRequiredModeGroupRef=modeNotificationPort_DcmModeRapidPowerShutDown
      BswInstance_IoHwAb: RteBswImplementationRef=BswImplementation_IoHwAb, RteBswModuleConfigurationRef=IoHwAb
        IoHwAbProtection (RteBswExclusiveAreaImpl): category=TOOL_CONFIGURED, RteExclusiveAreaImplMechanism=ALL_INTERRUPT_BLOCKING, RteBswExclusiveAreaRef=IoHwAbProtection
        BswTE_IoHwAb_IOM_10ms (RteBswEventToTaskMapping):
          category = TOOL_CONFIGURED
          RteBswImmediateRestart = 0
          RteBswPositionInTask = 0
          RteBswMappedToTaskRef = OsTask_BSW_FG1_10ms
          RteBswUsedOsAlarmRef = OsAlarm_BSW_10ms
          RteBswEventRef = BswTE_IoHwAb_IOM_10ms
        BswTE_IoHwAb_IOM_5ms (RteBswEventToTaskMapping):
          category = TOOL_CONFIGURED
          RteBswImmediateRestart = 0
          RteBswPositionInTask = 0
          RteBswMappedToTaskRef = OsTask_BSW_FG1_5ms_Com
          RteBswUsedOsAlarmRef = OsAlarm_BSW_5ms_Com
          RteBswEventRef = BswTE_IoHwAb_IOM_5ms
      BswInstance_Crc: RteBswImplementationRef=BswImplementation_Crc, RteBswModuleConfigurationRef=Crc
        CriticalSection (RteBswExclusiveAreaImpl): category=TOOL_CONFIGURED, RteExclusiveAreaImplMechanism=ALL_INTERRUPT_BLOCKING, RteBswExclusiveAreaRef=CriticalSection
      BswInstance_Spi: RteBswImplementationRef=SpiImplementation, RteBswModuleConfigurationRef=Spi
        SPI_EXCLUSIVE_AREA_0 (RteBswExclusiveAreaImpl): category=TOOL_CONFIGURED, RteExclusiveAreaImplMechanism=ALL_INTERRUPT_BLOCKING, RteBswExclusiveAreaRef=SPI_EXCLUSIVE_AREA_0
      BswInstance_WdgM: RteBswImplementationRef=BswImplementation_WdgM, RteBswModuleConfigurationRef=WdgM
        GLOBALSUPVSNSTATUS_PROTECTION (RteBswExclusiveAreaImpl): category=TOOL_CONFIGURED, RteExclusiveAreaImplMechanism=ALL_INTERRUPT_BLOCKING, RteBswExclusiveAreaRef=GLOBALSUPVSNSTATUS_PROTECTION
        BswTE_WdgM_MainFunction (RteBswEventToTaskMapping):
          category = TOOL_CONFIGURED
          RteBswImmediateRestart = 0
          RteBswPositionInTask = 1
          RteBswMappedToTaskRef = OsTask_BSW_FG1_10ms
          RteBswUsedOsAlarmRef = OsAlarm_BSW_10ms
          RteBswEventRef = BswTE_WdgM_MainFunction
        modeNotificationPort_EcuMode (RteBswRequiredModeGroupConnection):
          category = TOOL_CONFIGURED
          RteBswProvidedModeGroupRef = modeSwitchPort_EcuMode
          RteBswRequiredModeGroupRef = modeNotificationPort_EcuMode
          RteBswProvidedModeGrpModInstRef = BswInstance_BswM
      BswInstance_Icu: RteBswImplementationRef=IcuImplementation, RteBswModuleConfigurationRef=Icu
        ICU_EXCLUSIVE_AREA_0 (RteBswExclusiveAreaImpl): category=TOOL_CONFIGURED, RteExclusiveAreaImplMechanism=ALL_INTERRUPT_BLOCKING, RteBswExclusiveAreaRef=ICU_EXCLUSIVE_AREA_0
      BswInstance_RomTst: RteBswImplementationRef=BswImplementation_RomTst, RteBswModuleConfigurationRef=RomTst
        BITP_RomTst (RteBswInternalTriggerConfig): category=TOOL_CONFIGURED, RteBswTriggerSourceQueueLength=1, RteBswTriggerSourceRef=BITP_RomTst
        BITOE_RomTst (RteBswEventToTaskMapping): category=TOOL_CONFIGURED, RteBswImmediateRestart=0, RteBswPositionInTask=10, RteBswMappedToTaskRef=OsTask_BSW_RomTst, RteBswEventRef=BITOE_RomTst
      BswInstance_Port: RteBswImplementationRef=PortImplementation, RteBswModuleConfigurationRef=Port
        PORT_EXCLUSIVE_AREA_0 (RteBswExclusiveAreaImpl): category=TOOL_CONFIGURED, RteExclusiveAreaImplMechanism=ALL_INTERRUPT_BLOCKING, RteBswExclusiveAreaRef=PORT_EXCLUSIVE_AREA_0
      BswInstance_Fls: RteBswImplementationRef=FlsImplementation, RteBswModuleConfigurationRef=Fls
        FLS_EXCLUSIVE_AREA_0 (RteBswExclusiveAreaImpl): category=TOOL_CONFIGURED, RteExclusiveAreaImplMechanism=ALL_INTERRUPT_BLOCKING, RteBswExclusiveAreaRef=FLS_EXCLUSIVE_AREA_0
      BswInstance_CanNm: RteBswImplementationRef=BswImplementation_CanNm, RteBswModuleConfigurationRef=CanNm
        3 x RteBswExclusiveAreaImpl, all with category=TOOL_CONFIGURED, RteExclusiveAreaImplMechanism=ALL_INTERRUPT_BLOCKING:
          INTERNAL_STATUS: RteBswExclusiveAreaRef=INTERNAL_STATUS
          RX_USER_DATA: RteBswExclusiveAreaRef=RX_USER_DATA
          TX_USER_DATA: RteBswExclusiveAreaRef=TX_USER_DATA
        BswTE_CanNm_MainFunction (RteBswEventToTaskMapping):
          category = TOOL_CONFIGURED
          RteBswImmediateRestart = 0
          RteBswPositionInTask = 7
          RteBswMappedToTaskRef = OsTask_BSW_FG1_10ms
          RteBswUsedOsAlarmRef = OsAlarm_BSW_10ms
          RteBswEventRef = BswTE_CanNm_MainFunction
      BswInstance_Pwm: RteBswImplementationRef=PwmImplementation, RteBswModuleConfigurationRef=Pwm
        PWM_EXCLUSIVE_AREA_0 (RteBswExclusiveAreaImpl): category=TOOL_CONFIGURED, RteExclusiveAreaImplMechanism=ALL_INTERRUPT_BLOCKING, RteBswExclusiveAreaRef=PWM_EXCLUSIVE_AREA_0
      BswInstance_CanTrcv: RteBswImplementationRef=BswImplementation_CanTrcv, RteBswModuleConfigurationRef=CanTrcv
        INTERRUPT_PROTECTION_AREA (RteBswExclusiveAreaImpl): category=TOOL_CONFIGURED, RteExclusiveAreaImplMechanism=ALL_INTERRUPT_BLOCKING, RteBswExclusiveAreaRef=INTERRUPT_PROTECTION_AREA
      BswInstance_CanSM: RteBswImplementationRef=BswImplementation_CanSM, RteBswModuleConfigurationRef=CanSM
        MODE_STATUS_PROTECTION (RteBswExclusiveAreaImpl): category=TOOL_CONFIGURED, RteExclusiveAreaImplMechanism=ALL_INTERRUPT_BLOCKING, RteBswExclusiveAreaRef=MODE_STATUS_PROTECTION
        BUSOFF_STATUS_PROTECTION (RteBswExclusiveAreaImpl): category=TOOL_CONFIGURED, RteExclusiveAreaImplMechanism=ALL_INTERRUPT_BLOCKING, RteBswExclusiveAreaRef=BUSOFF_STATUS_PROTECTION
        BswTE_CanSM_MainFunction (RteBswEventToTaskMapping):
          category = TOOL_CONFIGURED
          RteBswImmediateRestart = 0
          RteBswPositionInTask = 40
          RteBswMappedToTaskRef = OsTask_BSW_FG1_5ms_Com
          RteBswUsedOsAlarmRef = OsAlarm_BSW_5ms_Com
          RteBswEventRef = BswTE_CanSM_MainFunction
      BswInstance_Dcm: RteBswImplementationRef=BswImplementation_Dcm, RteBswModuleConfigurationRef=Dcm
        6 x RteBswExclusiveAreaImpl, all with category=TOOL_CONFIGURED, RteExclusiveAreaImplMechanism=ALL_INTERRUPT_BLOCKING:
          SIGNAL_DATA_PROTECTION_AREA: RteBswExclusiveAreaRef=SIGNAL_DATA_PROTECTION_AREA
          ProtclProtection: RteBswExclusiveAreaRef=ProtclProtection
          RxPduIdProtection: RteBswExclusiveAreaRef=RxPduIdProtection
          RxLengthProtection: RteBswExclusiveAreaRef=RxLengthProtection
          TimerProtection: RteBswExclusiveAreaRef=TimerProtection
          DATA_UPDATE: RteBswExclusiveAreaRef=DATA_UPDATE
        BswTE_Dcm_MainFunction (RteBswEventToTaskMapping):
          category = TOOL_CONFIGURED
          RteBswImmediateRestart = 0
          RteBswPositionInTask = 50
          RteBswMappedToTaskRef = OsTask_BSW_FG1_10ms
          RteBswUsedOsAlarmRef = OsAlarm_BSW_10ms
          RteBswEventRef = BswTE_Dcm_MainFunction
        Dcm_EM_R (RteBswRequiredModeGroupConnection): RteBswProvidedModeGroupRef=modeSwitchPort_EcuMode, RteBswRequiredModeGroupRef=Dcm_EM_R, RteBswProvidedModeGrpModInstRef=BswInstance_BswM
      BswInstance_NvM: RteBswImplementationRef=BswImplementation_NvM, RteBswModuleConfigurationRef=NvM
        RAM_INDEX (RteBswExclusiveAreaImpl): category=TOOL_CONFIGURED, RteExclusiveAreaImplMechanism=ALL_INTERRUPT_BLOCKING, RteBswExclusiveAreaRef=RAM_INDEX
        RAM_STATUS_PROTECTION (RteBswExclusiveAreaImpl): category=TOOL_CONFIGURED, RteExclusiveAreaImplMechanism=ALL_INTERRUPT_BLOCKING, RteBswExclusiveAreaRef=RAM_STATUS_PROTECTION
      BswInstance_Dem: RteBswImplementationRef=BswImplementation_Dem, RteBswModuleConfigurationRef=Dem
        10 x RteBswExclusiveAreaImpl, all with category=TOOL_CONFIGURED, RteExclusiveAreaImplMechanism=ALL_INTERRUPT_BLOCKING:
          REQUEST_BUFFER_PROTECTION: RteBswExclusiveAreaRef=REQUEST_BUFFER_PROTECTION
          REQUEST_RECORD_PROTECTION: RteBswExclusiveAreaRef=REQUEST_RECORD_PROTECTION
          REQUEST_STATUS_PROTECTION: RteBswExclusiveAreaRef=REQUEST_STATUS_PROTECTION
          REQUEST_OCC_PROTECTION: RteBswExclusiveAreaRef=REQUEST_OCC_PROTECTION
          REQUEST_OCCTIME_PROTECTION: RteBswExclusiveAreaRef=REQUEST_OCCTIME_PROTECTION
          REQUEST_NVDATA_PROTECTION: RteBswExclusiveAreaRef=REQUEST_NVDATA_PROTECTION
          CAPTURE_OBD_DATA: RteBswExclusiveAreaRef=CAPTURE_OBD_DATA
          REQUEST_DATA_PROTECTION: RteBswExclusiveAreaRef=REQUEST_DATA_PROTECTION
          REQUEST_DEBOUNCETIMEBASED: RteBswExclusiveAreaRef=REQUEST_DEBOUNCETIMEBASED
          REQUEST_BEFOREOS_PROTECTION: RteBswExclusiveAreaRef=REQUEST_BEFOREOS_PROTECTION
        BswTE_Dem_MainFunction (RteBswEventToTaskMapping):
          category = TOOL_CONFIGURED
          RteBswImmediateRestart = 0
          RteBswPositionInTask = 5
          RteBswMappedToTaskRef = OsTask_BSW_FG1_10ms
          RteBswUsedOsAlarmRef = OsAlarm_BSW_10ms
          RteBswEventRef = BswTE_Dem_MainFunction
      BswInstance_CanCM: RteBswImplementationRef=BswImplementation_CanCM, RteBswModuleConfigurationRef=CanCM
        MAIN_PROTECTION (RteBswExclusiveAreaImpl): category=TOOL_CONFIGURED, RteExclusiveAreaImplMechanism=ALL_INTERRUPT_BLOCKING, RteBswExclusiveAreaRef=MAIN_PROTECTION
        BswTE_CanCM_MainFunction (RteBswEventToTaskMapping):
          category = TOOL_CONFIGURED
          RteBswImmediateRestart = 0
          RteBswPositionInTask = 21
          RteBswMappedToTaskRef = OsTask_BSW_FG1_5ms_Com
          RteBswUsedOsAlarmRef = OsAlarm_BSW_5ms_Com
          RteBswEventRef = BswTE_CanCM_MainFunction
        CanCM_EM_R (RteBswRequiredModeGroupConnection):
          category = TOOL_CONFIGURED
          RteBswProvidedModeGroupRef = modeSwitchPort_EcuMode
          RteBswRequiredModeGroupRef = CanCM_EM_R
          RteBswProvidedModeGrpModInstRef = BswInstance_BswM
      BswInstance_Dio: RteBswImplementationRef=DioImplementation, RteBswModuleConfigurationRef=Dio
        DIO_EXCLUSIVE_AREA_0 (RteBswExclusiveAreaImpl): category=TOOL_CONFIGURED, RteExclusiveAreaImplMechanism=ALL_INTERRUPT_BLOCKING, RteBswExclusiveAreaRef=DIO_EXCLUSIVE_AREA_0
      BswInstance_Can: RteBswImplementationRef=CanImplementation, RteBswModuleConfigurationRef=Can
        CAN_EXCLUSIVE_AREA_0 (RteBswExclusiveAreaImpl): category=TOOL_CONFIGURED, RteExclusiveAreaImplMechanism=ALL_INTERRUPT_BLOCKING, RteBswExclusiveAreaRef=CAN_EXCLUSIVE_AREA_0
      BswInstance_IpduM: RteBswImplementationRef=BswImplementation_IpduM, RteBswModuleConfigurationRef=IpduM
        3 x RteBswExclusiveAreaImpl, all with category=TOOL_CONFIGURED, RteExclusiveAreaImplMechanism=ALL_INTERRUPT_BLOCKING:
          DEST_DATA_PROTECTION_AREA: RteBswExclusiveAreaRef=DEST_DATA_PROTECTION_AREA
          TX_STATUS_PROTECTION_AREA: RteBswExclusiveAreaRef=TX_STATUS_PROTECTION_AREA
          TX_CONFIRMATION_PROTECTION_AREA: RteBswExclusiveAreaRef=TX_CONFIRMATION_PROTECTION_AREA
        BswTE_IpduM_MainFunction (RteBswEventToTaskMapping):
          category = TOOL_CONFIGURED
          RteBswImmediateRestart = 0
          RteBswPositionInTask = 80
          RteBswMappedToTaskRef = OsTask_BSW_FG1_5ms_Com
          RteBswUsedOsAlarmRef = OsAlarm_BSW_5ms_Com
          RteBswEventRef = BswTE_IpduM_MainFunction
      BswInstance_Wdg_76_Acw: RteBswImplementationRef=BswImplementation_Wdg_76_Acw, RteBswModuleConfigurationRef=Wdg_76_Acw
        WDG_EXCLUSIVE_AREA (RteBswExclusiveAreaImpl): category=TOOL_CONFIGURED, RteExclusiveAreaImplMechanism=ALL_INTERRUPT_BLOCKING, RteBswExclusiveAreaRef=WDG_EXCLUSIVE_AREA
      BswInstance_CanIf: RteBswImplementationRef=BswImplementation_CanIf, RteBswModuleConfigurationRef=CanIf
        7 x RteBswExclusiveAreaImpl, all with category=TOOL_CONFIGURED, RteExclusiveAreaImplMechanism=ALL_INTERRUPT_BLOCKING:
          MODE_STATUS_PROTECTION: RteBswExclusiveAreaRef=MODE_STATUS_PROTECTION
          TX_QUEUE_PROTECTION: RteBswExclusiveAreaRef=TX_QUEUE_PROTECTION
          ExclusiveArea_0: RteBswExclusiveAreaRef=ExclusiveArea_0
          RX_NOTIFSTATUS_PROTECTION: RteBswExclusiveAreaRef=RX_NOTIFSTATUS_PROTECTION
          RX_DATA_PROTECTION: RteBswExclusiveAreaRef=RX_DATA_PROTECTION
          TX_DYNCANID_PROTECTION: RteBswExclusiveAreaRef=TX_DYNCANID_PROTECTION
          TX_NOTIFSTATUS_PROTECTION: RteBswExclusiveAreaRef=TX_NOTIFSTATUS_PROTECTION
      BswInstance_PduR: RteBswImplementationRef=BswImplementation_PduR, RteBswModuleConfigurationRef=PduR
        6 x RteBswExclusiveAreaImpl, all with category=TOOL_CONFIGURED, RteExclusiveAreaImplMechanism=ALL_INTERRUPT_BLOCKING:
          TP_TX_PROTECTION_AREA: RteBswExclusiveAreaRef=TP_TX_PROTECTION_AREA
          GROUP_STATUS_PROTECTION_AREA: RteBswExclusiveAreaRef=GROUP_STATUS_PROTECTION_AREA
          FIFO_STATUS_PROTECTION_AREA: RteBswExclusiveAreaRef=FIFO_STATUS_PROTECTION_AREA
          DATA_BUFFER_PROTECTION_AREA: RteBswExclusiveAreaRef=DATA_BUFFER_PROTECTION_AREA
          MULTICAST_PROTECTION_AREA: RteBswExclusiveAreaRef=MULTICAST_PROTECTION_AREA
          TP_GATEWAY_PROTECTION_AREA: RteBswExclusiveAreaRef=TP_GATEWAY_PROTECTION_AREA
      BswInstance_Gpt: RteBswImplementationRef=GptImplementation, RteBswModuleConfigurationRef=Gpt
        GPT_EXCLUSIVE_AREA_0 (RteBswExclusiveAreaImpl): category=TOOL_CONFIGURED, RteExclusiveAreaImplMechanism=ALL_INTERRUPT_BLOCKING, RteBswExclusiveAreaRef=GPT_EXCLUSIVE_AREA_0
      BswInstance_Adc: RteBswImplementationRef=AdcImplementation, RteBswModuleConfigurationRef=Adc
        ADC_EXCLUSIVE_AREA_0 (RteBswExclusiveAreaImpl): category=TOOL_CONFIGURED, RteExclusiveAreaImplMechanism=ALL_INTERRUPT_BLOCKING, RteBswExclusiveAreaRef=ADC_EXCLUSIVE_AREA_0
    SwcInstance_SWC_WdgMTest (RteSwComponentInstance): category=TOOL_CONFIGURED, RteSoftwareComponentInstanceRef=SWC_WdgMTest
      5 x RteEventToTaskMapping, all with category=TOOL_CONFIGURED, RteImmediateRestart=0:
        RteEventToTaskMapping_TE_WdgMTest: RtePositionInTask=0, RteMappedToTaskRef=OsTask_ASW_FG1_10ms, RteUsedOsAlarmRef=OsAlarm_ASW_10ms, RteEventRef=TE_WdgMTest
        RteEventToTaskMapping_SwcModeSwitchEvent_globalMode_OK: RtePositionInTask=0, RteMappedToTaskRef=OsTask_ASW_FG2_WdgMTestMode, RteEventRef=SwcModeSwitchEvent_globalMode_OK
        RteEventToTaskMapping_SwcModeSwitchEvent_globalMode_FAILED: RtePositionInTask=1, RteMappedToTaskRef=OsTask_ASW_FG2_WdgMTestMode, RteEventRef=SwcModeSwitchEvent_globalMode_FAILED
        RteEventToTaskMapping_SwcModeSwitchEvent_globalMode_EXPIRED: RtePositionInTask=2, RteMappedToTaskRef=OsTask_ASW_FG2_WdgMTestMode, RteEventRef=SwcModeSwitchEvent_globalMode_EXPIRED
        RteEventToTaskMapping_SwcModeSwitchEvent_globalMode_STOPPED: RtePositionInTask=3, RteMappedToTaskRef=OsTask_ASW_FG2_WdgMTestMode, RteEventRef=SwcModeSwitchEvent_globalMode_STOPPED
    RteSwComponentType_SWC_WdgMTest (RteSwComponentType): RteComponentTypeRef=SWC_WdgMTest
      RteComponentTypeCalibration: category=TOOL_CONFIGURED, RteCalibrationSupportEnabled=0
    SwcInstance_CanTp (RteSwComponentInstance): category=TOOL_CONFIGURED, RteSoftwareComponentInstanceRef=CanTp
      RteEventToTaskMapping_OIE_ChangeParameter (RteEventToTaskMapping): category=TOOL_CONFIGURED, RteImmediateRestart=0, RteEventRef=OIE_ChangeParameter
      RteEventToTaskMapping_OIE_ReadParameter (RteEventToTaskMapping): category=TOOL_CONFIGURED, RteImmediateRestart=0, RteEventRef=OIE_ReadParameter
    RteSwComponentType_CanTp (RteSwComponentType): RteComponentTypeRef=CanTp
      RteComponentTypeCalibration: category=TOOL_CONFIGURED, RteCalibrationSupportEnabled=0
    SwcInstance_Os_Master (RteSwComponentInstance): category=TOOL_CONFIGURED, RteSoftwareComponentInstanceRef=Os_Master
      RteEventToTaskMapping_Os_TE_100ms_Master (RteEventToTaskMapping):
        category = TOOL_CONFIGURED
        RteImmediateRestart = 0
        RtePositionInTask = 3
        RteMappedToTaskRef = OsTask_ASW_FG1_100ms
        RteUsedOsAlarmRef = OsAlarm_ASW_100ms
        RteEventRef = Os_TE_100ms_Master
    SwcInstance_CDD_Router_SwComponentType (RteSwComponentInstance): category=TOOL_CONFIGURED, RteSoftwareComponentInstanceRef=CDD_Router_SwComponentType
    RteSwComponentType_CDD_Router_SwComponentType (RteSwComponentType): RteComponentTypeRef=CDD_Router_SwComponentType
      RteComponentTypeCalibration: category=TOOL_CONFIGURED, RteCalibrationSupportEnabled=0
    SwcInstance_BswM (RteSwComponentInstance): category=TOOL_CONFIGURED, RteSoftwareComponentInstanceRef=BswM
      4 x RteEventToTaskMapping, all with category=TOOL_CONFIGURED, RteImmediateRestart=0, RteMappedToTaskRef=OsTask_BSW_ComMModeRequest:
        RteEventToTaskMapping_DRE_BswM_Immediate_SwcModeRequest_ComMMode_PNC141_modeRequestPort_ComMMode_PNC141_ComMMode_PNC141: RtePositionInTask=1, RteEventRef=DRE_BswM_Immediate_SwcModeRequest_ComMMode_PNC141_modeRequestPort_ComMMode_PNC141_ComMMode_PNC141
        RteEventToTaskMapping_DRE_BswM_Immediate_SwcModeRequest_ComMMode_PNC153_modeRequestPort_ComMMode_PNC153_ComMMode_PNC153: RtePositionInTask=2, RteEventRef=DRE_BswM_Immediate_SwcModeRequest_ComMMode_PNC153_modeRequestPort_ComMMode_PNC153_ComMMode_PNC153
        RteEventToTaskMapping_DRE_BswM_Immediate_SwcModeRequest_ComMMode_PNC159_modeRequestPort_ComMMode_PNC159_ComMMode_PNC159: RtePositionInTask=3, RteEventRef=DRE_BswM_Immediate_SwcModeRequest_ComMMode_PNC159_modeRequestPort_ComMMode_PNC159_ComMMode_PNC159
        RteEventToTaskMapping_DRE_BswM_Immediate_SwcModeRequest_ComMMode_PNC32_modeRequestPort_ComMMode_PNC32_ComMMode_PNC32: RtePositionInTask=4, RteEventRef=DRE_BswM_Immediate_SwcModeRequest_ComMMode_PNC32_modeRequestPort_ComMMode_PNC32_ComMMode_PNC32
    RteSwComponentType_BswM (RteSwComponentType): RteComponentTypeRef=BswM
      RteComponentTypeCalibration: category=TOOL_CONFIGURED, RteCalibrationSupportEnabled=0
    SwcInstance_ComM (RteSwComponentInstance): category=TOOL_CONFIGURED, RteSoftwareComponentInstanceRef=ComM
      39 x RteEventToTaskMapping, all with category=TOOL_CONFIGURED, RteImmediateRestart=0:
        RteEventToTaskMapping_OIE_GetStatus_ML: RteEventRef=OIE_GetStatus_ML
        RteEventToTaskMapping_OIE_LimitECUToNoComMode_ML: RteEventRef=OIE_LimitECUToNoComMode_ML
        RteEventToTaskMapping_OIE_ReadInhibitCounter_ML: RteEventRef=OIE_ReadInhibitCounter_ML
        RteEventToTaskMapping_OIE_ResetInhibitCounter_ML: RteEventRef=OIE_ResetInhibitCounter_ML
        RteEventToTaskMapping_OIE_SetECUGroupClassification_ML: RteEventRef=OIE_SetECUGroupClassification_ML
        RteEventToTaskMapping_OIE_LimitChannelToNoComMode_CL000: RteEventRef=OIE_LimitChannelToNoComMode_CL000
        RteEventToTaskMapping_OIE_PreventWakeUp_CL000: RteEventRef=OIE_PreventWakeUp_CL000
        RteEventToTaskMapping_OIE_GetState_CL000: RteEventRef=OIE_GetState_CL000
        RteEventToTaskMapping_OIE_GetInhibitionStatus_CL000: RteEventRef=OIE_GetInhibitionStatus_CL000
        RteEventToTaskMapping_OIE_LimitChannelToNoComMode_CL001: RteEventRef=OIE_LimitChannelToNoComMode_CL001
        RteEventToTaskMapping_OIE_PreventWakeUp_CL001: RteEventRef=OIE_PreventWakeUp_CL001
        RteEventToTaskMapping_OIE_GetState_CL001: RteEventRef=OIE_GetState_CL001
        RteEventToTaskMapping_OIE_GetInhibitionStatus_CL001: RteEventRef=OIE_GetInhibitionStatus_CL001
        RteEventToTaskMapping_OIE_LimitChannelToNoComMode_CL002: RteEventRef=OIE_LimitChannelToNoComMode_CL002
        RteEventToTaskMapping_OIE_PreventWakeUp_CL002: RteEventRef=OIE_PreventWakeUp_CL002
        RteEventToTaskMapping_OIE_GetState_CL002: RteEventRef=OIE_GetState_CL002
        RteEventToTaskMapping_OIE_GetInhibitionStatus_CL002: RteEventRef=OIE_GetInhibitionStatus_CL002
        RteEventToTaskMapping_OIE_RequestComMode_UR000: RteEventRef=OIE_RequestComMode_UR000
        RteEventToTaskMapping_OIE_GetCurrentComMode_UR000: RteEventRef=OIE_GetCurrentComMode_UR000
        RteEventToTaskMapping_OIE_GetRequestedComMode_UR000: RteEventRef=OIE_GetRequestedComMode_UR000
        RteEventToTaskMapping_OIE_RequestComMode_UR001: RteEventRef=OIE_RequestComMode_UR001
        RteEventToTaskMapping_OIE_GetCurrentComMode_UR001: RteEventRef=OIE_GetCurrentComMode_UR001
        RteEventToTaskMapping_OIE_GetRequestedComMode_UR001: RteEventRef=OIE_GetRequestedComMode_UR001
        RteEventToTaskMapping_OIE_RequestComMode_UR002: RteEventRef=OIE_RequestComMode_UR002
        RteEventToTaskMapping_OIE_GetCurrentComMode_UR002: RteEventRef=OIE_GetCurrentComMode_UR002
        RteEventToTaskMapping_OIE_GetRequestedComMode_UR002: RteEventRef=OIE_GetRequestedComMode_UR002
        RteEventToTaskMapping_OIE_ComM_GetChannelBusLoad_ComM_GetChannelBusLoad_GetChannelBusLoad: RteEventRef=OIE_ComM_GetChannelBusLoad_ComM_GetChannelBusLoad_GetChannelBusLoad
        RteEventToTaskMapping_OperationInvokedEvent_RequestComMode_ComMUser_PNC141: RteEventRef=OperationInvokedEvent_RequestComMode_ComMUser_PNC141
        RteEventToTaskMapping_OperationInvokedEvent_GetCurrentComMode_ComMUser_PNC141: RteEventRef=OperationInvokedEvent_GetCurrentComMode_ComMUser_PNC141
        RteEventToTaskMapping_OperationInvokedEvent_GetRequestedComMode_ComMUser_PNC141: RteEventRef=OperationInvokedEvent_GetRequestedComMode_ComMUser_PNC141
        RteEventToTaskMapping_OperationInvokedEvent_RequestComMode_ComMUser_PNC153: RteEventRef=OperationInvokedEvent_RequestComMode_ComMUser_PNC153
        RteEventToTaskMapping_OperationInvokedEvent_GetCurrentComMode_ComMUser_PNC153: RteEventRef=OperationInvokedEvent_GetCurrentComMode_ComMUser_PNC153
        RteEventToTaskMapping_OperationInvokedEvent_GetRequestedComMode_ComMUser_PNC153: RteEventRef=OperationInvokedEvent_GetRequestedComMode_ComMUser_PNC153
        RteEventToTaskMapping_OperationInvokedEvent_RequestComMode_ComMUser_PNC32: RteEventRef=OperationInvokedEvent_RequestComMode_ComMUser_PNC32
        RteEventToTaskMapping_OperationInvokedEvent_GetCurrentComMode_ComMUser_PNC32: RteEventRef=OperationInvokedEvent_GetCurrentComMode_ComMUser_PNC32
        RteEventToTaskMapping_OperationInvokedEvent_GetRequestedComMode_ComMUser_PNC32: RteEventRef=OperationInvokedEvent_GetRequestedComMode_ComMUser_PNC32
        RteEventToTaskMapping_OperationInvokedEvent_RequestComMode_ComMUser_PNC159: RteEventRef=OperationInvokedEvent_RequestComMode_ComMUser_PNC159
        RteEventToTaskMapping_OperationInvokedEvent_GetCurrentComMode_ComMUser_PNC159: RteEventRef=OperationInvokedEvent_GetCurrentComMode_ComMUser_PNC159
        RteEventToTaskMapping_OperationInvokedEvent_GetRequestedComMode_ComMUser_PNC159: RteEventRef=OperationInvokedEvent_GetRequestedComMode_ComMUser_PNC159
    RteSwComponentType_ComM (RteSwComponentType): RteComponentTypeRef=ComM
      RteComponentTypeCalibration: category=TOOL_CONFIGURED, RteCalibrationSupportEnabled=0
    SwcInstance_CtrlRam (RteSwComponentInstance): category=TOOL_CONFIGURED, RteSoftwareComponentInstanceRef=CtrlRam
      5 x RteEventToTaskMapping, all with category=TOOL_CONFIGURED, RteImmediateRestart=0:
        RteEventToTaskMapping_OperationInvokedEvent_ByteWrite: RteEventRef=OperationInvokedEvent_ByteWrite
        RteEventToTaskMapping_OperationInvokedEvent_WordWrite: RteEventRef=OperationInvokedEvent_WordWrite
        RteEventToTaskMapping_OperationInvokedEvent_LongWrite: RteEventRef=OperationInvokedEvent_LongWrite
        RteEventToTaskMapping_OperationInvokedEvent_StructWrite: RteEventRef=OperationInvokedEvent_StructWrite
        RteEventToTaskMapping_OperationInvokedEvent_GetErrorStatus: RteEventRef=OperationInvokedEvent_GetErrorStatus
    RteSwComponentType_CtrlRam (RteSwComponentType): RteComponentTypeRef=CtrlRam
      RteComponentTypeCalibration: category=TOOL_CONFIGURED, RteCalibrationSupportEnabled=0
    SwcInstance_Det (RteSwComponentInstance): category=TOOL_CONFIGURED, RteSoftwareComponentInstanceRef=Det
      RteEventToTaskMapping_OperationInvokedEvent_Det (RteEventToTaskMapping): category=TOOL_CONFIGURED, RteImmediateRestart=0, RteEventRef=OperationInvokedEvent_Det
    RteSwComponentType_Det (RteSwComponentType): RteComponentTypeRef=Det
      RteComponentTypeCalibration: category=TOOL_CONFIGURED, RteCalibrationSupportEnabled=0
    SwcInstance_SWC_AppMode (RteSwComponentInstance): category=TOOL_CONFIGURED, RteSoftwareComponentInstanceRef=SWC_AppMode
      66 x RteEventToTaskMapping, all with category=TOOL_CONFIGURED, RteImmediateRestart=0:
        RteEventToTaskMapping_SMSE_Entry_InitCompleted_modeNotificationPort_InitState_InitState_COMPLETE: RteEventRef=SMSE_Entry_InitCompleted_modeNotificationPort_InitState_InitState_COMPLETE
        RteEventToTaskMapping_SMSE_Entry_BusOffStateSwitched_modeNotificationPort_CanSMBORState_BCAN_CanSMBORState_BCAN_COMPLETE: RteEventRef=SMSE_Entry_BusOffStateSwitched_modeNotificationPort_CanSMBORState_BCAN_CanSMBORState_BCAN_COMPLETE
        RteEventToTaskMapping_SMSE_Entry_BusOffStateSwitched_modeNotificationPort_CanSMBORState_BCAN_CanSMBORState_BCAN_START: RteEventRef=SMSE_Entry_BusOffStateSwitched_modeNotificationPort_CanSMBORState_BCAN_CanSMBORState_BCAN_START
        RteEventToTaskMapping_SMSE_Entry_BusOffStateSwitched_modeNotificationPort_CanSMBORState_LCAN_CanSMBORState_LCAN_COMPLETE: RteEventRef=SMSE_Entry_BusOffStateSwitched_modeNotificationPort_CanSMBORState_LCAN_CanSMBORState_LCAN_COMPLETE
        RteEventToTaskMapping_SMSE_Entry_BusOffStateSwitched_modeNotificationPort_CanSMBORState_LCAN_CanSMBORState_LCAN_START: RteEventRef=SMSE_Entry_BusOffStateSwitched_modeNotificationPort_CanSMBORState_LCAN_CanSMBORState_LCAN_START
        RteEventToTaskMapping_SMSE_Entry_ComMModeSwitched_PNC141_modeNotificationPort_ComMMode_PNC141_ComMMode_PNC141_PNC_REQUESTED: RteEventRef=SMSE_Entry_ComMModeSwitched_PNC141_modeNotificationPort_ComMMode_PNC141_ComMMode_PNC141_PNC_REQUESTED
        RteEventToTaskMapping_SMSE_Entry_ComMModeSwitched_PNC141_modeNotificationPort_ComMMode_PNC141_ComMMode_PNC141_PNC_READY_SLEEP: RteEventRef=SMSE_Entry_ComMModeSwitched_PNC141_modeNotificationPort_ComMMode_PNC141_ComMMode_PNC141_PNC_READY_SLEEP
        RteEventToTaskMapping_SMSE_Entry_ComMModeSwitched_PNC141_modeNotificationPort_ComMMode_PNC141_ComMMode_PNC141_PNC_PREPARE_SLEEP: RteEventRef=SMSE_Entry_ComMModeSwitched_PNC141_modeNotificationPort_ComMMode_PNC141_ComMMode_PNC141_PNC_PREPARE_SLEEP
        RteEventToTaskMapping_SMSE_Entry_ComMModeSwitched_PNC141_modeNotificationPort_ComMMode_PNC141_ComMMode_PNC141_PNC_NO_COMMUNICATION: RteEventRef=SMSE_Entry_ComMModeSwitched_PNC141_modeNotificationPort_ComMMode_PNC141_ComMMode_PNC141_PNC_NO_COMMUNICATION
        RteEventToTaskMapping_SMSE_Entry_PduGroupSwitched_BCAN_PNC141_Rx_modeNotificationPort_PduGroupRx_BCAN_PNC141_PduGroupRx_BCAN_PNC141_STOP: RteEventRef=SMSE_Entry_PduGroupSwitched_BCAN_PNC141_Rx_modeNotificationPort_PduGroupRx_BCAN_PNC141_PduGroupRx_BCAN_PNC141_STOP
        RteEventToTaskMapping_SMSE_Entry_PduGroupSwitched_BCAN_PNC141_Rx_modeNotificationPort_PduGroupRx_BCAN_PNC141_PduGroupRx_BCAN_PNC141_START: RteEventRef=SMSE_Entry_PduGroupSwitched_BCAN_PNC141_Rx_modeNotificationPort_PduGroupRx_BCAN_PNC141_PduGroupRx_BCAN_PNC141_START
        RteEventToTaskMapping_SMSE_Entry_PduGroupSwitched_BCAN_PNC141_Tx_modeNotificationPort_PduGroupTx_BCAN_PNC141_PduGroupTx_BCAN_PNC141_STOP: RteEventRef=SMSE_Entry_PduGroupSwitched_BCAN_PNC141_Tx_modeNotificationPort_PduGroupTx_BCAN_PNC141_PduGroupTx_BCAN_PNC141_STOP
        RteEventToTaskMapping_SMSE_Entry_PduGroupSwitched_BCAN_PNC141_Tx_modeNotificationPort_PduGroupTx_BCAN_PNC141_PduGroupTx_BCAN_PNC141_START: RteEventRef=SMSE_Entry_PduGroupSwitched_BCAN_PNC141_Tx_modeNotificationPort_PduGroupTx_BCAN_PNC141_PduGroupTx_BCAN_PNC141_START
        RteEventToTaskMapping_SMSE_Entry_WakeupEventValidated_modeNotificationPort_WakeupEvent_WakeupEvent_BCAN_RX: RteEventRef=SMSE_Entry_WakeupEventValidated_modeNotificationPort_WakeupEvent_WakeupEvent_BCAN_RX
        RteEventToTaskMapping_SMSE_Entry_WakeupEventValidated_modeNotificationPort_WakeupEvent_WakeupEvent_BCAN_RX_POLL: RteEventRef=SMSE_Entry_WakeupEventValidated_modeNotificationPort_WakeupEvent_WakeupEvent_BCAN_RX_POLL
        RteEventToTaskMapping_SMSE_Entry_WakeupEventValidated_modeNotificationPort_WakeupEvent_WakeupEvent_LCAN_RX: RteEventRef=SMSE_Entry_WakeupEventValidated_modeNotificationPort_WakeupEvent_WakeupEvent_LCAN_RX
        RteEventToTaskMapping_SMSE_Entry_WakeupEventValidated_modeNotificationPort_WakeupEvent_WakeupEvent_LCAN_RX_POLL: RteEventRef=SMSE_Entry_WakeupEventValidated_modeNotificationPort_WakeupEvent_WakeupEvent_LCAN_RX_POLL
        RteEventToTaskMapping_SMSE_Entry_EcuModeSwitched_modeNotificationPort_EcuMode_EcuMode_ECUM_STATE_RUN: RteEventRef=SMSE_Entry_EcuModeSwitched_modeNotificationPort_EcuMode_EcuMode_ECUM_STATE_RUN
        RteEventToTaskMapping_SMSE_Entry_EcuModeSwitched_modeNotificationPort_EcuMode_EcuMode_ECUM_STATE_SHUTDOWN: RteEventRef=SMSE_Entry_EcuModeSwitched_modeNotificationPort_EcuMode_EcuMode_ECUM_STATE_SHUTDOWN
        RteEventToTaskMapping_SMSE_Entry_EcuModeSwitched_modeNotificationPort_EcuMode_EcuMode_ECUM_STATE_PREP_SHUTDOWN: RteEventRef=SMSE_Entry_EcuModeSwitched_modeNotificationPort_EcuMode_EcuMode_ECUM_STATE_PREP_SHUTDOWN
        RteEventToTaskMapping_SMSE_Entry_EcuModeSwitched_modeNotificationPort_EcuMode_EcuMode_ECUM_STATE_SLEEP: RteEventRef=SMSE_Entry_EcuModeSwitched_modeNotificationPort_EcuMode_EcuMode_ECUM_STATE_SLEEP
        RteEventToTaskMapping_SMSE_Entry_EcuModeSwitched_modeNotificationPort_EcuMode_EcuMode_ECUM_STATE_OFF: RteEventRef=SMSE_Entry_EcuModeSwitched_modeNotificationPort_EcuMode_EcuMode_ECUM_STATE_OFF
        RteEventToTaskMapping_SMSE_Entry_EcuModeSwitched_modeNotificationPort_EcuMode_EcuMode_ECUM_STATE_RESET: RteEventRef=SMSE_Entry_EcuModeSwitched_modeNotificationPort_EcuMode_EcuMode_ECUM_STATE_RESET
        RteEventToTaskMapping_TE_Mode_TE: RtePositionInTask=20, RteMappedToTaskRef=OsTask_ASW_FG1_10ms, RteUsedOsAlarmRef=OsAlarm_ASW_10ms, RteEventRef=TE_Mode_TE
        RteEventToTaskMapping_SMSE_Entry_ComMModeSwitched_PNC153_modeNotificationPort_ComMMode_PNC153_ComMMode_PNC153_PNC_FULL_COMMUNICATION: RteEventRef=SMSE_Entry_ComMModeSwitched_PNC153_modeNotificationPort_ComMMode_PNC153_ComMMode_PNC153_PNC_FULL_COMMUNICATION
        RteEventToTaskMapping_SMSE_Entry_ComMModeSwitched_PNC153_modeNotificationPort_ComMMode_PNC153_ComMMode_PNC153_PNC_NO_COMMUNICATION: RteEventRef=SMSE_Entry_ComMModeSwitched_PNC153_modeNotificationPort_ComMMode_PNC153_ComMMode_PNC153_PNC_NO_COMMUNICATION
        RteEventToTaskMapping_SMSE_Entry_ComMModeSwitched_PNC153_modeNotificationPort_ComMMode_PNC153_ComMMode_PNC153_PNC_PREPARE_SLEEP: RteEventRef=SMSE_Entry_ComMModeSwitched_PNC153_modeNotificationPort_ComMMode_PNC153_ComMMode_PNC153_PNC_PREPARE_SLEEP
        RteEventToTaskMapping_SMSE_Entry_ComMModeSwitched_PNC153_modeNotificationPort_ComMMode_PNC153_ComMMode_PNC153_PNC_READY_SLEEP: RteEventRef=SMSE_Entry_ComMModeSwitched_PNC153_modeNotificationPort_ComMMode_PNC153_ComMMode_PNC153_PNC_READY_SLEEP
        RteEventToTaskMapping_SMSE_Entry_ComMModeSwitched_PNC153_modeNotificationPort_ComMMode_PNC153_ComMMode_PNC153_PNC_REQUESTED: RteEventRef=SMSE_Entry_ComMModeSwitched_PNC153_modeNotificationPort_ComMMode_PNC153_ComMMode_PNC153_PNC_REQUESTED
        RteEventToTaskMapping_SMSE_Entry_PduGroupSwitched_BCAN_PNC153_Rx_modeNotificationPort_PduGroupRx_BCAN_PNC153_PduGroupRx_BCAN_PNC153_START: RteEventRef=SMSE_Entry_PduGroupSwitched_BCAN_PNC153_Rx_modeNotificationPort_PduGroupRx_BCAN_PNC153_PduGroupRx_BCAN_PNC153_START
        RteEventToTaskMapping_SMSE_Entry_PduGroupSwitched_BCAN_PNC153_Rx_modeNotificationPort_PduGroupRx_BCAN_PNC153_PduGroupRx_BCAN_PNC153_STOP: RteEventRef=SMSE_Entry_PduGroupSwitched_BCAN_PNC153_Rx_modeNotificationPort_PduGroupRx_BCAN_PNC153_PduGroupRx_BCAN_PNC153_STOP
        RteEventToTaskMapping_SMSE_Entry_PduGroupSwitched_BCAN_PNC153_Tx_modeNotificationPort_PduGroupTx_BCAN_PNC153_PduGroupTx_BCAN_PNC153_START: RteEventRef=SMSE_Entry_PduGroupSwitched_BCAN_PNC153_Tx_modeNotificationPort_PduGroupTx_BCAN_PNC153_PduGroupTx_BCAN_PNC153_START
        RteEventToTaskMapping_SMSE_Entry_PduGroupSwitched_BCAN_PNC153_Tx_modeNotificationPort_PduGroupTx_BCAN_PNC153_PduGroupTx_BCAN_PNC153_STOP: RteEventRef=SMSE_Entry_PduGroupSwitched_BCAN_PNC153_Tx_modeNotificationPort_PduGroupTx_BCAN_PNC153_PduGroupTx_BCAN_PNC153_STOP
        RteEventToTaskMapping_SMSE_Entry_ComMModeSwitched_BCAN_modeNotificationPort_ComMMode_BCAN_ComMMode_BCAN_FULL_COM: RteEventRef=SMSE_Entry_ComMModeSwitched_BCAN_modeNotificationPort_ComMMode_BCAN_ComMMode_BCAN_FULL_COM
        RteEventToTaskMapping_SMSE_Entry_ComMModeSwitched_BCAN_modeNotificationPort_ComMMode_BCAN_ComMMode_BCAN_NO_COM: RteEventRef=SMSE_Entry_ComMModeSwitched_BCAN_modeNotificationPort_ComMMode_BCAN_ComMMode_BCAN_NO_COM
        RteEventToTaskMapping_SMSE_Entry_ComMModeSwitched_BCAN_modeNotificationPort_ComMMode_BCAN_ComMMode_BCAN_SILENT_COM: RteEventRef=SMSE_Entry_ComMModeSwitched_BCAN_modeNotificationPort_ComMMode_BCAN_ComMMode_BCAN_SILENT_COM
        RteEventToTaskMapping_SMSE_Entry_ComMModeSwitched_LCAN_modeNotificationPort_ComMMode_LCAN_ComMMode_LCAN_FULL_COM: RteEventRef=SMSE_Entry_ComMModeSwitched_LCAN_modeNotificationPort_ComMMode_LCAN_ComMMode_LCAN_FULL_COM
        RteEventToTaskMapping_SMSE_Entry_ComMModeSwitched_LCAN_modeNotificationPort_ComMMode_LCAN_ComMMode_LCAN_NO_COM: RteEventRef=SMSE_Entry_ComMModeSwitched_LCAN_modeNotificationPort_ComMMode_LCAN_ComMMode_LCAN_NO_COM
        RteEventToTaskMapping_SMSE_Entry_ComMModeSwitched_LCAN_modeNotificationPort_ComMMode_LCAN_ComMMode_LCAN_SILENT_COM: RteEventRef=SMSE_Entry_ComMModeSwitched_LCAN_modeNotificationPort_ComMMode_LCAN_ComMMode_LCAN_SILENT_COM
        RteEventToTaskMapping_OIE_Mode_CS_ApplicationInit_P_CS_Mode_ApplicationInit: RteEventRef=OIE_Mode_CS_ApplicationInit_P_CS_Mode_ApplicationInit
        RteEventToTaskMapping_OIE_Mode_CS_ModeInit_P_CS_Mode_ModeInit: RteEventRef=OIE_Mode_CS_ModeInit_P_CS_Mode_ModeInit
        RteEventToTaskMapping_OIE_Mode_CS_NvMInit_P_CS_Mode_NvMInit: RteEventRef=OIE_Mode_CS_NvMInit_P_CS_Mode_NvMInit
        RteEventToTaskMapping_SMSE_Entry_WakeupEventValidated_modeNotificationPort_WakeupEvent_WakeupEvent_IGN1: RteEventRef=SMSE_Entry_WakeupEventValidated_modeNotificationPort_WakeupEvent_WakeupEvent_IGN1
        RteEventToTaskMapping_SMSE_Entry_ComMModeSwitched_PNC159_modeNotificationPort_ComMMode_PNC159_ComMMode_PNC159_PNC_FULL_COMMUNICATION: RteEventRef=SMSE_Entry_ComMModeSwitched_PNC159_modeNotificationPort_ComMMode_PNC159_ComMMode_PNC159_PNC_FULL_COMMUNICATION
        RteEventToTaskMapping_SMSE_Entry_ComMModeSwitched_PNC159_modeNotificationPort_ComMMode_PNC159_ComMMode_PNC159_PNC_NO_COMMUNICATION: RteEventRef=SMSE_Entry_ComMModeSwitched_PNC159_modeNotificationPort_ComMMode_PNC159_ComMMode_PNC159_PNC_NO_COMMUNICATION
        RteEventToTaskMapping_SMSE_Entry_ComMModeSwitched_PNC159_modeNotificationPort_ComMMode_PNC159_ComMMode_PNC159_PNC_PREPARE_SLEEP: RteEventRef=SMSE_Entry_ComMModeSwitched_PNC159_modeNotificationPort_ComMMode_PNC159_ComMMode_PNC159_PNC_PREPARE_SLEEP
        RteEventToTaskMapping_SMSE_Entry_ComMModeSwitched_PNC159_modeNotificationPort_ComMMode_PNC159_ComMMode_PNC159_PNC_READY_SLEEP: RteEventRef=SMSE_Entry_ComMModeSwitched_PNC159_modeNotificationPort_ComMMode_PNC159_ComMMode_PNC159_PNC_READY_SLEEP
        RteEventToTaskMapping_SMSE_Entry_ComMModeSwitched_PNC159_modeNotificationPort_ComMMode_PNC159_ComMMode_PNC159_PNC_REQUESTED: RteEventRef=SMSE_Entry_ComMModeSwitched_PNC159_modeNotificationPort_ComMMode_PNC159_ComMMode_PNC159_PNC_REQUESTED
        RteEventToTaskMapping_SMSE_Entry_ComMModeSwitched_PNC141_modeNotificationPort_ComMMode_PNC141_ComMMode_PNC141_PNC_FULL_COMMUNICATION: RteEventRef=SMSE_Entry_ComMModeSwitched_PNC141_modeNotificationPort_ComMMode_PNC141_ComMMode_PNC141_PNC_FULL_COMMUNICATION
        RteEventToTaskMapping_SMSE_Entry_PduGroupSwitched_LCAN_PNC159_Rx_modeNotificationPort_PduGroupRx_LCAN_PNC159_PduGroupRx_LCAN_PNC159_START: RteEventRef=SMSE_Entry_PduGroupSwitched_LCAN_PNC159_Rx_modeNotificationPort_PduGroupRx_LCAN_PNC159_PduGroupRx_LCAN_PNC159_START
        RteEventToTaskMapping_SMSE_Entry_PduGroupSwitched_LCAN_PNC159_Rx_modeNotificationPort_PduGroupRx_LCAN_PNC159_PduGroupRx_LCAN_PNC159_STOP: RteEventRef=SMSE_Entry_PduGroupSwitched_LCAN_PNC159_Rx_modeNotificationPort_PduGroupRx_LCAN_PNC159_PduGroupRx_LCAN_PNC159_STOP
        RteEventToTaskMapping_SMSE_Entry_PduGroupSwitched_LCAN_PNC159_Tx_modeNotificationPort_PduGroupTx_LCAN_PNC159_PduGroupTx_LCAN_PNC159_START: RteEventRef=SMSE_Entry_PduGroupSwitched_LCAN_PNC159_Tx_modeNotificationPort_PduGroupTx_LCAN_PNC159_PduGroupTx_LCAN_PNC159_START
        RteEventToTaskMapping_SMSE_Entry_PduGroupSwitched_LCAN_PNC159_Tx_modeNotificationPort_PduGroupTx_LCAN_PNC159_PduGroupTx_LCAN_PNC159_STOP: RteEventRef=SMSE_Entry_PduGroupSwitched_LCAN_PNC159_Tx_modeNotificationPort_PduGroupTx_LCAN_PNC159_PduGroupTx_LCAN_PNC159_STOP
        RteEventToTaskMapping_SMSE_Entry_ComMModeSwitched_PNC32_modeNotificationPort_ComMMode_PNC32_ComMMode_PNC32_PNC_FULL_COMMUNICATION: RteEventRef=SMSE_Entry_ComMModeSwitched_PNC32_modeNotificationPort_ComMMode_PNC32_ComMMode_PNC32_PNC_FULL_COMMUNICATION
        RteEventToTaskMapping_SMSE_Entry_ComMModeSwitched_PNC32_modeNotificationPort_ComMMode_PNC32_ComMMode_PNC32_PNC_NO_COMMUNICATION: RteEventRef=SMSE_Entry_ComMModeSwitched_PNC32_modeNotificationPort_ComMMode_PNC32_ComMMode_PNC32_PNC_NO_COMMUNICATION
        RteEventToTaskMapping_SMSE_Entry_ComMModeSwitched_PNC32_modeNotificationPort_ComMMode_PNC32_ComMMode_PNC32_PNC_PREPARE_SLEEP: RteEventRef=SMSE_Entry_ComMModeSwitched_PNC32_modeNotificationPort_ComMMode_PNC32_ComMMode_PNC32_PNC_PREPARE_SLEEP
        RteEventToTaskMapping_SMSE_Entry_ComMModeSwitched_PNC32_modeNotificationPort_ComMMode_PNC32_ComMMode_PNC32_PNC_READY_SLEEP: RteEventRef=SMSE_Entry_ComMModeSwitched_PNC32_modeNotificationPort_ComMMode_PNC32_ComMMode_PNC32_PNC_READY_SLEEP
        RteEventToTaskMapping_SMSE_Entry_ComMModeSwitched_PNC32_modeNotificationPort_ComMMode_PNC32_ComMMode_PNC32_PNC_REQUESTED: RteEventRef=SMSE_Entry_ComMModeSwitched_PNC32_modeNotificationPort_ComMMode_PNC32_ComMMode_PNC32_PNC_REQUESTED
        RteEventToTaskMapping_SMSE_Entry_PduGroupSwitched_BCAN_PNC32_Rx_modeNotificationPort_PduGroupRx_BCAN_PNC32_PduGroupRx_BCAN_PNC32_START: RteEventRef=SMSE_Entry_PduGroupSwitched_BCAN_PNC32_Rx_modeNotificationPort_PduGroupRx_BCAN_PNC32_PduGroupRx_BCAN_PNC32_START
        RteEventToTaskMapping_SMSE_Entry_PduGroupSwitched_BCAN_PNC32_Rx_modeNotificationPort_PduGroupRx_BCAN_PNC32_PduGroupRx_BCAN_PNC32_STOP: RteEventRef=SMSE_Entry_PduGroupSwitched_BCAN_PNC32_Rx_modeNotificationPort_PduGroupRx_BCAN_PNC32_PduGroupRx_BCAN_PNC32_STOP
        RteEventToTaskMapping_SMSE_Entry_PduGroupSwitched_BCAN_PNC32_Tx_modeNotificationPort_PduGroupTx_BCAN_PNC32_PduGroupTx_BCAN_PNC32_START: RteEventRef=SMSE_Entry_PduGroupSwitched_BCAN_PNC32_Tx_modeNotificationPort_PduGroupTx_BCAN_PNC32_PduGroupTx_BCAN_PNC32_START
        RteEventToTaskMapping_SMSE_Entry_PduGroupSwitched_BCAN_PNC32_Tx_modeNotificationPort_PduGroupTx_BCAN_PNC32_PduGroupTx_BCAN_PNC32_STOP: RteEventRef=SMSE_Entry_PduGroupSwitched_BCAN_PNC32_Tx_modeNotificationPort_PduGroupTx_BCAN_PNC32_PduGroupTx_BCAN_PNC32_STOP
        RteEventToTaskMapping_SMSE_Entry_PduGroupSwitched_LCAN_PNC32_Tx_modeNotificationPort_PduGroupTx_LCAN_PNC32_PduGroupTx_LCAN_PNC32_START: RteEventRef=SMSE_Entry_PduGroupSwitched_LCAN_PNC32_Tx_modeNotificationPort_PduGroupTx_LCAN_PNC32_PduGroupTx_LCAN_PNC32_START
        RteEventToTaskMapping_SMSE_Entry_PduGroupSwitched_LCAN_PNC32_Tx_modeNotificationPort_PduGroupTx_LCAN_PNC32_PduGroupTx_LCAN_PNC32_STOP: RteEventRef=SMSE_Entry_PduGroupSwitched_LCAN_PNC32_Tx_modeNotificationPort_PduGroupTx_LCAN_PNC32_PduGroupTx_LCAN_PNC32_STOP
        RteEventToTaskMapping_SMSE_Entry_PduGroupSwitched_LCAN_PNC32_Rx_modeNotificationPort_PduGroupRx_LCAN_PNC32_PduGroupRx_LCAN_PNC32_START: RteEventRef=SMSE_Entry_PduGroupSwitched_LCAN_PNC32_Rx_modeNotificationPort_PduGroupRx_LCAN_PNC32_PduGroupRx_LCAN_PNC32_START
        RteEventToTaskMapping_SMSE_Entry_PduGroupSwitched_LCAN_PNC32_Rx_modeNotificationPort_PduGroupRx_LCAN_PNC32_PduGroupRx_LCAN_PNC32_STOP: RteEventRef=SMSE_Entry_PduGroupSwitched_LCAN_PNC32_Rx_modeNotificationPort_PduGroupRx_LCAN_PNC32_PduGroupRx_LCAN_PNC32_STOP
    RteSwComponentType_SWC_AppMode (RteSwComponentType): RteComponentTypeRef=SWC_AppMode
      RteComponentTypeCalibration: category=TOOL_CONFIGURED, RteCalibrationSupportEnabled=0
    SwcInstance_SWC_DiagnosticService (RteSwComponentInstance): category=TOOL_CONFIGURED, RteSoftwareComponentInstanceRef=SWC_DiagnosticService
      13 x RteEventToTaskMapping, all with category=TOOL_CONFIGURED, RteImmediateRestart=0:
        RteEventToTaskMapping_OIE_CallbackDCMRequestServices_StopProtocol: RteEventRef=OIE_CallbackDCMRequestServices_StopProtocol
        RteEventToTaskMapping_OIE_CallbackDCMRequestServices_StartProtocol: RteEventRef=OIE_CallbackDCMRequestServices_StartProtocol
        RteEventToTaskMapping_OIE_L9_CompareKey: RteEventRef=OIE_L9_CompareKey
        RteEventToTaskMapping_OIE_L9_GetSeed: RteEventRef=OIE_L9_GetSeed
        RteEventToTaskMapping_OIE_ServiceRequestSupplierNotification_Indication: RteEventRef=OIE_ServiceRequestSupplierNotification_Indication
        RteEventToTaskMapping_OIE_ServiceRequestSupplierNotification_Confirmation: RteEventRef=OIE_ServiceRequestSupplierNotification_Confirmation
        RteEventToTaskMapping_SMSE_Entry_DiagnosticSessionControlNotification_modeNotificationPort_SessionControl_DcmDiagnosticSessionControl_DCM_DEFAULT_SESSION: RteEventRef=SMSE_Entry_DiagnosticSessionControlNotification_modeNotificationPort_SessionControl_DcmDiagnosticSessionControl_DCM_DEFAULT_SESSION
        RteEventToTaskMapping_SMSE_Entry_DiagnosticSessionControlNotification_modeNotificationPort_SessionControl_DcmDiagnosticSessionControl_DCM_EXTENDED_DIAGNOSTIC_SESSION: RteEventRef=SMSE_Entry_DiagnosticSessionControlNotification_modeNotificationPort_SessionControl_DcmDiagnosticSessionControl_DCM_EXTENDED_DIAGNOSTIC_SESSION
        RteEventToTaskMapping_SMSE_ApplicationUpdatedIndication_modeNotificationPort_ApplicationUpdated_DcmApplicationUpdated_APP_UPDATED: RteEventRef=SMSE_ApplicationUpdatedIndication_modeNotificationPort_ApplicationUpdated_DcmApplicationUpdated_APP_UPDATED
        RteEventToTaskMapping_SMSE_ApplicationUpdatedIndication_modeNotificationPort_ApplicationUpdated_DcmApplicationUpdated_APP_NOT_UPDATED: RteEventRef=SMSE_ApplicationUpdatedIndication_modeNotificationPort_ApplicationUpdated_DcmApplicationUpdated_APP_NOT_UPDATED
        RteEventToTaskMapping_OIE_L10_GetSeed_SecurityAccess_L10_GetSeed: RteEventRef=OIE_L10_GetSeed_SecurityAccess_L10_GetSeed
        RteEventToTaskMapping_OIE_L10_CompareKey_SecurityAccess_L10_CompareKey: RteEventRef=OIE_L10_CompareKey_SecurityAccess_L10_CompareKey
        RteEventToTaskMapping_OIE_OEUK_AsyncVerifyFinished_CallbackNotification_SignatureVerify_CallbackNotification: RteEventRef=OIE_OEUK_AsyncVerifyFinished_CallbackNotification_SignatureVerify_CallbackNotification
    RteSwComponentType_SWC_DiagnosticService (RteSwComponentType): RteComponentTypeRef=SWC_DiagnosticService
      RteComponentTypeCalibration: category=TOOL_CONFIGURED, RteCalibrationSupportEnabled=0
    SwcInstance_Csm (RteSwComponentInstance): category=TOOL_CONFIGURED, RteSoftwareComponentInstanceRef=Csm
      26 x RteEventToTaskMapping, all with category=TOOL_CONFIGURED, RteImmediateRestart=0:
        RteEventToTaskMapping_OperationInvokedEvent_CsmJob_RandomGenerate_L9_RandomGenerate: RteEventRef=OperationInvokedEvent_CsmJob_RandomGenerate_L9_RandomGenerate
        RteEventToTaskMapping_OperationInvokedEvent_CsmKey_CryptoKey_Dummy_KeyCopy: RteEventRef=OperationInvokedEvent_CsmKey_CryptoKey_Dummy_KeyCopy
        RteEventToTaskMapping_OperationInvokedEvent_CsmKey_CryptoKey_Dummy_KeyDerive: RteEventRef=OperationInvokedEvent_CsmKey_CryptoKey_Dummy_KeyDerive
        RteEventToTaskMapping_OperationInvokedEvent_CsmKey_CryptoKey_Dummy_KeyElementCopy: RteEventRef=OperationInvokedEvent_CsmKey_CryptoKey_Dummy_KeyElementCopy
        RteEventToTaskMapping_OperationInvokedEvent_CsmKey_CryptoKey_Dummy_KeyElementCopyPartial: RteEventRef=OperationInvokedEvent_CsmKey_CryptoKey_Dummy_KeyElementCopyPartial
        RteEventToTaskMapping_OperationInvokedEvent_CsmKey_CryptoKey_Dummy_KeyElementGet: RteEventRef=OperationInvokedEvent_CsmKey_CryptoKey_Dummy_KeyElementGet
        RteEventToTaskMapping_OperationInvokedEvent_CsmKey_CryptoKey_Dummy_KeyElementSet: RteEventRef=OperationInvokedEvent_CsmKey_CryptoKey_Dummy_KeyElementSet
        RteEventToTaskMapping_OperationInvokedEvent_CsmKey_CryptoKey_Dummy_KeyExchangeCalcPubVal: RteEventRef=OperationInvokedEvent_CsmKey_CryptoKey_Dummy_KeyExchangeCalcPubVal
        RteEventToTaskMapping_OperationInvokedEvent_CsmKey_CryptoKey_Dummy_KeyExchangeCalcSecret: RteEventRef=OperationInvokedEvent_CsmKey_CryptoKey_Dummy_KeyExchangeCalcSecret
        RteEventToTaskMapping_OperationInvokedEvent_CsmKey_CryptoKey_Dummy_KeyGenerate: RteEventRef=OperationInvokedEvent_CsmKey_CryptoKey_Dummy_KeyGenerate
        RteEventToTaskMapping_OperationInvokedEvent_CsmKey_CryptoKey_Dummy_KeySetValid: RteEventRef=OperationInvokedEvent_CsmKey_CryptoKey_Dummy_KeySetValid
        RteEventToTaskMapping_OperationInvokedEvent_CsmKey_CryptoKey_Dummy_RandomSeed: RteEventRef=OperationInvokedEvent_CsmKey_CryptoKey_Dummy_RandomSeed
        RteEventToTaskMapping_OperationInvokedEvent_CsmJob_RandomGenerate_L10_RandomGenerate: RteEventRef=OperationInvokedEvent_CsmJob_RandomGenerate_L10_RandomGenerate
        RteEventToTaskMapping_OperationInvokedEvent_CsmJob_SignatureVerify_RSASSA_PKCS1_v1_5_CancelJob: RteEventRef=OperationInvokedEvent_CsmJob_SignatureVerify_RSASSA_PKCS1_v1_5_CancelJob
        RteEventToTaskMapping_OperationInvokedEvent_CsmJob_SignatureVerify_RSASSA_PKCS1_v1_5_SignatureVerify: RteEventRef=OperationInvokedEvent_CsmJob_SignatureVerify_RSASSA_PKCS1_v1_5_SignatureVerify
        RteEventToTaskMapping_OperationInvokedEvent_CsmKey_CryptoKey_OEUK_KeyCopy: RteEventRef=OperationInvokedEvent_CsmKey_CryptoKey_OEUK_KeyCopy
        RteEventToTaskMapping_OperationInvokedEvent_CsmKey_CryptoKey_OEUK_KeyDerive: RteEventRef=OperationInvokedEvent_CsmKey_CryptoKey_OEUK_KeyDerive
        RteEventToTaskMapping_OperationInvokedEvent_CsmKey_CryptoKey_OEUK_KeyElementCopy: RteEventRef=OperationInvokedEvent_CsmKey_CryptoKey_OEUK_KeyElementCopy
        RteEventToTaskMapping_OperationInvokedEvent_CsmKey_CryptoKey_OEUK_KeyElementCopyPartial: RteEventRef=OperationInvokedEvent_CsmKey_CryptoKey_OEUK_KeyElementCopyPartial
        RteEventToTaskMapping_OperationInvokedEvent_CsmKey_CryptoKey_OEUK_KeyElementGet: RteEventRef=OperationInvokedEvent_CsmKey_CryptoKey_OEUK_KeyElementGet
        RteEventToTaskMapping_OperationInvokedEvent_CsmKey_CryptoKey_OEUK_KeyElementSet: RteEventRef=OperationInvokedEvent_CsmKey_CryptoKey_OEUK_KeyElementSet
        RteEventToTaskMapping_OperationInvokedEvent_CsmKey_CryptoKey_OEUK_KeyExchangeCalcPubVal: RteEventRef=OperationInvokedEvent_CsmKey_CryptoKey_OEUK_KeyExchangeCalcPubVal
        RteEventToTaskMapping_OperationInvokedEvent_CsmKey_CryptoKey_OEUK_KeyExchangeCalcSecret: RteEventRef=OperationInvokedEvent_CsmKey_CryptoKey_OEUK_KeyExchangeCalcSecret
        RteEventToTaskMapping_OperationInvokedEvent_CsmKey_CryptoKey_OEUK_KeyGenerate: RteEventRef=OperationInvokedEvent_CsmKey_CryptoKey_OEUK_KeyGenerate
        RteEventToTaskMapping_OperationInvokedEvent_CsmKey_CryptoKey_OEUK_KeySetValid: RteEventRef=OperationInvokedEvent_CsmKey_CryptoKey_OEUK_KeySetValid
        RteEventToTaskMapping_OperationInvokedEvent_CsmKey_CryptoKey_OEUK_RandomSeed: RteEventRef=OperationInvokedEvent_CsmKey_CryptoKey_OEUK_RandomSeed
    RteSwComponentType_Csm (RteSwComponentType): RteComponentTypeRef=Csm
      RteComponentTypeCalibration: category=TOOL_CONFIGURED, RteCalibrationSupportEnabled=0
    SwcInstance_EcuM (RteSwComponentInstance): category=TOOL_CONFIGURED, RteSoftwareComponentInstanceRef=EcuM
      21 x RteEventToTaskMapping, all with category=TOOL_CONFIGURED, RteImmediateRestart=0:
        RteEventToTaskMapping_OIE_GetBootTarget: RteEventRef=OIE_GetBootTarget
        RteEventToTaskMapping_OIE_SelectBootTarget: RteEventRef=OIE_SelectBootTarget
        RteEventToTaskMapping_OIE_GetLastShutdownTarget: RteEventRef=OIE_GetLastShutdownTarget
        RteEventToTaskMapping_OIE_GetMostRecentShutdown: RteEventRef=OIE_GetMostRecentShutdown
        RteEventToTaskMapping_OIE_GetNextRecentShutdown: RteEventRef=OIE_GetNextRecentShutdown
        RteEventToTaskMapping_OIE_GetShutdownCause: RteEventRef=OIE_GetShutdownCause
        RteEventToTaskMapping_OIE_GetShutdownTarget: RteEventRef=OIE_GetShutdownTarget
        RteEventToTaskMapping_OIE_GoDown: RteEventRef=OIE_GoDown
        RteEventToTaskMapping_OIE_GoHalt: RteEventRef=OIE_GoHalt
        RteEventToTaskMapping_OIE_GoPoll: RteEventRef=OIE_GoPoll
        RteEventToTaskMapping_OIE_SelectShutdownCause: RteEventRef=OIE_SelectShutdownCause
        RteEventToTaskMapping_OIE_SelectShutdownTarget: RteEventRef=OIE_SelectShutdownTarget
        RteEventToTaskMapping_OIE_ReleaseRUN: RteEventRef=OIE_ReleaseRUN
        RteEventToTaskMapping_OIE_RequestOff: RteEventRef=OIE_RequestOff
        RteEventToTaskMapping_OIE_RequestRUN: RteEventRef=OIE_RequestRUN
        RteEventToTaskMapping_OIE_RequestReset: RteEventRef=OIE_RequestReset
        RteEventToTaskMapping_OIE_RequestSleep: RteEventRef=OIE_RequestSleep
        RteEventToTaskMapping_OIE_SetRunState: RteEventRef=OIE_SetRunState
        RteEventToTaskMapping_OIE_ClearWakeupEvent: RteEventRef=OIE_ClearWakeupEvent
        RteEventToTaskMapping_OIE_DisableWakeupSources: RteEventRef=OIE_DisableWakeupSources
        RteEventToTaskMapping_OIE_EnableWakeupSources: RteEventRef=OIE_EnableWakeupSources
    RteSwComponentType_EcuM (RteSwComponentType): RteComponentTypeRef=EcuM
      RteComponentTypeCalibration: category=TOOL_CONFIGURED, RteCalibrationSupportEnabled=0
    SwcInstance_Dcm (RteSwComponentInstance): category=TOOL_CONFIGURED, RteSoftwareComponentInstanceRef=Dcm
      6 x RteEventToTaskMapping, all with category=TOOL_CONFIGURED, RteImmediateRestart=0:
        RteEventToTaskMapping_OIE_DCMServices_GetSesCtrlType: RteEventRef=OIE_DCMServices_GetSesCtrlType
        RteEventToTaskMapping_OIE_DCMServices_GetActiveProtocol: RteEventRef=OIE_DCMServices_GetActiveProtocol
        RteEventToTaskMapping_OIE_DCMServices_ResetToDefaultSession: RteEventRef=OIE_DCMServices_ResetToDefaultSession
        RteEventToTaskMapping_OIE_DCMServices_GetCertificationInfo: RteEventRef=OIE_DCMServices_GetCertificationInfo
        RteEventToTaskMapping_OIE_DCMServices_GetSecurityLevel: RteEventRef=OIE_DCMServices_GetSecurityLevel
        RteEventToTaskMapping_OIE_DCMServices_GetCertHolderReference: RteEventRef=OIE_DCMServices_GetCertHolderReference
    RteSwComponentType_Dcm (RteSwComponentType): RteComponentTypeRef=Dcm
      RteComponentTypeCalibration: category=TOOL_CONFIGURED, RteCalibrationSupportEnabled=0
    SwcInstance_Dem (RteSwComponentInstance): category=TOOL_CONFIGURED, RteSoftwareComponentInstanceRef=Dem
      401 x RteEventToTaskMapping, all with category=TOOL_CONFIGURED, RteImmediateRestart=0:
        RteEventToTaskMapping_OIE_Cdd_ClearDTC: RteEventRef=OIE_Cdd_ClearDTC
        RteEventToTaskMapping_OIE_EventInfo_ADC_E_HARDWARE_ERROR_GetDTCOfEvent: RteEventRef=OIE_EventInfo_ADC_E_HARDWARE_ERROR_GetDTCOfEvent
        RteEventToTaskMapping_OIE_EventInfo_ADC_E_HARDWARE_ERROR_GetEventExtendedDataRecord: RteEventRef=OIE_EventInfo_ADC_E_HARDWARE_ERROR_GetEventExtendedDataRecord
        RteEventToTaskMapping_OIE_EventInfo_ADC_E_HARDWARE_ERROR_GetEventFailed: RteEventRef=OIE_EventInfo_ADC_E_HARDWARE_ERROR_GetEventFailed
        RteEventToTaskMapping_OIE_EventInfo_ADC_E_HARDWARE_ERROR_GetEventFreezeFrameData: RteEventRef=OIE_EventInfo_ADC_E_HARDWARE_ERROR_GetEventFreezeFrameData
        RteEventToTaskMapping_OIE_EventInfo_ADC_E_HARDWARE_ERROR_GetEventStatus: RteEventRef=OIE_EventInfo_ADC_E_HARDWARE_ERROR_GetEventStatus
        RteEventToTaskMapping_OIE_EventInfo_ADC_E_HARDWARE_ERROR_GetEventTested: RteEventRef=OIE_EventInfo_ADC_E_HARDWARE_ERROR_GetEventTested
        RteEventToTaskMapping_OIE_EventInfo_ADC_E_HARDWARE_ERROR_GetFaultDetectionCounter: RteEventRef=OIE_EventInfo_ADC_E_HARDWARE_ERROR_GetFaultDetectionCounter
        RteEventToTaskMapping_OIE_EventInfo_CANCM_E_BAT_FAIL_GetDTCOfEvent: RteEventRef=OIE_EventInfo_CANCM_E_BAT_FAIL_GetDTCOfEvent
        RteEventToTaskMapping_OIE_EventInfo_CANCM_E_BAT_FAIL_GetEventExtendedDataRecord: RteEventRef=OIE_EventInfo_CANCM_E_BAT_FAIL_GetEventExtendedDataRecord
        RteEventToTaskMapping_OIE_EventInfo_CANCM_E_BAT_FAIL_GetEventFailed: RteEventRef=OIE_EventInfo_CANCM_E_BAT_FAIL_GetEventFailed
        RteEventToTaskMapping_OIE_EventInfo_CANCM_E_BAT_FAIL_GetEventFreezeFrameData: RteEventRef=OIE_EventInfo_CANCM_E_BAT_FAIL_GetEventFreezeFrameData
        RteEventToTaskMapping_OIE_EventInfo_CANCM_E_BAT_FAIL_GetEventStatus: RteEventRef=OIE_EventInfo_CANCM_E_BAT_FAIL_GetEventStatus
        RteEventToTaskMapping_OIE_EventInfo_CANCM_E_BAT_FAIL_GetEventTested: RteEventRef=OIE_EventInfo_CANCM_E_BAT_FAIL_GetEventTested
        RteEventToTaskMapping_OIE_EventInfo_CANCM_E_BAT_FAIL_GetFaultDetectionCounter: RteEventRef=OIE_EventInfo_CANCM_E_BAT_FAIL_GetFaultDetectionCounter
        RteEventToTaskMapping_OIE_EventInfo_CANSM_E_BUS_OFF_BCAN_GetDTCOfEvent: RteEventRef=OIE_EventInfo_CANSM_E_BUS_OFF_BCAN_GetDTCOfEvent
        RteEventToTaskMapping_OIE_EventInfo_CANSM_E_BUS_OFF_BCAN_GetEventExtendedDataRecord: RteEventRef=OIE_EventInfo_CANSM_E_BUS_OFF_BCAN_GetEventExtendedDataRecord
        RteEventToTaskMapping_OIE_EventInfo_CANSM_E_BUS_OFF_BCAN_GetEventFailed: RteEventRef=OIE_EventInfo_CANSM_E_BUS_OFF_BCAN_GetEventFailed
        RteEventToTaskMapping_OIE_EventInfo_CANSM_E_BUS_OFF_BCAN_GetEventFreezeFrameData: RteEventRef=OIE_EventInfo_CANSM_E_BUS_OFF_BCAN_GetEventFreezeFrameData
        RteEventToTaskMapping_OIE_EventInfo_CANSM_E_BUS_OFF_BCAN_GetEventStatus: RteEventRef=OIE_EventInfo_CANSM_E_BUS_OFF_BCAN_GetEventStatus
        RteEventToTaskMapping_OIE_EventInfo_CANSM_E_BUS_OFF_BCAN_GetEventTested: RteEventRef=OIE_EventInfo_CANSM_E_BUS_OFF_BCAN_GetEventTested
        RteEventToTaskMapping_OIE_EventInfo_CANSM_E_BUS_OFF_BCAN_GetFaultDetectionCounter: RteEventRef=OIE_EventInfo_CANSM_E_BUS_OFF_BCAN_GetFaultDetectionCounter
        RteEventToTaskMapping_OIE_EventInfo_CANSM_E_BUS_OFF_LCAN_GetDTCOfEvent: RteEventRef=OIE_EventInfo_CANSM_E_BUS_OFF_LCAN_GetDTCOfEvent
        RteEventToTaskMapping_OIE_EventInfo_CANSM_E_BUS_OFF_LCAN_GetEventExtendedDataRecord: RteEventRef=OIE_EventInfo_CANSM_E_BUS_OFF_LCAN_GetEventExtendedDataRecord
        RteEventToTaskMapping_OIE_EventInfo_CANSM_E_BUS_OFF_LCAN_GetEventFailed: RteEventRef=OIE_EventInfo_CANSM_E_BUS_OFF_LCAN_GetEventFailed
        RteEventToTaskMapping_OIE_EventInfo_CANSM_E_BUS_OFF_LCAN_GetEventFreezeFrameData: RteEventRef=OIE_EventInfo_CANSM_E_BUS_OFF_LCAN_GetEventFreezeFrameData
        RteEventToTaskMapping_OIE_EventInfo_CANSM_E_BUS_OFF_LCAN_GetEventStatus: RteEventRef=OIE_EventInfo_CANSM_E_BUS_OFF_LCAN_GetEventStatus
        RteEventToTaskMapping_OIE_EventInfo_CANSM_E_BUS_OFF_LCAN_GetEventTested: RteEventRef=OIE_EventInfo_CANSM_E_BUS_OFF_LCAN_GetEventTested
        RteEventToTaskMapping_OIE_EventInfo_CANSM_E_BUS_OFF_LCAN_GetFaultDetectionCounter: RteEventRef=OIE_EventInfo_CANSM_E_BUS_OFF_LCAN_GetFaultDetectionCounter
        RteEventToTaskMapping_OIE_EventInfo_CANSM_E_MODE_CHANGE_BCAN_GetDTCOfEvent: RteEventRef=OIE_EventInfo_CANSM_E_MODE_CHANGE_BCAN_GetDTCOfEvent
        RteEventToTaskMapping_OIE_EventInfo_CANSM_E_MODE_CHANGE_BCAN_GetEventExtendedDataRecord: RteEventRef=OIE_EventInfo_CANSM_E_MODE_CHANGE_BCAN_GetEventExtendedDataRecord
        RteEventToTaskMapping_OIE_EventInfo_CANSM_E_MODE_CHANGE_BCAN_GetEventFailed: RteEventRef=OIE_EventInfo_CANSM_E_MODE_CHANGE_BCAN_GetEventFailed
        RteEventToTaskMapping_OIE_EventInfo_CANSM_E_MODE_CHANGE_BCAN_GetEventFreezeFrameData: RteEventRef=OIE_EventInfo_CANSM_E_MODE_CHANGE_BCAN_GetEventFreezeFrameData
        RteEventToTaskMapping_OIE_EventInfo_CANSM_E_MODE_CHANGE_BCAN_GetEventStatus: RteEventRef=OIE_EventInfo_CANSM_E_MODE_CHANGE_BCAN_GetEventStatus
        RteEventToTaskMapping_OIE_EventInfo_CANSM_E_MODE_CHANGE_BCAN_GetEventTested: RteEventRef=OIE_EventInfo_CANSM_E_MODE_CHANGE_BCAN_GetEventTested
        RteEventToTaskMapping_OIE_EventInfo_CANSM_E_MODE_CHANGE_BCAN_GetFaultDetectionCounter: RteEventRef=OIE_EventInfo_CANSM_E_MODE_CHANGE_BCAN_GetFaultDetectionCounter
        RteEventToTaskMapping_OIE_EventInfo_CANSM_E_MODE_CHANGE_LCAN_GetDTCOfEvent: RteEventRef=OIE_EventInfo_CANSM_E_MODE_CHANGE_LCAN_GetDTCOfEvent
        RteEventToTaskMapping_OIE_EventInfo_CANSM_E_MODE_CHANGE_LCAN_GetEventExtendedDataRecord: RteEventRef=OIE_EventInfo_CANSM_E_MODE_CHANGE_LCAN_GetEventExtendedDataRecord
        RteEventToTaskMapping_OIE_EventInfo_CANSM_E_MODE_CHANGE_LCAN_GetEventFailed: RteEventRef=OIE_EventInfo_CANSM_E_MODE_CHANGE_LCAN_GetEventFailed
        RteEventToTaskMapping_OIE_EventInfo_CANSM_E_MODE_CHANGE_LCAN_GetEventFreezeFrameData: RteEventRef=OIE_EventInfo_CANSM_E_MODE_CHANGE_LCAN_GetEventFreezeFrameData
        RteEventToTaskMapping_OIE_EventInfo_CANSM_E_MODE_CHANGE_LCAN_GetEventStatus: RteEventRef=OIE_EventInfo_CANSM_E_MODE_CHANGE_LCAN_GetEventStatus
        RteEventToTaskMapping_OIE_EventInfo_CANSM_E_MODE_CHANGE_LCAN_GetEventTested: RteEventRef=OIE_EventInfo_CANSM_E_MODE_CHANGE_LCAN_GetEventTested
        RteEventToTaskMapping_OIE_EventInfo_CANSM_E_MODE_CHANGE_LCAN_GetFaultDetectionCounter: RteEventRef=OIE_EventInfo_CANSM_E_MODE_CHANGE_LCAN_GetFaultDetectionCounter
        RteEventToTaskMapping_OIE_EventInfo_CAN_E_HARDWARE_ERROR_GetDTCOfEvent: RteEventRef=OIE_EventInfo_CAN_E_HARDWARE_ERROR_GetDTCOfEvent
        RteEventToTaskMapping_OIE_EventInfo_CAN_E_HARDWARE_ERROR_GetEventExtendedDataRecord: RteEventRef=OIE_EventInfo_CAN_E_HARDWARE_ERROR_GetEventExtendedDataRecord
        RteEventToTaskMapping_OIE_EventInfo_CAN_E_HARDWARE_ERROR_GetEventFailed: RteEventRef=OIE_EventInfo_CAN_E_HARDWARE_ERROR_GetEventFailed
        RteEventToTaskMapping_OIE_EventInfo_CAN_E_HARDWARE_ERROR_GetEventFreezeFrameData: RteEventRef=OIE_EventInfo_CAN_E_HARDWARE_ERROR_GetEventFreezeFrameData
        RteEventToTaskMapping_OIE_EventInfo_CAN_E_HARDWARE_ERROR_GetEventStatus: RteEventRef=OIE_EventInfo_CAN_E_HARDWARE_ERROR_GetEventStatus
        RteEventToTaskMapping_OIE_EventInfo_CAN_E_HARDWARE_ERROR_GetEventTested: RteEventRef=OIE_EventInfo_CAN_E_HARDWARE_ERROR_GetEventTested
        RteEventToTaskMapping_OIE_EventInfo_CAN_E_HARDWARE_ERROR_GetFaultDetectionCounter: RteEventRef=OIE_EventInfo_CAN_E_HARDWARE_ERROR_GetFaultDetectionCounter
        RteEventToTaskMapping_OIE_EventInfo_DEM_E_TEST_EVENT1_GetDTCOfEvent: RteEventRef=OIE_EventInfo_DEM_E_TEST_EVENT1_GetDTCOfEvent
        RteEventToTaskMapping_OIE_EventInfo_DEM_E_TEST_EVENT1_GetEventExtendedDataRecord: RteEventRef=OIE_EventInfo_DEM_E_TEST_EVENT1_GetEventExtendedDataRecord
        RteEventToTaskMapping_OIE_EventInfo_DEM_E_TEST_EVENT1_GetEventFailed: RteEventRef=OIE_EventInfo_DEM_E_TEST_EVENT1_GetEventFailed
        RteEventToTaskMapping_OIE_EventInfo_DEM_E_TEST_EVENT1_GetEventFreezeFrameData: RteEventRef=OIE_EventInfo_DEM_E_TEST_EVENT1_GetEventFreezeFrameData
        RteEventToTaskMapping_OIE_EventInfo_DEM_E_TEST_EVENT1_GetEventStatus: RteEventRef=OIE_EventInfo_DEM_E_TEST_EVENT1_GetEventStatus
        RteEventToTaskMapping_OIE_EventInfo_DEM_E_TEST_EVENT1_GetEventTested: RteEventRef=OIE_EventInfo_DEM_E_TEST_EVENT1_GetEventTested
        RteEventToTaskMapping_OIE_EventInfo_DEM_E_TEST_EVENT1_GetFaultDetectionCounter: RteEventRef=OIE_EventInfo_DEM_E_TEST_EVENT1_GetFaultDetectionCounter
        RteEventToTaskMapping_OIE_EventInfo_DEM_E_TEST_EVENT2_GetDTCOfEvent: RteEventRef=OIE_EventInfo_DEM_E_TEST_EVENT2_GetDTCOfEvent
        RteEventToTaskMapping_OIE_EventInfo_DEM_E_TEST_EVENT2_GetEventExtendedDataRecord: RteEventRef=OIE_EventInfo_DEM_E_TEST_EVENT2_GetEventExtendedDataRecord
        RteEventToTaskMapping_OIE_EventInfo_DEM_E_TEST_EVENT2_GetEventFailed: RteEventRef=OIE_EventInfo_DEM_E_TEST_EVENT2_GetEventFailed
        RteEventToTaskMapping_OIE_EventInfo_DEM_E_TEST_EVENT2_GetEventFreezeFrameData: RteEventRef=OIE_EventInfo_DEM_E_TEST_EVENT2_GetEventFreezeFrameData
        RteEventToTaskMapping_OIE_EventInfo_DEM_E_TEST_EVENT2_GetEventStatus: RteEventRef=OIE_EventInfo_DEM_E_TEST_EVENT2_GetEventStatus
        RteEventToTaskMapping_OIE_EventInfo_DEM_E_TEST_EVENT2_GetEventTested: RteEventRef=OIE_EventInfo_DEM_E_TEST_EVENT2_GetEventTested
        RteEventToTaskMapping_OIE_EventInfo_DEM_E_TEST_EVENT2_GetFaultDetectionCounter: RteEventRef=OIE_EventInfo_DEM_E_TEST_EVENT2_GetFaultDetectionCounter
        RteEventToTaskMapping_OIE_EventInfo_DEM_E_TEST_EVENT3_GetDTCOfEvent: RteEventRef=OIE_EventInfo_DEM_E_TEST_EVENT3_GetDTCOfEvent
        RteEventToTaskMapping_OIE_EventInfo_DEM_E_TEST_EVENT3_GetEventExtendedDataRecord: RteEventRef=OIE_EventInfo_DEM_E_TEST_EVENT3_GetEventExtendedDataRecord
        RteEventToTaskMapping_OIE_EventInfo_DEM_E_TEST_EVENT3_GetEventFailed: RteEventRef=OIE_EventInfo_DEM_E_TEST_EVENT3_GetEventFailed
        RteEventToTaskMapping_OIE_EventInfo_DEM_E_TEST_EVENT3_GetEventFreezeFrameData: RteEventRef=OIE_EventInfo_DEM_E_TEST_EVENT3_GetEventFreezeFrameData
        RteEventToTaskMapping_OIE_EventInfo_DEM_E_TEST_EVENT3_GetEventStatus: RteEventRef=OIE_EventInfo_DEM_E_TEST_EVENT3_GetEventStatus
        RteEventToTaskMapping_OIE_EventInfo_DEM_E_TEST_EVENT3_GetEventTested: RteEventRef=OIE_EventInfo_DEM_E_TEST_EVENT3_GetEventTested
        RteEventToTaskMapping_OIE_EventInfo_DEM_E_TEST_EVENT3_GetFaultDetectionCounter: RteEventRef=OIE_EventInfo_DEM_E_TEST_EVENT3_GetFaultDetectionCounter
        RteEventToTaskMapping_OIE_EventInfo_DEM_E_TEST_EVENT4_GetDTCOfEvent: RteEventRef=OIE_EventInfo_DEM_E_TEST_EVENT4_GetDTCOfEvent
        RteEventToTaskMapping_OIE_EventInfo_DEM_E_TEST_EVENT4_GetEventExtendedDataRecord: RteEventRef=OIE_EventInfo_DEM_E_TEST_EVENT4_GetEventExtendedDataRecord
        RteEventToTaskMapping_OIE_EventInfo_DEM_E_TEST_EVENT4_GetEventFailed: RteEventRef=OIE_EventInfo_DEM_E_TEST_EVENT4_GetEventFailed
        RteEventToTaskMapping_OIE_EventInfo_DEM_E_TEST_EVENT4_GetEventFreezeFrameData: RteEventRef=OIE_EventInfo_DEM_E_TEST_EVENT4_GetEventFreezeFrameData
        RteEventToTaskMapping_OIE_EventInfo_DEM_E_TEST_EVENT4_GetEventStatus: RteEventRef=OIE_EventInfo_DEM_E_TEST_EVENT4_GetEventStatus
        RteEventToTaskMapping_OIE_EventInfo_DEM_E_TEST_EVENT4_GetEventTested: RteEventRef=OIE_EventInfo_DEM_E_TEST_EVENT4_GetEventTested
        RteEventToTaskMapping_OIE_EventInfo_DEM_E_TEST_EVENT4_GetFaultDetectionCounter: RteEventRef=OIE_EventInfo_DEM_E_TEST_EVENT4_GetFaultDetectionCounter
        RteEventToTaskMapping_OIE_EventInfo_DEM_E_TEST_EVENT5_GetDTCOfEvent: RteEventRef=OIE_EventInfo_DEM_E_TEST_EVENT5_GetDTCOfEvent
        RteEventToTaskMapping_OIE_EventInfo_DEM_E_TEST_EVENT5_GetEventExtendedDataRecord: RteEventRef=OIE_EventInfo_DEM_E_TEST_EVENT5_GetEventExtendedDataRecord
        RteEventToTaskMapping_OIE_EventInfo_DEM_E_TEST_EVENT5_GetEventFailed: RteEventRef=OIE_EventInfo_DEM_E_TEST_EVENT5_GetEventFailed
        RteEventToTaskMapping_OIE_EventInfo_DEM_E_TEST_EVENT5_GetEventFreezeFrameData: RteEventRef=OIE_EventInfo_DEM_E_TEST_EVENT5_GetEventFreezeFrameData
        RteEventToTaskMapping_OIE_EventInfo_DEM_E_TEST_EVENT5_GetEventStatus: RteEventRef=OIE_EventInfo_DEM_E_TEST_EVENT5_GetEventStatus
        RteEventToTaskMapping_OIE_EventInfo_DEM_E_TEST_EVENT5_GetEventTested: RteEventRef=OIE_EventInfo_DEM_E_TEST_EVENT5_GetEventTested
        RteEventToTaskMapping_OIE_EventInfo_DEM_E_TEST_EVENT5_GetFaultDetectionCounter: RteEventRef=OIE_EventInfo_DEM_E_TEST_EVENT5_GetFaultDetectionCounter
        RteEventToTaskMapping_OIE_EventInfo_DEM_E_TEST_EVENT6_GetDTCOfEvent: RteEventRef=OIE_EventInfo_DEM_E_TEST_EVENT6_GetDTCOfEvent
        RteEventToTaskMapping_OIE_EventInfo_DEM_E_TEST_EVENT6_GetEventExtendedDataRecord: RteEventRef=OIE_EventInfo_DEM_E_TEST_EVENT6_GetEventExtendedDataRecord
        RteEventToTaskMapping_OIE_EventInfo_DEM_E_TEST_EVENT6_GetEventFailed: RteEventRef=OIE_EventInfo_DEM_E_TEST_EVENT6_GetEventFailed
        RteEventToTaskMapping_OIE_EventInfo_DEM_E_TEST_EVENT6_GetEventFreezeFrameData: RteEventRef=OIE_EventInfo_DEM_E_TEST_EVENT6_GetEventFreezeFrameData
        RteEventToTaskMapping_OIE_EventInfo_DEM_E_TEST_EVENT6_GetEventStatus: RteEventRef=OIE_EventInfo_DEM_E_TEST_EVENT6_GetEventStatus
        RteEventToTaskMapping_OIE_EventInfo_DEM_E_TEST_EVENT6_GetEventTested: RteEventRef=OIE_EventInfo_DEM_E_TEST_EVENT6_GetEventTested
        RteEventToTaskMapping_OIE_EventInfo_DEM_E_TEST_EVENT6_GetFaultDetectionCounter: RteEventRef=OIE_EventInfo_DEM_E_TEST_EVENT6_GetFaultDetectionCounter
        RteEventToTaskMapping_OIE_EventInfo_ECUM_E_CONFIGURATION_DATA_INCONSISTENT_GetDTCOfEvent: RteEventRef=OIE_EventInfo_ECUM_E_CONFIGURATION_DATA_INCONSISTENT_GetDTCOfEvent
        RteEventToTaskMapping_OIE_EventInfo_ECUM_E_CONFIGURATION_DATA_INCONSISTENT_GetEventExtendedDataRecord: RteEventRef=OIE_EventInfo_ECUM_E_CONFIGURATION_DATA_INCONSISTENT_GetEventExtendedDataRecord
        RteEventToTaskMapping_OIE_EventInfo_ECUM_E_CONFIGURATION_DATA_INCONSISTENT_GetEventFailed: RteEventRef=OIE_EventInfo_ECUM_E_CONFIGURATION_DATA_INCONSISTENT_GetEventFailed
        RteEventToTaskMapping_OIE_EventInfo_ECUM_E_CONFIGURATION_DATA_INCONSISTENT_GetEventFreezeFrameData: RteEventRef=OIE_EventInfo_ECUM_E_CONFIGURATION_DATA_INCONSISTENT_GetEventFreezeFrameData
        RteEventToTaskMapping_OIE_EventInfo_ECUM_E_CONFIGURATION_DATA_INCONSISTENT_GetEventStatus: RteEventRef=OIE_EventInfo_ECUM_E_CONFIGURATION_DATA_INCONSISTENT_GetEventStatus
        RteEventToTaskMapping_OIE_EventInfo_ECUM_E_CONFIGURATION_DATA_INCONSISTENT_GetEventTested: RteEventRef=OIE_EventInfo_ECUM_E_CONFIGURATION_DATA_INCONSISTENT_GetEventTested
        RteEventToTaskMapping_OIE_EventInfo_ECUM_E_CONFIGURATION_DATA_INCONSISTENT_GetFaultDetectionCounter: RteEventRef=OIE_EventInfo_ECUM_E_CONFIGURATION_DATA_INCONSISTENT_GetFaultDetectionCounter
        RteEventToTaskMapping_OIE_EventInfo_ECUM_E_IMPROPER_CALLER_GetDTCOfEvent: RteEventRef=OIE_EventInfo_ECUM_E_IMPROPER_CALLER_GetDTCOfEvent
        RteEventToTaskMapping_OIE_EventInfo_ECUM_E_IMPROPER_CALLER_GetEventExtendedDataRecord: RteEventRef=OIE_EventInfo_ECUM_E_IMPROPER_CALLER_GetEventExtendedDataRecord
        RteEventToTaskMapping_OIE_EventInfo_ECUM_E_IMPROPER_CALLER_GetEventFailed: RteEventRef=OIE_EventInfo_ECUM_E_IMPROPER_CALLER_GetEventFailed
        RteEventToTaskMapping_OIE_EventInfo_ECUM_E_IMPROPER_CALLER_GetEventFreezeFrameData: RteEventRef=OIE_EventInfo_ECUM_E_IMPROPER_CALLER_GetEventFreezeFrameData
        RteEventToTaskMapping_OIE_EventInfo_ECUM_E_IMPROPER_CALLER_GetEventStatus: RteEventRef=OIE_EventInfo_ECUM_E_IMPROPER_CALLER_GetEventStatus
        RteEventToTaskMapping_OIE_EventInfo_ECUM_E_IMPROPER_CALLER_GetEventTested: RteEventRef=OIE_EventInfo_ECUM_E_IMPROPER_CALLER_GetEventTested
        RteEventToTaskMapping_OIE_EventInfo_ECUM_E_IMPROPER_CALLER_GetFaultDetectionCounter: RteEventRef=OIE_EventInfo_ECUM_E_IMPROPER_CALLER_GetFaultDetectionCounter
        RteEventToTaskMapping_OIE_EventInfo_ECUM_E_RAM_CHECK_FAILED_GetDTCOfEvent: RteEventRef=OIE_EventInfo_ECUM_E_RAM_CHECK_FAILED_GetDTCOfEvent
        RteEventToTaskMapping_OIE_EventInfo_ECUM_E_RAM_CHECK_FAILED_GetEventExtendedDataRecord: RteEventRef=OIE_EventInfo_ECUM_E_RAM_CHECK_FAILED_GetEventExtendedDataRecord
        RteEventToTaskMapping_OIE_EventInfo_ECUM_E_RAM_CHECK_FAILED_GetEventFailed: RteEventRef=OIE_EventInfo_ECUM_E_RAM_CHECK_FAILED_GetEventFailed
        RteEventToTaskMapping_OIE_EventInfo_ECUM_E_RAM_CHECK_FAILED_GetEventFreezeFrameData: RteEventRef=OIE_EventInfo_ECUM_E_RAM_CHECK_FAILED_GetEventFreezeFrameData
        RteEventToTaskMapping_OIE_EventInfo_ECUM_E_RAM_CHECK_FAILED_GetEventStatus: RteEventRef=OIE_EventInfo_ECUM_E_RAM_CHECK_FAILED_GetEventStatus
        RteEventToTaskMapping_OIE_EventInfo_ECUM_E_RAM_CHECK_FAILED_GetEventTested: RteEventRef=OIE_EventInfo_ECUM_E_RAM_CHECK_FAILED_GetEventTested
        RteEventToTaskMapping_OIE_EventInfo_ECUM_E_RAM_CHECK_FAILED_GetFaultDetectionCounter: RteEventRef=OIE_EventInfo_ECUM_E_RAM_CHECK_FAILED_GetFaultDetectionCounter
        RteEventToTaskMapping_OIE_EventInfo_EEP_E_COMPARE_FAILED_GetDTCOfEvent: RteEventRef=OIE_EventInfo_EEP_E_COMPARE_FAILED_GetDTCOfEvent
        RteEventToTaskMapping_OIE_EventInfo_EEP_E_COMPARE_FAILED_GetEventExtendedDataRecord: RteEventRef=OIE_EventInfo_EEP_E_COMPARE_FAILED_GetEventExtendedDataRecord
        RteEventToTaskMapping_OIE_EventInfo_EEP_E_COMPARE_FAILED_GetEventFailed: RteEventRef=OIE_EventInfo_EEP_E_COMPARE_FAILED_GetEventFailed
        RteEventToTaskMapping_OIE_EventInfo_EEP_E_COMPARE_FAILED_GetEventFreezeFrameData: RteEventRef=OIE_EventInfo_EEP_E_COMPARE_FAILED_GetEventFreezeFrameData
        RteEventToTaskMapping_OIE_EventInfo_EEP_E_COMPARE_FAILED_GetEventStatus: RteEventRef=OIE_EventInfo_EEP_E_COMPARE_FAILED_GetEventStatus
        RteEventToTaskMapping_OIE_EventInfo_EEP_E_COMPARE_FAILED_GetEventTested: RteEventRef=OIE_EventInfo_EEP_E_COMPARE_FAILED_GetEventTested
        RteEventToTaskMapping_OIE_EventInfo_EEP_E_COMPARE_FAILED_GetFaultDetectionCounter: RteEventRef=OIE_EventInfo_EEP_E_COMPARE_FAILED_GetFaultDetectionCounter
        RteEventToTaskMapping_OIE_EventInfo_EEP_E_ERASE_FAILED_GetDTCOfEvent: RteEventRef=OIE_EventInfo_EEP_E_ERASE_FAILED_GetDTCOfEvent
        RteEventToTaskMapping_OIE_EventInfo_EEP_E_ERASE_FAILED_GetEventExtendedDataRecord: RteEventRef=OIE_EventInfo_EEP_E_ERASE_FAILED_GetEventExtendedDataRecord
        RteEventToTaskMapping_OIE_EventInfo_EEP_E_ERASE_FAILED_GetEventFailed: RteEventRef=OIE_EventInfo_EEP_E_ERASE_FAILED_GetEventFailed
        RteEventToTaskMapping_OIE_EventInfo_EEP_E_ERASE_FAILED_GetEventFreezeFrameData: RteEventRef=OIE_EventInfo_EEP_E_ERASE_FAILED_GetEventFreezeFrameData
        RteEventToTaskMapping_OIE_EventInfo_EEP_E_ERASE_FAILED_GetEventStatus: RteEventRef=OIE_EventInfo_EEP_E_ERASE_FAILED_GetEventStatus
        RteEventToTaskMapping_OIE_EventInfo_EEP_E_ERASE_FAILED_GetEventTested: RteEventRef=OIE_EventInfo_EEP_E_ERASE_FAILED_GetEventTested
        RteEventToTaskMapping_OIE_EventInfo_EEP_E_ERASE_FAILED_GetFaultDetectionCounter: RteEventRef=OIE_EventInfo_EEP_E_ERASE_FAILED_GetFaultDetectionCounter
        RteEventToTaskMapping_OIE_EventInfo_EEP_E_READ_FAILED_GetDTCOfEvent: RteEventRef=OIE_EventInfo_EEP_E_READ_FAILED_GetDTCOfEvent
        RteEventToTaskMapping_OIE_EventInfo_EEP_E_READ_FAILED_GetEventExtendedDataRecord: RteEventRef=OIE_EventInfo_EEP_E_READ_FAILED_GetEventExtendedDataRecord
        RteEventToTaskMapping_OIE_EventInfo_EEP_E_READ_FAILED_GetEventFailed: RteEventRef=OIE_EventInfo_EEP_E_READ_FAILED_GetEventFailed
        RteEventToTaskMapping_OIE_EventInfo_EEP_E_READ_FAILED_GetEventFreezeFrameData: RteEventRef=OIE_EventInfo_EEP_E_READ_FAILED_GetEventFreezeFrameData
        RteEventToTaskMapping_OIE_EventInfo_EEP_E_READ_FAILED_GetEventStatus: RteEventRef=OIE_EventInfo_EEP_E_READ_FAILED_GetEventStatus
        RteEventToTaskMapping_OIE_EventInfo_EEP_E_READ_FAILED_GetEventTested: RteEventRef=OIE_EventInfo_EEP_E_READ_FAILED_GetEventTested
        RteEventToTaskMapping_OIE_EventInfo_EEP_E_READ_FAILED_GetFaultDetectionCounter: RteEventRef=OIE_EventInfo_EEP_E_READ_FAILED_GetFaultDetectionCounter
        RteEventToTaskMapping_OIE_EventInfo_EEP_E_WRITE_FAILED_GetDTCOfEvent: RteEventRef=OIE_EventInfo_EEP_E_WRITE_FAILED_GetDTCOfEvent
        RteEventToTaskMapping_OIE_EventInfo_EEP_E_WRITE_FAILED_GetEventExtendedDataRecord: RteEventRef=OIE_EventInfo_EEP_E_WRITE_FAILED_GetEventExtendedDataRecord
        RteEventToTaskMapping_OIE_EventInfo_EEP_E_WRITE_FAILED_GetEventFailed: RteEventRef=OIE_EventInfo_EEP_E_WRITE_FAILED_GetEventFailed
        RteEventToTaskMapping_OIE_EventInfo_EEP_E_WRITE_FAILED_GetEventFreezeFrameData: RteEventRef=OIE_EventInfo_EEP_E_WRITE_FAILED_GetEventFreezeFrameData
        RteEventToTaskMapping_OIE_EventInfo_EEP_E_WRITE_FAILED_GetEventStatus: RteEventRef=OIE_EventInfo_EEP_E_WRITE_FAILED_GetEventStatus
        RteEventToTaskMapping_OIE_EventInfo_EEP_E_WRITE_FAILED_GetEventTested: RteEventRef=OIE_EventInfo_EEP_E_WRITE_FAILED_GetEventTested
        RteEventToTaskMapping_OIE_EventInfo_EEP_E_WRITE_FAILED_GetFaultDetectionCounter: RteEventRef=OIE_EventInfo_EEP_E_WRITE_FAILED_GetFaultDetectionCounter
        RteEventToTaskMapping_OIE_EventInfo_ICU_E_HARDWARE_ERROR_GetDTCOfEvent: RteEventRef=OIE_EventInfo_ICU_E_HARDWARE_ERROR_GetDTCOfEvent
        RteEventToTaskMapping_OIE_EventInfo_ICU_E_HARDWARE_ERROR_GetEventExtendedDataRecord: RteEventRef=OIE_EventInfo_ICU_E_HARDWARE_ERROR_GetEventExtendedDataRecord
        RteEventToTaskMapping_OIE_EventInfo_ICU_E_HARDWARE_ERROR_GetEventFailed: RteEventRef=OIE_EventInfo_ICU_E_HARDWARE_ERROR_GetEventFailed
        RteEventToTaskMapping_OIE_EventInfo_ICU_E_HARDWARE_ERROR_GetEventFreezeFrameData: RteEventRef=OIE_EventInfo_ICU_E_HARDWARE_ERROR_GetEventFreezeFrameData
        RteEventToTaskMapping_OIE_EventInfo_ICU_E_HARDWARE_ERROR_GetEventStatus: RteEventRef=OIE_EventInfo_ICU_E_HARDWARE_ERROR_GetEventStatus
        RteEventToTaskMapping_OIE_EventInfo_ICU_E_HARDWARE_ERROR_GetEventTested: RteEventRef=OIE_EventInfo_ICU_E_HARDWARE_ERROR_GetEventTested
        RteEventToTaskMapping_OIE_EventInfo_ICU_E_HARDWARE_ERROR_GetFaultDetectionCounter: RteEventRef=OIE_EventInfo_ICU_E_HARDWARE_ERROR_GetFaultDetectionCounter
        RteEventToTaskMapping_OIE_EventInfo_IOHWAB_E_BUSY_GetDTCOfEvent: RteEventRef=OIE_EventInfo_IOHWAB_E_BUSY_GetDTCOfEvent
        RteEventToTaskMapping_OIE_EventInfo_IOHWAB_E_BUSY_GetEventExtendedDataRecord: RteEventRef=OIE_EventInfo_IOHWAB_E_BUSY_GetEventExtendedDataRecord
        RteEventToTaskMapping_OIE_EventInfo_IOHWAB_E_BUSY_GetEventFailed: RteEventRef=OIE_EventInfo_IOHWAB_E_BUSY_GetEventFailed
        RteEventToTaskMapping_OIE_EventInfo_IOHWAB_E_BUSY_GetEventFreezeFrameData: RteEventRef=OIE_EventInfo_IOHWAB_E_BUSY_GetEventFreezeFrameData
        RteEventToTaskMapping_OIE_EventInfo_IOHWAB_E_BUSY_GetEventStatus: RteEventRef=OIE_EventInfo_IOHWAB_E_BUSY_GetEventStatus
        RteEventToTaskMapping_OIE_EventInfo_IOHWAB_E_BUSY_GetEventTested: RteEventRef=OIE_EventInfo_IOHWAB_E_BUSY_GetEventTested
        RteEventToTaskMapping_OIE_EventInfo_IOHWAB_E_BUSY_GetFaultDetectionCounter: RteEventRef=OIE_EventInfo_IOHWAB_E_BUSY_GetFaultDetectionCounter
        RteEventToTaskMapping_OIE_EventInfo_IOHWAB_E_PROC_FAIL_GetDTCOfEvent: RteEventRef=OIE_EventInfo_IOHWAB_E_PROC_FAIL_GetDTCOfEvent
        RteEventToTaskMapping_OIE_EventInfo_IOHWAB_E_PROC_FAIL_GetEventExtendedDataRecord: RteEventRef=OIE_EventInfo_IOHWAB_E_PROC_FAIL_GetEventExtendedDataRecord
        RteEventToTaskMapping_OIE_EventInfo_IOHWAB_E_PROC_FAIL_GetEventFailed: RteEventRef=OIE_EventInfo_IOHWAB_E_PROC_FAIL_GetEventFailed
        RteEventToTaskMapping_OIE_EventInfo_IOHWAB_E_PROC_FAIL_GetEventFreezeFrameData: RteEventRef=OIE_EventInfo_IOHWAB_E_PROC_FAIL_GetEventFreezeFrameData
        RteEventToTaskMapping_OIE_EventInfo_IOHWAB_E_PROC_FAIL_GetEventStatus: RteEventRef=OIE_EventInfo_IOHWAB_E_PROC_FAIL_GetEventStatus
        RteEventToTaskMapping_OIE_EventInfo_IOHWAB_E_PROC_FAIL_GetEventTested: RteEventRef=OIE_EventInfo_IOHWAB_E_PROC_FAIL_GetEventTested
        RteEventToTaskMapping_OIE_EventInfo_IOHWAB_E_PROC_FAIL_GetFaultDetectionCounter: RteEventRef=OIE_EventInfo_IOHWAB_E_PROC_FAIL_GetFaultDetectionCounter
        RteEventToTaskMapping_OIE_EventInfo_IOHWAB_E_SETUP_FAIL_GetDTCOfEvent: RteEventRef=OIE_EventInfo_IOHWAB_E_SETUP_FAIL_GetDTCOfEvent
        RteEventToTaskMapping_OIE_EventInfo_IOHWAB_E_SETUP_FAIL_GetEventExtendedDataRecord: RteEventRef=OIE_EventInfo_IOHWAB_E_SETUP_FAIL_GetEventExtendedDataRecord
        RteEventToTaskMapping_OIE_EventInfo_IOHWAB_E_SETUP_FAIL_GetEventFailed: RteEventRef=OIE_EventInfo_IOHWAB_E_SETUP_FAIL_GetEventFailed
        RteEventToTaskMapping_OIE_EventInfo_IOHWAB_E_SETUP_FAIL_GetEventFreezeFrameData: RteEventRef=OIE_EventInfo_IOHWAB_E_SETUP_FAIL_GetEventFreezeFrameData
        RteEventToTaskMapping_OIE_EventInfo_IOHWAB_E_SETUP_FAIL_GetEventStatus: RteEventRef=OIE_EventInfo_IOHWAB_E_SETUP_FAIL_GetEventStatus
        RteEventToTaskMapping_OIE_EventInfo_IOHWAB_E_SETUP_FAIL_GetEventTested: RteEventRef=OIE_EventInfo_IOHWAB_E_SETUP_FAIL_GetEventTested
        RteEventToTaskMapping_OIE_EventInfo_IOHWAB_E_SETUP_FAIL_GetFaultDetectionCounter: RteEventRef=OIE_EventInfo_IOHWAB_E_SETUP_FAIL_GetFaultDetectionCounter
        RteEventToTaskMapping_OIE_EventInfo_IOHWAB_E_WRONG_PARAM_GetDTCOfEvent: RteEventRef=OIE_EventInfo_IOHWAB_E_WRONG_PARAM_GetDTCOfEvent
        RteEventToTaskMapping_OIE_EventInfo_IOHWAB_E_WRONG_PARAM_GetEventExtendedDataRecord: RteEventRef=OIE_EventInfo_IOHWAB_E_WRONG_PARAM_GetEventExtendedDataRecord
        RteEventToTaskMapping_OIE_EventInfo_IOHWAB_E_WRONG_PARAM_GetEventFailed: RteEventRef=OIE_EventInfo_IOHWAB_E_WRONG_PARAM_GetEventFailed
        RteEventToTaskMapping_OIE_EventInfo_IOHWAB_E_WRONG_PARAM_GetEventFreezeFrameData: RteEventRef=OIE_EventInfo_IOHWAB_E_WRONG_PARAM_GetEventFreezeFrameData
        RteEventToTaskMapping_OIE_EventInfo_IOHWAB_E_WRONG_PARAM_GetEventStatus: RteEventRef=OIE_EventInfo_IOHWAB_E_WRONG_PARAM_GetEventStatus
        RteEventToTaskMapping_OIE_EventInfo_IOHWAB_E_WRONG_PARAM_GetEventTested: RteEventRef=OIE_EventInfo_IOHWAB_E_WRONG_PARAM_GetEventTested
        RteEventToTaskMapping_OIE_EventInfo_IOHWAB_E_WRONG_PARAM_GetFaultDetectionCounter: RteEventRef=OIE_EventInfo_IOHWAB_E_WRONG_PARAM_GetFaultDetectionCounter
        RteEventToTaskMapping_OIE_EventInfo_IOHWAB_E_WRONG_SETTING_GetDTCOfEvent: RteEventRef=OIE_EventInfo_IOHWAB_E_WRONG_SETTING_GetDTCOfEvent
        RteEventToTaskMapping_OIE_EventInfo_IOHWAB_E_WRONG_SETTING_GetEventExtendedDataRecord: RteEventRef=OIE_EventInfo_IOHWAB_E_WRONG_SETTING_GetEventExtendedDataRecord
        RteEventToTaskMapping_OIE_EventInfo_IOHWAB_E_WRONG_SETTING_GetEventFailed: RteEventRef=OIE_EventInfo_IOHWAB_E_WRONG_SETTING_GetEventFailed
        RteEventToTaskMapping_OIE_EventInfo_IOHWAB_E_WRONG_SETTING_GetEventFreezeFrameData: RteEventRef=OIE_EventInfo_IOHWAB_E_WRONG_SETTING_GetEventFreezeFrameData
        RteEventToTaskMapping_OIE_EventInfo_IOHWAB_E_WRONG_SETTING_GetEventStatus: RteEventRef=OIE_EventInfo_IOHWAB_E_WRONG_SETTING_GetEventStatus
        RteEventToTaskMapping_OIE_EventInfo_IOHWAB_E_WRONG_SETTING_GetEventTested: RteEventRef=OIE_EventInfo_IOHWAB_E_WRONG_SETTING_GetEventTested
        RteEventToTaskMapping_OIE_EventInfo_IOHWAB_E_WRONG_SETTING_GetFaultDetectionCounter: RteEventRef=OIE_EventInfo_IOHWAB_E_WRONG_SETTING_GetFaultDetectionCounter
        RteEventToTaskMapping_OIE_EventInfo_IOHWAB_E_WRONG_STATE_GetDTCOfEvent: RteEventRef=OIE_EventInfo_IOHWAB_E_WRONG_STATE_GetDTCOfEvent
        RteEventToTaskMapping_OIE_EventInfo_IOHWAB_E_WRONG_STATE_GetEventExtendedDataRecord: RteEventRef=OIE_EventInfo_IOHWAB_E_WRONG_STATE_GetEventExtendedDataRecord
        RteEventToTaskMapping_OIE_EventInfo_IOHWAB_E_WRONG_STATE_GetEventFailed: RteEventRef=OIE_EventInfo_IOHWAB_E_WRONG_STATE_GetEventFailed
        RteEventToTaskMapping_OIE_EventInfo_IOHWAB_E_WRONG_STATE_GetEventFreezeFrameData: RteEventRef=OIE_EventInfo_IOHWAB_E_WRONG_STATE_GetEventFreezeFrameData
        RteEventToTaskMapping_OIE_EventInfo_IOHWAB_E_WRONG_STATE_GetEventStatus: RteEventRef=OIE_EventInfo_IOHWAB_E_WRONG_STATE_GetEventStatus
        RteEventToTaskMapping_OIE_EventInfo_IOHWAB_E_WRONG_STATE_GetEventTested: RteEventRef=OIE_EventInfo_IOHWAB_E_WRONG_STATE_GetEventTested
        RteEventToTaskMapping_OIE_EventInfo_IOHWAB_E_WRONG_STATE_GetFaultDetectionCounter: RteEventRef=OIE_EventInfo_IOHWAB_E_WRONG_STATE_GetFaultDetectionCounter
        RteEventToTaskMapping_OIE_EventInfo_LIN_E_TIMEOUT_GetDTCOfEvent: RteEventRef=OIE_EventInfo_LIN_E_TIMEOUT_GetDTCOfEvent
        RteEventToTaskMapping_OIE_EventInfo_LIN_E_TIMEOUT_GetEventExtendedDataRecord: RteEventRef=OIE_EventInfo_LIN_E_TIMEOUT_GetEventExtendedDataRecord
        RteEventToTaskMapping_OIE_EventInfo_LIN_E_TIMEOUT_GetEventFailed: RteEventRef=OIE_EventInfo_LIN_E_TIMEOUT_GetEventFailed
        RteEventToTaskMapping_OIE_EventInfo_LIN_E_TIMEOUT_GetEventFreezeFrameData: RteEventRef=OIE_EventInfo_LIN_E_TIMEOUT_GetEventFreezeFrameData
        RteEventToTaskMapping_OIE_EventInfo_LIN_E_TIMEOUT_GetEventStatus: RteEventRef=OIE_EventInfo_LIN_E_TIMEOUT_GetEventStatus
        RteEventToTaskMapping_OIE_EventInfo_LIN_E_TIMEOUT_GetEventTested: RteEventRef=OIE_EventInfo_LIN_E_TIMEOUT_GetEventTested
        RteEventToTaskMapping_OIE_EventInfo_LIN_E_TIMEOUT_GetFaultDetectionCounter: RteEventRef=OIE_EventInfo_LIN_E_TIMEOUT_GetFaultDetectionCounter
        RteEventToTaskMapping_OIE_EventInfo_MCU_E_CLOCK_FAILURE_GetDTCOfEvent: RteEventRef=OIE_EventInfo_MCU_E_CLOCK_FAILURE_GetDTCOfEvent
        RteEventToTaskMapping_OIE_EventInfo_MCU_E_CLOCK_FAILURE_GetEventExtendedDataRecord: RteEventRef=OIE_EventInfo_MCU_E_CLOCK_FAILURE_GetEventExtendedDataRecord
        RteEventToTaskMapping_OIE_EventInfo_MCU_E_CLOCK_FAILURE_GetEventFailed: RteEventRef=OIE_EventInfo_MCU_E_CLOCK_FAILURE_GetEventFailed
        RteEventToTaskMapping_OIE_EventInfo_MCU_E_CLOCK_FAILURE_GetEventFreezeFrameData: RteEventRef=OIE_EventInfo_MCU_E_CLOCK_FAILURE_GetEventFreezeFrameData
        RteEventToTaskMapping_OIE_EventInfo_MCU_E_CLOCK_FAILURE_GetEventStatus: RteEventRef=OIE_EventInfo_MCU_E_CLOCK_FAILURE_GetEventStatus
        RteEventToTaskMapping_OIE_EventInfo_MCU_E_CLOCK_FAILURE_GetEventTested: RteEventRef=OIE_EventInfo_MCU_E_CLOCK_FAILURE_GetEventTested
        RteEventToTaskMapping_OIE_EventInfo_MCU_E_CLOCK_FAILURE_GetFaultDetectionCounter: RteEventRef=OIE_EventInfo_MCU_E_CLOCK_FAILURE_GetFaultDetectionCounter
        RteEventToTaskMapping_OIE_EventInfo_MCU_E_RESET_FAILURE_GetDTCOfEvent: RteEventRef=OIE_EventInfo_MCU_E_RESET_FAILURE_GetDTCOfEvent
        RteEventToTaskMapping_OIE_EventInfo_MCU_E_RESET_FAILURE_GetEventExtendedDataRecord: RteEventRef=OIE_EventInfo_MCU_E_RESET_FAILURE_GetEventExtendedDataRecord
        RteEventToTaskMapping_OIE_EventInfo_MCU_E_RESET_FAILURE_GetEventFailed: RteEventRef=OIE_EventInfo_MCU_E_RESET_FAILURE_GetEventFailed
        RteEventToTaskMapping_OIE_EventInfo_MCU_E_RESET_FAILURE_GetEventFreezeFrameData: RteEventRef=OIE_EventInfo_MCU_E_RESET_FAILURE_GetEventFreezeFrameData
        RteEventToTaskMapping_OIE_EventInfo_MCU_E_RESET_FAILURE_GetEventStatus: RteEventRef=OIE_EventInfo_MCU_E_RESET_FAILURE_GetEventStatus
        RteEventToTaskMapping_OIE_EventInfo_MCU_E_RESET_FAILURE_GetEventTested: RteEventRef=OIE_EventInfo_MCU_E_RESET_FAILURE_GetEventTested
        RteEventToTaskMapping_OIE_EventInfo_MCU_E_RESET_FAILURE_GetFaultDetectionCounter: RteEventRef=OIE_EventInfo_MCU_E_RESET_FAILURE_GetFaultDetectionCounter
        RteEventToTaskMapping_OIE_EventInfo_NVM_E_INTEGRITY_FAILED_GetDTCOfEvent: RteEventRef=OIE_EventInfo_NVM_E_INTEGRITY_FAILED_GetDTCOfEvent
        RteEventToTaskMapping_OIE_EventInfo_NVM_E_INTEGRITY_FAILED_GetEventExtendedDataRecord: RteEventRef=OIE_EventInfo_NVM_E_INTEGRITY_FAILED_GetEventExtendedDataRecord
        RteEventToTaskMapping_OIE_EventInfo_NVM_E_INTEGRITY_FAILED_GetEventFailed: RteEventRef=OIE_EventInfo_NVM_E_INTEGRITY_FAILED_GetEventFailed
        RteEventToTaskMapping_OIE_EventInfo_NVM_E_INTEGRITY_FAILED_GetEventFreezeFrameData: RteEventRef=OIE_EventInfo_NVM_E_INTEGRITY_FAILED_GetEventFreezeFrameData
        RteEventToTaskMapping_OIE_EventInfo_NVM_E_INTEGRITY_FAILED_GetEventStatus: RteEventRef=OIE_EventInfo_NVM_E_INTEGRITY_FAILED_GetEventStatus
        RteEventToTaskMapping_OIE_EventInfo_NVM_E_INTEGRITY_FAILED_GetEventTested: RteEventRef=OIE_EventInfo_NVM_E_INTEGRITY_FAILED_GetEventTested
        RteEventToTaskMapping_OIE_EventInfo_NVM_E_INTEGRITY_FAILED_GetFaultDetectionCounter: RteEventRef=OIE_EventInfo_NVM_E_INTEGRITY_FAILED_GetFaultDetectionCounter
        RteEventToTaskMapping_OIE_EventInfo_NVM_E_LOSS_OF_REDUNDANCY_GetDTCOfEvent: RteEventRef=OIE_EventInfo_NVM_E_LOSS_OF_REDUNDANCY_GetDTCOfEvent
        RteEventToTaskMapping_OIE_EventInfo_NVM_E_LOSS_OF_REDUNDANCY_GetEventExtendedDataRecord: RteEventRef=OIE_EventInfo_NVM_E_LOSS_OF_REDUNDANCY_GetEventExtendedDataRecord
        RteEventToTaskMapping_OIE_EventInfo_NVM_E_LOSS_OF_REDUNDANCY_GetEventFailed: RteEventRef=OIE_EventInfo_NVM_E_LOSS_OF_REDUNDANCY_GetEventFailed
        RteEventToTaskMapping_OIE_EventInfo_NVM_E_LOSS_OF_REDUNDANCY_GetEventFreezeFrameData: RteEventRef=OIE_EventInfo_NVM_E_LOSS_OF_REDUNDANCY_GetEventFreezeFrameData
        RteEventToTaskMapping_OIE_EventInfo_NVM_E_LOSS_OF_REDUNDANCY_GetEventStatus: RteEventRef=OIE_EventInfo_NVM_E_LOSS_OF_REDUNDANCY_GetEventStatus
        RteEventToTaskMapping_OIE_EventInfo_NVM_E_LOSS_OF_REDUNDANCY_GetEventTested: RteEventRef=OIE_EventInfo_NVM_E_LOSS_OF_REDUNDANCY_GetEventTested
        RteEventToTaskMapping_OIE_EventInfo_NVM_E_LOSS_OF_REDUNDANCY_GetFaultDetectionCounter: RteEventRef=OIE_EventInfo_NVM_E_LOSS_OF_REDUNDANCY_GetFaultDetectionCounter
        RteEventToTaskMapping_OIE_EventInfo_NVM_E_QUEUE_OVERFLOW_GetDTCOfEvent: RteEventRef=OIE_EventInfo_NVM_E_QUEUE_OVERFLOW_GetDTCOfEvent
        RteEventToTaskMapping_OIE_EventInfo_NVM_E_QUEUE_OVERFLOW_GetEventExtendedDataRecord: RteEventRef=OIE_EventInfo_NVM_E_QUEUE_OVERFLOW_GetEventExtendedDataRecord
        RteEventToTaskMapping_OIE_EventInfo_NVM_E_QUEUE_OVERFLOW_GetEventFailed: RteEventRef=OIE_EventInfo_NVM_E_QUEUE_OVERFLOW_GetEventFailed
        RteEventToTaskMapping_OIE_EventInfo_NVM_E_QUEUE_OVERFLOW_GetEventFreezeFrameData: RteEventRef=OIE_EventInfo_NVM_E_QUEUE_OVERFLOW_GetEventFreezeFrameData
        RteEventToTaskMapping_OIE_EventInfo_NVM_E_QUEUE_OVERFLOW_GetEventStatus: RteEventRef=OIE_EventInfo_NVM_E_QUEUE_OVERFLOW_GetEventStatus
        RteEventToTaskMapping_OIE_EventInfo_NVM_E_QUEUE_OVERFLOW_GetEventTested: RteEventRef=OIE_EventInfo_NVM_E_QUEUE_OVERFLOW_GetEventTested
        RteEventToTaskMapping_OIE_EventInfo_NVM_E_QUEUE_OVERFLOW_GetFaultDetectionCounter: RteEventRef=OIE_EventInfo_NVM_E_QUEUE_OVERFLOW_GetFaultDetectionCounter
        RteEventToTaskMapping_OIE_EventInfo_NVM_E_REQ_FAILED_GetDTCOfEvent: RteEventRef=OIE_EventInfo_NVM_E_REQ_FAILED_GetDTCOfEvent
        RteEventToTaskMapping_OIE_EventInfo_NVM_E_REQ_FAILED_GetEventExtendedDataRecord: RteEventRef=OIE_EventInfo_NVM_E_REQ_FAILED_GetEventExtendedDataRecord
        RteEventToTaskMapping_OIE_EventInfo_NVM_E_REQ_FAILED_GetEventFailed: RteEventRef=OIE_EventInfo_NVM_E_REQ_FAILED_GetEventFailed
        RteEventToTaskMapping_OIE_EventInfo_NVM_E_REQ_FAILED_GetEventFreezeFrameData: RteEventRef=OIE_EventInfo_NVM_E_REQ_FAILED_GetEventFreezeFrameData
        RteEventToTaskMapping_OIE_EventInfo_NVM_E_REQ_FAILED_GetEventStatus: RteEventRef=OIE_EventInfo_NVM_E_REQ_FAILED_GetEventStatus
        RteEventToTaskMapping_OIE_EventInfo_NVM_E_REQ_FAILED_GetEventTested: RteEventRef=OIE_EventInfo_NVM_E_REQ_FAILED_GetEventTested
        RteEventToTaskMapping_OIE_EventInfo_NVM_E_REQ_FAILED_GetFaultDetectionCounter: RteEventRef=OIE_EventInfo_NVM_E_REQ_FAILED_GetFaultDetectionCounter
        RteEventToTaskMapping_OIE_EventInfo_NVM_E_VERIFY_FAILED_GetDTCOfEvent: RteEventRef=OIE_EventInfo_NVM_E_VERIFY_FAILED_GetDTCOfEvent
        RteEventToTaskMapping_OIE_EventInfo_NVM_E_VERIFY_FAILED_GetEventExtendedDataRecord: RteEventRef=OIE_EventInfo_NVM_E_VERIFY_FAILED_GetEventExtendedDataRecord
        RteEventToTaskMapping_OIE_EventInfo_NVM_E_VERIFY_FAILED_GetEventFailed: RteEventRef=OIE_EventInfo_NVM_E_VERIFY_FAILED_GetEventFailed
        RteEventToTaskMapping_OIE_EventInfo_NVM_E_VERIFY_FAILED_GetEventFreezeFrameData: RteEventRef=OIE_EventInfo_NVM_E_VERIFY_FAILED_GetEventFreezeFrameData
        RteEventToTaskMapping_OIE_EventInfo_NVM_E_VERIFY_FAILED_GetEventStatus: RteEventRef=OIE_EventInfo_NVM_E_VERIFY_FAILED_GetEventStatus
        RteEventToTaskMapping_OIE_EventInfo_NVM_E_VERIFY_FAILED_GetEventTested: RteEventRef=OIE_EventInfo_NVM_E_VERIFY_FAILED_GetEventTested
        RteEventToTaskMapping_OIE_EventInfo_NVM_E_VERIFY_FAILED_GetFaultDetectionCounter: RteEventRef=OIE_EventInfo_NVM_E_VERIFY_FAILED_GetFaultDetectionCounter
        RteEventToTaskMapping_OIE_EventInfo_NVM_E_WRITE_PROTECTED_GetDTCOfEvent: RteEventRef=OIE_EventInfo_NVM_E_WRITE_PROTECTED_GetDTCOfEvent
        RteEventToTaskMapping_OIE_EventInfo_NVM_E_WRITE_PROTECTED_GetEventExtendedDataRecord: RteEventRef=OIE_EventInfo_NVM_E_WRITE_PROTECTED_GetEventExtendedDataRecord
        RteEventToTaskMapping_OIE_EventInfo_NVM_E_WRITE_PROTECTED_GetEventFailed: RteEventRef=OIE_EventInfo_NVM_E_WRITE_PROTECTED_GetEventFailed
        RteEventToTaskMapping_OIE_EventInfo_NVM_E_WRITE_PROTECTED_GetEventFreezeFrameData: RteEventRef=OIE_EventInfo_NVM_E_WRITE_PROTECTED_GetEventFreezeFrameData
        RteEventToTaskMapping_OIE_EventInfo_NVM_E_WRITE_PROTECTED_GetEventStatus: RteEventRef=OIE_EventInfo_NVM_E_WRITE_PROTECTED_GetEventStatus
        RteEventToTaskMapping_OIE_EventInfo_NVM_E_WRITE_PROTECTED_GetEventTested: RteEventRef=OIE_EventInfo_NVM_E_WRITE_PROTECTED_GetEventTested
        RteEventToTaskMapping_OIE_EventInfo_NVM_E_WRITE_PROTECTED_GetFaultDetectionCounter: RteEventRef=OIE_EventInfo_NVM_E_WRITE_PROTECTED_GetFaultDetectionCounter
        RteEventToTaskMapping_OIE_EventInfo_NVM_E_WRONG_BLOCK_ID_GetDTCOfEvent: RteEventRef=OIE_EventInfo_NVM_E_WRONG_BLOCK_ID_GetDTCOfEvent
        RteEventToTaskMapping_OIE_EventInfo_NVM_E_WRONG_BLOCK_ID_GetEventExtendedDataRecord: RteEventRef=OIE_EventInfo_NVM_E_WRONG_BLOCK_ID_GetEventExtendedDataRecord
        RteEventToTaskMapping_OIE_EventInfo_NVM_E_WRONG_BLOCK_ID_GetEventFailed: RteEventRef=OIE_EventInfo_NVM_E_WRONG_BLOCK_ID_GetEventFailed
        RteEventToTaskMapping_OIE_EventInfo_NVM_E_WRONG_BLOCK_ID_GetEventFreezeFrameData: RteEventRef=OIE_EventInfo_NVM_E_WRONG_BLOCK_ID_GetEventFreezeFrameData
        RteEventToTaskMapping_OIE_EventInfo_NVM_E_WRONG_BLOCK_ID_GetEventStatus: RteEventRef=OIE_EventInfo_NVM_E_WRONG_BLOCK_ID_GetEventStatus
        RteEventToTaskMapping_OIE_EventInfo_NVM_E_WRONG_BLOCK_ID_GetEventTested: RteEventRef=OIE_EventInfo_NVM_E_WRONG_BLOCK_ID_GetEventTested
        RteEventToTaskMapping_OIE_EventInfo_NVM_E_WRONG_BLOCK_ID_GetFaultDetectionCounter: RteEventRef=OIE_EventInfo_NVM_E_WRONG_BLOCK_ID_GetFaultDetectionCounter
        RteEventToTaskMapping_OIE_EventInfo_RAMTST_E_RAM_FAILURE_GetDTCOfEvent: RteEventRef=OIE_EventInfo_RAMTST_E_RAM_FAILURE_GetDTCOfEvent
        RteEventToTaskMapping_OIE_EventInfo_RAMTST_E_RAM_FAILURE_GetEventExtendedDataRecord: RteEventRef=OIE_EventInfo_RAMTST_E_RAM_FAILURE_GetEventExtendedDataRecord
        RteEventToTaskMapping_OIE_EventInfo_RAMTST_E_RAM_FAILURE_GetEventFailed: RteEventRef=OIE_EventInfo_RAMTST_E_RAM_FAILURE_GetEventFailed
        RteEventToTaskMapping_OIE_EventInfo_RAMTST_E_RAM_FAILURE_GetEventFreezeFrameData: RteEventRef=OIE_EventInfo_RAMTST_E_RAM_FAILURE_GetEventFreezeFrameData
        RteEventToTaskMapping_OIE_EventInfo_RAMTST_E_RAM_FAILURE_GetEventStatus: RteEventRef=OIE_EventInfo_RAMTST_E_RAM_FAILURE_GetEventStatus
        RteEventToTaskMapping_OIE_EventInfo_RAMTST_E_RAM_FAILURE_GetEventTested: RteEventRef=OIE_EventInfo_RAMTST_E_RAM_FAILURE_GetEventTested
        RteEventToTaskMapping_OIE_EventInfo_RAMTST_E_RAM_FAILURE_GetFaultDetectionCounter: RteEventRef=OIE_EventInfo_RAMTST_E_RAM_FAILURE_GetFaultDetectionCounter
        RteEventToTaskMapping_OIE_EventInfo_SPI_E_HARDWARE_ERROR_GetDTCOfEvent: RteEventRef=OIE_EventInfo_SPI_E_HARDWARE_ERROR_GetDTCOfEvent
        RteEventToTaskMapping_OIE_EventInfo_SPI_E_HARDWARE_ERROR_GetEventExtendedDataRecord: RteEventRef=OIE_EventInfo_SPI_E_HARDWARE_ERROR_GetEventExtendedDataRecord
        RteEventToTaskMapping_OIE_EventInfo_SPI_E_HARDWARE_ERROR_GetEventFailed: RteEventRef=OIE_EventInfo_SPI_E_HARDWARE_ERROR_GetEventFailed
        RteEventToTaskMapping_OIE_EventInfo_SPI_E_HARDWARE_ERROR_GetEventFreezeFrameData: RteEventRef=OIE_EventInfo_SPI_E_HARDWARE_ERROR_GetEventFreezeFrameData
        RteEventToTaskMapping_OIE_EventInfo_SPI_E_HARDWARE_ERROR_GetEventStatus: RteEventRef=OIE_EventInfo_SPI_E_HARDWARE_ERROR_GetEventStatus
        RteEventToTaskMapping_OIE_EventInfo_SPI_E_HARDWARE_ERROR_GetEventTested: RteEventRef=OIE_EventInfo_SPI_E_HARDWARE_ERROR_GetEventTested
        RteEventToTaskMapping_OIE_EventInfo_SPI_E_HARDWARE_ERROR_GetFaultDetectionCounter: RteEventRef=OIE_EventInfo_SPI_E_HARDWARE_ERROR_GetFaultDetectionCounter
        RteEventToTaskMapping_OIE_EventInfo_WDGM_E_IMPROPER_CALLER_GetDTCOfEvent: RteEventRef=OIE_EventInfo_WDGM_E_IMPROPER_CALLER_GetDTCOfEvent
        RteEventToTaskMapping_OIE_EventInfo_WDGM_E_IMPROPER_CALLER_GetEventExtendedDataRecord: RteEventRef=OIE_EventInfo_WDGM_E_IMPROPER_CALLER_GetEventExtendedDataRecord
        RteEventToTaskMapping_OIE_EventInfo_WDGM_E_IMPROPER_CALLER_GetEventFailed: RteEventRef=OIE_EventInfo_WDGM_E_IMPROPER_CALLER_GetEventFailed
        RteEventToTaskMapping_OIE_EventInfo_WDGM_E_IMPROPER_CALLER_GetEventFreezeFrameData: RteEventRef=OIE_EventInfo_WDGM_E_IMPROPER_CALLER_GetEventFreezeFrameData
        RteEventToTaskMapping_OIE_EventInfo_WDGM_E_IMPROPER_CALLER_GetEventStatus: RteEventRef=OIE_EventInfo_WDGM_E_IMPROPER_CALLER_GetEventStatus
        RteEventToTaskMapping_OIE_EventInfo_WDGM_E_IMPROPER_CALLER_GetEventTested: RteEventRef=OIE_EventInfo_WDGM_E_IMPROPER_CALLER_GetEventTested
        RteEventToTaskMapping_OIE_EventInfo_WDGM_E_IMPROPER_CALLER_GetFaultDetectionCounter: RteEventRef=OIE_EventInfo_WDGM_E_IMPROPER_CALLER_GetFaultDetectionCounter
        RteEventToTaskMapping_OIE_EventInfo_WDGM_E_MONITORING_GetDTCOfEvent: RteEventRef=OIE_EventInfo_WDGM_E_MONITORING_GetDTCOfEvent
        RteEventToTaskMapping_OIE_EventInfo_WDGM_E_MONITORING_GetEventExtendedDataRecord: RteEventRef=OIE_EventInfo_WDGM_E_MONITORING_GetEventExtendedDataRecord
        RteEventToTaskMapping_OIE_EventInfo_WDGM_E_MONITORING_GetEventFailed: RteEventRef=OIE_EventInfo_WDGM_E_MONITORING_GetEventFailed
        RteEventToTaskMapping_OIE_EventInfo_WDGM_E_MONITORING_GetEventFreezeFrameData: RteEventRef=OIE_EventInfo_WDGM_E_MONITORING_GetEventFreezeFrameData
        RteEventToTaskMapping_OIE_EventInfo_WDGM_E_MONITORING_GetEventStatus: RteEventRef=OIE_EventInfo_WDGM_E_MONITORING_GetEventStatus
        RteEventToTaskMapping_OIE_EventInfo_WDGM_E_MONITORING_GetEventTested: RteEventRef=OIE_EventInfo_WDGM_E_MONITORING_GetEventTested
        RteEventToTaskMapping_OIE_EventInfo_WDGM_E_MONITORING_GetFaultDetectionCounter: RteEventRef=OIE_EventInfo_WDGM_E_MONITORING_GetFaultDetectionCounter
        RteEventToTaskMapping_OIE_EventInfo_WDGM_E_SET_MODE_GetDTCOfEvent: RteEventRef=OIE_EventInfo_WDGM_E_SET_MODE_GetDTCOfEvent
        RteEventToTaskMapping_OIE_EventInfo_WDGM_E_SET_MODE_GetEventExtendedDataRecord: RteEventRef=OIE_EventInfo_WDGM_E_SET_MODE_GetEventExtendedDataRecord
        RteEventToTaskMapping_OIE_EventInfo_WDGM_E_SET_MODE_GetEventFailed: RteEventRef=OIE_EventInfo_WDGM_E_SET_MODE_GetEventFailed
        RteEventToTaskMapping_OIE_EventInfo_WDGM_E_SET_MODE_GetEventFreezeFrameData: RteEventRef=OIE_EventInfo_WDGM_E_SET_MODE_GetEventFreezeFrameData
        RteEventToTaskMapping_OIE_EventInfo_WDGM_E_SET_MODE_GetEventStatus: RteEventRef=OIE_EventInfo_WDGM_E_SET_MODE_GetEventStatus
        RteEventToTaskMapping_OIE_EventInfo_WDGM_E_SET_MODE_GetEventTested: RteEventRef=OIE_EventInfo_WDGM_E_SET_MODE_GetEventTested
        RteEventToTaskMapping_OIE_EventInfo_WDGM_E_SET_MODE_GetFaultDetectionCounter: RteEventRef=OIE_EventInfo_WDGM_E_SET_MODE_GetFaultDetectionCounter
        RteEventToTaskMapping_OIE_EventInfo_WDG_76_ACW_E_DISABLE_REJECTED_GetDTCOfEvent: RteEventRef=OIE_EventInfo_WDG_76_ACW_E_DISABLE_REJECTED_GetDTCOfEvent
        RteEventToTaskMapping_OIE_EventInfo_WDG_76_ACW_E_DISABLE_REJECTED_GetEventExtendedDataRecord: RteEventRef=OIE_EventInfo_WDG_76_ACW_E_DISABLE_REJECTED_GetEventExtendedDataRecord
        RteEventToTaskMapping_OIE_EventInfo_WDG_76_ACW_E_DISABLE_REJECTED_GetEventFailed: RteEventRef=OIE_EventInfo_WDG_76_ACW_E_DISABLE_REJECTED_GetEventFailed
        RteEventToTaskMapping_OIE_EventInfo_WDG_76_ACW_E_DISABLE_REJECTED_GetEventFreezeFrameData: RteEventRef=OIE_EventInfo_WDG_76_ACW_E_DISABLE_REJECTED_GetEventFreezeFrameData
        RteEventToTaskMapping_OIE_EventInfo_WDG_76_ACW_E_DISABLE_REJECTED_GetEventStatus: RteEventRef=OIE_EventInfo_WDG_76_ACW_E_DISABLE_REJECTED_GetEventStatus
        RteEventToTaskMapping_OIE_EventInfo_WDG_76_ACW_E_DISABLE_REJECTED_GetEventTested: RteEventRef=OIE_EventInfo_WDG_76_ACW_E_DISABLE_REJECTED_GetEventTested
        RteEventToTaskMapping_OIE_EventInfo_WDG_76_ACW_E_DISABLE_REJECTED_GetFaultDetectionCounter: RteEventRef=OIE_EventInfo_WDG_76_ACW_E_DISABLE_REJECTED_GetFaultDetectionCounter
        RteEventToTaskMapping_OIE_EventInfo_WDG_76_ACW_E_MODE_FAILED_GetDTCOfEvent: RteEventRef=OIE_EventInfo_WDG_76_ACW_E_MODE_FAILED_GetDTCOfEvent
        RteEventToTaskMapping_OIE_EventInfo_WDG_76_ACW_E_MODE_FAILED_GetEventExtendedDataRecord: RteEventRef=OIE_EventInfo_WDG_76_ACW_E_MODE_FAILED_GetEventExtendedDataRecord
        RteEventToTaskMapping_OIE_EventInfo_WDG_76_ACW_E_MODE_FAILED_GetEventFailed: RteEventRef=OIE_EventInfo_WDG_76_ACW_E_MODE_FAILED_GetEventFailed
        RteEventToTaskMapping_OIE_EventInfo_WDG_76_ACW_E_MODE_FAILED_GetEventFreezeFrameData: RteEventRef=OIE_EventInfo_WDG_76_ACW_E_MODE_FAILED_GetEventFreezeFrameData
        RteEventToTaskMapping_OIE_EventInfo_WDG_76_ACW_E_MODE_FAILED_GetEventStatus: RteEventRef=OIE_EventInfo_WDG_76_ACW_E_MODE_FAILED_GetEventStatus
        RteEventToTaskMapping_OIE_EventInfo_WDG_76_ACW_E_MODE_FAILED_GetEventTested: RteEventRef=OIE_EventInfo_WDG_76_ACW_E_MODE_FAILED_GetEventTested
        RteEventToTaskMapping_OIE_EventInfo_WDG_76_ACW_E_MODE_FAILED_GetFaultDetectionCounter: RteEventRef=OIE_EventInfo_WDG_76_ACW_E_MODE_FAILED_GetFaultDetectionCounter
        RteEventToTaskMapping_OIE_EventInfo_WDG_E_DISABLE_REJECTED_GetDTCOfEvent: RteEventRef=OIE_EventInfo_WDG_E_DISABLE_REJECTED_GetDTCOfEvent
        RteEventToTaskMapping_OIE_EventInfo_WDG_E_DISABLE_REJECTED_GetEventExtendedDataRecord: RteEventRef=OIE_EventInfo_WDG_E_DISABLE_REJECTED_GetEventExtendedDataRecord
        RteEventToTaskMapping_OIE_EventInfo_WDG_E_DISABLE_REJECTED_GetEventFailed: RteEventRef=OIE_EventInfo_WDG_E_DISABLE_REJECTED_GetEventFailed
        RteEventToTaskMapping_OIE_EventInfo_WDG_E_DISABLE_REJECTED_GetEventFreezeFrameData: RteEventRef=OIE_EventInfo_WDG_E_DISABLE_REJECTED_GetEventFreezeFrameData
        RteEventToTaskMapping_OIE_EventInfo_WDG_E_DISABLE_REJECTED_GetEventStatus: RteEventRef=OIE_EventInfo_WDG_E_DISABLE_REJECTED_GetEventStatus
        RteEventToTaskMapping_OIE_EventInfo_WDG_E_DISABLE_REJECTED_GetEventTested: RteEventRef=OIE_EventInfo_WDG_E_DISABLE_REJECTED_GetEventTested
        RteEventToTaskMapping_OIE_EventInfo_WDG_E_DISABLE_REJECTED_GetFaultDetectionCounter: RteEventRef=OIE_EventInfo_WDG_E_DISABLE_REJECTED_GetFaultDetectionCounter
        RteEventToTaskMapping_OIE_EventInfo_WDG_E_HW_TIMEOUT_GetDTCOfEvent: RteEventRef=OIE_EventInfo_WDG_E_HW_TIMEOUT_GetDTCOfEvent
        RteEventToTaskMapping_OIE_EventInfo_WDG_E_HW_TIMEOUT_GetEventExtendedDataRecord: RteEventRef=OIE_EventInfo_WDG_E_HW_TIMEOUT_GetEventExtendedDataRecord
        RteEventToTaskMapping_OIE_EventInfo_WDG_E_HW_TIMEOUT_GetEventFailed: RteEventRef=OIE_EventInfo_WDG_E_HW_TIMEOUT_GetEventFailed
        RteEventToTaskMapping_OIE_EventInfo_WDG_E_HW_TIMEOUT_GetEventFreezeFrameData: RteEventRef=OIE_EventInfo_WDG_E_HW_TIMEOUT_GetEventFreezeFrameData
        RteEventToTaskMapping_OIE_EventInfo_WDG_E_HW_TIMEOUT_GetEventStatus: RteEventRef=OIE_EventInfo_WDG_E_HW_TIMEOUT_GetEventStatus
        RteEventToTaskMapping_OIE_EventInfo_WDG_E_HW_TIMEOUT_GetEventTested: RteEventRef=OIE_EventInfo_WDG_E_HW_TIMEOUT_GetEventTested
        RteEventToTaskMapping_OIE_EventInfo_WDG_E_HW_TIMEOUT_GetFaultDetectionCounter: RteEventRef=OIE_EventInfo_WDG_E_HW_TIMEOUT_GetFaultDetectionCounter
        RteEventToTaskMapping_OIE_EventInfo_WDG_E_MODE_FAILED_GetDTCOfEvent: RteEventRef=OIE_EventInfo_WDG_E_MODE_FAILED_GetDTCOfEvent
        RteEventToTaskMapping_OIE_EventInfo_WDG_E_MODE_FAILED_GetEventExtendedDataRecord: RteEventRef=OIE_EventInfo_WDG_E_MODE_FAILED_GetEventExtendedDataRecord
        RteEventToTaskMapping_OIE_EventInfo_WDG_E_MODE_FAILED_GetEventFailed: RteEventRef=OIE_EventInfo_WDG_E_MODE_FAILED_GetEventFailed
        RteEventToTaskMapping_OIE_EventInfo_WDG_E_MODE_FAILED_GetEventFreezeFrameData: RteEventRef=OIE_EventInfo_WDG_E_MODE_FAILED_GetEventFreezeFrameData
        RteEventToTaskMapping_OIE_EventInfo_WDG_E_MODE_FAILED_GetEventStatus: RteEventRef=OIE_EventInfo_WDG_E_MODE_FAILED_GetEventStatus
        RteEventToTaskMapping_OIE_EventInfo_WDG_E_MODE_FAILED_GetEventTested: RteEventRef=OIE_EventInfo_WDG_E_MODE_FAILED_GetEventTested
        RteEventToTaskMapping_OIE_EventInfo_WDG_E_MODE_FAILED_GetFaultDetectionCounter: RteEventRef=OIE_EventInfo_WDG_E_MODE_FAILED_GetFaultDetectionCounter
        RteEventToTaskMapping_OIE_EventInfo_WDG_E_WDG_STOPPED_GetDTCOfEvent: RteEventRef=OIE_EventInfo_WDG_E_WDG_STOPPED_GetDTCOfEvent
        RteEventToTaskMapping_OIE_EventInfo_WDG_E_WDG_STOPPED_GetEventExtendedDataRecord: RteEventRef=OIE_EventInfo_WDG_E_WDG_STOPPED_GetEventExtendedDataRecord
        RteEventToTaskMapping_OIE_EventInfo_WDG_E_WDG_STOPPED_GetEventFailed: RteEventRef=OIE_EventInfo_WDG_E_WDG_STOPPED_GetEventFailed
        RteEventToTaskMapping_OIE_EventInfo_WDG_E_WDG_STOPPED_GetEventFreezeFrameData: RteEventRef=OIE_EventInfo_WDG_E_WDG_STOPPED_GetEventFreezeFrameData
        RteEventToTaskMapping_OIE_EventInfo_WDG_E_WDG_STOPPED_GetEventStatus: RteEventRef=OIE_EventInfo_WDG_E_WDG_STOPPED_GetEventStatus
        RteEventToTaskMapping_OIE_EventInfo_WDG_E_WDG_STOPPED_GetEventTested: RteEventRef=OIE_EventInfo_WDG_E_WDG_STOPPED_GetEventTested
        RteEventToTaskMapping_OIE_EventInfo_WDG_E_WDG_STOPPED_GetFaultDetectionCounter: RteEventRef=OIE_EventInfo_WDG_E_WDG_STOPPED_GetFaultDetectionCounter
        RteEventToTaskMapping_OIE_Event_DEM_E_TEST_EVENT1_ResetEventStatus: RteEventRef=OIE_Event_DEM_E_TEST_EVENT1_ResetEventStatus
        RteEventToTaskMapping_OIE_Event_DEM_E_TEST_EVENT1_SetEventDisabled: RteEventRef=OIE_Event_DEM_E_TEST_EVENT1_SetEventDisabled
        RteEventToTaskMapping_OIE_Event_DEM_E_TEST_EVENT1_SetEventStatus: RteEventRef=OIE_Event_DEM_E_TEST_EVENT1_SetEventStatus
        RteEventToTaskMapping_OIE_Event_DEM_E_TEST_EVENT2_ResetEventStatus: RteEventRef=OIE_Event_DEM_E_TEST_EVENT2_ResetEventStatus
        RteEventToTaskMapping_OIE_Event_DEM_E_TEST_EVENT2_SetEventDisabled: RteEventRef=OIE_Event_DEM_E_TEST_EVENT2_SetEventDisabled
        RteEventToTaskMapping_OIE_Event_DEM_E_TEST_EVENT2_SetEventStatus: RteEventRef=OIE_Event_DEM_E_TEST_EVENT2_SetEventStatus
        RteEventToTaskMapping_OIE_Event_DEM_E_TEST_EVENT3_ResetEventStatus: RteEventRef=OIE_Event_DEM_E_TEST_EVENT3_ResetEventStatus
        RteEventToTaskMapping_OIE_Event_DEM_E_TEST_EVENT3_SetEventDisabled: RteEventRef=OIE_Event_DEM_E_TEST_EVENT3_SetEventDisabled
        RteEventToTaskMapping_OIE_Event_DEM_E_TEST_EVENT3_SetEventStatus: RteEventRef=OIE_Event_DEM_E_TEST_EVENT3_SetEventStatus
        RteEventToTaskMapping_OIE_Event_DEM_E_TEST_EVENT4_ResetEventStatus: RteEventRef=OIE_Event_DEM_E_TEST_EVENT4_ResetEventStatus
        RteEventToTaskMapping_OIE_Event_DEM_E_TEST_EVENT4_SetEventDisabled: RteEventRef=OIE_Event_DEM_E_TEST_EVENT4_SetEventDisabled
        RteEventToTaskMapping_OIE_Event_DEM_E_TEST_EVENT4_SetEventStatus: RteEventRef=OIE_Event_DEM_E_TEST_EVENT4_SetEventStatus
        RteEventToTaskMapping_OIE_Event_DEM_E_TEST_EVENT5_ResetEventStatus: RteEventRef=OIE_Event_DEM_E_TEST_EVENT5_ResetEventStatus
        RteEventToTaskMapping_OIE_Event_DEM_E_TEST_EVENT5_SetEventDisabled: RteEventRef=OIE_Event_DEM_E_TEST_EVENT5_SetEventDisabled
        RteEventToTaskMapping_OIE_Event_DEM_E_TEST_EVENT5_SetEventStatus: RteEventRef=OIE_Event_DEM_E_TEST_EVENT5_SetEventStatus
        RteEventToTaskMapping_OIE_Event_DEM_E_TEST_EVENT6_ResetEventStatus: RteEventRef=OIE_Event_DEM_E_TEST_EVENT6_ResetEventStatus
        RteEventToTaskMapping_OIE_Event_DEM_E_TEST_EVENT6_SetEventDisabled: RteEventRef=OIE_Event_DEM_E_TEST_EVENT6_SetEventDisabled
        RteEventToTaskMapping_OIE_Event_DEM_E_TEST_EVENT6_SetEventStatus: RteEventRef=OIE_Event_DEM_E_TEST_EVENT6_SetEventStatus
        RteEventToTaskMapping_OIE_GeneralEvtInfo_GetDTCOfEvent: RteEventRef=OIE_GeneralEvtInfo_GetDTCOfEvent
        RteEventToTaskMapping_OIE_GeneralEvtInfo_GetEventExtendedDataRecord: RteEventRef=OIE_GeneralEvtInfo_GetEventExtendedDataRecord
        RteEventToTaskMapping_OIE_GeneralEvtInfo_GetEventFailed: RteEventRef=OIE_GeneralEvtInfo_GetEventFailed
        RteEventToTaskMapping_OIE_GeneralEvtInfo_GetEventFreezeFrameData: RteEventRef=OIE_GeneralEvtInfo_GetEventFreezeFrameData
        RteEventToTaskMapping_OIE_GeneralEvtInfo_GetEventStatus: RteEventRef=OIE_GeneralEvtInfo_GetEventStatus
        RteEventToTaskMapping_OIE_GeneralEvtInfo_GetEventTested: RteEventRef=OIE_GeneralEvtInfo_GetEventTested
        RteEventToTaskMapping_OIE_GeneralEvtInfo_GetFaultDetectionCounter: RteEventRef=OIE_GeneralEvtInfo_GetFaultDetectionCounter
        RteEventToTaskMapping_OIE_OverflowIndPrimaryMemory_GetEventMemoryOverflow: RteEventRef=OIE_OverflowIndPrimaryMemory_GetEventMemoryOverflow
        RteEventToTaskMapping_OIE_StorageCond_DemStorageCondition_SetStorageCondition: RteEventRef=OIE_StorageCond_DemStorageCondition_SetStorageCondition
        RteEventToTaskMapping_OIE_EventInfo_DemEventParameter_ECU_Internal_ERR_GetDTCOfEvent: RteEventRef=OIE_EventInfo_DemEventParameter_ECU_Internal_ERR_GetDTCOfEvent
        RteEventToTaskMapping_OIE_EventInfo_DemEventParameter_ECU_Internal_ERR_GetEventExtendedDataRecord: RteEventRef=OIE_EventInfo_DemEventParameter_ECU_Internal_ERR_GetEventExtendedDataRecord
        RteEventToTaskMapping_OIE_EventInfo_DemEventParameter_ECU_Internal_ERR_GetEventFailed: RteEventRef=OIE_EventInfo_DemEventParameter_ECU_Internal_ERR_GetEventFailed
        RteEventToTaskMapping_OIE_EventInfo_DemEventParameter_ECU_Internal_ERR_GetEventFreezeFrameData: RteEventRef=OIE_EventInfo_DemEventParameter_ECU_Internal_ERR_GetEventFreezeFrameData
        RteEventToTaskMapping_OIE_EventInfo_DemEventParameter_ECU_Internal_ERR_GetEventStatus: RteEventRef=OIE_EventInfo_DemEventParameter_ECU_Internal_ERR_GetEventStatus
        RteEventToTaskMapping_OIE_EventInfo_DemEventParameter_ECU_Internal_ERR_GetEventTested: RteEventRef=OIE_EventInfo_DemEventParameter_ECU_Internal_ERR_GetEventTested
        RteEventToTaskMapping_OIE_EventInfo_DemEventParameter_ECU_Internal_ERR_GetFaultDetectionCounter: RteEventRef=OIE_EventInfo_DemEventParameter_ECU_Internal_ERR_GetFaultDetectionCounter
        RteEventToTaskMapping_OIE_EventInfo_DemEventParameter_Fan_Fault_GetDTCOfEvent: RteEventRef=OIE_EventInfo_DemEventParameter_Fan_Fault_GetDTCOfEvent
        RteEventToTaskMapping_OIE_EventInfo_DemEventParameter_Fan_Fault_GetEventExtendedDataRecord: RteEventRef=OIE_EventInfo_DemEventParameter_Fan_Fault_GetEventExtendedDataRecord
        RteEventToTaskMapping_OIE_EventInfo_DemEventParameter_Fan_Fault_GetEventFailed: RteEventRef=OIE_EventInfo_DemEventParameter_Fan_Fault_GetEventFailed
        RteEventToTaskMapping_OIE_EventInfo_DemEventParameter_Fan_Fault_GetEventFreezeFrameData: RteEventRef=OIE_EventInfo_DemEventParameter_Fan_Fault_GetEventFreezeFrameData
        RteEventToTaskMapping_OIE_EventInfo_DemEventParameter_Fan_Fault_GetEventStatus: RteEventRef=OIE_EventInfo_DemEventParameter_Fan_Fault_GetEventStatus
        RteEventToTaskMapping_OIE_EventInfo_DemEventParameter_Fan_Fault_GetEventTested: RteEventRef=OIE_EventInfo_DemEventParameter_Fan_Fault_GetEventTested
        RteEventToTaskMapping_OIE_EventInfo_DemEventParameter_Fan_Fault_GetFaultDetectionCounter: RteEventRef=OIE_EventInfo_DemEventParameter_Fan_Fault_GetFaultDetectionCounter
        RteEventToTaskMapping_OIE_EventInfo_DemEventParameter_Temp_Snsr_Fault_GetDTCOfEvent: RteEventRef=OIE_EventInfo_DemEventParameter_Temp_Snsr_Fault_GetDTCOfEvent
        RteEventToTaskMapping_OIE_EventInfo_DemEventParameter_Temp_Snsr_Fault_GetEventExtendedDataRecord: RteEventRef=OIE_EventInfo_DemEventParameter_Temp_Snsr_Fault_GetEventExtendedDataRecord
        RteEventToTaskMapping_OIE_EventInfo_DemEventParameter_Temp_Snsr_Fault_GetEventFailed: RteEventRef=OIE_EventInfo_DemEventParameter_Temp_Snsr_Fault_GetEventFailed
        RteEventToTaskMapping_OIE_EventInfo_DemEventParameter_Temp_Snsr_Fault_GetEventFreezeFrameData: RteEventRef=OIE_EventInfo_DemEventParameter_Temp_Snsr_Fault_GetEventFreezeFrameData
        RteEventToTaskMapping_OIE_EventInfo_DemEventParameter_Temp_Snsr_Fault_GetEventStatus: RteEventRef=OIE_EventInfo_DemEventParameter_Temp_Snsr_Fault_GetEventStatus
        RteEventToTaskMapping_OIE_EventInfo_DemEventParameter_Temp_Snsr_Fault_GetEventTested: RteEventRef=OIE_EventInfo_DemEventParameter_Temp_Snsr_Fault_GetEventTested
        RteEventToTaskMapping_OIE_EventInfo_DemEventParameter_Temp_Snsr_Fault_GetFaultDetectionCounter: RteEventRef=OIE_EventInfo_DemEventParameter_Temp_Snsr_Fault_GetFaultDetectionCounter
        RteEventToTaskMapping_OIE_Event_DemEventParameter_ECU_Internal_ERR_ResetEventStatus: RteEventRef=OIE_Event_DemEventParameter_ECU_Internal_ERR_ResetEventStatus
        RteEventToTaskMapping_OIE_Event_DemEventParameter_ECU_Internal_ERR_SetEventDisabled: RteEventRef=OIE_Event_DemEventParameter_ECU_Internal_ERR_SetEventDisabled
        RteEventToTaskMapping_OIE_Event_DemEventParameter_ECU_Internal_ERR_SetEventStatus: RteEventRef=OIE_Event_DemEventParameter_ECU_Internal_ERR_SetEventStatus
        RteEventToTaskMapping_OIE_Event_DemEventParameter_Fan_Fault_ResetEventStatus: RteEventRef=OIE_Event_DemEventParameter_Fan_Fault_ResetEventStatus
        RteEventToTaskMapping_OIE_Event_DemEventParameter_Fan_Fault_SetEventDisabled: RteEventRef=OIE_Event_DemEventParameter_Fan_Fault_SetEventDisabled
        RteEventToTaskMapping_OIE_Event_DemEventParameter_Fan_Fault_SetEventStatus: RteEventRef=OIE_Event_DemEventParameter_Fan_Fault_SetEventStatus
        RteEventToTaskMapping_OIE_Event_DemEventParameter_Temp_Snsr_Fault_ResetEventStatus: RteEventRef=OIE_Event_DemEventParameter_Temp_Snsr_Fault_ResetEventStatus
        RteEventToTaskMapping_OIE_Event_DemEventParameter_Temp_Snsr_Fault_SetEventDisabled: RteEventRef=OIE_Event_DemEventParameter_Temp_Snsr_Fault_SetEventDisabled
        RteEventToTaskMapping_OIE_Event_DemEventParameter_Temp_Snsr_Fault_SetEventStatus: RteEventRef=OIE_Event_DemEventParameter_Temp_Snsr_Fault_SetEventStatus
        RteEventToTaskMapping_OIE_IndStatus_DemIndicator_BCAN_BUSOFF_GetIndicatorStatus: RteEventRef=OIE_IndStatus_DemIndicator_BCAN_BUSOFF_GetIndicatorStatus
        RteEventToTaskMapping_OIE_IndStatus_DemIndicator_ECU_Internal_ERR_GetIndicatorStatus: RteEventRef=OIE_IndStatus_DemIndicator_ECU_Internal_ERR_GetIndicatorStatus
        RteEventToTaskMapping_OIE_IndStatus_DemIndicator_Fan_Fault_GetIndicatorStatus: RteEventRef=OIE_IndStatus_DemIndicator_Fan_Fault_GetIndicatorStatus
        RteEventToTaskMapping_OIE_IndStatus_DemIndicator_LCAN_BUSOFF_GetIndicatorStatus: RteEventRef=OIE_IndStatus_DemIndicator_LCAN_BUSOFF_GetIndicatorStatus
        RteEventToTaskMapping_OIE_IndStatus_DemIndicator_Temp_Snsr_Fault_GetIndicatorStatus: RteEventRef=OIE_IndStatus_DemIndicator_Temp_Snsr_Fault_GetIndicatorStatus
        RteEventToTaskMapping_OIE_OpCycle_DemOperationCycle_IGN_SetOperationCycleState: RteEventRef=OIE_OpCycle_DemOperationCycle_IGN_SetOperationCycleState
        RteEventToTaskMapping_OIE_OpCycle_DemOperationCycle_PWR_SetOperationCycleState: RteEventRef=OIE_OpCycle_DemOperationCycle_PWR_SetOperationCycleState
    RteSwComponentType_Dem (RteSwComponentType): RteComponentTypeRef=Dem
      RteComponentTypeCalibration: category=TOOL_CONFIGURED, RteCalibrationSupportEnabled=0
