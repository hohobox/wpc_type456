AUTOSAR XML (schema 4-0-3)
package /AUTOSAR
  module config CanIf: implementation-config-variant=VARIANT-PRE-COMPILE, module-description=BswImplementation_CanIf
    CanIfDispatchCfg:
      CanIfDispatchUserCtrlBusOffUL = CAN_SM
      CanIfDispatchUserCtrlModeIndicationUL = CAN_SM
      CanIfDispatchUserValidateWakeupEventUL = ECUM
      CanIfDispatchUserCheckTrcvWakeFlagIndicationUL = CAN_SM
      CanIfDispatchUserClearTrcvWufFlagIndicationUL = CAN_SM
      CanIfDispatchUserTrcvModeIndicationUL = CAN_SM
    CanIfPrivateCfg: CanIfPrivateDlcCheck=1, CanIfPrivateSoftwareFilterType=BINARY, CanIfSupportTTCAN=0, CanIfSupportCanCM=1, CanIfSupportCANFD=1
    CanIfPublicCfg:
      CanIfPublicChangeBaudrateSupport = 0
      CanIfPublicDevErrorDetect = 1
      CanIfPublicMultipleDrvSupport = 0
      CanIfPublicNumberOfCanHwUnits = 1
      CanIfPublicPnSupport = 0
      CanIfPublicReadRxPduDataApi = 0
      CanIfPublicReadRxPduNotifyStatusApi = 0
      CanIfPublicReadTxPduNotifyStatusApi = 0
      CanIfPublicSetDynamicTxIdApi = 0
      CanIfPublicTxBuffering = 1
      CanIfPublicTxConfirmPollingSupport = 1
      CanIfPublicVersionInfoApi = 1
      CanIfPublicWakeupCheckValidSupport = 0
      CanIfPublicWakeupCheckValidByNM = 0
      CanIfPublicCancelTransmitSupport = 0
      CanIfMetaDataSupport = 0
      CanIfPublicHandleTypeEnum = UINT16
      CanIfCANFDID16BitSupport = 0
      CanIfCANFDDiscreteDlcSupport = 0
      CanIfExternalTrcvDrvSupport = 0
      CanIfBusloadDetectingSupport = 1
      CanIfPublicCddHeaderFile = CDD_Router
      CanIfPublicCanDrvVersion = AR_403
    CanIfTrcvDrvCfg0 (CanIfTrcvDrvCfg)
      CanIfTrcvCfg_BCAN (CanIfTrcvCfg): CanIfTrcvWakeupSupport=0, CanIfTrcvId=0, CanIfTrcvCanTrcvRef=CanTrcvChannel_BCAN
      CanIfTrcvCfg_LCAN (CanIfTrcvCfg): CanIfTrcvWakeupSupport=0, CanIfTrcvId=1, CanIfTrcvCanTrcvRef=CanTrcvChannel_LCAN
    CanIfInitCfg
      CanIfInitHohCfg0 (CanIfInitHohCfg): category=TOOL_CONFIGURED, CanIfInitRefCfgSet=CanConfigSet
        35 x CanIfHrhCfg, all with category=TOOL_CONFIGURED, CanIfHrhSoftwareFilter=1:
          CanIfHrhCfg_IN_WPC_BCAN_0x7df_BCAN_GST_ALL: CanIfHrhIdSymRef=IN_HwObj_WPC_BCAN_0x7df_BCAN_GST_ALL, CanIfHrhCanHandleTypeRef=IN_HwObj_WPC_BCAN_0x7df_BCAN_GST_ALL, CanIfHrhCanCtrlIdRef=CanIfCtrlCfg_WPC_BCAN
          CanIfHrhCfg_IN_WPC_BCAN_0x4da_BCAN_CLU_09_00ms: CanIfHrhIdSymRef=IN_HwObj_WPC_BCAN_0x4da_BCAN_CLU_09_00ms, CanIfHrhCanHandleTypeRef=IN_HwObj_WPC_BCAN_0x4da_BCAN_CLU_09_00ms, CanIfHrhCanCtrlIdRef=CanIfCtrlCfg_WPC_BCAN
          CanIfHrhCfg_IN_WPC_BCAN_0x4d1_BCAN_CLU_05_00ms: CanIfHrhIdSymRef=IN_HwObj_WPC_BCAN_0x4d1_BCAN_CLU_05_00ms, CanIfHrhCanHandleTypeRef=IN_HwObj_WPC_BCAN_0x4d1_BCAN_CLU_05_00ms, CanIfHrhCanCtrlIdRef=CanIfCtrlCfg_WPC_BCAN
          CanIfHrhCfg_IN_WPC_BCAN_0x401_BCAN_BDC_FD_SMK_02_200ms: CanIfHrhIdSymRef=IN_HwObj_WPC_BCAN_0x401_BCAN_BDC_FD_SMK_02_200ms, CanIfHrhCanHandleTypeRef=IN_HwObj_WPC_BCAN_0x401_BCAN_BDC_FD_SMK_02_200ms, CanIfHrhCanCtrlIdRef=CanIfCtrlCfg_WPC_BCAN
          CanIfHrhCfg_IN_WPC_BCAN_0x3e2_BCAN_PDC_FD_03_200ms: CanIfHrhIdSymRef=IN_HwObj_WPC_BCAN_0x3e2_BCAN_PDC_FD_03_200ms, CanIfHrhCanHandleTypeRef=IN_HwObj_WPC_BCAN_0x3e2_BCAN_PDC_FD_03_200ms, CanIfHrhCanCtrlIdRef=CanIfCtrlCfg_WPC_BCAN
          CanIfHrhCfg_IN_WPC_BCAN_0x3d4_BCAN_BDC_FD_05_200ms: CanIfHrhIdSymRef=IN_HwObj_WPC_BCAN_0x3d4_BCAN_BDC_FD_05_200ms, CanIfHrhCanHandleTypeRef=IN_HwObj_WPC_BCAN_0x3d4_BCAN_BDC_FD_05_200ms, CanIfHrhCanCtrlIdRef=CanIfCtrlCfg_WPC_BCAN
          CanIfHrhCfg_IN_WPC_BCAN_0x3d1_BCAN_BDC_FD_02_200ms: CanIfHrhIdSymRef=IN_HwObj_WPC_BCAN_0x3d1_BCAN_BDC_FD_02_200ms, CanIfHrhCanHandleTypeRef=IN_HwObj_WPC_BCAN_0x3d1_BCAN_BDC_FD_02_200ms, CanIfHrhCanCtrlIdRef=CanIfCtrlCfg_WPC_BCAN
          CanIfHrhCfg_IN_WPC_BCAN_0x366_BCAN_HU_GW_03_200ms: CanIfHrhIdSymRef=IN_HwObj_WPC_BCAN_0x366_BCAN_HU_GW_03_200ms, CanIfHrhCanHandleTypeRef=IN_HwObj_WPC_BCAN_0x366_BCAN_HU_GW_03_200ms, CanIfHrhCanCtrlIdRef=CanIfCtrlCfg_WPC_BCAN
          CanIfHrhCfg_IN_WPC_BCAN_0x351_BCAN_IAU_FD_04_200ms: CanIfHrhIdSymRef=IN_HwObj_WPC_BCAN_0x351_BCAN_IAU_FD_04_200ms, CanIfHrhCanHandleTypeRef=IN_HwObj_WPC_BCAN_0x351_BCAN_IAU_FD_04_200ms, CanIfHrhCanCtrlIdRef=CanIfCtrlCfg_WPC_BCAN
          CanIfHrhCfg_IN_WPC_BCAN_0x33e_BCAN_SBCM_RL_FD_01_200ms: CanIfHrhIdSymRef=IN_HwObj_WPC_BCAN_0x33e_BCAN_SBCM_RL_FD_01_200ms, CanIfHrhCanHandleTypeRef=IN_HwObj_WPC_BCAN_0x33e_BCAN_SBCM_RL_FD_01_200ms, CanIfHrhCanCtrlIdRef=CanIfCtrlCfg_WPC_BCAN
          CanIfHrhCfg_IN_WPC_BCAN_0x33d_BCAN_SBCM_RR_FD_01_200ms: CanIfHrhIdSymRef=IN_HwObj_WPC_BCAN_0x33d_BCAN_SBCM_RR_FD_01_200ms, CanIfHrhCanHandleTypeRef=IN_HwObj_WPC_BCAN_0x33d_BCAN_SBCM_RR_FD_01_200ms, CanIfHrhCanCtrlIdRef=CanIfCtrlCfg_WPC_BCAN
          CanIfHrhCfg_IN_WPC_BCAN_0x32d_BCAN_SBCM_DRV_FD_01_200ms: CanIfHrhIdSymRef=IN_HwObj_WPC_BCAN_0x32d_BCAN_SBCM_DRV_FD_01_200ms, CanIfHrhCanHandleTypeRef=IN_HwObj_WPC_BCAN_0x32d_BCAN_SBCM_DRV_FD_01_200ms, CanIfHrhCanCtrlIdRef=CanIfCtrlCfg_WPC_BCAN
          CanIfHrhCfg_IN_WPC_BCAN_0x32b_BCAN_SBCM_AST_FD_01_200ms: CanIfHrhIdSymRef=IN_HwObj_WPC_BCAN_0x32b_BCAN_SBCM_AST_FD_01_200ms, CanIfHrhCanHandleTypeRef=IN_HwObj_WPC_BCAN_0x32b_BCAN_SBCM_AST_FD_01_200ms, CanIfHrhCanCtrlIdRef=CanIfCtrlCfg_WPC_BCAN
          CanIfHrhCfg_IN_WPC_BCAN_0x315_BCAN_CLU_20_200ms: CanIfHrhIdSymRef=IN_HwObj_WPC_BCAN_0x315_BCAN_CLU_20_200ms, CanIfHrhCanHandleTypeRef=IN_HwObj_WPC_BCAN_0x315_BCAN_CLU_20_200ms, CanIfHrhCanCtrlIdRef=CanIfCtrlCfg_WPC_BCAN
          CanIfHrhCfg_IN_WPC_BCAN_0x314_BCAN_RWPC_FD_01_200ms: CanIfHrhIdSymRef=IN_HwObj_WPC_BCAN_0x314_BCAN_RWPC_FD_01_200ms, CanIfHrhCanHandleTypeRef=IN_HwObj_WPC_BCAN_0x314_BCAN_RWPC_FD_01_200ms, CanIfHrhCanCtrlIdRef=CanIfCtrlCfg_WPC_BCAN
          CanIfHrhCfg_IN_WPC_BCAN_0x1aa_BCAN_CLU_01_20ms: CanIfHrhIdSymRef=IN_HwObj_WPC_BCAN_0x1aa_BCAN_CLU_01_20ms, CanIfHrhCanHandleTypeRef=IN_HwObj_WPC_BCAN_0x1aa_BCAN_CLU_01_20ms, CanIfHrhCanCtrlIdRef=CanIfCtrlCfg_WPC_BCAN
          CanIfHrhCfg_IN_WPC_BCAN_0x116_BCAN_HU_USM_05_00ms: CanIfHrhIdSymRef=IN_HwObj_WPC_BCAN_0x116_BCAN_HU_USM_05_00ms, CanIfHrhCanHandleTypeRef=IN_HwObj_WPC_BCAN_0x116_BCAN_HU_USM_05_00ms, CanIfHrhCanCtrlIdRef=CanIfCtrlCfg_WPC_BCAN
          CanIfHrhCfg_IN_WPC_BCAN_0x112_BCAN_HU_USM_02_00ms: CanIfHrhIdSymRef=IN_HwObj_WPC_BCAN_0x112_BCAN_HU_USM_02_00ms, CanIfHrhCanHandleTypeRef=IN_HwObj_WPC_BCAN_0x112_BCAN_HU_USM_02_00ms, CanIfHrhCanCtrlIdRef=CanIfCtrlCfg_WPC_BCAN
          CanIfHrhCfg_IN_WPC_BCAN_0x111_BCAN_HU_USM_01_00ms: CanIfHrhIdSymRef=IN_HwObj_WPC_BCAN_0x111_BCAN_HU_USM_01_00ms, CanIfHrhCanHandleTypeRef=IN_HwObj_WPC_BCAN_0x111_BCAN_HU_USM_01_00ms, CanIfHrhCanCtrlIdRef=CanIfCtrlCfg_WPC_BCAN
          CanIfHrhCfg_IN_WPC_BCAN_0x105_BCAN_EMS_07_10ms: CanIfHrhIdSymRef=IN_HwObj_WPC_BCAN_0x105_BCAN_EMS_07_10ms, CanIfHrhCanHandleTypeRef=IN_HwObj_WPC_BCAN_0x105_BCAN_EMS_07_10ms, CanIfHrhCanCtrlIdRef=CanIfCtrlCfg_WPC_BCAN
          CanIfHrhCfg_IN_WPC_BCAN_0x100_BCAN_EMS_02_10ms: CanIfHrhIdSymRef=IN_HwObj_WPC_BCAN_0x100_BCAN_EMS_02_10ms, CanIfHrhCanHandleTypeRef=IN_HwObj_WPC_BCAN_0x100_BCAN_EMS_02_10ms, CanIfHrhCanCtrlIdRef=CanIfCtrlCfg_WPC_BCAN
          CanIfHrhCfg_IN_WPC_BCAN_0xfa_BCAN_HCU_03_10ms: CanIfHrhIdSymRef=IN_HwObj_WPC_BCAN_0xfa_BCAN_HCU_03_10ms, CanIfHrhCanHandleTypeRef=IN_HwObj_WPC_BCAN_0xfa_BCAN_HCU_03_10ms, CanIfHrhCanCtrlIdRef=CanIfCtrlCfg_WPC_BCAN
          CanIfHrhCfg_IN_WPC_BCAN_0x35_BCAN_VCU_01_10ms: CanIfHrhIdSymRef=IN_HwObj_WPC_BCAN_0x35_BCAN_VCU_01_10ms, CanIfHrhCanHandleTypeRef=IN_HwObj_WPC_BCAN_0x35_BCAN_VCU_01_10ms, CanIfHrhCanCtrlIdRef=CanIfCtrlCfg_WPC_BCAN
          CanIfHrhCfg_IN_0x17fc0000_0x17fc00fe_WPC_BCAN_NM_Message: CanIfHrhIdSymRef=IN_HwObj_0x17fc0000_0x17fc00fe_WPC_BCAN_NM_Message, CanIfHrhCanHandleTypeRef=IN_HwObj_0x17fc0000_0x17fc00fe_WPC_BCAN_NM_Message, CanIfHrhCanCtrlIdRef=CanIfCtrlCfg_WPC_BCAN
            CanIfHrhRangeCfg0 (CanIfHrhRangeCfg):
              category = TOOL_CONFIGURED
              CanIfHrhRangeRxPduLowerCanId = 402391040
              CanIfHrhRangeRxPduUpperCanId = 402391294
              CanIfHrhRangeRxPduRangeCanIdType = EXTENDED
          CanIfHrhCfg_IN_WPC_BCAN_0x2e9_BCAN_PDC_FD_15_300ms: CanIfHrhIdSymRef=IN_HwObj_WPC_BCAN_0x2e9_BCAN_PDC_FD_15_300ms, CanIfHrhCanHandleTypeRef=IN_HwObj_WPC_BCAN_0x2e9_BCAN_PDC_FD_15_300ms, CanIfHrhCanCtrlIdRef=CanIfCtrlCfg_WPC_BCAN
          CanIfHrhCfg_IN_WPC_BCAN_0x114_BCAN_HU_USM_04_00ms: CanIfHrhIdSymRef=IN_HwObj_WPC_BCAN_0x114_BCAN_HU_USM_04_00ms, CanIfHrhCanHandleTypeRef=IN_HwObj_WPC_BCAN_0x114_BCAN_HU_USM_04_00ms, CanIfHrhCanCtrlIdRef=CanIfCtrlCfg_WPC_BCAN
          CanIfHrhCfg_IN_WPC_BCAN_0x725_BCAN_GST_WPC: CanIfHrhCanCtrlIdRef=CanIfCtrlCfg_WPC_BCAN, CanIfHrhCanHandleTypeRef=IN_HwObj_WPC_BCAN_0x725_BCAN_GST_WPC, CanIfHrhIdSymRef=IN_HwObj_WPC_BCAN_0x725_BCAN_GST_WPC
          CanIfHrhCfg_IN_WPC_LCAN_0xc000104_LCAN_L_TP_BDC_FD_L_WPC_FD: CanIfHrhIdSymRef=IN_HwObj_WPC_LCAN_0xc000104_LCAN_L_TP_BDC_FD_L_WPC_FD, CanIfHrhCanHandleTypeRef=IN_HwObj_WPC_LCAN_0xc000104_LCAN_L_TP_BDC_FD_L_WPC_FD, CanIfHrhCanCtrlIdRef=CanIfCtrlCfg_WPC_LCAN
          CanIfHrhCfg_IN_WPC_LCAN_0x8000050_LCAN_L_BDC_FD_IAU_10_200ms: CanIfHrhIdSymRef=IN_HwObj_WPC_LCAN_0x8000050_LCAN_L_BDC_FD_IAU_10_200ms, CanIfHrhCanHandleTypeRef=IN_HwObj_WPC_LCAN_0x8000050_LCAN_L_BDC_FD_IAU_10_200ms, CanIfHrhCanCtrlIdRef=CanIfCtrlCfg_WPC_LCAN
          CanIfHrhCfg_IN_WPC_LCAN_0x4000050_LCAN_L_BDC_FD_IAU_01_00ms: CanIfHrhIdSymRef=IN_HwObj_WPC_LCAN_0x4000050_LCAN_L_BDC_FD_IAU_01_00ms, CanIfHrhCanHandleTypeRef=IN_HwObj_WPC_LCAN_0x4000050_LCAN_L_BDC_FD_IAU_01_00ms, CanIfHrhCanCtrlIdRef=CanIfCtrlCfg_WPC_LCAN
          CanIfHrhCfg_IN_WPC_LCAN_0x43f_LCAN_CCU_01_00ms: CanIfHrhIdSymRef=IN_HwObj_WPC_LCAN_0x43f_LCAN_CCU_01_00ms, CanIfHrhCanHandleTypeRef=IN_HwObj_WPC_LCAN_0x43f_LCAN_CCU_01_00ms, CanIfHrhCanCtrlIdRef=CanIfCtrlCfg_WPC_LCAN
          CanIfHrhCfg_IN_WPC_LCAN_0x352_LCAN_IAU_FD_05_200ms: CanIfHrhIdSymRef=IN_HwObj_WPC_LCAN_0x352_LCAN_IAU_FD_05_200ms, CanIfHrhCanHandleTypeRef=IN_HwObj_WPC_LCAN_0x352_LCAN_IAU_FD_05_200ms, CanIfHrhCanCtrlIdRef=CanIfCtrlCfg_WPC_LCAN
          CanIfHrhCfg_IN_WPC_LCAN_0x351_LCAN_IAU_FD_04_200ms: CanIfHrhIdSymRef=IN_HwObj_WPC_LCAN_0x351_LCAN_IAU_FD_04_200ms, CanIfHrhCanHandleTypeRef=IN_HwObj_WPC_LCAN_0x351_LCAN_IAU_FD_04_200ms, CanIfHrhCanCtrlIdRef=CanIfCtrlCfg_WPC_LCAN
          CanIfHrhCfg_IN_0x17fc0000_0x17fc00fe_WPC_LCAN_NM_Message: CanIfHrhIdSymRef=IN_HwObj_0x17fc0000_0x17fc00fe_WPC_LCAN_NM_Message, CanIfHrhCanHandleTypeRef=IN_HwObj_0x17fc0000_0x17fc00fe_WPC_LCAN_NM_Message, CanIfHrhCanCtrlIdRef=CanIfCtrlCfg_WPC_LCAN
            CanIfHrhRangeCfg0 (CanIfHrhRangeCfg):
              category = TOOL_CONFIGURED
              CanIfHrhRangeRxPduLowerCanId = 402391040
              CanIfHrhRangeRxPduUpperCanId = 402391294
              CanIfHrhRangeRxPduRangeCanIdType = EXTENDED
          CanIfHrhCfg_IN_WPC_LCAN_0x2e9_LCAN_PDC_FD_15_300ms: CanIfHrhIdSymRef=IN_HwObj_WPC_LCAN_0x2e9_LCAN_PDC_FD_15_300ms, CanIfHrhCanHandleTypeRef=IN_HwObj_WPC_LCAN_0x2e9_LCAN_PDC_FD_15_300ms, CanIfHrhCanCtrlIdRef=CanIfCtrlCfg_WPC_LCAN
        11 x CanIfHthCfg, all with category=TOOL_CONFIGURED:
          CanIfHthCfg_OUT_WPC_BCAN_0x21f_BCAN_WPC_FD_VCRM_01_00ms: CanIfHthCanHandleTypeRef=OUT_HwObj_WPC_BCAN_0x21f_BCAN_WPC_FD_VCRM_01_00ms, CanIfHthIdSymRef=OUT_HwObj_WPC_BCAN_0x21f_BCAN_WPC_FD_VCRM_01_00ms, CanIfHthCanCtrlIdRef=CanIfCtrlCfg_WPC_BCAN
          CanIfHthCfg_OUT_WPC_BCAN_0x391_BCAN_WPC_FD_01_200ms: CanIfHthCanHandleTypeRef=OUT_HwObj_WPC_BCAN_0x391_BCAN_WPC_FD_01_200ms, CanIfHthIdSymRef=OUT_HwObj_WPC_BCAN_0x391_BCAN_WPC_FD_01_200ms, CanIfHthCanCtrlIdRef=CanIfCtrlCfg_WPC_BCAN
          CanIfHthCfg_OUT_WPC_BCAN_0x17fc009e_BCAN_NM_WPC_FD: CanIfHthCanHandleTypeRef=OUT_HwObj_WPC_BCAN_0x17fc009e_BCAN_NM_WPC_FD, CanIfHthIdSymRef=OUT_HwObj_WPC_BCAN_0x17fc009e_BCAN_NM_WPC_FD, CanIfHthCanCtrlIdRef=CanIfCtrlCfg_WPC_BCAN
          CanIfHthCfg_OUT_WPC_BCAN_0x392_BCAN_WPC2_FD_01_200ms: CanIfHthCanHandleTypeRef=OUT_HwObj_WPC_BCAN_0x392_BCAN_WPC2_FD_01_200ms, CanIfHthIdSymRef=OUT_HwObj_WPC_BCAN_0x392_BCAN_WPC2_FD_01_200ms, CanIfHthCanCtrlIdRef=CanIfCtrlCfg_WPC_BCAN
          CanIfHthCfg_OUT_WPC_BCAN_0x686_BCAN_WPCmsgDvp1: CanIfHthCanHandleTypeRef=OUT_HwObj_WPC_BCAN_0x686_BCAN_WPCmsgDvp1, CanIfHthIdSymRef=OUT_HwObj_WPC_BCAN_0x686_BCAN_WPCmsgDvp1, CanIfHthCanCtrlIdRef=CanIfCtrlCfg_WPC_BCAN
          CanIfHthCfg_OUT_WPC_BCAN_0x0_BASIC: CanIfHthCanCtrlIdRef=CanIfCtrlCfg_WPC_BCAN, CanIfHthCanHandleTypeRef=OUT_WPC_BCAN_HwObj_0x0_BASIC, CanIfHthIdSymRef=OUT_WPC_BCAN_HwObj_0x0_BASIC
          CanIfHthCfg_OUT_WPC_BCAN_0x1ec7b001_BCAN_WPC_WU_01_500ms: CanIfHthCanCtrlIdRef=CanIfCtrlCfg_WPC_BCAN, CanIfHthCanHandleTypeRef=OUT_HwObj_WPC_BCAN_0x1ec7b001_BCAN_WPC_WU_01_500ms, CanIfHthIdSymRef=OUT_HwObj_WPC_BCAN_0x1ec7b001_BCAN_WPC_WU_01_500ms
          CanIfHthCfg_OUT_WPC_LCAN_0x4000070_LCAN_L_WPC_FD_01_00ms: CanIfHthCanHandleTypeRef=OUT_HwObj_WPC_LCAN_0x4000070_LCAN_L_WPC_FD_01_00ms, CanIfHthIdSymRef=OUT_HwObj_WPC_LCAN_0x4000070_LCAN_L_WPC_FD_01_00ms, CanIfHthCanCtrlIdRef=CanIfCtrlCfg_WPC_LCAN
          CanIfHthCfg_OUT_WPC_LCAN_0x8000070_LCAN_L_WPC_FD_20_200ms: CanIfHthCanHandleTypeRef=OUT_HwObj_WPC_LCAN_0x8000070_LCAN_L_WPC_FD_20_200ms, CanIfHthIdSymRef=OUT_HwObj_WPC_LCAN_0x8000070_LCAN_L_WPC_FD_20_200ms, CanIfHthCanCtrlIdRef=CanIfCtrlCfg_WPC_LCAN
          CanIfHthCfg_OUT_WPC_LCAN_0xc000105_LCAN_L_TP_L_WPC_FD_BDC_FD: CanIfHthCanHandleTypeRef=OUT_HwObj_WPC_LCAN_0xc000105_LCAN_L_TP_L_WPC_FD_BDC_FD, CanIfHthIdSymRef=OUT_HwObj_WPC_LCAN_0xc000105_LCAN_L_TP_L_WPC_FD_BDC_FD, CanIfHthCanCtrlIdRef=CanIfCtrlCfg_WPC_LCAN
          CanIfHthCfg_OUT_WPC_LCAN_0x17fc001e_LCAN_NM_L_WPC_FD: CanIfHthCanHandleTypeRef=OUT_HwObj_WPC_LCAN_0x17fc001e_LCAN_NM_L_WPC_FD, CanIfHthIdSymRef=OUT_HwObj_WPC_LCAN_0x17fc001e_LCAN_NM_L_WPC_FD, CanIfHthCanCtrlIdRef=CanIfCtrlCfg_WPC_LCAN
      11 x CanIfBufferCfg, all with category=TOOL_CONFIGURED, CanIfBufferSize=0:
        CanIfBufferCfg_OUT_WPC_BCAN_0x21f_BCAN_WPC_FD_VCRM_01_00ms: CanIfBufferHthRef=CanIfHthCfg_OUT_WPC_BCAN_0x21f_BCAN_WPC_FD_VCRM_01_00ms
        CanIfBufferCfg_OUT_WPC_BCAN_0x391_BCAN_WPC_FD_01_200ms: CanIfBufferHthRef=CanIfHthCfg_OUT_WPC_BCAN_0x391_BCAN_WPC_FD_01_200ms
        CanIfBufferCfg_OUT_WPC_BCAN_0x17fc009e_BCAN_NM_WPC_FD: CanIfBufferHthRef=CanIfHthCfg_OUT_WPC_BCAN_0x17fc009e_BCAN_NM_WPC_FD
        CanIfBufferCfg_OUT_WPC_BCAN_0x392_BCAN_WPC2_FD_01_200ms: CanIfBufferHthRef=CanIfHthCfg_OUT_WPC_BCAN_0x392_BCAN_WPC2_FD_01_200ms
        CanIfBufferCfg_OUT_WPC_BCAN_0x686_BCAN_WPCmsgDvp1: CanIfBufferHthRef=CanIfHthCfg_OUT_WPC_BCAN_0x686_BCAN_WPCmsgDvp1
        CanIfBufferCfg_OUT_WPC_BCAN_0x0_BASIC: CanIfBufferHthRef=CanIfHthCfg_OUT_WPC_BCAN_0x0_BASIC
        CanIfBufferCfg_OUT_WPC_BCAN_0x1ec7b001_BCAN_WPC_WU_01_500ms: CanIfBufferHthRef=CanIfHthCfg_OUT_WPC_BCAN_0x1ec7b001_BCAN_WPC_WU_01_500ms
        CanIfBufferCfg_OUT_WPC_LCAN_0x4000070_LCAN_L_WPC_FD_01_00ms: CanIfBufferHthRef=CanIfHthCfg_OUT_WPC_LCAN_0x4000070_LCAN_L_WPC_FD_01_00ms
        CanIfBufferCfg_OUT_WPC_LCAN_0x8000070_LCAN_L_WPC_FD_20_200ms: CanIfBufferHthRef=CanIfHthCfg_OUT_WPC_LCAN_0x8000070_LCAN_L_WPC_FD_20_200ms
        CanIfBufferCfg_OUT_WPC_LCAN_0xc000105_LCAN_L_TP_L_WPC_FD_BDC_FD: CanIfBufferHthRef=CanIfHthCfg_OUT_WPC_LCAN_0xc000105_LCAN_L_TP_L_WPC_FD_BDC_FD
        CanIfBufferCfg_OUT_WPC_LCAN_0x17fc001e_LCAN_NM_L_WPC_FD: CanIfBufferHthRef=CanIfHthCfg_OUT_WPC_LCAN_0x17fc001e_LCAN_NM_L_WPC_FD
      35 x CanIfRxPduCfg, all with category=TOOL_CONFIGURED, CanIfPduReportIdsMEnable=0, CanIfRxPduReadNotifyStatus=0, CanIfRxPduReadData=0:
        CanIfRxPduCfg_IN_WPC_BCAN_0x7df_BCAN_GST_ALL: CanIfRxPduCanId=2015, CanIfRxPduCanIdType=STANDARD_CAN, CanIfRxPduCanIdMask=2047, CanIfRxPduId=0, CanIfRxPduDlc=8, CanIfRxPduUserRxIndicationUL=CAN_TP, CanIfRxPduHrhIdRef=CanIfHrhCfg_IN_WPC_BCAN_0x7df_BCAN_GST_ALL, CanIfRxPduRef=Pdu_NPdu_BCAN_GST_ALL
        CanIfRxPduCfg_IN_WPC_BCAN_0x4da_BCAN_CLU_09_00ms: CanIfRxPduCanId=1242, CanIfRxPduCanIdType=STANDARD_CAN, CanIfRxPduCanIdMask=2047, CanIfRxPduId=1, CanIfRxPduDlc=8, CanIfRxPduUserRxIndicationUL=PDUR, CanIfRxPduHrhIdRef=CanIfHrhCfg_IN_WPC_BCAN_0x4da_BCAN_CLU_09_00ms, CanIfRxPduRef=Pdu_ISignalIPdu_BCAN_CLU_09_00ms
        CanIfRxPduCfg_IN_WPC_BCAN_0x4d1_BCAN_CLU_05_00ms: CanIfRxPduCanId=1233, CanIfRxPduCanIdType=STANDARD_CAN, CanIfRxPduCanIdMask=2047, CanIfRxPduId=2, CanIfRxPduDlc=8, CanIfRxPduUserRxIndicationUL=PDUR, CanIfRxPduHrhIdRef=CanIfHrhCfg_IN_WPC_BCAN_0x4d1_BCAN_CLU_05_00ms, CanIfRxPduRef=Pdu_ISignalIPdu_BCAN_CLU_05_00ms
        CanIfRxPduCfg_IN_WPC_BCAN_0x401_BCAN_BDC_FD_SMK_02_200ms: CanIfRxPduCanId=1025, CanIfRxPduCanIdType=STANDARD_CAN, CanIfRxPduCanIdMask=2047, CanIfRxPduId=3, CanIfRxPduDlc=32, CanIfRxPduUserRxIndicationUL=PDUR, CanIfRxPduHrhIdRef=CanIfHrhCfg_IN_WPC_BCAN_0x401_BCAN_BDC_FD_SMK_02_200ms, CanIfRxPduRef=Pdu_ISignalIPdu_BCAN_BDC_FD_SMK_02_200ms
        CanIfRxPduCfg_IN_WPC_BCAN_0x3e2_BCAN_PDC_FD_03_200ms: CanIfRxPduCanId=994, CanIfRxPduCanIdType=STANDARD_CAN, CanIfRxPduCanIdMask=2047, CanIfRxPduId=4, CanIfRxPduDlc=16, CanIfRxPduUserRxIndicationUL=PDUR, CanIfRxPduHrhIdRef=CanIfHrhCfg_IN_WPC_BCAN_0x3e2_BCAN_PDC_FD_03_200ms, CanIfRxPduRef=Pdu_ISignalIPdu_BCAN_PDC_FD_03_200ms
        CanIfRxPduCfg_IN_WPC_BCAN_0x3d4_BCAN_BDC_FD_05_200ms: CanIfRxPduCanId=980, CanIfRxPduCanIdType=STANDARD_CAN, CanIfRxPduCanIdMask=2047, CanIfRxPduId=5, CanIfRxPduDlc=32, CanIfRxPduUserRxIndicationUL=PDUR, CanIfRxPduHrhIdRef=CanIfHrhCfg_IN_WPC_BCAN_0x3d4_BCAN_BDC_FD_05_200ms, CanIfRxPduRef=Pdu_ISignalIPdu_BCAN_BDC_FD_05_200ms
        CanIfRxPduCfg_IN_WPC_BCAN_0x3d1_BCAN_BDC_FD_02_200ms: CanIfRxPduCanId=977, CanIfRxPduCanIdType=STANDARD_CAN, CanIfRxPduCanIdMask=2047, CanIfRxPduId=6, CanIfRxPduDlc=32, CanIfRxPduUserRxIndicationUL=PDUR, CanIfRxPduHrhIdRef=CanIfHrhCfg_IN_WPC_BCAN_0x3d1_BCAN_BDC_FD_02_200ms, CanIfRxPduRef=Pdu_ISignalIPdu_BCAN_BDC_FD_02_200ms
        CanIfRxPduCfg_IN_WPC_BCAN_0x366_BCAN_HU_GW_03_200ms: CanIfRxPduCanId=870, CanIfRxPduCanIdType=STANDARD_CAN, CanIfRxPduCanIdMask=2047, CanIfRxPduId=7, CanIfRxPduDlc=24, CanIfRxPduUserRxIndicationUL=PDUR, CanIfRxPduHrhIdRef=CanIfHrhCfg_IN_WPC_BCAN_0x366_BCAN_HU_GW_03_200ms, CanIfRxPduRef=Pdu_ISignalIPdu_BCAN_HU_GW_03_200ms
        CanIfRxPduCfg_IN_WPC_BCAN_0x351_BCAN_IAU_FD_04_200ms: CanIfRxPduCanId=849, CanIfRxPduCanIdType=STANDARD_CAN, CanIfRxPduCanIdMask=2047, CanIfRxPduId=8, CanIfRxPduDlc=32, CanIfRxPduUserRxIndicationUL=PDUR, CanIfRxPduHrhIdRef=CanIfHrhCfg_IN_WPC_BCAN_0x351_BCAN_IAU_FD_04_200ms, CanIfRxPduRef=Pdu_ISignalIPdu_BCAN_IAU_FD_04_200ms
        CanIfRxPduCfg_IN_WPC_BCAN_0x33e_BCAN_SBCM_RL_FD_01_200ms: CanIfRxPduCanId=830, CanIfRxPduCanIdType=STANDARD_CAN, CanIfRxPduCanIdMask=2047, CanIfRxPduId=9, CanIfRxPduDlc=24, CanIfRxPduUserRxIndicationUL=PDUR, CanIfRxPduHrhIdRef=CanIfHrhCfg_IN_WPC_BCAN_0x33e_BCAN_SBCM_RL_FD_01_200ms, CanIfRxPduRef=Pdu_ISignalIPdu_BCAN_SBCM_RL_FD_01_200ms
        CanIfRxPduCfg_IN_WPC_BCAN_0x33d_BCAN_SBCM_RR_FD_01_200ms: CanIfRxPduCanId=829, CanIfRxPduCanIdType=STANDARD_CAN, CanIfRxPduCanIdMask=2047, CanIfRxPduId=10, CanIfRxPduDlc=24, CanIfRxPduUserRxIndicationUL=PDUR, CanIfRxPduHrhIdRef=CanIfHrhCfg_IN_WPC_BCAN_0x33d_BCAN_SBCM_RR_FD_01_200ms, CanIfRxPduRef=Pdu_ISignalIPdu_BCAN_SBCM_RR_FD_01_200ms
        CanIfRxPduCfg_IN_WPC_BCAN_0x32d_BCAN_SBCM_DRV_FD_01_200ms: CanIfRxPduCanId=813, CanIfRxPduCanIdType=STANDARD_CAN, CanIfRxPduCanIdMask=2047, CanIfRxPduId=11, CanIfRxPduDlc=32, CanIfRxPduUserRxIndicationUL=PDUR, CanIfRxPduHrhIdRef=CanIfHrhCfg_IN_WPC_BCAN_0x32d_BCAN_SBCM_DRV_FD_01_200ms, CanIfRxPduRef=Pdu_ISignalIPdu_BCAN_SBCM_DRV_FD_01_200ms
        CanIfRxPduCfg_IN_WPC_BCAN_0x32b_BCAN_SBCM_AST_FD_01_200ms: CanIfRxPduCanId=811, CanIfRxPduCanIdType=STANDARD_CAN, CanIfRxPduCanIdMask=2047, CanIfRxPduId=12, CanIfRxPduDlc=32, CanIfRxPduUserRxIndicationUL=PDUR, CanIfRxPduHrhIdRef=CanIfHrhCfg_IN_WPC_BCAN_0x32b_BCAN_SBCM_AST_FD_01_200ms, CanIfRxPduRef=Pdu_ISignalIPdu_BCAN_SBCM_AST_FD_01_200ms
        CanIfRxPduCfg_IN_WPC_BCAN_0x315_BCAN_CLU_20_200ms: CanIfRxPduCanId=789, CanIfRxPduCanIdType=STANDARD_CAN, CanIfRxPduCanIdMask=2047, CanIfRxPduId=13, CanIfRxPduDlc=16, CanIfRxPduUserRxIndicationUL=PDUR, CanIfRxPduHrhIdRef=CanIfHrhCfg_IN_WPC_BCAN_0x315_BCAN_CLU_20_200ms, CanIfRxPduRef=Pdu_ISignalIPdu_BCAN_CLU_20_200ms
        CanIfRxPduCfg_IN_WPC_BCAN_0x314_BCAN_RWPC_FD_01_200ms: CanIfRxPduCanId=788, CanIfRxPduCanIdType=STANDARD_CAN, CanIfRxPduCanIdMask=2047, CanIfRxPduId=14, CanIfRxPduDlc=16, CanIfRxPduUserRxIndicationUL=PDUR, CanIfRxPduHrhIdRef=CanIfHrhCfg_IN_WPC_BCAN_0x314_BCAN_RWPC_FD_01_200ms, CanIfRxPduRef=Pdu_ISignalIPdu_BCAN_RWPC_FD_01_200ms
        CanIfRxPduCfg_IN_WPC_BCAN_0x1aa_BCAN_CLU_01_20ms: CanIfRxPduCanId=426, CanIfRxPduCanIdType=STANDARD_CAN, CanIfRxPduCanIdMask=2047, CanIfRxPduId=15, CanIfRxPduDlc=16, CanIfRxPduUserRxIndicationUL=PDUR, CanIfRxPduHrhIdRef=CanIfHrhCfg_IN_WPC_BCAN_0x1aa_BCAN_CLU_01_20ms, CanIfRxPduRef=Pdu_ISignalIPdu_BCAN_CLU_01_20ms
        CanIfRxPduCfg_IN_WPC_BCAN_0x116_BCAN_HU_USM_05_00ms: CanIfRxPduCanId=278, CanIfRxPduCanIdType=STANDARD_CAN, CanIfRxPduCanIdMask=2047, CanIfRxPduId=16, CanIfRxPduDlc=32, CanIfRxPduUserRxIndicationUL=PDUR, CanIfRxPduHrhIdRef=CanIfHrhCfg_IN_WPC_BCAN_0x116_BCAN_HU_USM_05_00ms, CanIfRxPduRef=Pdu_ISignalIPdu_BCAN_HU_USM_05_00ms
        CanIfRxPduCfg_IN_WPC_BCAN_0x112_BCAN_HU_USM_02_00ms: CanIfRxPduCanId=274, CanIfRxPduCanIdType=STANDARD_CAN, CanIfRxPduCanIdMask=2047, CanIfRxPduId=17, CanIfRxPduDlc=32, CanIfRxPduUserRxIndicationUL=PDUR, CanIfRxPduHrhIdRef=CanIfHrhCfg_IN_WPC_BCAN_0x112_BCAN_HU_USM_02_00ms, CanIfRxPduRef=Pdu_ISignalIPdu_BCAN_HU_USM_02_00ms
        CanIfRxPduCfg_IN_WPC_BCAN_0x111_BCAN_HU_USM_01_00ms: CanIfRxPduCanId=273, CanIfRxPduCanIdType=STANDARD_CAN, CanIfRxPduCanIdMask=2047, CanIfRxPduId=18, CanIfRxPduDlc=32, CanIfRxPduUserRxIndicationUL=PDUR, CanIfRxPduHrhIdRef=CanIfHrhCfg_IN_WPC_BCAN_0x111_BCAN_HU_USM_01_00ms, CanIfRxPduRef=Pdu_ISignalIPdu_BCAN_HU_USM_01_00ms
        CanIfRxPduCfg_IN_WPC_BCAN_0x105_BCAN_EMS_07_10ms: CanIfRxPduCanId=261, CanIfRxPduCanIdType=STANDARD_CAN, CanIfRxPduCanIdMask=2047, CanIfRxPduId=19, CanIfRxPduDlc=32, CanIfRxPduUserRxIndicationUL=PDUR, CanIfRxPduHrhIdRef=CanIfHrhCfg_IN_WPC_BCAN_0x105_BCAN_EMS_07_10ms, CanIfRxPduRef=Pdu_ISignalIPdu_BCAN_EMS_07_10ms
        CanIfRxPduCfg_IN_WPC_BCAN_0x100_BCAN_EMS_02_10ms: CanIfRxPduCanId=256, CanIfRxPduCanIdType=STANDARD_CAN, CanIfRxPduCanIdMask=2047, CanIfRxPduId=20, CanIfRxPduDlc=32, CanIfRxPduUserRxIndicationUL=PDUR, CanIfRxPduHrhIdRef=CanIfHrhCfg_IN_WPC_BCAN_0x100_BCAN_EMS_02_10ms, CanIfRxPduRef=Pdu_ISignalIPdu_BCAN_EMS_02_10ms
        CanIfRxPduCfg_IN_WPC_BCAN_0xfa_BCAN_HCU_03_10ms: CanIfRxPduCanId=250, CanIfRxPduCanIdType=STANDARD_CAN, CanIfRxPduCanIdMask=2047, CanIfRxPduId=21, CanIfRxPduDlc=32, CanIfRxPduUserRxIndicationUL=PDUR, CanIfRxPduHrhIdRef=CanIfHrhCfg_IN_WPC_BCAN_0xfa_BCAN_HCU_03_10ms, CanIfRxPduRef=Pdu_ISignalIPdu_BCAN_HCU_03_10ms
        CanIfRxPduCfg_IN_WPC_BCAN_0x35_BCAN_VCU_01_10ms: CanIfRxPduCanId=53, CanIfRxPduCanIdType=STANDARD_CAN, CanIfRxPduCanIdMask=2047, CanIfRxPduId=22, CanIfRxPduDlc=32, CanIfRxPduUserRxIndicationUL=PDUR, CanIfRxPduHrhIdRef=CanIfHrhCfg_IN_WPC_BCAN_0x35_BCAN_VCU_01_10ms, CanIfRxPduRef=Pdu_ISignalIPdu_BCAN_VCU_01_10ms
        CanIfRxPduCfg_IN_WPC_BCAN_CANNM_MESSAGE: CanIfRxPduCanId=402391257, CanIfRxPduCanIdType=EXTENDED_CAN, CanIfRxPduCanIdMask=536870911, CanIfRxPduId=23, CanIfRxPduDlc=32, CanIfRxPduUserRxIndicationUL=CAN_NM, CanIfRxPduHrhIdRef=CanIfHrhCfg_IN_0x17fc0000_0x17fc00fe_WPC_BCAN_NM_Message, CanIfRxPduRef=Pdu_NmPdu_BCAN_NM_GW_SAU_DRV_FD
          CanIfRxPduCanIdRange0 (CanIfRxPduCanIdRange): category=TOOL_CONFIGURED, CanIfRxPduCanIdRangeLowerCanId=402391040, CanIfRxPduCanIdRangeUpperCanId=402391294
        CanIfRxPduCfg_IN_WPC_BCAN_0x2e9_BCAN_PDC_FD_15_300ms: CanIfRxPduCanId=745, CanIfRxPduCanIdType=STANDARD_CAN, CanIfRxPduCanIdMask=2047, CanIfRxPduId=24, CanIfRxPduDlc=32, CanIfRxPduUserRxIndicationUL=PDUR, CanIfRxPduHrhIdRef=CanIfHrhCfg_IN_WPC_BCAN_0x2e9_BCAN_PDC_FD_15_300ms, CanIfRxPduRef=Pdu_ISignalIPdu_BCAN_PDC_FD_15_300ms
        CanIfRxPduCfg_IN_WPC_BCAN_0x114_BCAN_HU_USM_04_00ms: CanIfRxPduCanId=276, CanIfRxPduCanIdType=STANDARD_CAN, CanIfRxPduCanIdMask=2047, CanIfRxPduId=25, CanIfRxPduDlc=32, CanIfRxPduUserRxIndicationUL=PDUR, CanIfRxPduHrhIdRef=CanIfHrhCfg_IN_WPC_BCAN_0x114_BCAN_HU_USM_04_00ms, CanIfRxPduRef=Pdu_ISignalIPdu_BCAN_HU_USM_04_00ms
        CanIfRxPduCfg_IN_WPC_BCAN_0x725_BCAN_GST_WPC: CanIfRxPduCanId=1829, CanIfRxPduCanIdType=STANDARD_CAN, CanIfRxPduCanIdMask=2047, CanIfRxPduId=26, CanIfRxPduDlc=8, CanIfRxPduUserRxIndicationUL=CAN_TP, CanIfRxPduHrhIdRef=CanIfHrhCfg_IN_WPC_BCAN_0x725_BCAN_GST_WPC, CanIfRxPduRef=Pdu_NPdu_BCAN_GST_WPC
        CanIfRxPduCfg_IN_WPC_LCAN_0xc000104_LCAN_L_TP_BDC_FD_L_WPC_FD: CanIfRxPduCanId=201326852, CanIfRxPduCanIdType=EXTENDED_CAN, CanIfRxPduCanIdMask=536870911, CanIfRxPduId=27, CanIfRxPduDlc=8, CanIfRxPduUserRxIndicationUL=CAN_TP, CanIfRxPduHrhIdRef=CanIfHrhCfg_IN_WPC_LCAN_0xc000104_LCAN_L_TP_BDC_FD_L_WPC_FD, CanIfRxPduRef=Pdu_NPdu_LCAN_L_TP_BDC_FD_L_WPC_FD
        CanIfRxPduCfg_IN_WPC_LCAN_0x8000050_LCAN_L_BDC_FD_IAU_10_200ms: CanIfRxPduCanId=134217808, CanIfRxPduCanIdType=EXTENDED_CAN, CanIfRxPduCanIdMask=536870911, CanIfRxPduId=28, CanIfRxPduDlc=8, CanIfRxPduUserRxIndicationUL=PDUR, CanIfRxPduHrhIdRef=CanIfHrhCfg_IN_WPC_LCAN_0x8000050_LCAN_L_BDC_FD_IAU_10_200ms, CanIfRxPduRef=Pdu_ISignalIPdu_LCAN_L_BDC_FD_IAU_10_200ms
        CanIfRxPduCfg_IN_WPC_LCAN_0x4000050_LCAN_L_BDC_FD_IAU_01_00ms: CanIfRxPduCanId=67108944, CanIfRxPduCanIdType=EXTENDED_CAN, CanIfRxPduCanIdMask=536870911, CanIfRxPduId=29, CanIfRxPduDlc=8, CanIfRxPduUserRxIndicationUL=PDUR, CanIfRxPduHrhIdRef=CanIfHrhCfg_IN_WPC_LCAN_0x4000050_LCAN_L_BDC_FD_IAU_01_00ms, CanIfRxPduRef=Pdu_ISignalIPdu_LCAN_L_BDC_FD_IAU_01_00ms
        CanIfRxPduCfg_IN_WPC_LCAN_0x43f_LCAN_CCU_01_00ms: CanIfRxPduCanId=1087, CanIfRxPduCanIdType=STANDARD_CAN, CanIfRxPduCanIdMask=2047, CanIfRxPduId=30, CanIfRxPduDlc=8, CanIfRxPduUserRxIndicationUL=PDUR, CanIfRxPduHrhIdRef=CanIfHrhCfg_IN_WPC_LCAN_0x43f_LCAN_CCU_01_00ms, CanIfRxPduRef=Pdu_ISignalIPdu_LCAN_CCU_01_00ms
        CanIfRxPduCfg_IN_WPC_LCAN_0x352_LCAN_IAU_FD_05_200ms: CanIfRxPduCanId=850, CanIfRxPduCanIdType=STANDARD_CAN, CanIfRxPduCanIdMask=2047, CanIfRxPduId=31, CanIfRxPduDlc=32, CanIfRxPduUserRxIndicationUL=PDUR, CanIfRxPduHrhIdRef=CanIfHrhCfg_IN_WPC_LCAN_0x352_LCAN_IAU_FD_05_200ms, CanIfRxPduRef=Pdu_ISignalIPdu_LCAN_IAU_FD_05_200ms
        CanIfRxPduCfg_IN_WPC_LCAN_0x351_LCAN_IAU_FD_04_200ms: CanIfRxPduCanId=849, CanIfRxPduCanIdType=STANDARD_CAN, CanIfRxPduCanIdMask=2047, CanIfRxPduId=32, CanIfRxPduDlc=32, CanIfRxPduUserRxIndicationUL=PDUR, CanIfRxPduHrhIdRef=CanIfHrhCfg_IN_WPC_LCAN_0x351_LCAN_IAU_FD_04_200ms, CanIfRxPduRef=Pdu_ISignalIPdu_LCAN_IAU_FD_04_200ms
        CanIfRxPduCfg_IN_WPC_LCAN_CANNM_MESSAGE: CanIfRxPduCanId=402391209, CanIfRxPduCanIdType=EXTENDED_CAN, CanIfRxPduCanIdMask=536870911, CanIfRxPduId=33, CanIfRxPduDlc=32, CanIfRxPduUserRxIndicationUL=CAN_NM, CanIfRxPduHrhIdRef=CanIfHrhCfg_IN_0x17fc0000_0x17fc00fe_WPC_LCAN_NM_Message, CanIfRxPduRef=Pdu_NmPdu_LCAN_NM_L_SAL_FD
          CanIfRxPduCanIdRange0 (CanIfRxPduCanIdRange): category=TOOL_CONFIGURED, CanIfRxPduCanIdRangeLowerCanId=402391040, CanIfRxPduCanIdRangeUpperCanId=402391294
        CanIfRxPduCfg_IN_WPC_LCAN_0x2e9_LCAN_PDC_FD_15_300ms: CanIfRxPduCanId=745, CanIfRxPduCanIdType=STANDARD_CAN, CanIfRxPduCanIdMask=2047, CanIfRxPduId=34, CanIfRxPduDlc=32, CanIfRxPduUserRxIndicationUL=PDUR, CanIfRxPduHrhIdRef=CanIfHrhCfg_IN_WPC_LCAN_0x2e9_LCAN_PDC_FD_15_300ms, CanIfRxPduRef=Pdu_ISignalIPdu_LCAN_PDC_FD_15_300ms
      11 x CanIfTxPduCfg, all with category=TOOL_CONFIGURED, CanIfTxPduPnFilterPdu=0, CanIfTxPduType=STATIC, CanIfTxPduReadNotifyStatus=0:
        CanIfTxPduCfg_OUT_WPC_BCAN_0x21f_BCAN_WPC_FD_VCRM_01_00ms: CanIfTxPduCanId=543, CanIfTxPduCanIdType=STANDARD_FD_CAN, CanIfTxPduCanIdMask=2047, CanIfTxPduId=0, CanIfTxPduDlc=16, CanIfTxPduUserTxConfirmationUL=PDUR, CanIfTxPduBufferRef=CanIfBufferCfg_OUT_WPC_BCAN_0x21f_BCAN_WPC_FD_VCRM_01_00ms, CanIfTxPduRef=Pdu_ISignalIPdu_BCAN_WPC_FD_VCRM_01_00ms
        CanIfTxPduCfg_OUT_WPC_BCAN_0x391_BCAN_WPC_FD_01_200ms: CanIfTxPduCanId=913, CanIfTxPduCanIdType=STANDARD_FD_CAN, CanIfTxPduCanIdMask=2047, CanIfTxPduId=1, CanIfTxPduDlc=16, CanIfTxPduUserTxConfirmationUL=PDUR, CanIfTxPduBufferRef=CanIfBufferCfg_OUT_WPC_BCAN_0x391_BCAN_WPC_FD_01_200ms, CanIfTxPduRef=Pdu_ISignalIPdu_BCAN_WPC_FD_01_200ms
        CanIfTxPduCfg_OUT_WPC_BCAN_0x17fc009e_BCAN_NM_WPC_FD: CanIfTxPduCanId=402391198, CanIfTxPduCanIdType=EXTENDED_FD_CAN, CanIfTxPduCanIdMask=536870911, CanIfTxPduId=2, CanIfTxPduDlc=32, CanIfTxPduUserTxConfirmationUL=CAN_NM, CanIfTxPduBufferRef=CanIfBufferCfg_OUT_WPC_BCAN_0x17fc009e_BCAN_NM_WPC_FD, CanIfTxPduRef=Pdu_NmPdu_BCAN_NM_WPC_FD
        CanIfTxPduCfg_OUT_WPC_BCAN_0x392_BCAN_WPC2_FD_01_200ms: CanIfTxPduCanId=914, CanIfTxPduCanIdType=STANDARD_FD_CAN, CanIfTxPduCanIdMask=2047, CanIfTxPduId=3, CanIfTxPduDlc=16, CanIfTxPduUserTxConfirmationUL=PDUR, CanIfTxPduBufferRef=CanIfBufferCfg_OUT_WPC_BCAN_0x392_BCAN_WPC2_FD_01_200ms, CanIfTxPduRef=Pdu_ISignalIPdu_BCAN_WPC2_FD_01_200ms
        CanIfTxPduCfg_OUT_WPC_BCAN_0x686_BCAN_WPCmsgDvp1: CanIfTxPduCanId=1670, CanIfTxPduCanIdType=STANDARD_FD_CAN, CanIfTxPduCanIdMask=2047, CanIfTxPduId=4, CanIfTxPduDlc=64, CanIfTxPduUserTxConfirmationUL=PDUR, CanIfTxPduBufferRef=CanIfBufferCfg_OUT_WPC_BCAN_0x686_BCAN_WPCmsgDvp1, CanIfTxPduRef=Pdu_ISignalIPdu_BCAN_WPCmsgDvp1
        CanIfTxPduCfg_OUT_WPC_BCAN_0x72d_BCAN_WPC_GST: CanIfTxPduCanId=1837, CanIfTxPduCanIdType=STANDARD_FD_CAN, CanIfTxPduCanIdMask=2047, CanIfTxPduId=5, CanIfTxPduDlc=8, CanIfTxPduUserTxConfirmationUL=CAN_TP, CanIfTxPduBufferRef=CanIfBufferCfg_OUT_WPC_BCAN_0x0_BASIC, CanIfTxPduRef=Pdu_NPdu_BCAN_WPC_GST
        CanIfTxPduCfg_OUT_WPC_BCAN_0x1ec7b001_BCAN_WPC_WU_01_500ms: CanIfTxPduCanId=516403201, CanIfTxPduCanIdType=EXTENDED_FD_CAN, CanIfTxPduCanIdMask=536870911, CanIfTxPduId=6, CanIfTxPduDlc=16, CanIfTxPduUserTxConfirmationUL=PDUR, CanIfTxPduBufferRef=CanIfBufferCfg_OUT_WPC_BCAN_0x1ec7b001_BCAN_WPC_WU_01_500ms, CanIfTxPduRef=Pdu_ISignalIPdu_BCAN_WPC_WU_01_500ms
        CanIfTxPduCfg_OUT_WPC_LCAN_0x4000070_LCAN_L_WPC_FD_01_00ms: CanIfTxPduCanId=67108976, CanIfTxPduCanIdType=EXTENDED_FD_CAN, CanIfTxPduCanIdMask=536870911, CanIfTxPduId=7, CanIfTxPduDlc=8, CanIfTxPduUserTxConfirmationUL=PDUR, CanIfTxPduBufferRef=CanIfBufferCfg_OUT_WPC_LCAN_0x4000070_LCAN_L_WPC_FD_01_00ms, CanIfTxPduRef=Pdu_ISignalIPdu_LCAN_L_WPC_FD_01_00ms
        CanIfTxPduCfg_OUT_WPC_LCAN_0x8000070_LCAN_L_WPC_FD_20_200ms: CanIfTxPduCanId=134217840, CanIfTxPduCanIdType=EXTENDED_FD_CAN, CanIfTxPduCanIdMask=536870911, CanIfTxPduId=8, CanIfTxPduDlc=8, CanIfTxPduUserTxConfirmationUL=PDUR, CanIfTxPduBufferRef=CanIfBufferCfg_OUT_WPC_LCAN_0x8000070_LCAN_L_WPC_FD_20_200ms, CanIfTxPduRef=Pdu_ISignalIPdu_LCAN_L_WPC_FD_20_200ms
        CanIfTxPduCfg_OUT_WPC_LCAN_0xc000105_LCAN_L_TP_L_WPC_FD_BDC_FD: CanIfTxPduCanId=201326853, CanIfTxPduCanIdType=EXTENDED_FD_CAN, CanIfTxPduCanIdMask=536870911, CanIfTxPduId=9, CanIfTxPduDlc=32, CanIfTxPduUserTxConfirmationUL=CAN_TP, CanIfTxPduBufferRef=CanIfBufferCfg_OUT_WPC_LCAN_0xc000105_LCAN_L_TP_L_WPC_FD_BDC_FD, CanIfTxPduRef=Pdu_NPdu_LCAN_L_TP_L_WPC_FD_BDC_FD
        CanIfTxPduCfg_OUT_WPC_LCAN_0x17fc001e_LCAN_NM_L_WPC_FD: CanIfTxPduCanId=402391070, CanIfTxPduCanIdType=EXTENDED_FD_CAN, CanIfTxPduCanIdMask=536870911, CanIfTxPduId=10, CanIfTxPduDlc=32, CanIfTxPduUserTxConfirmationUL=CAN_NM, CanIfTxPduBufferRef=CanIfBufferCfg_OUT_WPC_LCAN_0x17fc001e_LCAN_NM_L_WPC_FD, CanIfTxPduRef=Pdu_NmPdu_LCAN_NM_L_WPC_FD
    CanIfCtrlDrvCfg0 (CanIfCtrlDrvCfg): CanIfCtrlDrvTxCancellation=0, CanIfCtrlDrvInitHohConfigRef=CanIfInitHohCfg0, CanIfCtrlDrvNameRef=CanGeneral
      CanIfCtrlCfg_WPC_BCAN (CanIfCtrlCfg): category=TOOL_CONFIGURED, CanIfCtrlId=0, CanIfCtrlWakeupSupport=0, CanIfCtrlCanCtrlRef=WPC_BCAN
      CanIfCtrlCfg_WPC_LCAN (CanIfCtrlCfg): category=TOOL_CONFIGURED, CanIfCtrlId=1, CanIfCtrlWakeupSupport=0, CanIfCtrlCanCtrlRef=WPC_LCAN
