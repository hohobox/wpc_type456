AUTOSAR XML (schema 4-0-3)
package /Dem
  module config Dem: implementation-config-variant=VARIANT-POST-BUILD
    DemConfigSet
      8 x DemDTCClass, all with DemImmediateNvStorage=1:
        UDS_DTC_0xDD{01..03}: DemDTCSeverity=DEM_DTC_SEV_IMMEDIATELY, DemUdsDTC=0xdd{01..03}
        UDS_DTC_0xDD04: DemDTCFunctionalUnit=0x10, DemDTCSeverity=DEM_DTC_SEV_MAINTENANCE_ONLY, DemUdsDTC=0xdd04
        UDS_DTC_0xDD05: DemDTCSeverity=DEM_DTC_SEV_NO_SEVERITY, DemUdsDTC=0xdd05
        UDS_DTC_0xDD06: DemDTCSeverity=DEM_DTC_SEV_NO_SEVERITY, DemUdsDTC=0xdd06
        UDS_DTC_0x400F01: DemDTCSeverity=DEM_DTC_SEV_IMMEDIATELY, DemUdsDTC=0x400F01
        UDS_DTC_0x800F01: DemDTCSeverity=DEM_DTC_SEV_IMMEDIATELY, DemUdsDTC=0x800F01
      37 x DemEventParameter, all with DemEventKind=DEM_EVENT_KIND_BSW, DemMaxNumberFreezeFrameRecords=0:
        ADC_E_HARDWARE_ERROR: DemEventId=1
          DemEventClass0 (DemEventClass):
            DemAgingAllowed = 0
            DemConsiderPtoStatus = 0
            DemEventOBDReadinessGroup = DEM_OBD_RDY_NONE
            DemEventPriority = 1
            DemFFPrestorageSupported = 0
            DemOperationCycleRef = DemOperationCycle0
            DemDebounceAlgorithmClass0 (DemDebounceAlgorithmClass)
        CAN_E_HARDWARE_ERROR: DemEventId=2
          DemEventClass0 (DemEventClass):
            DemAgingAllowed = 0
            DemConsiderPtoStatus = 0
            DemEventOBDReadinessGroup = DEM_OBD_RDY_NONE
            DemEventPriority = 1
            DemFFPrestorageSupported = 0
            DemOperationCycleRef = DemOperationCycle0
            DemDebounceAlgorithmClass0 (DemDebounceAlgorithmClass)
        ICU_E_HARDWARE_ERROR: DemEventId=3
          DemEventClass0 (DemEventClass):
            DemAgingAllowed = 0
            DemConsiderPtoStatus = 0
            DemEventOBDReadinessGroup = DEM_OBD_RDY_NONE
            DemEventPriority = 1
            DemFFPrestorageSupported = 0
            DemOperationCycleRef = DemOperationCycle0
            DemDebounceAlgorithmClass0 (DemDebounceAlgorithmClass)
        LIN_E_TIMEOUT: DemEventId=4
          DemEventClass0 (DemEventClass):
            DemAgingAllowed = 0
            DemConsiderPtoStatus = 0
            DemEventOBDReadinessGroup = DEM_OBD_RDY_NONE
            DemEventPriority = 1
            DemFFPrestorageSupported = 0
            DemOperationCycleRef = DemOperationCycle0
            DemDebounceAlgorithmClass0 (DemDebounceAlgorithmClass)
        MCU_E_CLOCK_FAILURE: DemEventId=5
          DemEventClass0 (DemEventClass):
            DemAgingAllowed = 0
            DemConsiderPtoStatus = 0
            DemEventOBDReadinessGroup = DEM_OBD_RDY_NONE
            DemEventPriority = 1
            DemFFPrestorageSupported = 0
            DemOperationCycleRef = DemOperationCycle0
            DemDebounceAlgorithmClass0 (DemDebounceAlgorithmClass)
        MCU_E_RESET_FAILURE: DemEventId=6
          DemEventClass0 (DemEventClass):
            DemAgingAllowed = 0
            DemConsiderPtoStatus = 0
            DemEventOBDReadinessGroup = DEM_OBD_RDY_NONE
            DemEventPriority = 1
            DemFFPrestorageSupported = 0
            DemOperationCycleRef = DemOperationCycle0
            DemDebounceAlgorithmClass0 (DemDebounceAlgorithmClass)
        SPI_E_HARDWARE_ERROR: DemEventId=7
          DemEventClass0 (DemEventClass):
            DemAgingAllowed = 0
            DemConsiderPtoStatus = 0
            DemEventOBDReadinessGroup = DEM_OBD_RDY_NONE
            DemEventPriority = 1
            DemFFPrestorageSupported = 0
            DemOperationCycleRef = DemOperationCycle0
            DemDebounceAlgorithmClass0 (DemDebounceAlgorithmClass)
        WDG_E_DISABLE_REJECTED: DemEventId=8
          DemEventClass0 (DemEventClass):
            DemAgingAllowed = 0
            DemConsiderPtoStatus = 0
            DemEventOBDReadinessGroup = DEM_OBD_RDY_NONE
            DemEventPriority = 1
            DemFFPrestorageSupported = 0
            DemOperationCycleRef = DemOperationCycle0
            DemDebounceAlgorithmClass0 (DemDebounceAlgorithmClass)
        WDG_E_MODE_FAILED: DemEventId=9
          DemEventClass0 (DemEventClass):
            DemAgingAllowed = 0
            DemConsiderPtoStatus = 0
            DemEventOBDReadinessGroup = DEM_OBD_RDY_NONE
            DemEventPriority = 1
            DemFFPrestorageSupported = 0
            DemOperationCycleRef = DemOperationCycle0
            DemDebounceAlgorithmClass0 (DemDebounceAlgorithmClass)
        WDG_E_HW_TIMEOUT: DemEventId=10
          DemEventClass0 (DemEventClass):
            DemAgingAllowed = 0
            DemConsiderPtoStatus = 0
            DemFFPrestorageSupported = 0
            DemEventOBDReadinessGroup = DEM_OBD_RDY_NONE
            DemEventPriority = 1
            DemOperationCycleRef = DemOperationCycle0
            DemDebounceAlgorithmClass0 (DemDebounceAlgorithmClass)
        WDG_E_WDG_STOPPED: DemEventId=11
          DemEventClass0 (DemEventClass):
            DemAgingAllowed = 0
            DemConsiderPtoStatus = 0
            DemFFPrestorageSupported = 0
            DemEventOBDReadinessGroup = DEM_OBD_RDY_NONE
            DemEventPriority = 1
            DemOperationCycleRef = DemOperationCycle0
            DemDebounceAlgorithmClass0 (DemDebounceAlgorithmClass)
        ECUM_E_CONFIGURATION_DATA_INCONSISTENT: DemEventId=12
          DemEventClass0 (DemEventClass):
            DemAgingAllowed = 0
            DemConsiderPtoStatus = 0
            DemEventOBDReadinessGroup = DEM_OBD_RDY_NONE
            DemEventPriority = 1
            DemFFPrestorageSupported = 0
            DemOperationCycleRef = DemOperationCycle0
            DemDebounceAlgorithmClass0 (DemDebounceAlgorithmClass)
        ECUM_E_IMPROPER_CALLER: DemEventId=13
          DemEventClass0 (DemEventClass):
            DemAgingAllowed = 0
            DemConsiderPtoStatus = 0
            DemEventOBDReadinessGroup = DEM_OBD_RDY_NONE
            DemEventPriority = 1
            DemFFPrestorageSupported = 0
            DemOperationCycleRef = DemOperationCycle0
            DemDebounceAlgorithmClass0 (DemDebounceAlgorithmClass)
        ECUM_E_RAM_CHECK_FAILED: DemEventId=14
          DemEventClass0 (DemEventClass):
            DemAgingAllowed = 0
            DemConsiderPtoStatus = 0
            DemEventOBDReadinessGroup = DEM_OBD_RDY_NONE
            DemEventPriority = 1
            DemFFPrestorageSupported = 0
            DemOperationCycleRef = DemOperationCycle0
            DemDebounceAlgorithmClass0 (DemDebounceAlgorithmClass)
        IOHWAB_E_BUSY: DemEventId=15
          DemEventClass:
            DemAgingAllowed = 0
            DemConsiderPtoStatus = 0
            DemEventFailureCycleCounterThreshold = 1
            DemEventOBDReadinessGroup = DEM_OBD_RDY_NONE
            DemEventPriority = 1
            DemFFPrestorageSupported = 0
            DemOperationCycleRef = DemOperationCycle0
            DemDebounceAlgorithmClass
        IOHWAB_E_PROC_FAIL: DemEventId=16
          DemEventClass:
            DemAgingAllowed = 0
            DemConsiderPtoStatus = 0
            DemEventFailureCycleCounterThreshold = 1
            DemEventOBDReadinessGroup = DEM_OBD_RDY_NONE
            DemEventPriority = 1
            DemFFPrestorageSupported = 0
            DemOperationCycleRef = DemOperationCycle0
            DemDebounceAlgorithmClass
        IOHWAB_E_SETUP_FAIL: DemEventId=17
          DemEventClass:
            DemAgingAllowed = 0
            DemConsiderPtoStatus = 0
            DemEventFailureCycleCounterThreshold = 1
            DemEventOBDReadinessGroup = DEM_OBD_RDY_NONE
            DemEventPriority = 1
            DemFFPrestorageSupported = 0
            DemOperationCycleRef = DemOperationCycle0
            DemDebounceAlgorithmClass
        IOHWAB_E_WRONG_PARAM: DemEventId=18
          DemEventClass:
            DemAgingAllowed = 0
            DemConsiderPtoStatus = 0
            DemEventFailureCycleCounterThreshold = 1
            DemEventOBDReadinessGroup = DEM_OBD_RDY_NONE
            DemEventPriority = 1
            DemFFPrestorageSupported = 0
            DemOperationCycleRef = DemOperationCycle0
            DemDebounceAlgorithmClass
        IOHWAB_E_WRONG_SETTING: DemEventId=19
          DemEventClass:
            DemAgingAllowed = 0
            DemConsiderPtoStatus = 0
            DemEventFailureCycleCounterThreshold = 1
            DemEventOBDReadinessGroup = DEM_OBD_RDY_NONE
            DemEventPriority = 1
            DemFFPrestorageSupported = 0
            DemOperationCycleRef = DemOperationCycle0
            DemDebounceAlgorithmClass
        IOHWAB_E_WRONG_STATE: DemEventId=20
          DemEventClass:
            DemAgingAllowed = 0
            DemConsiderPtoStatus = 0
            DemEventFailureCycleCounterThreshold = 1
            DemEventOBDReadinessGroup = DEM_OBD_RDY_NONE
            DemEventPriority = 1
            DemFFPrestorageSupported = 0
            DemOperationCycleRef = DemOperationCycle0
            DemDebounceAlgorithmClass
        NVM_E_INTEGRITY_FAILED: DemEventId=21
          DemEventClass0 (DemEventClass):
            DemAgingAllowed = 0
            DemConsiderPtoStatus = 0
            DemEventOBDReadinessGroup = DEM_OBD_RDY_NONE
            DemEventPriority = 1
            DemFFPrestorageSupported = 0
            DemOperationCycleRef = DemOperationCycle0
            DemDebounceAlgorithmClass0 (DemDebounceAlgorithmClass)
        NVM_E_LOSS_OF_REDUNDANCY: DemEventId=22
          DemEventClass0 (DemEventClass):
            DemAgingAllowed = 0
            DemConsiderPtoStatus = 0
            DemEventOBDReadinessGroup = DEM_OBD_RDY_NONE
            DemEventPriority = 1
            DemFFPrestorageSupported = 0
            DemOperationCycleRef = DemOperationCycle0
            DemDebounceAlgorithmClass0 (DemDebounceAlgorithmClass)
        NVM_E_QUEUE_OVERFLOW: DemEventId=23
          DemEventClass0 (DemEventClass):
            DemAgingAllowed = 0
            DemConsiderPtoStatus = 0
            DemEventOBDReadinessGroup = DEM_OBD_RDY_NONE
            DemEventPriority = 1
            DemFFPrestorageSupported = 0
            DemOperationCycleRef = DemOperationCycle0
            DemDebounceAlgorithmClass0 (DemDebounceAlgorithmClass)
        NVM_E_REQ_FAILED: DemEventId=24
          DemEventClass0 (DemEventClass):
            DemAgingAllowed = 0
            DemConsiderPtoStatus = 0
            DemEventOBDReadinessGroup = DEM_OBD_RDY_NONE
            DemEventPriority = 1
            DemFFPrestorageSupported = 0
            DemOperationCycleRef = DemOperationCycle0
            DemDebounceAlgorithmClass0 (DemDebounceAlgorithmClass)
        NVM_E_VERIFY_FAILED: DemEventId=25
          DemEventClass0 (DemEventClass):
            DemAgingAllowed = 0
            DemConsiderPtoStatus = 0
            DemEventOBDReadinessGroup = DEM_OBD_RDY_NONE
            DemEventPriority = 1
            DemFFPrestorageSupported = 0
            DemOperationCycleRef = DemOperationCycle0
            DemDebounceAlgorithmClass0 (DemDebounceAlgorithmClass)
        NVM_E_WRITE_PROTECTED: DemEventId=26
          DemEventClass0 (DemEventClass):
            DemAgingAllowed = 0
            DemConsiderPtoStatus = 0
            DemEventOBDReadinessGroup = DEM_OBD_RDY_NONE
            DemEventPriority = 1
            DemFFPrestorageSupported = 0
            DemOperationCycleRef = DemOperationCycle0
            DemDebounceAlgorithmClass0 (DemDebounceAlgorithmClass)
        NVM_E_WRONG_BLOCK_ID: DemEventId=27
          DemEventClass0 (DemEventClass):
            DemAgingAllowed = 0
            DemConsiderPtoStatus = 0
            DemEventOBDReadinessGroup = DEM_OBD_RDY_NONE
            DemEventPriority = 1
            DemFFPrestorageSupported = 0
            DemOperationCycleRef = DemOperationCycle0
            DemDebounceAlgorithmClass0 (DemDebounceAlgorithmClass)
        RAMTST_E_RAM_FAILURE: DemEventId=28
          DemEventClass:
            DemAgingAllowed = 0
            DemConsiderPtoStatus = 0
            DemEventOBDReadinessGroup = DEM_OBD_RDY_NONE
            DemEventPriority = 1
            DemFFPrestorageSupported = 0
            DemOperationCycleRef = DemOperationCycle0
        WDG_76_ACW_E_DISABLE_REJECTED: DemEventId=29
          DemEventClass:
            DemAgingAllowed = 0
            DemConsiderPtoStatus = 0
            DemFFPrestorageSupported = 0
            DemEventOBDReadinessGroup = DEM_OBD_RDY_NONE
            DemEventPriority = 1
            DemOperationCycleRef = DemOperationCycle0
        WDG_76_ACW_E_MODE_FAILED: DemEventId=30
          DemEventClass:
            DemAgingAllowed = 0
            DemConsiderPtoStatus = 0
            DemFFPrestorageSupported = 0
            DemEventOBDReadinessGroup = DEM_OBD_RDY_NONE
            DemEventPriority = 1
            DemOperationCycleRef = DemOperationCycle0
        WDGM_E_IMPROPER_CALLER: DemEventId=31
          DemEventClass0 (DemEventClass):
            DemAgingAllowed = 0
            DemConsiderPtoStatus = 0
            DemEventOBDReadinessGroup = DEM_OBD_RDY_NONE
            DemEventPriority = 1
            DemFFPrestorageSupported = 0
            DemOperationCycleRef = DemOperationCycle0
            DemDebounceAlgorithmClass0 (DemDebounceAlgorithmClass)
        WDGM_E_MONITORING: DemEventId=32
          DemEventClass0 (DemEventClass):
            DemAgingAllowed = 0
            DemConsiderPtoStatus = 0
            DemEventOBDReadinessGroup = DEM_OBD_RDY_NONE
            DemEventPriority = 1
            DemFFPrestorageSupported = 0
            DemOperationCycleRef = DemOperationCycle0
            DemDebounceAlgorithmClass0 (DemDebounceAlgorithmClass)
        WDGM_E_SET_MODE: DemEventId=33
          DemEventClass0 (DemEventClass):
            DemAgingAllowed = 0
            DemConsiderPtoStatus = 0
            DemEventOBDReadinessGroup = DEM_OBD_RDY_NONE
            DemEventPriority = 1
            DemFFPrestorageSupported = 0
            DemOperationCycleRef = DemOperationCycle0
            DemDebounceAlgorithmClass0 (DemDebounceAlgorithmClass)
        EEP_E_COMPARE_FAILED: DemEventId=34
          DemEventClass:
            DemAgingAllowed = 0
            DemConsiderPtoStatus = 0
            DemFFPrestorageSupported = 0
            DemEventOBDReadinessGroup = DEM_OBD_RDY_NONE
            DemEventPriority = 1
            DemOperationCycleRef = DemOperationCycle0
        EEP_E_ERASE_FAILED: DemEventId=35
          DemEventClass:
            DemAgingAllowed = 0
            DemConsiderPtoStatus = 0
            DemFFPrestorageSupported = 0
            DemEventOBDReadinessGroup = DEM_OBD_RDY_NONE
            DemEventPriority = 1
            DemOperationCycleRef = DemOperationCycle0
        EEP_E_READ_FAILED: DemEventId=36
          DemEventClass:
            DemAgingAllowed = 0
            DemConsiderPtoStatus = 0
            DemFFPrestorageSupported = 0
            DemEventOBDReadinessGroup = DEM_OBD_RDY_NONE
            DemEventPriority = 1
            DemOperationCycleRef = DemOperationCycle0
        EEP_E_WRITE_FAILED: DemEventId=37
          DemEventClass:
            DemAgingAllowed = 0
            DemConsiderPtoStatus = 0
            DemFFPrestorageSupported = 0
            DemEventOBDReadinessGroup = DEM_OBD_RDY_NONE
            DemEventPriority = 1
            DemOperationCycleRef = DemOperationCycle0
    DemGeneral:
      DemAgingCycleCounterProcessing = DEM_PROCESS_AGINGCTR_INTERN
      DemBswErrorBufferSize = 25
      DemClearDTCBehavior = DEM_CLRRESP_NONVOLATILE_TRIGGER
      DemDTCSuppressionSupport = 0
      DemDebounceCounterBasedSupport = 0
      DemDebounceTimeBasedSupport = 0
      DemDevErrorDetect = 1
      DemDtcStatusAvailabilityMask = 0x09
      DemEventCombinationSupport = DEM_EVCOMB_DISABLED
      DemEventDisplacementSupport = 0
      DemMaxNumberEventEntryMirror = 0
      DemMaxNumberEventEntryPermanent = 0
      DemMaxNumberEventEntryPrimary = 3
      DemMaxNumberEventEntrySecondary = 0
      DemMaxNumberPrestoredFF = 0
      DemOBDSupport = 0
      DemOccurrenceCounterProcessing = DEM_PROCESS_OCCCTR_TF
      DemOperationCycleStatusStorage = 1
      DemPTOSupport = 0
      DemStatusBitHandlingTestFailedSinceLastClear = DEM_STATUS_BIT_NORMAL
      DemStatusBitStorageTestFailed = 0
      DemTaskTime = 0.01
      DemTriggerDcmReports = 0
      DemTriggerDltReports = 0
      DemTriggerFiMReports = 1
      DemTriggerMonitorInitBeforeClearOk = 0
      DemTypeOfDTCSupported = DEM_DTC_TRANSLATION_ISO15031_6
      DemTypeOfFreezeFrameRecordNumeration = DEM_FF_RECNUM_CALCULATED
      DemVersionInfoApi = 0
      DemEnableConditionSupport = 1
      DemStorageConditionSupport = 1
      DemImmediateNvStorageLimit = 5
      DemFreezeFrameCapture = DEM_TRIGGER_TESTFAILED
      DemExtendedDataCapture = DEM_TRIGGER_TESTFAILED
      4 x DemGroupOfDTC:
        DEM_DTC_GROUP_POWERTRAIN_DTCS: DemGroupDTCs=0xff
        DEM_DTC_GROUP_CHASSIS_DTCS: DemGroupDTCs=0x4000ff
        DEM_DTC_GROUP_BODY_DTCS: DemGroupDTCs=0x8000ff
        DEM_DTC_GROUP_NETWORK_COM_DTCS: DemGroupDTCs=0xc000ff
      DemOperationCycle0 (DemOperationCycle): DemOperationCycleType=DEM_OPCYC_POWER
      DemNvRamBlockId
      4 x DemExtendedDataClass:
        ED_TEST_01: DemExtendedDataRecordClassRef=EDR_TEST_01
        ED_TEST_02: DemExtendedDataRecordClassRef=EDR_TEST_01, DemExtendedDataRecordClassRef=EDR_TEST_02
        ED_TEST_03: DemExtendedDataRecordClassRef=EDR_TEST_03
        ED_TEST_04: DemExtendedDataRecordClassRef=EDR_TEST_04
      4 x DemExtendedDataRecordClass, all with DemExtendedDataRecordUpdate=DEM_UPDATE_RECORD_YES:
        EDR_TEST_01: DemExtendedDataRecordNumber=5, DemDataElementClassRef=DemInternalDataElementClass
        EDR_TEST_02: DemExtendedDataRecordNumber=6, DemDataElementClassRef=DemInternalDataElementClass
        EDR_TEST_03: DemExtendedDataRecordNumber=1, DemDataElementClassRef=DemExternalCSDataElementClass_0
        EDR_TEST_04: DemExtendedDataRecordNumber=1, DemDataElementClassRef=DemExternalCSDataElementClass_0
      4 x DemDataElementClass:
        DE_0001
          DemExternalCSDataElementClass: DemDataElementDataSize=3, DemDataElementUsePort=1
        DE_0002
          DemExternalCSDataElementClass: DemDataElementUsePort=1, DemDataElementDataSize=3
        AgingCounter
          DemInternalDataElementClass: DemDataElementDataSize=1, DemInternalDataElement=DEM_AGINGCTR
        OccurrenceCounter
          DemInternalDataElementClass: DemDataElementDataSize=1, DemInternalDataElement=DEM_OCCCTR
      DemFreezeFrameClass0 (DemFreezeFrameClass): DemDidClassRef=DemDidClass0
      DemFreezeFrameClass1 (DemFreezeFrameClass): DemDidClassRef=DemDidClass1
      DemDidClass0 (DemDidClass): DemDidIdentifier=0x4710, DemDidDataElementClassRef=DemExternalCSDataElementClass_0
      DemDidClass1 (DemDidClass): DemDidIdentifier=0x4711, DemDidDataElementClassRef=DemExternalCSDataElementClass_0
      DemEnableCondition0 (DemEnableCondition): DemEnableConditionStatus=1, DemEnableConditionId=0
      DemEnableConditionGroup0 (DemEnableConditionGroup): DemEnableConditionRef=DemEnableCondition0
      DemIndicator0 (DemIndicator): DemIndicatorID=0
      DemIndicator1 (DemIndicator): DemIndicatorID=1
      DemStorageCondition0 (DemStorageCondition): DemStorageConditionStatus=1, DemStorageConditionId=0
      DemStorageConditionGroup0 (DemStorageConditionGroup): DemStorageConditionRef=DemStorageCondition
    CommonPublishedInformation
