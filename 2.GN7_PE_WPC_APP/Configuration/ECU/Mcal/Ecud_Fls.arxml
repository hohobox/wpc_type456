AUTOSAR XML (schema 4-0-3)
package /Fls
  module config Fls: implementation-config-variant=VARIANT-PRE-COMPILE, module-description=FlsImplementation
    FlsConfigSet_0 (FlsConfigSet):
      FlsAcErase = 0
      FlsAcWrite = 0
      FlsCallCycle = 0.001
      FlsDefaultMode = MEMIF_MODE_FAST
      FlsMaxReadFastMode = 1024
      FlsMaxReadNormalMode = 128
      FlsMaxWriteFastMode = 64
      FlsMaxWriteNormalMode = 16
      FlsNumberOfDelayLoop = 2000
      FlsProtection = 0
      FlsSectorList
        56 x FlsSector, all with FlsPageSize=4:
          FlsSector_LG_0: FlsSectorIdentifier=WFLASH_LG_SBM_SECTOR_0, FlsNumberOfSectors=1, FlsSectorSize=2048, FlsSectorStartaddress=0
          FlsSector_LG_1: FlsSectorIdentifier=WFLASH_LG_SBM_SECTOR_1, FlsNumberOfSectors=1, FlsSectorSize=2048, FlsSectorStartaddress=2048
          FlsSector_LG_2: FlsSectorIdentifier=WFLASH_LG_SBM_SECTOR_2, FlsNumberOfSectors=1, FlsSectorSize=2048, FlsSectorStartaddress=4096
          FlsSector_LG_3: FlsSectorIdentifier=WFLASH_LG_SBM_SECTOR_3, FlsNumberOfSectors=1, FlsSectorSize=2048, FlsSectorStartaddress=6144
          FlsSector_LG_4: FlsSectorIdentifier=WFLASH_LG_SBM_SECTOR_4, FlsNumberOfSectors=1, FlsSectorSize=2048, FlsSectorStartaddress=8192
          FlsSector_LG_5: FlsSectorIdentifier=WFLASH_LG_SBM_SECTOR_5, FlsNumberOfSectors=1, FlsSectorSize=2048, FlsSectorStartaddress=10240
          FlsSector_LG_6: FlsSectorIdentifier=WFLASH_LG_SBM_SECTOR_6, FlsNumberOfSectors=1, FlsSectorSize=2048, FlsSectorStartaddress=12288
          FlsSector_LG_7: FlsSectorIdentifier=WFLASH_LG_SBM_SECTOR_7, FlsNumberOfSectors=1, FlsSectorSize=2048, FlsSectorStartaddress=14336
          FlsSector_LG_8: FlsSectorIdentifier=WFLASH_LG_SBM_SECTOR_8, FlsNumberOfSectors=1, FlsSectorSize=2048, FlsSectorStartaddress=16384
          FlsSector_LG_9: FlsSectorIdentifier=WFLASH_LG_SBM_SECTOR_9, FlsNumberOfSectors=1, FlsSectorSize=2048, FlsSectorStartaddress=18432
          FlsSector_LG_10: FlsSectorIdentifier=WFLASH_LG_SBM_SECTOR_10, FlsNumberOfSectors=1, FlsSectorSize=2048, FlsSectorStartaddress=20480
          FlsSector_LG_11: FlsSectorIdentifier=WFLASH_LG_SBM_SECTOR_11, FlsNumberOfSectors=1, FlsSectorSize=2048, FlsSectorStartaddress=22528
          FlsSector_LG_12: FlsSectorIdentifier=WFLASH_LG_SBM_SECTOR_12, FlsNumberOfSectors=1, FlsSectorSize=2048, FlsSectorStartaddress=24576
          FlsSector_LG_13: FlsSectorIdentifier=WFLASH_LG_SBM_SECTOR_13, FlsNumberOfSectors=1, FlsSectorSize=2048, FlsSectorStartaddress=26624
          FlsSector_LG_14: FlsSectorIdentifier=WFLASH_LG_SBM_SECTOR_14, FlsNumberOfSectors=1, FlsSectorSize=2048, FlsSectorStartaddress=28672
          FlsSector_LG_15: FlsSectorIdentifier=WFLASH_LG_SBM_SECTOR_15, FlsNumberOfSectors=1, FlsSectorSize=2048, FlsSectorStartaddress=30720
          FlsSector_LG_16: FlsSectorIdentifier=WFLASH_LG_SBM_SECTOR_16, FlsNumberOfSectors=1, FlsSectorSize=2048, FlsSectorStartaddress=32768
          FlsSector_LG_17: FlsSectorIdentifier=WFLASH_LG_SBM_SECTOR_17, FlsNumberOfSectors=1, FlsSectorSize=2048, FlsSectorStartaddress=34816
          FlsSector_LG_18: FlsSectorIdentifier=WFLASH_LG_SBM_SECTOR_18, FlsNumberOfSectors=1, FlsSectorSize=2048, FlsSectorStartaddress=36864
          FlsSector_LG_19: FlsSectorIdentifier=WFLASH_LG_SBM_SECTOR_19, FlsNumberOfSectors=1, FlsSectorSize=2048, FlsSectorStartaddress=38912
          FlsSector_LG_20: FlsSectorIdentifier=WFLASH_LG_SBM_SECTOR_20, FlsNumberOfSectors=1, FlsSectorSize=2048, FlsSectorStartaddress=40960
          FlsSector_LG_21: FlsSectorIdentifier=WFLASH_LG_SBM_SECTOR_21, FlsNumberOfSectors=1, FlsSectorSize=2048, FlsSectorStartaddress=43008
          FlsSector_LG_22: FlsSectorIdentifier=WFLASH_LG_SBM_SECTOR_22, FlsNumberOfSectors=1, FlsSectorSize=2048, FlsSectorStartaddress=45056
          FlsSector_LG_23: FlsSectorIdentifier=WFLASH_LG_SBM_SECTOR_23, FlsNumberOfSectors=1, FlsSectorSize=2048, FlsSectorStartaddress=47104
          FlsSector_LG_24: FlsSectorIdentifier=WFLASH_LG_SBM_SECTOR_24, FlsNumberOfSectors=1, FlsSectorSize=2048, FlsSectorStartaddress=49152
          FlsSector_LG_25: FlsSectorIdentifier=WFLASH_LG_SBM_SECTOR_25, FlsNumberOfSectors=1, FlsSectorSize=2048, FlsSectorStartaddress=51200
          FlsSector_LG_26: FlsSectorIdentifier=WFLASH_LG_SBM_SECTOR_26, FlsNumberOfSectors=1, FlsSectorSize=2048, FlsSectorStartaddress=53248
          FlsSector_LG_27: FlsSectorIdentifier=WFLASH_LG_SBM_SECTOR_27, FlsNumberOfSectors=1, FlsSectorSize=2048, FlsSectorStartaddress=55296
          FlsSector_LG_28: FlsSectorIdentifier=WFLASH_LG_SBM_SECTOR_28, FlsNumberOfSectors=1, FlsSectorSize=2048, FlsSectorStartaddress=57344
          FlsSector_LG_29: FlsSectorIdentifier=WFLASH_LG_SBM_SECTOR_29, FlsNumberOfSectors=1, FlsSectorSize=2048, FlsSectorStartaddress=59392
          FlsSector_LG_30: FlsSectorIdentifier=WFLASH_LG_SBM_SECTOR_30, FlsNumberOfSectors=1, FlsSectorSize=2048, FlsSectorStartaddress=61440
          FlsSector_LG_31: FlsSectorIdentifier=WFLASH_LG_SBM_SECTOR_31, FlsNumberOfSectors=1, FlsSectorSize=2048, FlsSectorStartaddress=63488
          FlsSector_LG_32: FlsSectorIdentifier=WFLASH_LG_SBM_SECTOR_32, FlsNumberOfSectors=1, FlsSectorSize=2048, FlsSectorStartaddress=65536
          FlsSector_LG_33: FlsSectorIdentifier=WFLASH_LG_SBM_SECTOR_33, FlsNumberOfSectors=1, FlsSectorSize=2048, FlsSectorStartaddress=67584
          FlsSector_LG_34: FlsSectorIdentifier=WFLASH_LG_SBM_SECTOR_34, FlsNumberOfSectors=1, FlsSectorSize=2048, FlsSectorStartaddress=69632
          FlsSector_LG_35: FlsSectorIdentifier=WFLASH_LG_SBM_SECTOR_35, FlsNumberOfSectors=1, FlsSectorSize=2048, FlsSectorStartaddress=71680
          FlsSector_LG_36: FlsSectorIdentifier=WFLASH_LG_SBM_SECTOR_36, FlsNumberOfSectors=1, FlsSectorSize=2048, FlsSectorStartaddress=73728
          FlsSector_LG_37: FlsSectorIdentifier=WFLASH_LG_SBM_SECTOR_37, FlsNumberOfSectors=1, FlsSectorSize=2048, FlsSectorStartaddress=75776
          FlsSector_LG_38: FlsSectorIdentifier=WFLASH_LG_SBM_SECTOR_38, FlsNumberOfSectors=1, FlsSectorSize=2048, FlsSectorStartaddress=77824
          FlsSector_LG_39: FlsSectorIdentifier=WFLASH_LG_SBM_SECTOR_39, FlsNumberOfSectors=1, FlsSectorSize=2048, FlsSectorStartaddress=79872
          FlsSector_LG_40: FlsSectorIdentifier=WFLASH_LG_SBM_SECTOR_40, FlsNumberOfSectors=1, FlsSectorSize=2048, FlsSectorStartaddress=81920
          FlsSector_LG_41: FlsSectorIdentifier=WFLASH_LG_SBM_SECTOR_41, FlsNumberOfSectors=1, FlsSectorSize=2048, FlsSectorStartaddress=83968
          FlsSector_LG_42: FlsSectorIdentifier=WFLASH_LG_SBM_SECTOR_42, FlsNumberOfSectors=1, FlsSectorSize=2048, FlsSectorStartaddress=86016
          FlsSector_LG_43: FlsSectorIdentifier=WFLASH_LG_SBM_SECTOR_43, FlsNumberOfSectors=1, FlsSectorSize=2048, FlsSectorStartaddress=88064
          FlsSector_LG_44: FlsSectorIdentifier=WFLASH_LG_SBM_SECTOR_44, FlsNumberOfSectors=1, FlsSectorSize=2048, FlsSectorStartaddress=90112
          FlsSector_LG_45: FlsSectorIdentifier=WFLASH_LG_SBM_SECTOR_45, FlsNumberOfSectors=1, FlsSectorSize=2048, FlsSectorStartaddress=92160
          FlsSector_LG_46: FlsSectorIdentifier=WFLASH_LG_SBM_SECTOR_46, FlsNumberOfSectors=1, FlsSectorSize=2048, FlsSectorStartaddress=94208
          FlsSector_LG_47: FlsSectorIdentifier=WFLASH_LG_SBM_SECTOR_47, FlsNumberOfSectors=1, FlsSectorSize=2048, FlsSectorStartaddress=96256
          FlsSector_SM_0_15: FlsSectorIdentifier=WFLASH_SM_SBM_SECTOR_0, FlsNumberOfSectors=16, FlsSectorSize=128, FlsSectorStartaddress=98304
          FlsSector_SM_16_31: FlsSectorIdentifier=WFLASH_SM_SBM_SECTOR_16, FlsNumberOfSectors=16, FlsSectorSize=128, FlsSectorStartaddress=100352
          FlsSector_SM_32_47: FlsSectorIdentifier=WFLASH_SM_SBM_SECTOR_32, FlsNumberOfSectors=16, FlsSectorSize=128, FlsSectorStartaddress=102400
          FlsSector_SM_48_63: FlsSectorIdentifier=WFLASH_SM_SBM_SECTOR_48, FlsNumberOfSectors=16, FlsSectorSize=128, FlsSectorStartaddress=104448
          FlsSector_SM_64_79: FlsSectorIdentifier=WFLASH_SM_SBM_SECTOR_64, FlsNumberOfSectors=16, FlsSectorSize=128, FlsSectorStartaddress=106496
          FlsSector_SM_80_95: FlsSectorIdentifier=WFLASH_SM_SBM_SECTOR_80, FlsNumberOfSectors=16, FlsSectorSize=128, FlsSectorStartaddress=108544
          FlsSector_SM_96_111: FlsSectorIdentifier=WFLASH_SM_SBM_SECTOR_96, FlsNumberOfSectors=16, FlsSectorSize=128, FlsSectorStartaddress=110592
          FlsSector_SM_112_127: FlsSectorIdentifier=WFLASH_SM_SBM_SECTOR_112, FlsNumberOfSectors=16, FlsSectorSize=128, FlsSectorStartaddress=112640
    FlsGeneral:
      FlsAcLoadOnJobStart = 0
      FlsBaseAddress = 0
      FlsBeforeWriteVerification = 0
      FlsBlankCheckApi = 1
      FlsCancelApi = 1
      FlsCompareApi = 1
      FlsDevErrorDetect = 1
      FlsDriverIndex = 0
      FlsEraseVerification = 1
      FlsErrorCalloutFunction = Det_ReportError
      FlsGetJobResultApi = 1
      FlsGetStatusApi = 1
      FlsHsmPresent = 0
      FlsIpcInterruptStructure = 7
      FlsIpcStructure = 7
      FlsReadImmediateApi = 1
      FlsRuntimeErrorDetect = 0
      FlsSetModeApi = 1
      FlsSuspendResumeApi = 0
      FlsTotalSize = 131072
      FlsUseInterrupts = 0
      FlsUseSafetyMechanism = 0
      FlsVersionInfoApi = 1
      FlsWorkEmbeddedNotification = WorkEmbeddedNotification
      FlsWriteVerification = 1
      FlsIncludeFile = Det.h
      FlsIncludeFile = Fee_Cfg.h
      FlsSetFlashCtlRegister = FLS_FLASH_CTL_WORKONLY
      FlsUserValueForFlashCtlRegister = 22085632
      FlsSetWorkFlashSafetyRegister = 0
      FlsDefineWdgClear = 1
      FlsDmaChannel = 2
    FlsPublishedInformation:
      FlsAcLocationErase = 0
      FlsAcLocationWrite = 0
      FlsAcSizeErase = 0
      FlsAcSizeWrite = 0
      FlsEraseTime = 0.16
      FlsErasedValue = 4294967295
      FlsExpectedHwId = Traveo
      FlsSpecifiedEraseCycles = 250000
      FlsWriteTime = 0.001
