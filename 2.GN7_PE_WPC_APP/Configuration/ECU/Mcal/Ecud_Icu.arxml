AUTOSAR XML (schema 4-0-3)
package /Icu
  module config Icu: implementation-config-variant=VARIANT-POST-BUILD, module-description=IcuImplementation
    IcuConfigSet_0 (IcuConfigSet): IcuMaxChannel=3
      3 x IcuChannel, all with IcuMeasurementMode=ICU_MODE_SIGNAL_EDGE_DETECT, IcuWakeupCapability=0:
        IcuChannel_IGN1: IcuChannelId=0, IcuResource=GPIO_8_2, IcuDefaultStartEdge=ICU_RISING_EDGE
          IcuSignalEdgeDetection: IcuSignalNotification=IcuChannel_IGN1_Cbk
        IcuChannel_BCAN_RX: IcuChannelId=1, IcuResource=GPIO_6_3, IcuDefaultStartEdge=ICU_FALLING_EDGE
          IcuSignalEdgeDetection: IcuSignalNotification=IcuChannel_BCAN_RX_Cbk
        IcuChannel_LCAN_RX: IcuChannelId=2, IcuResource=GPIO_19_1, IcuDefaultStartEdge=ICU_FALLING_EDGE
          IcuSignalEdgeDetection: IcuSignalNotification=IcuChannel_LCAN_RX_Cbk
    IcuGeneral:
      IcuErrorCalloutFunction = Det_ReportError
      IcuIndex = 0
      IcuReportWakeupSource = 0
      IcuIncludeFile = Det.h
      IcuDevErrorDetect = 1
      IcuIncludeFile = LowPower_Callout.h
    IcuOptionalApis:
      IcuChannelGroupApi = 1
      IcuDeInitApi = 1
      IcuDisableNotiApiCapableWakeup = 0
      IcuDisableWakeupApi = 1
      IcuEdgeCountApi = 1
      IcuEdgeDetectApi = 1
      IcuEnableNotiApiCapableWakeup = 0
      IcuEnableWakeupApi = 1
      IcuGetDutyCycleValuesApi = 1
      IcuGetInputLevelApi = 1
      IcuGetInputStateApi = 1
      IcuGetTimeElapsedApi = 1
      IcuGetVersionInfoApi = 1
      IcuSafetyFunctionApi = 1
      IcuSetModeApi = 1
      IcuSetPrescalerApi = 1
      IcuSignalMeasurementApi = 1
      IcuTimestampApi = 1
      IcuWakeupAcceptanceInSetMode = 1
      IcuWakeupFunctionalityApi = 1
    IcuDemEventParameterRefs: ICU_E_HARDWARE_ERROR=ICU_E_HARDWARE_ERROR
