AUTOSAR XML (schema 4-0-3)
package /Can
  module config Can: implementation-config-variant=VARIANT-POST-BUILD, module-description=CanImplementation
    CanConfigSet
      WPC_BCAN (CanController):
        category = TOOL_CONFIGURED
        CanBusoffProcessing = INTERRUPT
        CanControllerActivation = 1
        CanControllerId = 0
        CanTxProcessing = INTERRUPT
        CanRxProcessing = INTERRUPT
        CanWakeupProcessing = POLLING
        CanWakeupSupport = 1
        CanWakeupFunctionalityAPI = 1
        CanControllerBaseAddress = 0x40520400
        CanMessageRamBaseAddress = 0x40530000
        CanControllerPhysicalChannel = CANFD02
        CanMessageRamSize = 32768
        CanControllerInstance = INSTANCE0
        CanCpuClockRef = McuClockReferencePoint_CANFD0_CLOCK_CAN2
        CanWakeupSourceRef = ECUM_WKSOURCE_BCAN_RX
        CanControllerDefaultBaudrate = WPC_BCAN/CanControllerBaudrateConfig
        CanControllerBaudrateConfig:
          category = TOOL_CONFIGURED
          CanControllerBaudRate = 500
          CanControllerBaudRateConfigID = 0
          CanControllerPropSeg = 0
          CanControllerSeg1 = 63
          CanControllerSeg2 = 16
          CanControllerSyncJumpWidth = 16
          CanControllerFdBaudrateConfig:
            CanControllerFdBaudRate = 1000
            CanControllerPropSeg = 0
            CanControllerSeg1 = 14
            CanControllerSeg2 = 5
            CanControllerSyncJumpWidth = 4
            CanControllerTrcvDelayCompensationOffset = 375
            CanControllerTxBitRateSwitch = 1
      WPC_LCAN (CanController):
        category = TOOL_CONFIGURED
        CanBusoffProcessing = INTERRUPT
        CanControllerActivation = 1
        CanControllerId = 1
        CanTxProcessing = INTERRUPT
        CanRxProcessing = INTERRUPT
        CanWakeupProcessing = POLLING
        CanWakeupSupport = 1
        CanWakeupFunctionalityAPI = 1
        CanControllerBaseAddress = 0x40540600
        CanMessageRamBaseAddress = 0x40550000
        CanControllerPhysicalChannel = CANFD13
        CanMessageRamSize = 32768
        CanControllerInstance = INSTANCE1
        CanCpuClockRef = McuClockReferencePoint_CANFD1_CLOCK_CAN3
        CanWakeupSourceRef = ECUM_WKSOURCE_LCAN_RX
        CanControllerDefaultBaudrate = WPC_LCAN/CanControllerBaudrateConfig
        CanControllerBaudrateConfig:
          category = TOOL_CONFIGURED
          CanControllerBaudRate = 500
          CanControllerBaudRateConfigID = 0
          CanControllerPropSeg = 0
          CanControllerSeg1 = 63
          CanControllerSeg2 = 16
          CanControllerSyncJumpWidth = 16
          CanControllerFdBaudrateConfig:
            CanControllerFdBaudRate = 1000
            CanControllerPropSeg = 0
            CanControllerSeg1 = 14
            CanControllerSeg2 = 5
            CanControllerSyncJumpWidth = 4
            CanControllerTrcvDelayCompensationOffset = 375
            CanControllerTxBitRateSwitch = 1
      46 x CanHardwareObject, all with category=TOOL_CONFIGURED, CanTriggerTransmitEnable=0, CanIcomRxMessageDedicated=0:
        IN_HwObj_WPC_BCAN_0x7df_BCAN_GST_ALL: CanIdValue=2015, CanObjectType=RECEIVE, CanHandleType=FULL, CanHwObjectCount=1, CanIdType=STANDARD, CanRxBufferSelection=CAN_RX_DEDICATED, CanObjectId=0, CanControllerRef=WPC_BCAN
          CanHwFilter0 (CanHwFilter): category=TOOL_CONFIGURED, CanHwFilterMask=2047, CanHwFilterCode=2015
        IN_HwObj_WPC_BCAN_0x725_BCAN_GST_WPC: CanIdValue=1829, CanObjectType=RECEIVE, CanHandleType=BASIC, CanHwObjectCount=32, CanIdType=STANDARD, CanRxBufferSelection=CAN_RX_FIFO1, CanObjectId=1, CanControllerRef=WPC_BCAN
          CanHwFilter0 (CanHwFilter): category=TOOL_CONFIGURED, CanHwFilterMask=2047, CanHwFilterCode=1829
        IN_HwObj_WPC_BCAN_0x4da_BCAN_CLU_09_00ms: CanIdValue=1242, CanObjectType=RECEIVE, CanHandleType=FULL, CanHwObjectCount=1, CanIdType=STANDARD, CanRxBufferSelection=CAN_RX_DEDICATED, CanObjectId=2, CanControllerRef=WPC_BCAN
          CanHwFilter0 (CanHwFilter): category=TOOL_CONFIGURED, CanHwFilterMask=2047, CanHwFilterCode=1242
        IN_HwObj_WPC_BCAN_0x4d1_BCAN_CLU_05_00ms: CanIdValue=1233, CanObjectType=RECEIVE, CanHandleType=FULL, CanHwObjectCount=1, CanIdType=STANDARD, CanRxBufferSelection=CAN_RX_DEDICATED, CanObjectId=3, CanControllerRef=WPC_BCAN
          CanHwFilter0 (CanHwFilter): category=TOOL_CONFIGURED, CanHwFilterMask=2047, CanHwFilterCode=1233
        IN_HwObj_WPC_BCAN_0x401_BCAN_BDC_FD_SMK_02_200ms: CanIdValue=1025, CanObjectType=RECEIVE, CanHandleType=FULL, CanHwObjectCount=1, CanIdType=STANDARD, CanRxBufferSelection=CAN_RX_DEDICATED, CanObjectId=4, CanControllerRef=WPC_BCAN
          CanHwFilter0 (CanHwFilter): category=TOOL_CONFIGURED, CanHwFilterMask=2047, CanHwFilterCode=1025
        IN_HwObj_WPC_BCAN_0x3e2_BCAN_PDC_FD_03_200ms: CanIdValue=994, CanObjectType=RECEIVE, CanHandleType=FULL, CanHwObjectCount=1, CanIdType=STANDARD, CanRxBufferSelection=CAN_RX_DEDICATED, CanObjectId=5, CanControllerRef=WPC_BCAN
          CanHwFilter0 (CanHwFilter): category=TOOL_CONFIGURED, CanHwFilterMask=2047, CanHwFilterCode=994
        IN_HwObj_WPC_BCAN_0x3d4_BCAN_BDC_FD_05_200ms: CanIdValue=980, CanObjectType=RECEIVE, CanHandleType=FULL, CanHwObjectCount=1, CanIdType=STANDARD, CanRxBufferSelection=CAN_RX_DEDICATED, CanObjectId=6, CanControllerRef=WPC_BCAN
          CanHwFilter0 (CanHwFilter): category=TOOL_CONFIGURED, CanHwFilterMask=2047, CanHwFilterCode=980
        IN_HwObj_WPC_BCAN_0x3d1_BCAN_BDC_FD_02_200ms: CanIdValue=977, CanObjectType=RECEIVE, CanHandleType=FULL, CanHwObjectCount=1, CanIdType=STANDARD, CanRxBufferSelection=CAN_RX_DEDICATED, CanObjectId=7, CanControllerRef=WPC_BCAN
          CanHwFilter0 (CanHwFilter): category=TOOL_CONFIGURED, CanHwFilterMask=2047, CanHwFilterCode=977
        IN_HwObj_WPC_BCAN_0x366_BCAN_HU_GW_03_200ms: CanIdValue=870, CanObjectType=RECEIVE, CanHandleType=FULL, CanHwObjectCount=1, CanIdType=STANDARD, CanRxBufferSelection=CAN_RX_DEDICATED, CanObjectId=8, CanControllerRef=WPC_BCAN
          CanHwFilter0 (CanHwFilter): category=TOOL_CONFIGURED, CanHwFilterMask=2047, CanHwFilterCode=870
        IN_HwObj_WPC_BCAN_0x351_BCAN_IAU_FD_04_200ms: CanIdValue=849, CanObjectType=RECEIVE, CanHandleType=FULL, CanHwObjectCount=1, CanIdType=STANDARD, CanRxBufferSelection=CAN_RX_DEDICATED, CanObjectId=9, CanControllerRef=WPC_BCAN
          CanHwFilter0 (CanHwFilter): category=TOOL_CONFIGURED, CanHwFilterMask=2047, CanHwFilterCode=849
        IN_HwObj_WPC_BCAN_0x33e_BCAN_SBCM_RL_FD_01_200ms: CanIdValue=830, CanObjectType=RECEIVE, CanHandleType=FULL, CanHwObjectCount=1, CanIdType=STANDARD, CanRxBufferSelection=CAN_RX_DEDICATED, CanObjectId=10, CanControllerRef=WPC_BCAN
          CanHwFilter0 (CanHwFilter): category=TOOL_CONFIGURED, CanHwFilterMask=2047, CanHwFilterCode=830
        IN_HwObj_WPC_BCAN_0x33d_BCAN_SBCM_RR_FD_01_200ms: CanIdValue=829, CanObjectType=RECEIVE, CanHandleType=FULL, CanHwObjectCount=1, CanIdType=STANDARD, CanRxBufferSelection=CAN_RX_DEDICATED, CanObjectId=11, CanControllerRef=WPC_BCAN
          CanHwFilter0 (CanHwFilter): category=TOOL_CONFIGURED, CanHwFilterMask=2047, CanHwFilterCode=829
        IN_HwObj_WPC_BCAN_0x32d_BCAN_SBCM_DRV_FD_01_200ms: CanIdValue=813, CanObjectType=RECEIVE, CanHandleType=FULL, CanHwObjectCount=1, CanIdType=STANDARD, CanRxBufferSelection=CAN_RX_DEDICATED, CanObjectId=12, CanControllerRef=WPC_BCAN
          CanHwFilter0 (CanHwFilter): category=TOOL_CONFIGURED, CanHwFilterMask=2047, CanHwFilterCode=813
        IN_HwObj_WPC_BCAN_0x32b_BCAN_SBCM_AST_FD_01_200ms: CanIdValue=811, CanObjectType=RECEIVE, CanHandleType=FULL, CanHwObjectCount=1, CanIdType=STANDARD, CanRxBufferSelection=CAN_RX_DEDICATED, CanObjectId=13, CanControllerRef=WPC_BCAN
          CanHwFilter0 (CanHwFilter): category=TOOL_CONFIGURED, CanHwFilterMask=2047, CanHwFilterCode=811
        IN_HwObj_WPC_BCAN_0x315_BCAN_CLU_20_200ms: CanIdValue=789, CanObjectType=RECEIVE, CanHandleType=FULL, CanHwObjectCount=1, CanIdType=STANDARD, CanRxBufferSelection=CAN_RX_DEDICATED, CanObjectId=14, CanControllerRef=WPC_BCAN
          CanHwFilter0 (CanHwFilter): category=TOOL_CONFIGURED, CanHwFilterMask=2047, CanHwFilterCode=789
        IN_HwObj_WPC_BCAN_0x314_BCAN_RWPC_FD_01_200ms: CanIdValue=788, CanObjectType=RECEIVE, CanHandleType=FULL, CanHwObjectCount=1, CanIdType=STANDARD, CanRxBufferSelection=CAN_RX_DEDICATED, CanObjectId=15, CanControllerRef=WPC_BCAN
          CanHwFilter0 (CanHwFilter): category=TOOL_CONFIGURED, CanHwFilterMask=2047, CanHwFilterCode=788
        IN_HwObj_WPC_BCAN_0x2e9_BCAN_PDC_FD_15_300ms: CanIdValue=745, CanObjectType=RECEIVE, CanHandleType=FULL, CanHwObjectCount=1, CanIdType=STANDARD, CanRxBufferSelection=CAN_RX_DEDICATED, CanObjectId=16, CanControllerRef=WPC_BCAN
          CanHwFilter0 (CanHwFilter): category=TOOL_CONFIGURED, CanHwFilterMask=2047, CanHwFilterCode=745
        IN_HwObj_WPC_BCAN_0x1aa_BCAN_CLU_01_20ms: CanIdValue=426, CanObjectType=RECEIVE, CanHandleType=FULL, CanHwObjectCount=1, CanIdType=STANDARD, CanRxBufferSelection=CAN_RX_DEDICATED, CanObjectId=17, CanControllerRef=WPC_BCAN
          CanHwFilter0 (CanHwFilter): category=TOOL_CONFIGURED, CanHwFilterMask=2047, CanHwFilterCode=426
        IN_HwObj_WPC_BCAN_0x116_BCAN_HU_USM_05_00ms: CanIdValue=278, CanObjectType=RECEIVE, CanHandleType=FULL, CanHwObjectCount=1, CanIdType=STANDARD, CanRxBufferSelection=CAN_RX_DEDICATED, CanObjectId=18, CanControllerRef=WPC_BCAN
          CanHwFilter0 (CanHwFilter): category=TOOL_CONFIGURED, CanHwFilterMask=2047, CanHwFilterCode=278
        IN_HwObj_WPC_BCAN_0x114_BCAN_HU_USM_04_00ms: CanIdValue=276, CanObjectType=RECEIVE, CanHandleType=FULL, CanHwObjectCount=1, CanIdType=STANDARD, CanRxBufferSelection=CAN_RX_DEDICATED, CanObjectId=19, CanControllerRef=WPC_BCAN
          CanHwFilter0 (CanHwFilter): category=TOOL_CONFIGURED, CanHwFilterMask=2047, CanHwFilterCode=276
        IN_HwObj_WPC_BCAN_0x112_BCAN_HU_USM_02_00ms: CanIdValue=274, CanObjectType=RECEIVE, CanHandleType=FULL, CanHwObjectCount=1, CanIdType=STANDARD, CanRxBufferSelection=CAN_RX_DEDICATED, CanObjectId=20, CanControllerRef=WPC_BCAN
          CanHwFilter0 (CanHwFilter): category=TOOL_CONFIGURED, CanHwFilterMask=2047, CanHwFilterCode=274
        IN_HwObj_WPC_BCAN_0x111_BCAN_HU_USM_01_00ms: CanIdValue=273, CanObjectType=RECEIVE, CanHandleType=FULL, CanHwObjectCount=1, CanIdType=STANDARD, CanRxBufferSelection=CAN_RX_DEDICATED, CanObjectId=21, CanControllerRef=WPC_BCAN
          CanHwFilter0 (CanHwFilter): category=TOOL_CONFIGURED, CanHwFilterMask=2047, CanHwFilterCode=273
        IN_HwObj_WPC_BCAN_0x105_BCAN_EMS_07_10ms: CanIdValue=261, CanObjectType=RECEIVE, CanHandleType=FULL, CanHwObjectCount=1, CanIdType=STANDARD, CanRxBufferSelection=CAN_RX_DEDICATED, CanObjectId=22, CanControllerRef=WPC_BCAN
          CanHwFilter0 (CanHwFilter): category=TOOL_CONFIGURED, CanHwFilterMask=2047, CanHwFilterCode=261
        IN_HwObj_WPC_BCAN_0x100_BCAN_EMS_02_10ms: CanIdValue=256, CanObjectType=RECEIVE, CanHandleType=FULL, CanHwObjectCount=1, CanIdType=STANDARD, CanRxBufferSelection=CAN_RX_DEDICATED, CanObjectId=23, CanControllerRef=WPC_BCAN
          CanHwFilter0 (CanHwFilter): category=TOOL_CONFIGURED, CanHwFilterMask=2047, CanHwFilterCode=256
        IN_HwObj_WPC_BCAN_0xfa_BCAN_HCU_03_10ms: CanIdValue=250, CanObjectType=RECEIVE, CanHandleType=FULL, CanHwObjectCount=1, CanIdType=STANDARD, CanRxBufferSelection=CAN_RX_DEDICATED, CanObjectId=24, CanControllerRef=WPC_BCAN
          CanHwFilter0 (CanHwFilter): category=TOOL_CONFIGURED, CanHwFilterMask=2047, CanHwFilterCode=250
        IN_HwObj_WPC_BCAN_0x35_BCAN_VCU_01_10ms: CanIdValue=53, CanObjectType=RECEIVE, CanHandleType=FULL, CanHwObjectCount=1, CanIdType=STANDARD, CanRxBufferSelection=CAN_RX_DEDICATED, CanObjectId=25, CanControllerRef=WPC_BCAN
          CanHwFilter0 (CanHwFilter): category=TOOL_CONFIGURED, CanHwFilterMask=2047, CanHwFilterCode=53
        IN_HwObj_0x17fc0000_0x17fc00fe_WPC_BCAN_NM_Message: CanIdValue=402391040, CanObjectType=RECEIVE, CanHandleType=BASIC, CanIdType=EXTENDED, CanHwObjectCount=27, CanRxBufferSelection=CAN_RX_FIFO0, CanObjectId=26, CanControllerRef=WPC_BCAN
          CanHwFilter0 (CanHwFilter): category=TOOL_CONFIGURED, CanHwFilterMask=536870656, CanHwFilterCode=402391040
        IN_HwObj_WPC_LCAN_0xc000104_LCAN_L_TP_BDC_FD_L_WPC_FD: CanIdValue=201326852, CanObjectType=RECEIVE, CanHandleType=FULL, CanHwObjectCount=1, CanIdType=EXTENDED, CanRxBufferSelection=CAN_RX_DEDICATED, CanObjectId=27, CanControllerRef=WPC_LCAN
          CanHwFilter0 (CanHwFilter): category=TOOL_CONFIGURED, CanHwFilterMask=536870911, CanHwFilterCode=201326852
        IN_HwObj_WPC_LCAN_0x8000050_LCAN_L_BDC_FD_IAU_10_200ms: CanIdValue=134217808, CanObjectType=RECEIVE, CanHandleType=FULL, CanHwObjectCount=1, CanIdType=EXTENDED, CanRxBufferSelection=CAN_RX_DEDICATED, CanObjectId=28, CanControllerRef=WPC_LCAN
          CanHwFilter0 (CanHwFilter): category=TOOL_CONFIGURED, CanHwFilterMask=536870911, CanHwFilterCode=134217808
        IN_HwObj_WPC_LCAN_0x4000050_LCAN_L_BDC_FD_IAU_01_00ms: CanIdValue=67108944, CanObjectType=RECEIVE, CanHandleType=FULL, CanHwObjectCount=1, CanIdType=EXTENDED, CanRxBufferSelection=CAN_RX_DEDICATED, CanObjectId=29, CanControllerRef=WPC_LCAN
          CanHwFilter0 (CanHwFilter): category=TOOL_CONFIGURED, CanHwFilterMask=536870911, CanHwFilterCode=67108944
        IN_HwObj_WPC_LCAN_0x43f_LCAN_CCU_01_00ms: CanIdValue=1087, CanObjectType=RECEIVE, CanHandleType=FULL, CanHwObjectCount=1, CanIdType=STANDARD, CanRxBufferSelection=CAN_RX_DEDICATED, CanObjectId=30, CanControllerRef=WPC_LCAN
          CanHwFilter0 (CanHwFilter): category=TOOL_CONFIGURED, CanHwFilterMask=2047, CanHwFilterCode=1087
        IN_HwObj_WPC_LCAN_0x352_LCAN_IAU_FD_05_200ms: CanIdValue=850, CanObjectType=RECEIVE, CanHandleType=FULL, CanHwObjectCount=1, CanIdType=STANDARD, CanRxBufferSelection=CAN_RX_DEDICATED, CanObjectId=31, CanControllerRef=WPC_LCAN
          CanHwFilter0 (CanHwFilter): category=TOOL_CONFIGURED, CanHwFilterMask=2047, CanHwFilterCode=850
        IN_HwObj_WPC_LCAN_0x351_LCAN_IAU_FD_04_200ms: CanIdValue=849, CanObjectType=RECEIVE, CanHandleType=FULL, CanHwObjectCount=1, CanIdType=STANDARD, CanRxBufferSelection=CAN_RX_DEDICATED, CanObjectId=32, CanControllerRef=WPC_LCAN
          CanHwFilter0 (CanHwFilter): category=TOOL_CONFIGURED, CanHwFilterMask=2047, CanHwFilterCode=849
        IN_HwObj_WPC_LCAN_0x2e9_LCAN_PDC_FD_15_300ms: CanIdValue=745, CanObjectType=RECEIVE, CanHandleType=FULL, CanHwObjectCount=1, CanIdType=STANDARD, CanRxBufferSelection=CAN_RX_DEDICATED, CanObjectId=33, CanControllerRef=WPC_LCAN
          CanHwFilter0 (CanHwFilter): category=TOOL_CONFIGURED, CanHwFilterMask=2047, CanHwFilterCode=745
        IN_HwObj_0x17fc0000_0x17fc00fe_WPC_LCAN_NM_Message: CanIdValue=402391040, CanObjectType=RECEIVE, CanHandleType=BASIC, CanIdType=EXTENDED, CanHwObjectCount=16, CanRxBufferSelection=CAN_RX_FIFO1, CanObjectId=34, CanControllerRef=WPC_LCAN
          CanHwFilter0 (CanHwFilter): category=TOOL_CONFIGURED, CanHwFilterMask=536870656, CanHwFilterCode=402391040
        OUT_HwObj_WPC_BCAN_0x21f_BCAN_WPC_FD_VCRM_01_00ms: CanIdValue=543, CanObjectType=TRANSMIT, CanHandleType=FULL, CanIdType=STANDARD, CanObjectId=35, CanHwObjectCount=1, CanControllerRef=WPC_BCAN
        OUT_HwObj_WPC_BCAN_0x391_BCAN_WPC_FD_01_200ms: CanIdValue=913, CanObjectType=TRANSMIT, CanHandleType=FULL, CanIdType=STANDARD, CanObjectId=36, CanHwObjectCount=1, CanControllerRef=WPC_BCAN
        OUT_HwObj_WPC_BCAN_0x392_BCAN_WPC2_FD_01_200ms: CanIdValue=914, CanObjectType=TRANSMIT, CanHandleType=FULL, CanIdType=STANDARD, CanObjectId=37, CanHwObjectCount=1, CanControllerRef=WPC_BCAN
        OUT_HwObj_WPC_BCAN_0x686_BCAN_WPCmsgDvp1: CanIdValue=1670, CanObjectType=TRANSMIT, CanHandleType=FULL, CanIdType=STANDARD, CanObjectId=38, CanHwObjectCount=1, CanControllerRef=WPC_BCAN
        OUT_WPC_BCAN_HwObj_0x0_BASIC: CanHandleType=BASIC, CanObjectType=TRANSMIT, CanIdType=STANDARD, CanIdValue=2047, CanObjectId=39, CanHwObjectCount=1, CanControllerRef=WPC_BCAN
        OUT_HwObj_WPC_BCAN_0x17fc009e_BCAN_NM_WPC_FD: CanIdValue=402391198, CanObjectType=TRANSMIT, CanHandleType=FULL, CanIdType=EXTENDED, CanObjectId=40, CanHwObjectCount=1, CanControllerRef=WPC_BCAN
        OUT_HwObj_WPC_BCAN_0x1ec7b001_BCAN_WPC_WU_01_500ms: CanIdValue=516403201, CanObjectType=TRANSMIT, CanHandleType=FULL, CanIdType=EXTENDED, CanObjectId=41, CanHwObjectCount=1, CanControllerRef=WPC_BCAN
        OUT_HwObj_WPC_LCAN_0x4000070_LCAN_L_WPC_FD_01_00ms: CanIdValue=67108976, CanObjectType=TRANSMIT, CanHandleType=FULL, CanIdType=EXTENDED, CanObjectId=42, CanHwObjectCount=1, CanControllerRef=WPC_LCAN
        OUT_HwObj_WPC_LCAN_0x8000070_LCAN_L_WPC_FD_20_200ms: CanIdValue=134217840, CanObjectType=TRANSMIT, CanHandleType=FULL, CanIdType=EXTENDED, CanObjectId=43, CanHwObjectCount=1, CanControllerRef=WPC_LCAN
        OUT_HwObj_WPC_LCAN_0xc000105_LCAN_L_TP_L_WPC_FD_BDC_FD: CanIdValue=201326853, CanObjectType=TRANSMIT, CanHandleType=FULL, CanIdType=EXTENDED, CanObjectId=44, CanHwObjectCount=1, CanControllerRef=WPC_LCAN
        OUT_HwObj_WPC_LCAN_0x17fc001e_LCAN_NM_L_WPC_FD: CanIdValue=402391070, CanObjectType=TRANSMIT, CanHandleType=FULL, CanIdType=EXTENDED, CanObjectId=45, CanHwObjectCount=1, CanControllerRef=WPC_LCAN
    CanGeneral:
      CanChangeBaudrateApi = 0
      CanDeInitApi = 0
      CanDevErrorDetection = 1
      CanErrorCalloutFunction = Det_ReportError
      CanGetStatusApi = 1
      CanHardwareCancellation = 0
      CanIdenticalIdCancellation = 0
      CanIncludeFile = Can_Version.h
      CanIncludeFile = Det.h
      CanIndex = 0
      CanMainFunctionModePeriod = 0.005
      CanPublicIcomSupport = 0
      CanRxIndicationCompatibility = CAN_ASR_422_COMPATIBILITY
      CanSetBaudrateInChangedClockApi = 0
      CanTimeoutDuration = 0.005
      CanVersionInfoApi = 1
      CanMultiplexedTransmission = 1
      CanOsCounterRef = OsCounter_0
      CanDemEventParameterRefs: CAN_E_HARDWARE_ERROR=CAN_E_HARDWARE_ERROR
      CanMainFunctionRWPeriods: CanMainFunctionPeriod=0.01
      CanMainFunctionRWPeriods: category=TOOL_CONFIGURED
