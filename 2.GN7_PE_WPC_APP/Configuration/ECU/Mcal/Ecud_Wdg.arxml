AUTOSAR XML (schema 4-0-3)
package /Wdg
  module config Wdg: implementation-config-variant=VARIANT-POST-BUILD, module-description=WdgImplementation
    WdgDemEventParameterRefs:
      WDG_E_DISABLE_REJECTED = WDG_E_DISABLE_REJECTED
      WDG_E_HW_TIMEOUT = WDG_E_HW_TIMEOUT
      WDG_E_MODE_FAILED = WDG_E_MODE_FAILED
      WDG_E_WDG_STOPPED = WDG_E_WDG_STOPPED
    WdgGeneral:
      WdgDemEventDisableRejected = 0
      WdgDemEventHwTimeout = 0
      WdgDemEventModeFailed = 0
      WdgDemEventWdgStopped = 0
      WdgDevErrorDetect = 1
      WdgDisableAllowed = 1
      WdgErrorCalloutFunction = Det_ReportError
      WdgIndex = 0
      WdgInitialTimeout = 4.0
      WdgMaxTimeout = 4.2
      WdgRunArea = ROM
      WdgTriggerAddress = 134281216
      WdgTriggerLocation = Wdg_66_IA_ActivateTrigger
      WdgVersionInfoApi = 1
      WdgIncludeFile = Det.h
    WdgPublishedInformation
    WdgSettingsConfig_0 (WdgSettingsConfig): WdgDefaultMode=WDGIF_OFF_MODE
      WdgSettingsFast
        WdgSettingsFastList_0 (WdgSettingsFastList):
          WdgFastLowerLimitPercent = 0
          WdgFastMaxWaitTime = 250
          WdgFastTimeoutValue = 100
          WdgFastWarnLimitPercent = 80
          WdgFastMcuClockRef = McuClockReferencePoint_ROOT0
          WdgFastTimerConfigRef = WdgTimerConfigList_0
      WdgSettingsOff
        WdgSettingsOffList_0 (WdgSettingsOffList): WdgOffMaxWaitTime=250, WdgOffMcuClockRef=McuClockReferencePoint_ROOT0, WdgOffTimerConfigRef=WdgTimerConfigList_0
      WdgSettingsSlow
        WdgSettingsSlowList_0 (WdgSettingsSlowList):
          WdgSlowLowerLimitPercent = 0
          WdgSlowMaxWaitTime = 250
          WdgSlowTimeoutValue = 500
          WdgSlowWarnLimitPercent = 80
          WdgSlowMcuClockRef = McuClockReferencePoint_ROOT0
          WdgSlowTimerConfigRef = WdgTimerConfigList_0
      WdgTimerConfigList_0 (WdgTimerConfigList):
        WdgCPUSelect = 0
        WdgDebugModeConfig = WDG_DEBUGMODE_RUN
        WdgDeepsleepConfig = WDG_DEEPSLEEP_FREEZE
        WdgEnableWarningIrq = 0
        WdgLowerActionConfig = WDG_ACTION_RESET
        WdgStopWDT = 0
        WdgTimerSelection = WDG_TIMER_WDT
        WdgUpperActionConfig = WDG_ACTION_RESET
        WdgTimerClockRef = McuClockReferencePoint_ILO0
