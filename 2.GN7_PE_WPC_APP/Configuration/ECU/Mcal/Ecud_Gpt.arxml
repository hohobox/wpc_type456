AUTOSAR XML (schema 4-0-3)
package /Gpt
  module config Gpt: implementation-config-variant=VARIANT-POST-BUILD, module-description=GptImplementation
    GptChannelConfigSet_0 (GptChannelConfigSet)
      3 x GptChannelConfiguration, all with GptChannelClkSrc=CLK_INT, GptChannelMode=GPT_CH_MODE_ONESHOT, GptChannelTickFrequency=1000000, GptChannelTickValueMax=65535, GptEnableDebug=1, GptEnableWakeup=0:
        GptChannelConfiguration_WdgExt: GptChannelId=0, GptNotification=Wdg_76_Acw_Cbk_GptNotification, GptTimer=TCPWM_0_7, GptChannelClkSrcRef=GptClockReferencePoint_0
        GptChannelConfiguration_IOManager: GptChannelId=1, GptNotification=IoHwAb_IOMOnTimer, GptTimer=TCPWM_0_10, GptChannelClkSrcRef=GptClockReferencePoint_2
        GptChannelConfiguration_GptTest: GptChannelId=2, GptNotification=GptChannelConfiguration_IoHwAbTest_Cbk, GptTimer=TCPWM_0_3, GptChannelClkSrcRef=GptClockReferencePoint_3
      GptChannelConfiguration_OSDebug (GptPredefTimerChannelConfiguration):
        GptPredefTimerTickFrequencyResult = 1000000.0
        GptPredefTimer = TCPWM_0_512
        GptPredefTimerEnableDebug = 1
        GptPredefTimerType = GPT_PREDEF_TIMER_1US_16_24_32BIT
        GptPredefTimerClkSrcRef = GptClockReferencePoint_1
      GptPredefTimerStartTriggerConfiguration
    GptConfigurationOfOptApiServices:
      GptDeinitApi = 1
      GptEnableDisableNotificationApi = 1
      GptSafetyFunctionApi = 1
      GptSetPredefTimerPrescalerApi = 1
      GptSetPrescalerApi = 1
      GptTimeElapsedApi = 1
      GptTimeRemainingApi = 1
      GptVersionInfoApi = 1
      GptWakeupFunctionalityApi = 1
    GptDriverConfiguration:
      GptDevErrorDetect = 1
      GptErrorCalloutFunction = Det_ReportError
      GptPredefTimer100us32bitEnable = 0
      GptPredefTimer1usEnablingGrade = GPT_PREDEF_TIMER_1US_16_24_32BIT_ENABLED
      GptReportWakeupSource = 1
      GptIncludeFile = Det.h
      4 x GptClockReferencePoint:
        GptClockReferencePoint_0: GptClockReference=McuClockReferencePoint_TCPWM0_CLOCKS7
        GptClockReferencePoint_1: GptClockReference=McuClockReferencePoint_TCPWM0_CLOCKS512
        GptClockReferencePoint_2: GptClockReference=McuClockReferencePoint_TCPWM0_CLOCKS10
        GptClockReferencePoint_3: GptClockReference=McuClockReferencePoint_TCPWM0_CLOCKS3
