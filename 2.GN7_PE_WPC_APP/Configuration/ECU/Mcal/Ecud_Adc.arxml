AUTOSAR XML (schema 4-0-3)
package /Adc
  module config Adc: implementation-config-variant=VARIANT-POST-BUILD, module-description=AdcImplementation
    AdcConfigSet_0 (AdcConfigSet)
      AdcHwUnit_0 (AdcHwUnit): AdcDiagnoseEnable=0, AdcHwUnitId=ADC_SAR_0_0, AdcPreconditionCycle=1, AdcClockSource=ADC_NOT_USED
        AdcChannel_U0C16 (AdcChannel):
          AdcChannelConvTime = 14
          AdcChannelHighLimit = 65535
          AdcChannelId = 16
          AdcChannelLimitCheck = 0
          AdcChannelLowLimit = 0
          AdcChannelRangeSelect = ADC_RANGE_ALWAYS
          AdcChannelRefVoltsrcHigh = ADC_NOT_USED
          AdcChannelRefVoltsrcLow = ADC_NOT_USED
          AdcChannelResolution = 12
          AdcChannelSampTime = 60
          AdcChannelResultSigned = 0
        AdcGroup_U0C16 (AdcGroup):
          AdcGroupAccessMode = ADC_ACCESS_MODE_SINGLE
          AdcGroupConversionMode = ADC_CONV_MODE_ONESHOT
          AdcGroupId = 0
          AdcGroupPriority = 0
          AdcGroupTriggSrc = ADC_TRIGG_SRC_SW
          AdcStreamingBufferMode = ADC_STREAM_BUFFER_LINEAR
          AdcStreamingNumSamples = 1
          AdcInterruptMode = 1
          AdcUseDma = 0
          AdcFirstLogicalChannel = 0
          AdcUseAlternateCalibration = 0
          AdcSampleMode = ADC_SAMPLE_NORMAL
          AdcGroupDefinition = AdcChannel_U0C16
        AdcChannel_U0C17 (AdcChannel):
          AdcChannelConvTime = 14
          AdcChannelHighLimit = 65535
          AdcChannelId = 17
          AdcChannelLimitCheck = 0
          AdcChannelLowLimit = 0
          AdcChannelRangeSelect = ADC_RANGE_ALWAYS
          AdcChannelRefVoltsrcHigh = ADC_NOT_USED
          AdcChannelRefVoltsrcLow = ADC_NOT_USED
          AdcChannelResolution = 12
          AdcChannelSampTime = 60
          AdcChannelResultSigned = 0
        AdcGroup_U0C17 (AdcGroup):
          AdcGroupAccessMode = ADC_ACCESS_MODE_SINGLE
          AdcGroupConversionMode = ADC_CONV_MODE_ONESHOT
          AdcGroupId = 1
          AdcGroupPriority = 1
          AdcGroupTriggSrc = ADC_TRIGG_SRC_SW
          AdcStreamingBufferMode = ADC_STREAM_BUFFER_LINEAR
          AdcStreamingNumSamples = 1
          AdcInterruptMode = 1
          AdcUseDma = 0
          AdcFirstLogicalChannel = 1
          AdcUseAlternateCalibration = 0
          AdcSampleMode = ADC_SAMPLE_NORMAL
          AdcGroupDefinition = AdcChannel_U0C17
    AdcGeneral:
      AdcCalibrationApi = 0
      AdcDeInitApi = 0
      AdcDevErrorDetect = 1
      AdcEnableLimitCheck = 0
      AdcEnableQueuing = 0
      AdcEnableStartStopGroupApi = 1
      AdcHwTriggerApi = 0
      AdcLowPowerStatesSupport = 0
      AdcPriorityImplementation = ADC_PRIORITY_HW
      AdcReadGroupApi = 1
      AdcResultAlignment = ADC_ALIGN_RIGHT
      AdcVersionInfoApi = 1
      AdcErrorCalloutFunction = Det_ReportError
      AdcIncludeFile = Det.h
      AdcGrpNotifCapability = 1
      AdcIncludeFile = IoHwAb_Cfg.h
    AdcPublishedInformation: AdcChannelValueSigned=1, AdcGroupFirstChannelFixed=0, AdcMaxChannelResolution=12
    AdcDemEventParameterRefs: ADC_E_HARDWARE_ERROR=ADC_E_HARDWARE_ERROR
