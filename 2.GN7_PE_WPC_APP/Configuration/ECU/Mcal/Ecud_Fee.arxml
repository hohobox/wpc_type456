AUTOSAR XML (schema 4-0-3)
package /Fee
  module config Fee: implementation-config-variant=VARIANT-PRE-COMPILE, module-description=FeeImplementation
    FeeGeneral:
      FeeBlockMaxSize = 262
      FeeCleanupAndEraseApi = 0
      FeeClearApi = 0
      FeeDefaultCycleMode = MEMIF_MODE_FAST
      FeeDevErrorDetect = 1
      FeeErrorCalloutFunction = Det_ReportError
      FeeGetRemainingPagesApi = 0
      FeeInitiallyEraseEmptySectors = 1
      FeeNvmJobEndNotification = NvM_JobEndNotification
      FeeNvmJobErrorNotification = NvM_JobErrorNotification
      FeePollingMode = 1
      FeeSetCycleModeApi = 1
      FeeSetModeSupported = 1
      FeeUnmatchedBlockCheck = 0
      FeeVersionInfoApi = 1
      FeeVirtualPageSize = 4
      FeeIncludeFile = Det.h
      FeeMainFunctionPeriod = 1.0
      FeeDelayRecycleOperation = 1
      FeeUseConfig
        Config: FeeSectorStartAddress=0, FeeValidDataSize=512
    FeePublishedInformation: FeeBlockOverhead=20, FeeInstanceId=0, FeePageOverhead=16
    73 x FeeBlockConfiguration, all with FeeImmediateData=0, FeeNumberOfWriteCycles=0, FeeDeviceIndex=FlsGeneral:
      FeeBlock_ConfigID: FeeBlockSize=4, FeeBlockNumber=4
      FeeBlock_ConfigID_copy1: FeeBlockSize=4, FeeBlockNumber=5
      FeeBlock_ManagementBlock: FeeBlockSize=10, FeeBlockNumber=8
      FeeBlock_ManagementBlock_copy1: FeeBlockSize=10, FeeBlockNumber=9
      FeeBlock_EventStatusNvRamBlock: FeeBlockSize=3, FeeBlockNumber=12
      FeeBlock_EventStatusNvRamBlock_copy1: FeeBlockSize=3, FeeBlockNumber=13
      FeeBlock_PrimaryEventMemory0: FeeBlockSize=14, FeeBlockNumber=16
      FeeBlock_PrimaryEventMemory0_copy1: FeeBlockSize=14, FeeBlockNumber=17
      FeeBlock_PrimaryEventMemory1: FeeBlockSize=14, FeeBlockNumber=20
      FeeBlock_PrimaryEventMemory1_copy1: FeeBlockSize=14, FeeBlockNumber=21
      FeeBlock_PrimaryEventMemory2: FeeBlockSize=14, FeeBlockNumber=24
      FeeBlock_PrimaryEventMemory2_copy1: FeeBlockSize=14, FeeBlockNumber=25
      FeeBlock_IntTst_TestBlock1: FeeBlockSize=7, FeeBlockNumber=36
      FeeBlock_IntTst_TestBlock2: FeeBlockSize=9, FeeBlockNumber=40
      FeeBlock_IntTst_TestBlock3: FeeBlockSize=2, FeeBlockNumber=44
      FeeBlock_DataLog: FeeBlockSize=4, FeeBlockNumber=152
      FeeBlock_NmlLog: FeeBlockSize=202, FeeBlockNumber=156
      FeeBlock_SerialNum: FeeBlockSize=17, FeeBlockNumber=132
      FeeBlock_ProfileGuestWPCUSM0: FeeBlockSize=3, FeeBlockNumber=48
      FeeBlock_ProfileGuestWPCUSM1: FeeBlockSize=3, FeeBlockNumber=68
      FeeBlock_ProfileOneWPCUSM0: FeeBlockSize=3, FeeBlockNumber=52
      FeeBlock_ProfileOneWPCUSM1: FeeBlockSize=3, FeeBlockNumber=72
      FeeBlock_RWPCUSM0: FeeBlockSize=3, FeeBlockNumber=64
      FeeBlock_RWPCUSM1: FeeBlockSize=3, FeeBlockNumber=84
      FeeBlock_AutoBrightSta: FeeBlockSize=3, FeeBlockNumber=88
      FeeBlock_PDCReset: FeeBlockSize=3, FeeBlockNumber=92
      FeeBlock_ANT_Calibration: FeeBlockSize=3, FeeBlockNumber=96
      FeeBlock_WctReproRequest: FeeBlockSize=3, FeeBlockNumber=104
      FeeBlock_B0BADisableCnt: FeeBlockSize=3, FeeBlockNumber=100
      FeeBlock_WctReproRequest_copy1: FeeBlockSize=3, FeeBlockNumber=105
      FeeBlock_Array3: FeeBlockSize=10, FeeBlockNumber=148
      FeeBlock_QRCode: FeeBlockSize=23, FeeBlockNumber=136
      FeeBlock_PrimaryEventMemory4: FeeBlockSize=14, FeeBlockNumber=32
      FeeBlock_PrimaryEventMemory3: FeeBlockSize=14, FeeBlockNumber=28
      FeeBlock_ECU_Info: FeeBlockSize=19, FeeBlockNumber=128
      FeeBlock_Flag6: FeeBlockSize=3, FeeBlockNumber=124
      FeeBlock_Flag2: FeeBlockSize=3, FeeBlockNumber=108
      FeeBlock_Array1: FeeBlockSize=10, FeeBlockNumber=140
      FeeBlock_Array2: FeeBlockSize=10, FeeBlockNumber=144
      FeeBlock_Flag3: FeeBlockSize=3, FeeBlockNumber=112
      FeeBlock_Flag2_copy1: FeeBlockSize=3, FeeBlockNumber=109
      FeeBlock_Flag4: FeeBlockSize=3, FeeBlockNumber=116
      FeeBlock_Flag3_copy1: FeeBlockSize=3, FeeBlockNumber=113
      FeeBlock_Flag5: FeeBlockSize=3, FeeBlockNumber=120
      FeeBlock_Flag4_copy1: FeeBlockSize=3, FeeBlockNumber=117
      FeeBlock_Flag5_copy1: FeeBlockSize=3, FeeBlockNumber=121
      FeeBlock_Flag6_copy1: FeeBlockSize=3, FeeBlockNumber=125
      FeeBlock_PrimaryEventMemory4_copy1: FeeBlockSize=14, FeeBlockNumber=33
      FeeBlock_PrimaryEventMemory3_copy1: FeeBlockSize=14, FeeBlockNumber=29
      FeeBlock_RWPCUSM0_copy1: FeeBlockSize=3, FeeBlockNumber=65
      FeeBlock_ProfileGuestWPCUSM1_copy1: FeeBlockSize=3, FeeBlockNumber=69
      FeeBlock_AutoBrightSta_copy1: FeeBlockSize=3, FeeBlockNumber=89
      FeeBlock_ANT_Calibration_copy1: FeeBlockSize=3, FeeBlockNumber=97
      FeeBlock_ProfileGuestWPCUSM0_copy1: FeeBlockSize=3, FeeBlockNumber=49
      FeeBlock_PDCReset_copy1: FeeBlockSize=3, FeeBlockNumber=93
      FeeBlock_ProfileOneWPCUSM1_copy1: FeeBlockSize=3, FeeBlockNumber=73
      FeeBlock_B0BADisableCnt_copy1: FeeBlockSize=3, FeeBlockNumber=101
      FeeBlock_Array1_copy1: FeeBlockSize=10, FeeBlockNumber=141
      FeeBlock_SerialNum_copy1: FeeBlockSize=17, FeeBlockNumber=133
      FeeBlock_ProfileOneWPCUSM0_copy1: FeeBlockSize=3, FeeBlockNumber=53
      FeeBlock_ProfileTwoWPCUSM1: FeeBlockSize=3, FeeBlockNumber=76
      FeeBlock_ECU_Info_copy1: FeeBlockSize=19, FeeBlockNumber=129
      FeeBlock_Array3_copy1: FeeBlockSize=10, FeeBlockNumber=149
      FeeBlock_QRCode_copy1: FeeBlockSize=23, FeeBlockNumber=137
      FeeBlock_Array2_copy1: FeeBlockSize=10, FeeBlockNumber=145
      FeeBlock_ProfileTwoWPCUSM0: FeeBlockSize=3, FeeBlockNumber=56
      FeeBlock_ProfileTwoWPCUSM0_copy1: FeeBlockSize=3, FeeBlockNumber=57
      FeeBlock_ProfileTwoWPCUSM1_copy1: FeeBlockSize=3, FeeBlockNumber=77
      FeeBlock_RWPCUSM1_copy1: FeeBlockSize=3, FeeBlockNumber=85
      FeeBlock_ProfileThreeWPCUSM0: FeeBlockSize=3, FeeBlockNumber=60
      FeeBlock_ProfileThreeWPCUSM0_copy1: FeeBlockSize=3, FeeBlockNumber=61
      FeeBlock_ProfileThreeWPCUSM1: FeeBlockSize=3, FeeBlockNumber=80
      FeeBlock_ProfileThreeWPCUSM1_copy1: FeeBlockSize=3, FeeBlockNumber=81
