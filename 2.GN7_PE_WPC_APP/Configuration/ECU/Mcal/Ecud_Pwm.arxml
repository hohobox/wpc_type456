AUTOSAR XML (schema 4-0-3)
package /Pwm
  module config Pwm: implementation-config-variant=VARIANT-POST-BUILD, module-description=PwmImplementation
    PwmChannelConfigSet_0 (PwmChannelConfigSet)
      6 x PwmChannel, all with PwmAlignment=PWM_LEFT_ALIGNED, PwmChannelClass=PWM_FIXED_PERIOD, PwmDebugMode=PWM_DEBUG_MODE_CONTINUE, PwmDutycycleDefault=0, PwmIdleState=PWM_LOW, PwmPolarity=PWM_HIGH, PwmStartAtInit=1:
        PwmChannel_FANPWM1_Port12_1: PwmChannelId=0, PwmPeriodDefault=0.00004, PwmTimer=TCPWM_0_37, PwmMcuClockReferencePoint=McuClockReferencePoint_TCPWM0_CLOCKS37
        PwmChannel_FANPWM2_Port12_3: PwmChannelId=1, PwmPeriodDefault=0.00004, PwmTimer=TCPWM_0_39, PwmMcuClockReferencePoint=McuClockReferencePoint_TCPWM0_CLOCKS39
        PwmChannel_GreenIND1_Port0_1: PwmChannelId=2, PwmPeriodDefault=0.005, PwmTimer=TCPWM_0_17, PwmMcuClockReferencePoint=McuClockReferencePoint_TCPWM0_CLOCKS17
        PwmChannel_GreenIND2_Port2_2: PwmChannelId=3, PwmPeriodDefault=0.005, PwmTimer=TCPWM_0_5, PwmMcuClockReferencePoint=McuClockReferencePoint_TCPWM0_CLOCKS5
        PwmChannel_AmberIND1_Port0_0: PwmChannelId=4, PwmPeriodDefault=0.005, PwmTimer=TCPWM_0_18, PwmMcuClockReferencePoint=McuClockReferencePoint_TCPWM0_CLOCKS18
        PwmChannel_AmberIND2_Port2_1: PwmChannelId=5, PwmPeriodDefault=0.005, PwmTimer=TCPWM_0_6, PwmMcuClockReferencePoint=McuClockReferencePoint_TCPWM0_CLOCKS6
    PwmConfigurationOfOptApiServices:
      PwmDeInitApi = 1
      PwmEnableDisableTriggerApi = 0
      PwmGetOutputState = 1
      PwmSetDutyCycle = 1
      PwmSetOutputOffset = 0
      PwmSetOutputState = 0
      PwmSetOutputToIdle = 1
      PwmSetPeriodAndDuty = 1
      PwmSetPrescaler = 0
      PwmSetTriggerDelay = 0
      PwmStopGroup = 0
      PwmVersionInfoApi = 1
    PwmGeneral:
      PwmDevErrorDetect = 1
      PwmDutycycleUpdatedEndperiod = 1
      PwmErrorCalloutFunction = Det_ReportError
      PwmIndex = 0
      PwmNotificationSupported = 1
      PwmPeriodUpdatedEndperiod = 1
      PwmIncludeFile = Det.h
