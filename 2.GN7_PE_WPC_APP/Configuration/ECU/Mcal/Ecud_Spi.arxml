AUTOSAR XML (schema 4-0-3)
package /Spi
  module config Spi: implementation-config-variant=VARIANT-PRE-COMPILE, module-description=SpiImplementation
    SpiDemEventParameterRefs: SPI_E_HARDWARE_ERROR=SPI_E_HARDWARE_ERROR
    SpiDriver
      SpiChannel_NFC1 (SpiChannel): SpiAlignedBuffer=0, SpiChannelId=0, SpiChannelType=EB, SpiDataWidth=8, SpiDefaultData=0, SpiEbMaxLength=256, SpiIbNBuffers=256, SpiTransferStart=MSB
      SpiChannel_NFC2 (SpiChannel): SpiAlignedBuffer=0, SpiChannelId=1, SpiChannelType=EB, SpiDataWidth=8, SpiDefaultData=0, SpiEbMaxLength=256, SpiIbNBuffers=256, SpiTransferStart=MSB
      SpiExternalDevice_NFC1 (SpiExternalDevice):
        SpiBaudrate = 4000000
        SpiCsIdentifier = DioChannel_P018_3
        SpiCsPolarity = LOW
        SpiCsSelection = CS_VIA_GPIO
        SpiDataShiftEdge = LEADING
        SpiDeselect = 0.0
        SpiEnableCs = 1
        SpiHoldDelay = 0.75
        SpiHwUnit = SCB1
        SpiSetupDelay = 0.25
        SpiShiftClockIdleLevel = LOW
        SpiTimeClk2Cs = 0.0
        SpiUseDma = 0
        SpiUseFifo = 1
        SpiClockRef = McuClockReferencePoint_SCB1
      SpiExternalDevice_NFC2 (SpiExternalDevice):
        SpiBaudrate = 4000000
        SpiCsIdentifier = DioChannel_P007_3
        SpiCsPolarity = LOW
        SpiCsSelection = CS_VIA_GPIO
        SpiDataShiftEdge = LEADING
        SpiDeselect = 0.0
        SpiEnableCs = 1
        SpiHoldDelay = 0.75
        SpiHwUnit = SCB5
        SpiSetupDelay = 0.25
        SpiShiftClockIdleLevel = LOW
        SpiTimeClk2Cs = 0.0
        SpiUseDma = 0
        SpiUseFifo = 1
        SpiClockRef = McuClockReferencePoint_SCB5
      SpiJob_NFC1 (SpiJob):
        SpiHwUnitSynchronous = SYNCHRONOUS
        SpiJobId = 0
        SpiJobPriority = 0
        SpiJobEndNotification = NFC1_Spi_JobEnd_Notification
        SpiDeviceAssignment = SpiExternalDevice_NFC1
        SpiChannelList_NFC1 (SpiChannelList): SpiChannelIndex=0, SpiChannelAssignment=SpiChannel_NFC1
      SpiJob_NFC2 (SpiJob):
        SpiHwUnitSynchronous = SYNCHRONOUS
        SpiJobId = 1
        SpiJobPriority = 0
        SpiJobEndNotification = NFC2_Spi_JobEnd_Notification
        SpiDeviceAssignment = SpiExternalDevice_NFC2
        SpiChannelList_NFC2 (SpiChannelList): SpiChannelIndex=0, SpiChannelAssignment=SpiChannel_NFC2
      SpiSequence_NFC1 (SpiSequence): SpiInterruptibleSequence=0, SpiSequenceId=0, SpiSeqEndNotification=NFC1_Spi_SeqEnd_Notification, SpiJobAssignment=SpiJob_NFC1
      SpiSequence_NFC2 (SpiSequence): SpiInterruptibleSequence=0, SpiSequenceId=1, SpiSeqEndNotification=NFC2_Spi_SeqEnd_Notification, SpiJobAssignment=SpiJob_NFC2
    SpiGeneral:
      SpiCancelApi = 1
      SpiChannelBuffersAllowed = 2
      SpiDevErrorDetect = 1
      SpiErrorCalloutFunction = Det_ReportError
      SpiHwStatusApi = 1
      SpiInterruptibleSeqAllowed = 0
      SpiLevelDelivered = 2
      SpiMainFunctionPeriod = 0.005
      SpiSupportConcurrentSyncTransmit = 0
      SpiVersionInfoApi = 1
      SpiIncludeFile = Det.h
      SpiUserCallbackHeaderFile = SpiCbk.h
    SpiPublishedInformation: SpiMaxHwUnit=32
