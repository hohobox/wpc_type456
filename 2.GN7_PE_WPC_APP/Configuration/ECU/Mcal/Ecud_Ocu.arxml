AUTOSAR XML (schema 4-0-3)
package /Ocu
  module config Ocu: implementation-config-variant=VARIANT-POST-BUILD, module-description=OcuImplementation
    OcuConfigSet_0 (OcuConfigSet)
    OcuConfigurationOfOptionalApis:
      OcuDeInitApi = 1
      OcuGetCounterApi = 1
      OcuNotificationSupported = 1
      OcuSafetyFunctionApi = 1
      OcuSetAbsoluteThresholdApi = 1
      OcuSetPinActionApi = 1
      OcuSetPinStateApi = 1
      OcuSetPrescalerApi = 1
      OcuSetRelativeThresholdApi = 1
      OcuVersionInfoApi = 1
    OcuGeneral: OcuDevErrorDetect=0, OcuErrorCalloutFunction=Det_ReportError, OcuIncludeFile=Det.h
