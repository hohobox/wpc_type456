AUTOSAR XML (schema 4-0-3)
package /AUTOSAR
  module config CanTp: implementation-config-variant=VARIANT-PRE-COMPILE, module-description=BswImplementation_CanTp
    CanTpGeneral:
      CanTpDevErrorDetect = 1
      CanTpPaddingByte = 0xAA
      CanTpReadParameterApi = 0
      CanTpVersionInfoApi = 0
      CanTpChangeParameterApi = 0
      CanTpFlexibleDataRateSupport = 1
    CanTpConfig: CanTpMainFunctionPeriod=0.005
      3 x CanTpChannel, all with category=TOOL_CONFIGURED, CanTpChannelMode=CANTP_MODE_HALF_DUPLEX:
        CanTpChannel_0_Pdu_DcmIPdu_BCAN_GST_WPC
          CanTpTxNSdu_0_Pdu_DcmIPdu_BCAN_WPC_GST (CanTpTxNSdu):
            category = TOOL_CONFIGURED
            CanTpTxAddressingFormat = CANTP_STANDARD
            CanTpTxPaddingActivation = CANTP_ON
            CanTpTxDl = 1
            CanTpTxNSduId = 0
            CanTpTc = 1
            CanTpTxTaType = CANTP_CANFD_PHYSICAL
            CanTpNbs = 1
            CanTpNas = 1
            CanTpNcs = 0
            CanTpTxNSduRef = Pdu_DcmIPdu_BCAN_WPC_GST
            CanTpTxNPdu_0 (CanTpTxNPdu): category=TOOL_CONFIGURED, CanTpTxNPduConfirmationPduId=0, CanTpTxNPduRef=Pdu_NPdu_BCAN_WPC_GST
            CanTpRxFcNPdu_0 (CanTpRxFcNPdu): category=TOOL_CONFIGURED, CanTpRxFcNPduId=0, CanTpRxFcNPduRef=Pdu_NPdu_BCAN_GST_WPC
            CanTpNSa_0 (CanTpNSa): category=TOOL_CONFIGURED, CanTpNSa=8
            CanTpNTa_0 (CanTpNTa): category=TOOL_CONFIGURED, CanTpNTa=240
          CanTpRxNSdu_0_Pdu_DcmIPdu_BCAN_GST_WPC (CanTpRxNSdu):
            category = TOOL_CONFIGURED
            CanTpRxPaddingActivation = CANTP_ON
            CanTpRxAddressingFormat = CANTP_STANDARD
            CanTpRxTaType = CANTP_CANFD_PHYSICAL
            CanTpRxNSduId = 0
            CanTpRxDl = 1
            CanTpNcr = 1
            CanTpBs = 0
            CanTpNbr = 0
            CanTpRxWftMax = 0
            CanTpNar = 1
            CanTpSTmin = 0.005
            CanTpRxNSduRef = Pdu_DcmIPdu_BCAN_GST_WPC
            CanTpTxFcNPdu_0 (CanTpTxFcNPdu): category=TOOL_CONFIGURED, CanTpTxFcNPduConfirmationPduId=0, CanTpTxFcNPduRef=Pdu_NPdu_BCAN_WPC_GST
            CanTpRxNPdu_0 (CanTpRxNPdu): category=TOOL_CONFIGURED, CanTpRxNPduId=0, CanTpRxNPduRef=Pdu_NPdu_BCAN_GST_WPC
            CanTpNSa_0 (CanTpNSa): category=TOOL_CONFIGURED, CanTpNSa=8
            CanTpNTa_0 (CanTpNTa): category=TOOL_CONFIGURED, CanTpNTa=240
        CanTpChannel_1_Pdu_ISignalIPdu_LCAN_L_TP_BDC_FD_L_WPC_FD
          CanTpTxNSdu_1_Pdu_ISignalIPdu_LCAN_L_TP_L_WPC_FD_BDC_FD (CanTpTxNSdu):
            category = TOOL_CONFIGURED
            CanTpTxAddressingFormat = CANTP_STANDARD
            CanTpTxPaddingActivation = CANTP_ON
            CanTpTxDl = 1
            CanTpTxNSduId = 1
            CanTpTc = 1
            CanTpTxTaType = CANTP_CANFD_PHYSICAL
            CanTpNas = 1
            CanTpNbs = 1
            CanTpNcs = 0
            CanTpTxNSduRef = Pdu_ISignalIPdu_LCAN_L_TP_L_WPC_FD_BDC_FD
            CanTpTxNPdu_1 (CanTpTxNPdu): category=TOOL_CONFIGURED, CanTpTxNPduConfirmationPduId=1, CanTpTxNPduRef=Pdu_NPdu_LCAN_L_TP_L_WPC_FD_BDC_FD
            CanTpRxFcNPdu_1 (CanTpRxFcNPdu): category=TOOL_CONFIGURED, CanTpRxFcNPduId=1, CanTpRxFcNPduRef=Pdu_NPdu_LCAN_L_TP_BDC_FD_L_WPC_FD
            CanTpNSa_1 (CanTpNSa): category=TOOL_CONFIGURED, CanTpNSa=8
            CanTpNTa_1 (CanTpNTa): category=TOOL_CONFIGURED, CanTpNTa=240
          CanTpRxNSdu_1_Pdu_ISignalIPdu_LCAN_L_TP_BDC_FD_L_WPC_FD (CanTpRxNSdu):
            category = TOOL_CONFIGURED
            CanTpRxPaddingActivation = CANTP_ON
            CanTpRxAddressingFormat = CANTP_STANDARD
            CanTpRxTaType = CANTP_CANFD_PHYSICAL
            CanTpRxNSduId = 1
            CanTpRxDl = 1
            CanTpRxWftMax = 0
            CanTpNar = 1
            CanTpNbr = 0
            CanTpNcr = 1
            CanTpBs = 0
            CanTpSTmin = 0
            CanTpRxNSduRef = Pdu_ISignalIPdu_LCAN_L_TP_BDC_FD_L_WPC_FD
            CanTpTxFcNPdu_1 (CanTpTxFcNPdu): category=TOOL_CONFIGURED, CanTpTxFcNPduConfirmationPduId=1, CanTpTxFcNPduRef=Pdu_NPdu_LCAN_L_TP_L_WPC_FD_BDC_FD
            CanTpRxNPdu_1 (CanTpRxNPdu): category=TOOL_CONFIGURED, CanTpRxNPduId=1, CanTpRxNPduRef=Pdu_NPdu_LCAN_L_TP_BDC_FD_L_WPC_FD
            CanTpNSa_1 (CanTpNSa): category=TOOL_CONFIGURED, CanTpNSa=8
            CanTpNTa_1 (CanTpNTa): category=TOOL_CONFIGURED, CanTpNTa=240
        CanTpChannel_2_RxOnly_Pdu_DcmIPdu_BCAN_GST_ALL
          CanTpRxNSdu_2_Pdu_DcmIPdu_BCAN_GST_ALL (CanTpRxNSdu):
            category = TOOL_CONFIGURED
            CanTpRxPaddingActivation = CANTP_ON
            CanTpRxAddressingFormat = CANTP_STANDARD
            CanTpRxTaType = CANTP_CANFD_FUNCTIONAL
            CanTpRxNSduId = 2
            CanTpRxDl = 1
            CanTpNbr = 0
            CanTpNar = 1
            CanTpNcr = 1
            CanTpBs = 0
            CanTpRxWftMax = 0
            CanTpSTmin = 0.005
            CanTpRxNSduRef = Pdu_DcmIPdu_BCAN_GST_ALL
            CanTpRxNPdu_2 (CanTpRxNPdu): category=TOOL_CONFIGURED, CanTpRxNPduId=2, CanTpRxNPduRef=Pdu_NPdu_BCAN_GST_ALL
            CanTpNSa_2 (CanTpNSa): category=TOOL_CONFIGURED, CanTpNSa=8
            CanTpNTa_2 (CanTpNTa): category=TOOL_CONFIGURED, CanTpNTa=240
