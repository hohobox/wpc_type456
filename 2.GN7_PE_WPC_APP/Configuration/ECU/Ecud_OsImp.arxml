AUTOSAR XML (schema 4-2-1)
package /AUTOSAR
  module config OsImp: implementation-config-variant=VARIANT-PRE-COMPILE, module-description=BswImplementation_OsImp
    OsImpGeneral: OsImpOpfUsed=1, OsImpErrmUsed=1, OsImpDebugStackdepth=1, OsImpCpuLoad=1
    OsImpConfiguration
      SRAM (OsImpRamSector):
        category = TOOL_CONFIGURED
        OsImpRamDefaultValue = 0
        OsImpRamSectionBaseAddress = 0x08010000
        OsImpRamSectionSize = 0x70000
        OsImpRamInitProperty = PowerOnReset
