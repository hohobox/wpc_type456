AUTOSAR XML (schema 00047)
package /AUTRON
  module config CryIf: ecuc-def-edition=4.4.7, implementation-config-variant=VARIANT-PRE-COMPILE, module-description=BswImplementation_CryIf
    CryIfGeneral: CryIfDevErrorDetect=1, CryIfVersionInfoApi=1
    CryIf_76_HaeHsm (CryIfChannel): CryIfChannelId=0, CryIfDriverObjectRef=HaeHsm
    CryIf_HaeCryptoLib (CryIfChannel): CryIfChannelId=1, CryIfDriverObjectRef=HaeCryptoLib
    10 x CryIfKey:
      RandomSeed_L9: CryIfKeyId=0, CryIfKeyRef=CryptoKey_RandomSeed_L9
      Hash_Dummy_Fota: CryIfKeyId=1, CryIfKeyRef=CryptoKey_Hash_Dummy_Fota
      Pkcs1_Asims_Public_Key: CryIfKeyId=2, CryIfKeyRef=CryptoKey_RSASSA_PKCS1_v1_5_Asims_Public_Key
      Fota_Decrypt0Key: CryIfKeyId=3, CryIfKeyRef=CryptoKey_Fota_Decrypt0Key
      Fota_MacVerify0Key: CryIfKeyId=4, CryIfKeyRef=CryptoKey_Fota_MacVerify0Key
      PBKDF2_Key: CryIfKeyId=5, CryIfKeyRef=CryptoKey_PBKDF2_KeyDerivation_Key_Fota
      PBKDF2_TargetKey: CryIfKeyId=6, CryIfKeyRef=CryptoKey_PBKDF2_KeyDerivation_TargetKey_Fota
      CryptoKey_Dummy: CryIfKeyId=7, CryIfKeyRef=CryptoKey_Dummy
      RandomSeed_L10: CryIfKeyId=8, CryIfKeyRef=CryptoKey_RandomSeed_L10
      CryptoKey_OEUK: CryIfKeyId=9, CryIfKeyRef=CryptoKey_RSASSA_PKCS1_v1_5_OEUK
