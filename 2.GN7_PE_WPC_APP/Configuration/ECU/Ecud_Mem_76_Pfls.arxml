AUTOSAR XML (schema 00047)
package /EcucModules
  module config Mem_76_Pfls: definition=Mem, ecuc-def-edition=4.4.7, implementation-config-variant=VARIANT-PRE-COMPILE, module-description=BswImplementation_Mem, post-build-variant-used=false
    MemGeneral:
      MemDevErrorDetect = 1
      MemMainfunctionPeriod = 0.005
      MemProcessorSeries = CYT2BLX_CYT3BX_CYT4BBX
      MemUserIncludeFiles = Det.h
      MemUserIncludeFiles = Mem_76_Pfls_User_Callouts.h
      MemUserIncludeFiles = Fota.h
      MemUseNvm = 1
      MemUseRamCode = 0
      MemDisableEccTrap = 1
    MemInstance0 (MemInstance): MemInstanceId=0
      MemSectorBatch0_32KB (MemSectorBatch):
        MemReadPageSize = 1
        MemWritePageSize = 8
        MemEraseSectorSize = 0x8000
        MemSpecifiedEraseCycles = 0xFFFFFFFF
        MemStartAddress = 0x10058000
        MemNumberOfSectors = 52
        MemAltStartAddress = 0x12058000
        MemBurstSettings: MemEraseBurstSize=0x0, MemReadBurstSize=0x0, MemWriteBurstSize=0x200
      UserPostCalloutFunction1 (UserPostCalloutFunction): UserPostCalloutFunction=Mem_76_Pfls_FlashcMainFlashDisable_Callout
      UserPreCalloutFunction1 (UserPreCalloutFunction): UserPreCalloutFunction=Mem_76_Pfls_FlashcMainFlashEnable_Callout
    MemInstance1 (MemInstance): MemInstanceId=1
      MemSectorBatch1_32KB (MemSectorBatch):
        MemAltStartAddress = 0x12028000
        MemEraseSectorSize = 0x8000
        MemNumberOfSectors = 6
        MemReadPageSize = 1
        MemSpecifiedEraseCycles = 0xFFFFFFFF
        MemStartAddress = 0x10028000
        MemWritePageSize = 8
        MemBurstSettings: MemEraseBurstSize=0x0, MemReadBurstSize=0x0, MemWriteBurstSize=0x200
      UserPostCalloutFunction1 (UserPostCalloutFunction): UserPostCalloutFunction=Mem_76_Pfls_FlashcMainFlashDisable_Callout
      UserPreCalloutFunction1 (UserPreCalloutFunction): UserPreCalloutFunction=Mem_76_Pfls_FlashcMainFlashEnable_Callout
    MemPublishedInformation: MemErasedValue=0x00000000
