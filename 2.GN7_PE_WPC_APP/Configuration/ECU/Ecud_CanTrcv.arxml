AUTOSAR XML (schema 4-0-3)
package /AUTOSAR
  module config CanTrcv: implementation-config-variant=VARIANT-PRE-COMPILE, module-description=BswImplementation_CanTrcv
    CanTrcvGeneral:
      CanTrcvDevErrorDetect = 1
      CanTrcvGetVersionInfo = 0
      CanTrcvSPICommRetries = 0
      CanTrcvSPICommTimeout = 0
      CanTrcvWakeUpSupport = CANTRCV_WAKEUP_NOT_SUPPORTED
      CanTrcvWaitCount = 16000
      ArisuCanPwmAutoSupport = 0
      CanTrcvSupportAR42 = 1
      CanTrcvTCAN1043AWaitCount = 320000
    CanTrcvConfigSet
      CanTrcvChannel_BCAN (CanTrcvChannel):
        CanTrcvChannelId = 0
        CanTrcvChannelUsed = 1
        CanTrcvControlsPowerSupply = 0
        CanTrcvWakeupByBusUsed = 0
        CanTrcvHwPnSupport = 0
        CanTrcvMaxBaudrate = 1000
        CanTrcvInitState = CANTRCV_OP_MODE_SLEEP
        CanTrcvSleepModeUsed = 1
        CanTrcvHwDevName = TCAN1043A
        CanTrcvAccess
          CanTrcvDioAccess
            CanTrcvDioChannelAccess_STB (CanTrcvDioChannelAccess): CanTrcvHardwareInterfaceName=STB, CanTrcvDioSymNameRef=DioChannel_P006_1
            CanTrcvDioChannelAccess_EN (CanTrcvDioChannelAccess): CanTrcvHardwareInterfaceName=EN, CanTrcvDioSymNameRef=DioChannel_P005_3
        CanTrcvPartialNetwork:
          CanTrcvBaudRate = 500
          CanTrcvBusErrFlag = 0
          CanTrcvPnCanIdIsExtended = 0
          CanTrcvPnEnabled = 1
          CanTrcvPnFrameDlc = 8
          CanTrcvPowerOnFlag = 0
          CanTrcvPnDlcMatchingCondition = 0
      CanTrcvChannel_LCAN (CanTrcvChannel):
        CanTrcvChannelId = 1
        CanTrcvChannelUsed = 1
        CanTrcvControlsPowerSupply = 0
        CanTrcvWakeupByBusUsed = 0
        CanTrcvHwPnSupport = 0
        CanTrcvMaxBaudrate = 1000
        CanTrcvInitState = CANTRCV_OP_MODE_SLEEP
        CanTrcvHwDevName = TCAN1043A
        CanTrcvSleepModeUsed = 1
        CanTrcvAccess
          CanTrcvDioAccess
            CanTrcvDioChannelAccess_STB (CanTrcvDioChannelAccess): CanTrcvHardwareInterfaceName=STB, CanTrcvDioSymNameRef=DioChannel_P018_7
            CanTrcvDioChannelAccess_EN (CanTrcvDioChannelAccess): CanTrcvHardwareInterfaceName=EN, CanTrcvDioSymNameRef=DioChannel_P018_5
        CanTrcvPartialNetwork:
          CanTrcvBaudRate = 500
          CanTrcvBusErrFlag = 0
          CanTrcvPnCanIdIsExtended = 0
          CanTrcvPnEnabled = 1
          CanTrcvPnFrameDlc = 8
          CanTrcvPowerOnFlag = 0
          CanTrcvPnDlcMatchingCondition = 0
