AUTOSAR XML (schema 4-2-1)
package /AUTOSAR
  module config E2EXf: definition=Xfrm, module-description=BswImplementation_E2EXf
    XfrmGeneral: XfrmDevErrorDetect=1
    8 x XfrmImplementationMapping:
      E2EXf_MsgGr_E2E_BCAN_WPC_FD_01_200ms: XfrmTransformationTechnologyRef=XfTechTx_E2EXf_P5, XfrmVariableDataPrototypeInstanceRef=App_CAN_TX.Gr_MsgGr_E2E_BCAN_WPC_FD_01_200ms.MsgGr_E2E_BCAN_WPC_FD_01_200ms, XfrmTransformerBswModuleEntryRef=E2EXf_App_CAN_TX_Gr_MsgGr_E2E_BCAN_WPC_FD_01_200ms_MsgGr_E2E_BCAN_WPC_FD_01_200ms
        XfrmSignal: category=TOOL_CONFIGURED
          XfrmSignalChoice: category=TOOL_CONFIGURED
            XfrmISignalGroupRefChoice: category=TOOL_CONFIGURED, XfrmISignalGroupRef=MsgGr_E2E_BCAN_WPC_FD_01_200ms
      E2EXf_MsgGr_E2E_BCAN_WPC_FD_VCRM_01_00ms: XfrmTransformationTechnologyRef=XfTechTx_E2EXf_P5, XfrmVariableDataPrototypeInstanceRef=App_CAN_TX.Gr_MsgGr_E2E_BCAN_WPC_FD_VCRM_01_00ms.MsgGr_E2E_BCAN_WPC_FD_VCRM_01_00ms, XfrmTransformerBswModuleEntryRef=E2EXf_App_CAN_TX_Gr_MsgGr_E2E_BCAN_WPC_FD_VCRM_01_00ms_MsgGr_E2E_BCAN_WPC_FD_VCRM_01_00ms
        XfrmSignal: category=TOOL_CONFIGURED
          XfrmSignalChoice: category=TOOL_CONFIGURED
            XfrmISignalGroupRefChoice: category=TOOL_CONFIGURED, XfrmISignalGroupRef=MsgGr_E2E_BCAN_WPC_FD_VCRM_01_00ms
      E2EXf_MsgGr_E2E_LCAN_L_WPC_FD_01_00ms: XfrmTransformationTechnologyRef=XfTechTx_E2EXf_P5, XfrmVariableDataPrototypeInstanceRef=App_CAN_TX.Gr_MsgGr_E2E_LCAN_L_WPC_FD_01_00ms.MsgGr_E2E_LCAN_L_WPC_FD_01_00ms, XfrmTransformerBswModuleEntryRef=E2EXf_App_CAN_TX_Gr_MsgGr_E2E_LCAN_L_WPC_FD_01_00ms_MsgGr_E2E_LCAN_L_WPC_FD_01_00ms
        XfrmSignal: category=TOOL_CONFIGURED
          XfrmSignalChoice: category=TOOL_CONFIGURED
            XfrmISignalGroupRefChoice: category=TOOL_CONFIGURED, XfrmISignalGroupRef=MsgGr_E2E_LCAN_L_WPC_FD_01_00ms
      E2EXf_MsgGr_E2E_LCAN_L_WPC_FD_20_200ms: XfrmTransformationTechnologyRef=XfTechTx_E2EXf_P5, XfrmVariableDataPrototypeInstanceRef=App_CAN_TX.Gr_MsgGr_E2E_LCAN_L_WPC_FD_20_200ms.MsgGr_E2E_LCAN_L_WPC_FD_20_200ms, XfrmTransformerBswModuleEntryRef=E2EXf_App_CAN_TX_Gr_MsgGr_E2E_LCAN_L_WPC_FD_20_200ms_MsgGr_E2E_LCAN_L_WPC_FD_20_200ms
        XfrmSignal: category=TOOL_CONFIGURED
          XfrmSignalChoice: category=TOOL_CONFIGURED
            XfrmISignalGroupRefChoice: category=TOOL_CONFIGURED, XfrmISignalGroupRef=MsgGr_E2E_LCAN_L_WPC_FD_20_200ms
      E2EXf_MsgGr_E2E_LCAN_PDC_FD_15_300ms: XfrmTransformationTechnologyRef=XfTechRx_E2EXf_P5, XfrmInvTransformerBswModuleEntryRef=E2EXf_Inv_Com_ComISignalGroup_MsgGr_E2E_LCAN_PDC_FD_15_300ms
        XfrmSignal: category=TOOL_CONFIGURED
          XfrmSignalChoice: category=TOOL_CONFIGURED
            XfrmISignalGroupRefChoice: category=TOOL_CONFIGURED, XfrmISignalGroupRef=MsgGr_E2E_LCAN_PDC_FD_15_300ms
      E2EXf_MsgGr_E2E_BCAN_PDC_FD_15_300ms: XfrmTransformationTechnologyRef=XfTechRx_E2EXf_P5, XfrmVariableDataPrototypeInstanceRef=App_CAN_RX.Gr_MsgGr_E2E_BCAN_PDC_FD_15_300ms.MsgGr_E2E_BCAN_PDC_FD_15_300ms, XfrmInvTransformerBswModuleEntryRef=E2EXf_Inv_App_CAN_RX_Gr_MsgGr_E2E_BCAN_PDC_FD_15_300ms_MsgGr_E2E_BCAN_PDC_FD_15_300ms
        XfrmSignal: category=TOOL_CONFIGURED
          XfrmSignalChoice: category=TOOL_CONFIGURED
            XfrmISignalGroupRefChoice: category=TOOL_CONFIGURED, XfrmISignalGroupRef=MsgGr_E2E_BCAN_PDC_FD_15_300ms
      E2EXf_MsgGr_E2E_BCAN_WPC2_FD_01_200ms: XfrmTransformationTechnologyRef=XfTechTx_E2EXf_P5, XfrmVariableDataPrototypeInstanceRef=App_CAN_TX.Gr_MsgGr_E2E_BCAN_WPC2_FD_01_200ms.MsgGr_E2E_BCAN_WPC2_FD_01_200ms, XfrmTransformerBswModuleEntryRef=E2EXf_App_CAN_TX_Gr_MsgGr_E2E_BCAN_WPC2_FD_01_200ms_MsgGr_E2E_BCAN_WPC2_FD_01_200ms
        XfrmSignal: category=TOOL_CONFIGURED
          XfrmSignalChoice: category=TOOL_CONFIGURED
            XfrmISignalGroupRefChoice: category=TOOL_CONFIGURED, XfrmISignalGroupRef=MsgGr_E2E_BCAN_WPC2_FD_01_200ms
      E2EXf_MsgGr_E2E_BCAN_WPC_WU_01_500ms: XfrmTransformationTechnologyRef=XfTechTx_E2EXf_P5, XfrmTransformerBswModuleEntryRef=E2EXf_Com_ComISignalGroup_MsgGr_E2E_BCAN_WPC_WU_01_500ms
        XfrmSignal: category=TOOL_CONFIGURED
          XfrmSignalChoice: category=TOOL_CONFIGURED
            XfrmISignalGroupRefChoice: category=TOOL_CONFIGURED, XfrmISignalGroupRef=MsgGr_E2E_BCAN_WPC_WU_01_500ms
