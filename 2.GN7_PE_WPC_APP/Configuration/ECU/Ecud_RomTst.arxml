AUTOSAR XML (schema 4-1-2)
package /AUTOSAR
  module config RomTst: implementation-config-variant=VARIANT-PRE-COMPILE, module-description=BswImplementation_RomTst
    RomTstGeneral: RomTstTestCompletedNotificationSupported=1, RomTstDevErrorDetect=1
    RomTstConfigSet: RomTstTestCompletedNotification=RomTst_TestCompletedNotification
      RomTstBlockFgnd_RomTst (RomTstBlockFgnd): RomTstFgndBlockIndex=0, RomTstCrcAreaAddressFirst=268798988, RomTstTestAlgorithm=FLSTST_16BIT_CRC
      RomTstBlockBgnd_FBL (RomTstBlockBgnd): RomTstBgndBlockIndex=0, RomTstCrcAreaAddressFirst=268601360, RomTstTestAlgorithm=FLSTST_16BIT_CRC
      RomTstBlockBgnd_ASW (RomTstBlockBgnd): RomTstBgndBlockIndex=1, RomTstCrcAreaAddressFirst=268797968, RomTstTestAlgorithm=FLSTST_16BIT_CRC
