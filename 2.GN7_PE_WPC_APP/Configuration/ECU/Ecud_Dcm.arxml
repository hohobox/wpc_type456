AUTOSAR XML (schema 4-0-3)
package /AUTOSAR
  module config Dcm: implementation-config-variant=VARIANT-PRE-COMPILE, module-description=BswImplementation_Dcm
    DcmConfigSet
      DcmDsd
        ES95486_SERVICE (DcmDsdServiceTable): DcmDsdSidTabId=0
          18 x DcmDsdService:
            SID10_DiagnosticSessionControl: DcmDsdSidTabServiceId=0x10, DcmDsdSidTabSubfuncAvail=1, DcmDsdSidTabSessionLevelRef=DCM_ALL_SESSION_LEVEL
              5 x DcmDsdSubService:
                defaultSession: DcmDsdSubServiceId=0x01
                programmingSession: DcmDsdSubServiceId=0x02, DcmDsdSubServiceSessionLevelRef=DCM_DEFAULT_SESSION, DcmDsdSubServiceSessionLevelRef=DCM_PROGRAMMING_SESSION, DcmDsdSubServiceSessionLevelRef=DCM_EXTENDED_DIAGNOSTIC_SESSION
                extendedDiagnosticSession: DcmDsdSubServiceId=0x03, DcmDsdSubServiceSessionLevelRef=DCM_DEFAULT_SESSION, DcmDsdSubServiceSessionLevelRef=DCM_EXTENDED_DIAGNOSTIC_SESSION, DcmDsdSubServiceSessionLevelRef=DCM_SAFETY_SYSTEM_DIAGNOSTIC_SESSION
                quiescent_current_diagnostic_mode: DcmDsdSubServiceId=0x50, DcmDsdSubServiceSessionLevelRef=DCM_DEFAULT_SESSION, DcmDsdSubServiceSessionLevelRef=DCM_QUIESCENT_CURRENT_DIAGNOSTIC_MODE
                sleep_mode_start_request: DcmDsdSubServiceId=0x51
            SID11_ECUReset: DcmDsdSidTabServiceId=0x11, DcmDsdSidTabSubfuncAvail=1, DcmDsdSidTabSessionLevelRef=DCM_DEFAULT_SESSION, DcmDsdSidTabSessionLevelRef=DCM_PROGRAMMING_SESSION, DcmDsdSidTabSessionLevelRef=DCM_EXTENDED_DIAGNOSTIC_SESSION, DcmDsdSidTabSessionLevelRef=DCM_SAFETY_SYSTEM_DIAGNOSTIC_SESSION
              hardReset (DcmDsdSubService): DcmDsdSubServiceId=0x01
            SID27_SecurityAccess: DcmDsdSidTabServiceId=0x27, DcmDsdSidTabSubfuncAvail=1, DcmDsdSidTabSessionLevelRef=DCM_PROGRAMMING_SESSION, DcmDsdSidTabSessionLevelRef=DCM_EXTENDED_DIAGNOSTIC_SESSION, DcmDsdSidTabSessionLevelRef=DCM_SAFETY_SYSTEM_DIAGNOSTIC_SESSION
              4 x DcmDsdSubService:
                GetSeed_HSAC: DcmDsdSubServiceId=0x11
                CompareKey_HSAC: DcmDsdSubServiceId=0x12
                GetSeed_OEUK: DcmDsdSubServiceId=0x13
                CompareKey_OEUK: DcmDsdSubServiceId=0x14
            SID28_CommunicationControl: DcmDsdSidTabServiceId=0x28, DcmDsdSidTabSubfuncAvail=1, DcmDsdSidTabSessionLevelRef=DCM_PROGRAMMING_SESSION, DcmDsdSidTabSessionLevelRef=DCM_EXTENDED_DIAGNOSTIC_SESSION
              4 x DcmDsdSubService:
                enableRxAndTx: DcmDsdSubServiceId=0
                disableNormalMessageTransmission: DcmDsdSubServiceId=1
                disableRxAndEnableTx: DcmDsdSubServiceId=2
                disableRxAndTx: DcmDsdSubServiceId=3
            SID3E_TesterPresent: DcmDsdSidTabServiceId=0x3E, DcmDsdSidTabSubfuncAvail=1, DcmDsdSidTabSessionLevelRef=DCM_DEFAULT_SESSION, DcmDsdSidTabSessionLevelRef=DCM_PROGRAMMING_SESSION, DcmDsdSidTabSessionLevelRef=DCM_EXTENDED_DIAGNOSTIC_SESSION, DcmDsdSidTabSessionLevelRef=DCM_SAFETY_SYSTEM_DIAGNOSTIC_SESSION
              zeroSubFunction (DcmDsdSubService): DcmDsdSubServiceId=0x0
            SID85_ControlDTCSetting: DcmDsdSidTabServiceId=0x85, DcmDsdSidTabSubfuncAvail=1, DcmDsdSidTabSessionLevelRef=DCM_PROGRAMMING_SESSION, DcmDsdSidTabSessionLevelRef=DCM_EXTENDED_DIAGNOSTIC_SESSION
              On (DcmDsdSubService): DcmDsdSubServiceId=0x01
              Off (DcmDsdSubService): DcmDsdSubServiceId=0x02
            SID20_StopDiagnosticSession: DcmDsdSidTabServiceId=0x20, DcmDsdSidTabSubfuncAvail=0, DcmDsdSidTabSessionLevelRef=DCM_DEFAULT_SESSION, DcmDsdSidTabSessionLevelRef=DCM_PROGRAMMING_SESSION, DcmDsdSidTabSessionLevelRef=DCM_EXTENDED_DIAGNOSTIC_SESSION
            SID23_ReadMemoryByAddress: DcmDsdSidTabServiceId=0x23, DcmDsdSidTabSubfuncAvail=0, DcmDsdSidTabSecurityLevelRef=L9, DcmDsdSidTabSessionLevelRef=DCM_DEFAULT_SESSION, DcmDsdSidTabSessionLevelRef=DCM_EXTENDED_DIAGNOSTIC_SESSION
            SID22_ReadDataByIdentifier: DcmDsdSidTabServiceId=0x22, DcmDsdSidTabSubfuncAvail=0, DcmDsdSidTabSessionLevelRef=DCM_DEFAULT_SESSION, DcmDsdSidTabSessionLevelRef=DCM_EXTENDED_DIAGNOSTIC_SESSION, DcmDsdSidTabSessionLevelRef=DCM_SAFETY_SYSTEM_DIAGNOSTIC_SESSION, DcmDsdSidTabSessionLevelRef=DCM_QUIESCENT_CURRENT_DIAGNOSTIC_MODE
            SID2E_WriteDataByIdentifier: DcmDsdSidTabServiceId=0x2E, DcmDsdSidTabSubfuncAvail=0, DcmDsdSidTabSecurityLevelRef=L9, DcmDsdSidTabSessionLevelRef=DCM_DEFAULT_SESSION, DcmDsdSidTabSessionLevelRef=DCM_PROGRAMMING_SESSION, DcmDsdSidTabSessionLevelRef=DCM_EXTENDED_DIAGNOSTIC_SESSION, DcmDsdSidTabSessionLevelRef=DCM_SAFETY_SYSTEM_DIAGNOSTIC_SESSION
            SID3D_WriteMemoryByAddress: DcmDsdSidTabServiceId=0x3D, DcmDsdSidTabSubfuncAvail=0, DcmDsdSidTabSessionLevelRef=DCM_DEFAULT_SESSION, DcmDsdSidTabSessionLevelRef=DCM_PROGRAMMING_SESSION, DcmDsdSidTabSessionLevelRef=DCM_EXTENDED_DIAGNOSTIC_SESSION, DcmDsdSidTabSecurityLevelRef=L9
            SID19_ReadDTCInformation: DcmDsdSidTabServiceId=0x19, DcmDsdSidTabSubfuncAvail=1, DcmDsdSidTabSessionLevelRef=DCM_DEFAULT_SESSION, DcmDsdSidTabSessionLevelRef=DCM_EXTENDED_DIAGNOSTIC_SESSION
              reportNumberOfDTCByStatusMask (DcmDsdSubService): DcmDsdSubServiceId=0x01
              reportDTCByStatusMask (DcmDsdSubService): DcmDsdSubServiceId=0x02
            SID14_ClearDiagnosticInformation: DcmDsdSidTabServiceId=0x14, DcmDsdSidTabSubfuncAvail=0, DcmDsdSidTabSessionLevelRef=DCM_DEFAULT_SESSION, DcmDsdSidTabSessionLevelRef=DCM_EXTENDED_DIAGNOSTIC_SESSION
            SID2F_InputOutputControlByIdentifier: DcmDsdSidTabServiceId=0x2F, DcmDsdSidTabSubfuncAvail=0, DcmDsdSidTabSessionLevelRef=DCM_EXTENDED_DIAGNOSTIC_SESSION
            SID31_RoutineControl: DcmDsdSidTabServiceId=0x31, DcmDsdSidTabSubfuncAvail=1, DcmDsdSidTabSessionLevelRef=DCM_DEFAULT_SESSION, DcmDsdSidTabSessionLevelRef=DCM_PROGRAMMING_SESSION, DcmDsdSidTabSessionLevelRef=DCM_EXTENDED_DIAGNOSTIC_SESSION, DcmDsdSidTabSessionLevelRef=DCM_SAFETY_SYSTEM_DIAGNOSTIC_SESSION
              3 x DcmDsdSubService:
                startRoutine: DcmDsdSubServiceId=0x01
                stopRoutine: DcmDsdSubServiceId=0x02
                requestRoutineResults: DcmDsdSubServiceId=0x03
            SID34_RequestDownload: DcmDsdSidTabServiceId=0x34, DcmDsdSidTabSubfuncAvail=0, DcmDsdSidTabSecurityLevelRef=L10, DcmDsdSidTabSessionLevelRef=DCM_EXTENDED_DIAGNOSTIC_SESSION, DcmDsdSidTabSessionLevelRef=DCM_PROGRAMMING_SESSION, DcmDsdSidTabSecurityLevelRef=L9
            SID36_TransferData: DcmDsdSidTabSubfuncAvail=0, DcmDsdSidTabServiceId=0x36, DcmDsdSidTabSecurityLevelRef=L10, DcmDsdSidTabSessionLevelRef=DCM_EXTENDED_DIAGNOSTIC_SESSION, DcmDsdSidTabSessionLevelRef=DCM_PROGRAMMING_SESSION, DcmDsdSidTabSecurityLevelRef=L9
            SID37_RequestTransferExit: DcmDsdSidTabSubfuncAvail=0, DcmDsdSidTabServiceId=0x37, DcmDsdSidTabSecurityLevelRef=L10, DcmDsdSidTabSessionLevelRef=DCM_EXTENDED_DIAGNOSTIC_SESSION, DcmDsdSidTabSessionLevelRef=DCM_PROGRAMMING_SESSION, DcmDsdSidTabSecurityLevelRef=L9
      DcmDsl: category=TOOL_CONFIGURED
        UDS_RX (DcmDslBuffer): DcmDslBufferSize=2050
        UDS_TX (DcmDslBuffer): DcmDslBufferSize=512
        ECU1 (DcmDslCallbackDCMRequestService)
        DcmDslDiagResp: category=TOOL_CONFIGURED, DcmDslDiagRespMaxNumRespPend=50, DcmDslDiagRespOnSecondDeclinedRequest=1
        Dcm_DiagCom_Protocol (DcmDslProtocol): category=TOOL_CONFIGURED
          UDS_ON_CAN (DcmDslProtocolRow):
            category = TOOL_CONFIGURED
            DcmDslProtocolEndiannessConvEnabled = 0
            DcmDslProtocolID = DCM_UDS_ON_CAN
            DcmDslProtocolIsParallelExecutab = 1
            DcmDslProtocolPreemptTimeout = 0.01
            DcmDslProtocolPriority = 1
            DcmDslProtocolTransType = TYPE2
            DcmSendRespPendOnTransToBoot = 1
            DcmTimStrP2ServerAdjust = 0.02
            DcmTimStrP2StarServerAdjust = 2.5
            DcmDslProtocolSIDTable = ES95486_SERVICE
            DcmDslProtocolSessionRef = ES95486_SESSION
            DcmDslProtocolRxBufferRef = UDS_RX
            DcmDslProtocolTxBufferRef = UDS_TX
            UDS_ON_BCAN (DcmDslConnection): category=TOOL_CONFIGURED
              DcmDslMainConnection: category=TOOL_CONFIGURED, DcmDslProtocolRxTesterSourceAddr=0xf0, DcmDslProtocolRxConnectionId=0
                PhysicalRequest (DcmDslProtocolRx):
                  category = TOOL_CONFIGURED
                  DcmDslProtocolRxAddrType = DCM_PHYSICAL_TYPE
                  DcmDslProtocolRxPduId = 0
                  DcmDslProtocolRxChannelId = 0
                  DcmDslProtocolRxPduRef = Pdu_DcmIPdu_BCAN_GST_WPC
                  DcmDslProtocolRxComMChannelRef = ComMChannel_BCAN
                FunctionalRequest (DcmDslProtocolRx):
                  category = TOOL_CONFIGURED
                  DcmDslProtocolRxAddrType = DCM_FUNCTIONAL_TYPE
                  DcmDslProtocolRxPduId = 1
                  DcmDslProtocolRxChannelId = 0
                  DcmDslProtocolRxPduRef = Pdu_DcmIPdu_BCAN_GST_ALL
                  DcmDslProtocolRxComMChannelRef = ComMChannel_BCAN
                Response (DcmDslProtocolTx): category=TOOL_CONFIGURED, DcmDslTxConfirmationPduId=0, DcmDslProtocolTxPduRef=Pdu_DcmIPdu_BCAN_WPC_GST
        DcmDslServiceRequestSupplierNotification0 (DcmDslServiceRequestSupplierNotification)
        DcmDslServiceRequestSupplierNotification1 (DcmDslServiceRequestSupplierNotification)
        UDS_RX_BUFFER (DcmDslBuffer): category=TOOL_CONFIGURED, DcmDslBufferSize=2050
        UDS_TX_BUFFER (DcmDslBuffer): category=TOOL_CONFIGURED, DcmDslBufferSize=255
      DcmDsp: DcmDspMaxDidToRead=32, DcmDspPowerDownTime=10, DcmDspMaxPeriodicDidScheduler=2, DcmDspMaxPeriodicDidToRead=2, DcmDspDDDIDcheckPerSourceDID=0
        DcmDspComControl
          CommChannel_BCAN (DcmDspComControlAllChannel): DcmDspAllComMChannelRef=ComMChannel_BCAN
          SpecificCommChannel_BCAN (DcmDspComControlSpecificChannel): DcmDspSubnetNumber=1, DcmDspSpecificComMChannelRef=ComMChannel_BCAN
        32 x DcmDspData, all with DcmDspDataType=UINT8:
          DcmDspData_InputOutputRecordLocalIdentifier1: DcmDspDataSize=160, DcmDspDataUsePort=USE_DATA_SYNCH_FNC, DcmDspDataConditionCheckReadFnc=InputOutputRecordLocalIdentifier1_ConditionCheckRead, DcmDspDataReadFnc=InputOutputRecordLocalIdentifier1_Read, DcmDspDataInfoRef=NoScalingInfomation_FixedData
          DcmDspData_InputOutputRecordLocalIdentifier2: DcmDspDataSize=80, DcmDspDataUsePort=USE_DATA_SYNCH_FNC, DcmDspDataConditionCheckReadFnc=InputOutputRecordLocalIdentifier2_ConditionCheckRead, DcmDspDataReadFnc=InputOutputRecordLocalIdentifier2_Read, DcmDspDataInfoRef=NoScalingInfomation_FixedData
          DcmDspData_ECUSecurityInformationDataIdentifier: DcmDspDataSize=24, DcmDspDataUsePort=USE_DATA_SYNCH_FNC, DcmDspDataConditionCheckReadFnc=ECUSecurityInformationDataIdentifier_ConditionCheckRead, DcmDspDataReadFnc=ECUSecurityInformationDataIdentifier_Read, DcmDspDataInfoRef=NoScalingInfomation_FixedData
          DcmDspData_SystemName: DcmDspDataSize=24, DcmDspDataUsePort=USE_DATA_SYNCH_FNC, DcmDspDataConditionCheckReadFnc=SystemName_ConditionCheckRead, DcmDspDataReadFnc=SystemName_Read, DcmDspDataInfoRef=NoScalingInfomation_FixedData
          DcmDspData_VehicleManufacturerSparePartNumberDataIdentifier: DcmDspDataSize=80, DcmDspDataUsePort=USE_DATA_SYNCH_FNC, DcmDspDataConditionCheckReadFnc=VehicleManufacturerSparePartNumberDataIdentifier_ConditionCheckRead, DcmDspDataReadFnc=VehicleManufacturerSparePartNumberDataIdentifier_Read, DcmDspDataInfoRef=NoScalingInfomation_FixedData
          DcmDspData_ECUSoftwareUNITnumberDataIdentifier: DcmDspDataSize=8, DcmDspDataUsePort=USE_DATA_SYNCH_FNC, DcmDspDataConditionCheckReadFnc=ECUSoftwareUNITnumberDataIdentifier_ConditionCheckRead, DcmDspDataReadFnc=ECUSoftwareUNITnumberDataIdentifier_Read, DcmDspDataInfoRef=NoScalingInfomation_FixedData
          DcmDspData_ECUSoftwareUNIT1VersionDataIdentifier: DcmDspDataSize=40, DcmDspDataUsePort=USE_DATA_SYNCH_FNC, DcmDspDataConditionCheckReadFnc=ECUSoftwareUNIT1VersionDataIdentifier_ConditionCheckRead, DcmDspDataReadFnc=ECUSoftwareUNIT1VersionDataIdentifier_Read, DcmDspDataInfoRef=NoScalingInfomation_FixedData
          DcmDspData_ECUManufacturingDateDataIdentifier: DcmDspDataSize=32, DcmDspDataUsePort=USE_DATA_SYNCH_FNC, DcmDspDataConditionCheckReadFnc=ECUManufacturingDateDataIdentifier_ConditionCheckRead, DcmDspDataReadFnc=ECUManufacturingDateDataIdentifier_Read, DcmDspDataInfoRef=NoScalingInfomation_FixedData
          DcmDspData_ECUSerialNumberDataIdentifier: DcmDspDataSize=120, DcmDspDataUsePort=USE_DATA_SYNCH_FNC, DcmDspDataConditionCheckReadFnc=ECUSerialNumberDataIdentifier_ConditionCheckRead, DcmDspDataReadFnc=ECUSerialNumberDataIdentifier_Read, DcmDspDataInfoRef=NoScalingInfomation_FixedData
          DcmDspData_VehicleManufacturerECUHardwareNumberDataIdentifier: DcmDspDataSize=32, DcmDspDataUsePort=USE_DATA_SYNCH_FNC, DcmDspDataConditionCheckReadFnc=VehicleManufacturerECUHardwareNumberDataIdentifier_ConditionCheckRead, DcmDspDataReadFnc=VehicleManufacturerECUHardwareNumberDataIdentifier_Read, DcmDspDataInfoRef=NoScalingInfomation_FixedData
          DcmDspData_SystemSupplierECUHardwareVersionNumberDataIdentifier: DcmDspDataSize=32, DcmDspDataUsePort=USE_DATA_SYNCH_FNC, DcmDspDataConditionCheckReadFnc=SystemSupplierECUHardwareVersionNumberDataIdentifier_ConditionCheckRead, DcmDspDataReadFnc=SystemSupplierECUHardwareVersionNumberDataIdentifier_Read, DcmDspDataInfoRef=NoScalingInfomation_FixedData
          DcmDspData_SoftwareVersionforHKMCVehiclemanufactureDataIdentifier: DcmDspDataSize=40, DcmDspDataUsePort=USE_DATA_SYNCH_FNC, DcmDspDataConditionCheckReadFnc=SoftwareVersionforHKMCVehiclemanufactureDataIdentifier_ConditionCheckRead, DcmDspDataReadFnc=SoftwareVersionforHKMCVehiclemanufactureDataIdentifier_Read, DcmDspDataInfoRef=NoScalingInfomation_FixedData
          DcmDspData_ECUSupplierCodeDataIdentifier: DcmDspDataSize=32, DcmDspDataUsePort=USE_DATA_SYNCH_FNC, DcmDspDataConditionCheckReadFnc=ECUSupplierCodeDataIdentifier_ConditionCheckRead, DcmDspDataReadFnc=ECUSupplierCodeDataIdentifier_Read, DcmDspDataInfoRef=NoScalingInfomation_FixedData
          DcmDspData_CANDataBaseVersionNumberDataIdentifier: DcmDspDataSize=32, DcmDspDataUsePort=USE_DATA_SYNCH_FNC, DcmDspDataConditionCheckReadFnc=CANDataBaseVersionNumberDataIdentifier_ConditionCheckRead, DcmDspDataReadFnc=CANDataBaseVersionNumberDataIdentifier_Read, DcmDspDataInfoRef=NoScalingInfomation_FixedData
          DcmDspData_LocalRXSWINDataIdentifier: DcmDspDataSize=1024, DcmDspDataUsePort=USE_DATA_SYNCH_FNC, DcmDspDataConditionCheckReadFnc=LocalRXSWINDataIdentifier_ConditionCheckRead, DcmDspDataReadFnc=LocalRXSWINDataIdentifier_Read, DcmDspDataReadDataLengthFnc=LocalRXSWINDataIdentifier_ReadDataLength, DcmDspDataInfoRef=NoScalingInfomation_VariableData
          DcmDspData_ECUSoftwareUnit1IVDDataIdentifier: DcmDspDataSize=256, DcmDspDataUsePort=USE_DATA_ASYNCH_FNC, DcmDspDataConditionCheckReadFnc=ECUSoftwareUnit1IVDDataIdentifier_ConditionCheckRead, DcmDspDataReadFnc=ECUSoftwareUnit1IVDDataIdentifier_Read, DcmDspDataInfoRef=NoScalingInfomation_FixedData
          DcmDspData_PlatformSoftwareVersion: DcmDspDataSize=112, DcmDspDataUsePort=USE_DATA_SYNCH_FNC, DcmDspDataConditionCheckReadFnc=PlatformSoftwareVersion_ConditionCheckRead, DcmDspDataReadFnc=PlatformSoftwareVersion_Read, DcmDspDataInfoRef=NoScalingInfomation_FixedData
          DcmDspData_PlatformHardwareVersion: DcmDspDataSize=88, DcmDspDataUsePort=USE_DATA_SYNCH_FNC, DcmDspDataConditionCheckReadFnc=PlatformHardwareVersion_ConditionCheckRead, DcmDspDataReadFnc=PlatformHardwareVersion_Read, DcmDspDataInfoRef=NoScalingInfomation_FixedData
          DcmDspData_NonSleepCollectedEachEcuDataDataIdentifier: DcmDspDataSize=120, DcmDspDataUsePort=USE_DATA_ASYNCH_FNC, DcmDspDataConditionCheckReadFnc=NonSleepCollectedEachEcuDataDataIdentifier_ConditionCheckRead, DcmDspDataReadFnc=NonSleepCollectedEachEcuDataDataIdentifier_Read, DcmDspDataInfoRef=NoScalingInfomation_FixedData
          DcmDspData_NML_LogData: DcmDspDataConditionCheckReadFnc=Nml_RDBI_CondCheckRead, DcmDspDataReadFnc=Nml_RDBI_DataRead, DcmDspDataSize=1600, DcmDspDataUsePort=USE_DATA_SYNCH_FNC, DcmDspDataInfoRef=NoScalingInfomation_FixedData
          DcmDspData_InputOutputControlbyIdentifier_Supportedcheck: DcmDspDataSize=32, DcmDspDataUsePort=USE_DATA_SYNCH_FNC, DcmDspDataConditionCheckReadFnc=InputOutputControlbyIdentifier_Supportedcheck_ConditionCheckRead, DcmDspDataFreezeCurrentStateFnc=InputOutputControlbyIdentifier_Supportedcheck_FreezeCurrentState, DcmDspDataReadFnc=InputOutputControlbyIdentifier_Supportedcheck_Read, DcmDspDataInfoRef=NoScalingInfomation_FixedData
          DcmDspData_InputOutputControlbyIdentifier_{11..13}: DcmDspDataSize=8, DcmDspDataUsePort=USE_DATA_SYNCH_FNC, DcmDspDataConditionCheckReadFnc=InputOutputControlbyIdentifier_{11..13}_ConditionCheckRead, DcmDspDataReadFnc=InputOutputControlbyIdentifier_{11..13}_Read, DcmDspDataReturnControlToEcuFnc=InputOutputControlbyIdentifier_{11..13}_ReturnControlToECU, DcmDspDataReadDataLengthFnc=InputOutputControlbyIdentifier_{11..13}_ReadDataLength, DcmDspDataShortTermAdjustmentFnc=InputOutputControlbyIdentifier_{11..13}_ShortTermAdjustment, DcmDspDataInfoRef=NoScalingInfomation_VariableData
          DcmDspData_InputOutputControlbyIdentifier_16: DcmDspDataSize=8, DcmDspDataUsePort=USE_DATA_SYNCH_FNC, DcmDspDataConditionCheckReadFnc=InputOutputControlbyIdentifier_16_ConditionCheckRead, DcmDspDataReadFnc=InputOutputControlbyIdentifier_16_Read, DcmDspDataReturnControlToEcuFnc=InputOutputControlbyIdentifier_16_ReturnControlToECU, DcmDspDataReadDataLengthFnc=InputOutputControlbyIdentifier_16_ReadDataLength, DcmDspDataShortTermAdjustmentFnc=InputOutputControlbyIdentifier_16_ShortTermAdjustment, DcmDspDataInfoRef=NoScalingInfomation_VariableData
          DcmDspData_InputOutputControlbyIdentifier_17: DcmDspDataSize=8, DcmDspDataUsePort=USE_DATA_SYNCH_FNC, DcmDspDataConditionCheckReadFnc=InputOutputControlbyIdentifier_17_ConditionCheckRead, DcmDspDataReadFnc=InputOutputControlbyIdentifier_17_Read, DcmDspDataReturnControlToEcuFnc=InputOutputControlbyIdentifier_17_ReturnControlToECU, DcmDspDataReadDataLengthFnc=InputOutputControlbyIdentifier_17_ReadDataLength, DcmDspDataShortTermAdjustmentFnc=InputOutputControlbyIdentifier_17_ShortTermAdjustment, DcmDspDataInfoRef=NoScalingInfomation_VariableData
          DcmDspData_InputOutputControlbyIdentifier_18: DcmDspDataSize=80, DcmDspDataUsePort=USE_DATA_SYNCH_FNC, DcmDspDataConditionCheckReadFnc=InputOutputControlbyIdentifier_18_ConditionCheckRead, DcmDspDataReadFnc=InputOutputControlbyIdentifier_18_Read, DcmDspDataReturnControlToEcuFnc=InputOutputControlbyIdentifier_18_ReturnControlToECU, DcmDspDataReadDataLengthFnc=InputOutputControlbyIdentifier_18_ReadDataLength, DcmDspDataShortTermAdjustmentFnc=InputOutputControlbyIdentifier_18_ShortTermAdjustment, DcmDspDataInfoRef=NoScalingInfomation_VariableData
          DcmDspData_EcuInfoRead: DcmDspDataSize=576, DcmDspDataUsePort=USE_DATA_SYNCH_FNC, DcmDspDataConditionCheckReadFnc=EcuInfoRead_ConditionCheckRead, DcmDspDataReadFnc=EcuInfoRead_Read, DcmDspDataInfoRef=NoScalingInfomation_FixedData
          DcmDspData_EcuInfoWrite: DcmDspDataSize=144, DcmDspDataUsePort=USE_DATA_ASYNCH_FNC, DcmDspDataWriteFnc=EcuInfoWrite_Write, DcmDspDataInfoRef=NoScalingInfomation_VariableData
          DcmDspData_QRCodeWrite: DcmDspDataSize=168, DcmDspDataUsePort=USE_DATA_ASYNCH_FNC, DcmDspDataWriteFnc=QRCodeWrite_Write, DcmDspDataInfoRef=NoScalingInfomation_FixedData
          DcmDspData_ChallengeRequest: DcmDspDataSize=128, DcmDspDataUsePort=USE_DATA_SYNCH_FNC, DcmDspDataConditionCheckReadFnc=ChallengeRequest_ConditionCheckRead, DcmDspDataReadFnc=ChallengeRequest_Read, DcmDspDataWriteFnc=ChallengeRequest_Write, DcmDspDataInfoRef=NoScalingInfomation_FixedData
          DcmDspData_SecureBootEnable: DcmDspDataSize=8, DcmDspDataUsePort=USE_DATA_ASYNCH_FNC, DcmDspDataConditionCheckReadFnc=SecureBootEnable_ConditionCheckRead, DcmDspDataReadFnc=SecureBootEnable_Read, DcmDspDataInfoRef=NoScalingInfomation_FixedData
        4 x DcmDspDataInfo:
          VehicleSpeed_FixedData: DcmDspDataFixedLength=1, DcmDspDataScalingInfoSize=9
          NoScalingInfomation_FixedData: DcmDspDataFixedLength=1
          NoScalingInfomation_VariableData: DcmDspDataFixedLength=0
          VIN_DataIdentifier: DcmDspDataFixedLength=1, DcmDspDataScalingInfoSize=2
        32 x DcmDspDid, all with DcmDspDidUsed=1:
          DcmDspDid_InputOutputRecordLocalIdentifier1: DcmDspDidIdentifier=0xBE02, DcmDspDidInfoRef=DcmDspDidInfo_InputOutputRecordLocalIdentifier1
            DcmDspDidSignal_UserOptionRecordLocalIdentifier1 (DcmDspDidSignal): DcmDspDidDataPos=0, DcmDspDidDataRef=DcmDspData_InputOutputRecordLocalIdentifier1
          DcmDspDid_InputOutputRecordLocalIdentifier2: DcmDspDidIdentifier=0xBE03, DcmDspDidInfoRef=DcmDspDidInfo_InputOutputRecordLocalIdentifier2
            DcmDspDidSignal_UserOptionRecordLocalIdentifier2 (DcmDspDidSignal): DcmDspDidDataPos=0, DcmDspDidDataRef=DcmDspData_InputOutputRecordLocalIdentifier2
          DcmDspDid_ECUSecurityInformationDataIdentifier: DcmDspDidIdentifier=0xF1C0, DcmDspDidInfoRef=DcmDspDidInfo_ECUSecurityInformationDataIdentifier
            DcmDspDidSignal_ECUSecurityInformationDataIdentifier (DcmDspDidSignal): DcmDspDidDataPos=0, DcmDspDidDataRef=DcmDspData_ECUSecurityInformationDataIdentifier
          DcmDspDid_SystemName: DcmDspDidIdentifier=0xF197, DcmDspDidInfoRef=DcmDspDidInfo_SystemName
            DcmDspDidSignal_SystemName (DcmDspDidSignal): DcmDspDidDataPos=0, DcmDspDidDataRef=DcmDspData_SystemName
          DcmDspDid_VehicleManufacturerSparePartNumberDataIdentifier: DcmDspDidIdentifier=0xF187, DcmDspDidInfoRef=DcmDspDidInfo_VehicleManufacturerSparePartNumberDataIdentifier
            DcmDspDidSignal_VehicleManufacturerSparePartNumberDataIdentifier (DcmDspDidSignal): DcmDspDidDataPos=0, DcmDspDidDataRef=DcmDspData_VehicleManufacturerSparePartNumberDataIdentifier
          DcmDspDid_ECUSoftwareUNITnumberDataIdentifier: DcmDspDidIdentifier=0xF1B0, DcmDspDidInfoRef=DcmDspDidInfo_ECUSoftwareUNITnumberDataIdentifier
            DcmDspDidSignal_ECUSoftwareUNITnumberDataIdentifier (DcmDspDidSignal): DcmDspDidDataPos=0, DcmDspDidDataRef=DcmDspData_ECUSoftwareUNITnumberDataIdentifier
          DcmDspDid_ECUSoftwareUNIT1VersionDataIdentifier: DcmDspDidIdentifier=0xF1B1, DcmDspDidInfoRef=DcmDspDidInfo_ECUSoftwareUNIT1VersionDataIdentifier
            DcmDspDidSignal_ECUSoftwareUNIT1VersionDataIdentifier (DcmDspDidSignal): DcmDspDidDataPos=0, DcmDspDidDataRef=DcmDspData_ECUSoftwareUNIT1VersionDataIdentifier
          DcmDspDid_ECUManufacturingDateDataIdentifier: DcmDspDidIdentifier=0xF18B, DcmDspDidInfoRef=DcmDspDidInfo_ECUManufacturingDateDataIdentifier
            DcmDspDidSignal_ECUManufacturingDateDataIdentifier (DcmDspDidSignal): DcmDspDidDataPos=0, DcmDspDidDataRef=DcmDspData_ECUManufacturingDateDataIdentifier
          DcmDspDid_ECUSerialNumberDataIdentifier: DcmDspDidIdentifier=0xF18C, DcmDspDidInfoRef=DcmDspDidInfo_ECUSerialNumberDataIdentifier
            DcmDspDidSignal_ECUSerialNumberDataIdentifier (DcmDspDidSignal): DcmDspDidDataPos=0, DcmDspDidDataRef=DcmDspData_ECUSerialNumberDataIdentifier
          DcmDspDid_VehicleManufacturerECUHardwareNumberDataIdentifier: DcmDspDidIdentifier=0xF191, DcmDspDidInfoRef=DcmDspDidInfo_VehicleManufacturerECUHardwareNumberDataIdentifier
            DcmDspDidSignal_VehicleManufacturerECUHardwareNumberDataIdentifier (DcmDspDidSignal): DcmDspDidDataPos=0, DcmDspDidDataRef=DcmDspData_VehicleManufacturerECUHardwareNumberDataIdentifier
          DcmDspDid_SystemSupplierECUHardwareVersionNumberDataIdentifier: DcmDspDidIdentifier=0xF193, DcmDspDidInfoRef=DcmDspDidInfo_SystemSupplierECUHardwareVersionNumberDataIdentifier
            DcmDspDidSignal_SystemSupplierECUHardwareVersionNumberDataIdentifier (DcmDspDidSignal): DcmDspDidDataPos=0, DcmDspDidDataRef=DcmDspData_SystemSupplierECUHardwareVersionNumberDataIdentifier
          DcmDspDid_SoftwareVersionforHKMCVehiclemanufactureDataIdentifier: DcmDspDidIdentifier=0xF1A0, DcmDspDidInfoRef=DcmDspDidInfo_SoftwareVersionforHKMCVehiclemanufactureDataIdentifier
            DcmDspDidSignal_SoftwareVersionforHKMCVehiclemanufactureDataIdentifier (DcmDspDidSignal): DcmDspDidDataPos=0, DcmDspDidDataRef=DcmDspData_SoftwareVersionforHKMCVehiclemanufactureDataIdentifier
          DcmDspDid_ECUSupplierCodeDataIdentifier: DcmDspDidIdentifier=0xF1A1, DcmDspDidInfoRef=DcmDspDidInfo_ECUSupplierCodeDataIdentifier
            DcmDspDidSignal_ECUSupplierCodeDataIdentifier (DcmDspDidSignal): DcmDspDidDataPos=0, DcmDspDidDataRef=DcmDspData_ECUSupplierCodeDataIdentifier
          DcmDspDid_CANDataBaseVersionNumberDataIdentifier: DcmDspDidIdentifier=0xF100, DcmDspDidInfoRef=DcmDspDidInfo_CANDataBaseVersionNumberDataIdentifier
            DcmDspDidSignal_CANDataBaseVersionNumberDataIdentifier (DcmDspDidSignal): DcmDspDidDataPos=0, DcmDspDidDataRef=DcmDspData_CANDataBaseVersionNumberDataIdentifier
          DcmDspDid_LocalRXSWINDataIdentifier: DcmDspDidIdentifier=0xF1EF, DcmDspDidInfoRef=DcmDspDidInfo_LocalRXSWINDataIdentifier
            DcmDspDidSignal_LocalRXSWINDataIdentifier (DcmDspDidSignal): DcmDspDidDataPos=0, DcmDspDidDataRef=DcmDspData_LocalRXSWINDataIdentifier
          DcmDspDid_ECUSoftwareUnit1IVDDataIdentifier: DcmDspDidIdentifier=0xF1C1, DcmDspDidInfoRef=DcmDspDidInfo_ECUSoftwareUnit1IVDDataIdentifier
            DcmDspDidSignal_ECUSoftwareUnit1IVDDataIdentifier (DcmDspDidSignal): DcmDspDidDataPos=0, DcmDspDidDataRef=DcmDspData_ECUSoftwareUnit1IVDDataIdentifier
          DcmDspDid_PlatformSoftwareVersion: DcmDspDidIdentifier=0xF17F, DcmDspDidInfoRef=DcmDspDidInfo_PlatformSoftwareVersion
            DcmDspDidSignal_PlatformSoftwareVersion (DcmDspDidSignal): DcmDspDidDataPos=0, DcmDspDidDataRef=DcmDspData_PlatformSoftwareVersion
          DcmDspDid_PlatformHardwareVersion: DcmDspDidIdentifier=0xF17D, DcmDspDidInfoRef=DcmDspDidInfo_PlatformHardwareVersion
            DcmDspDidSignal_PlatformHardwareVersion (DcmDspDidSignal): DcmDspDidDataPos=0, DcmDspDidDataRef=DcmDspData_PlatformHardwareVersion
          DcmDspDid_NonSleepCollectedEachEcuDataDataIdentifier: DcmDspDidIdentifier=0xED90, DcmDspDidInfoRef=DcmDspDidInfo_NonSleepCollectedEachEcuDataDataIdentifier
            DcmDspDidSignal_NonSleepCollectedEachEcuDataDataIdentifier (DcmDspDidSignal): DcmDspDidDataPos=0, DcmDspDidDataRef=DcmDspData_NonSleepCollectedEachEcuDataDataIdentifier
          DcmDspDid_NML_LogData: DcmDspDidIdentifier=0xEDC0, DcmDspDidInfoRef=DcmDspDidInfo_NML_LogData
            DcmDspDidSignal_NML_LogData_Read (DcmDspDidSignal): DcmDspDidDataPos=0, DcmDspDidDataRef=DcmDspData_NML_LogData
          DcmDspDid_InputOutputControlbyIdentifier_Supportedcheck: DcmDspDidIdentifier=0xF010, DcmDspDidInfoRef=DcmDspDidInfo_InputOutputControlbyIdentifier_Supportedcheck
            DcmDspDidSignal_InputOutputControlbyIdentifier_Supportedcheck (DcmDspDidSignal): DcmDspDidDataPos=0, DcmDspDidDataRef=DcmDspData_InputOutputControlbyIdentifier_Supportedcheck
          DcmDspDid_InputOutputControlbyIdentifier_11: DcmDspDidIdentifier=0xF011, DcmDspDidInfoRef=DcmDspDidInfo_InputOutputControlbyIdentifier_11
            DcmDspDidSignal_InputOutputControlbyIdentifier_11 (DcmDspDidSignal): DcmDspDidDataPos=0, DcmDspDidDataRef=DcmDspData_InputOutputControlbyIdentifier_11
          DcmDspDid_InputOutputControlbyIdentifier_12: DcmDspDidIdentifier=0xF012, DcmDspDidInfoRef=DcmDspDidInfo_InputOutputControlbyIdentifier_12
            DcmDspDidSignal_InputOutputControlbyIdentifier_12 (DcmDspDidSignal): DcmDspDidDataPos=0, DcmDspDidDataRef=DcmDspData_InputOutputControlbyIdentifier_12
          DcmDspDid_InputOutputControlbyIdentifier_13: DcmDspDidIdentifier=0xF013, DcmDspDidInfoRef=DcmDspDidInfo_InputOutputControlbyIdentifier_13
            DcmDspDidSignal_InputOutputControlbyIdentifier_13 (DcmDspDidSignal): DcmDspDidDataPos=0, DcmDspDidDataRef=DcmDspData_InputOutputControlbyIdentifier_13
          DcmDspDid_InputOutputControlbyIdentifier_16: DcmDspDidIdentifier=0xF016, DcmDspDidInfoRef=DcmDspDidInfo_InputOutputControlbyIdentifier_16
            DcmDspDidSignal_InputOutputControlbyIdentifier_16 (DcmDspDidSignal): DcmDspDidDataPos=0, DcmDspDidDataRef=DcmDspData_InputOutputControlbyIdentifier_16
          DcmDspDid_InputOutputControlbyIdentifier_17: DcmDspDidIdentifier=0xF017, DcmDspDidInfoRef=DcmDspDidInfo_InputOutputControlbyIdentifier_16
            DcmDspDidSignal_InputOutputControlbyIdentifier_17 (DcmDspDidSignal): DcmDspDidDataPos=0, DcmDspDidDataRef=DcmDspData_InputOutputControlbyIdentifier_17
          DcmDspDid_InputOutputControlbyIdentifier_18: DcmDspDidIdentifier=0xF018, DcmDspDidInfoRef=DcmDspDidInfo_InputOutputControlbyIdentifier_18
            DcmDspDidSignal_InputOutputControlbyIdentifier_18 (DcmDspDidSignal): DcmDspDidDataPos=0, DcmDspDidDataRef=DcmDspData_InputOutputControlbyIdentifier_18
          DcmDspDid_EcuInfoRead: DcmDspDidIdentifier=0xB0BA, DcmDspDidInfoRef=DcmDspDidInfo_EcuInfoRead
            DcmDspDidSignal_EcuInfoRead (DcmDspDidSignal): DcmDspDidDataPos=0, DcmDspDidDataRef=DcmDspData_EcuInfoRead
          DcmDspDid_EcuInfoWrite: DcmDspDidIdentifier=0x12B0, DcmDspDidInfoRef=DcmDspDidInfo_EcuInfoWrite
            DcmDspDidSignal0 (DcmDspDidSignal): DcmDspDidDataPos=0, DcmDspDidDataRef=DcmDspData_EcuInfoWrite
          DcmDspDid_QRCodeWrite: DcmDspDidIdentifier=0x5152, DcmDspDidInfoRef=DcmDspDidInfo_QRCodeWrite
            DcmDspDidSignal0 (DcmDspDidSignal): DcmDspDidDataPos=0, DcmDspDidDataRef=DcmDspData_QRCodeWrite
          DcmDspDid_ChallengeRequest: DcmDspDidIdentifier=0x4348, DcmDspDidInfoRef=DcmDspDidInfo_ChallengeRequest
            DcmDspDidSignal0 (DcmDspDidSignal): DcmDspDidDataPos=0, DcmDspDidDataRef=DcmDspData_ChallengeRequest
          DcmDspDid_SecureBootEnable: DcmDspDidIdentifier=0x5242, DcmDspDidInfoRef=DcmDspDidInfo_SecureBootEnable
            DcmDspDidSignal_SecureBootEnable (DcmDspDidSignal): DcmDspDidDataPos=0, DcmDspDidDataRef=DcmDspData_SecureBootEnable
        32 x DcmDspDidInfo, all with DcmDspDidDynamicallyDefined=0:
          DcmDspDidInfo_InputOutputRecordLocalIdentifier1
            DcmDspDidAccess
              DcmDspDidRead: DcmDspDidReadSessionRef=DCM_DEFAULT_SESSION, DcmDspDidReadSessionRef=DCM_EXTENDED_DIAGNOSTIC_SESSION
          DcmDspDidInfo_InputOutputRecordLocalIdentifier2
            DcmDspDidAccess
              DcmDspDidRead: DcmDspDidReadSessionRef=DCM_DEFAULT_SESSION, DcmDspDidReadSessionRef=DCM_EXTENDED_DIAGNOSTIC_SESSION
          DcmDspDidInfo_ECUSecurityInformationDataIdentifier
            DcmDspDidAccess
              DcmDspDidRead: DcmDspDidReadSessionRef=DCM_DEFAULT_SESSION, DcmDspDidReadSessionRef=DCM_EXTENDED_DIAGNOSTIC_SESSION
          DcmDspDidInfo_VehicleManufacturerSparePartNumberDataIdentifier
            DcmDspDidAccess
              DcmDspDidRead: DcmDspDidReadSessionRef=DCM_DEFAULT_SESSION, DcmDspDidReadSessionRef=DCM_EXTENDED_DIAGNOSTIC_SESSION
          DcmDspDidInfo_ECUManufacturingDateDataIdentifier
            DcmDspDidAccess
              DcmDspDidRead: DcmDspDidReadSessionRef=DCM_DEFAULT_SESSION, DcmDspDidReadSessionRef=DCM_EXTENDED_DIAGNOSTIC_SESSION
          DcmDspDidInfo_ECUSerialNumberDataIdentifier
            DcmDspDidAccess
              DcmDspDidRead: DcmDspDidReadSessionRef=DCM_DEFAULT_SESSION, DcmDspDidReadSessionRef=DCM_EXTENDED_DIAGNOSTIC_SESSION
          DcmDspDidInfo_SoftwareVersionforHKMCVehiclemanufactureDataIdentifier
            DcmDspDidAccess
              DcmDspDidRead: DcmDspDidReadSessionRef=DCM_DEFAULT_SESSION, DcmDspDidReadSessionRef=DCM_EXTENDED_DIAGNOSTIC_SESSION
          DcmDspDidInfo_ECUSupplierCodeDataIdentifier
            DcmDspDidAccess
              DcmDspDidRead: DcmDspDidReadSessionRef=DCM_DEFAULT_SESSION, DcmDspDidReadSessionRef=DCM_EXTENDED_DIAGNOSTIC_SESSION
          DcmDspDidInfo_ECUSoftwareUNITnumberDataIdentifier
            DcmDspDidAccess
              DcmDspDidRead: DcmDspDidReadSessionRef=DCM_DEFAULT_SESSION, DcmDspDidReadSessionRef=DCM_EXTENDED_DIAGNOSTIC_SESSION
          DcmDspDidInfo_ECUSoftwareUNIT1VersionDataIdentifier
            DcmDspDidAccess
              DcmDspDidRead: DcmDspDidReadSessionRef=DCM_DEFAULT_SESSION, DcmDspDidReadSessionRef=DCM_EXTENDED_DIAGNOSTIC_SESSION
          DcmDspDidInfo_ECUSoftwareUnit1IVDDataIdentifier
            DcmDspDidAccess
              DcmDspDidRead: DcmDspDidReadSessionRef=DCM_DEFAULT_SESSION, DcmDspDidReadSessionRef=DCM_EXTENDED_DIAGNOSTIC_SESSION
          DcmDspDidInfo_VehicleManufacturerECUHardwareNumberDataIdentifier
            DcmDspDidAccess
              DcmDspDidRead: DcmDspDidReadSessionRef=DCM_DEFAULT_SESSION, DcmDspDidReadSessionRef=DCM_EXTENDED_DIAGNOSTIC_SESSION
          DcmDspDidInfo_SystemSupplierECUHardwareVersionNumberDataIdentifier
            DcmDspDidAccess
              DcmDspDidRead: DcmDspDidReadSessionRef=DCM_DEFAULT_SESSION, DcmDspDidReadSessionRef=DCM_EXTENDED_DIAGNOSTIC_SESSION
          DcmDspDidInfo_CANDataBaseVersionNumberDataIdentifier
            DcmDspDidAccess
              DcmDspDidRead: DcmDspDidReadSessionRef=DCM_DEFAULT_SESSION, DcmDspDidReadSessionRef=DCM_EXTENDED_DIAGNOSTIC_SESSION
          DcmDspDidInfo_LocalRXSWINDataIdentifier
            DcmDspDidAccess
              DcmDspDidRead: DcmDspDidReadSessionRef=DCM_DEFAULT_SESSION, DcmDspDidReadSessionRef=DCM_EXTENDED_DIAGNOSTIC_SESSION
          DcmDspDidInfo_InputOutputControlbyIdentifier_Supportedcheck
            DcmDspDidAccess
              DcmDspDidControl:
                DcmDspDidFreezeCurrentState = 1
                DcmDspDidReturnControlToEcu = 0
                DcmDspDidShortTermAdjustment = 0
                DcmDspDidControlSessionRef = DCM_EXTENDED_DIAGNOSTIC_SESSION
              DcmDspDidRead: DcmDspDidReadSessionRef=DCM_EXTENDED_DIAGNOSTIC_SESSION
          DcmDspDidInfo_InputOutputControlbyIdentifier_11
            DcmDspDidAccess
              DcmDspDidControl:
                DcmDspDidFreezeCurrentState = 1
                DcmDspDidReturnControlToEcu = 1
                DcmDspDidShortTermAdjustment = 1
                DcmDspDidControlSessionRef = DCM_EXTENDED_DIAGNOSTIC_SESSION
              DcmDspDidRead: DcmDspDidReadSessionRef=DCM_EXTENDED_DIAGNOSTIC_SESSION
          DcmDspDidInfo_InputOutputControlbyIdentifier_12
            DcmDspDidAccess
              DcmDspDidControl:
                DcmDspDidFreezeCurrentState = 1
                DcmDspDidReturnControlToEcu = 1
                DcmDspDidShortTermAdjustment = 1
                DcmDspDidControlSessionRef = DCM_EXTENDED_DIAGNOSTIC_SESSION
              DcmDspDidRead: DcmDspDidReadSessionRef=DCM_EXTENDED_DIAGNOSTIC_SESSION
          DcmDspDidInfo_InputOutputControlbyIdentifier_13
            DcmDspDidAccess
              DcmDspDidControl:
                DcmDspDidFreezeCurrentState = 1
                DcmDspDidReturnControlToEcu = 1
                DcmDspDidShortTermAdjustment = 1
                DcmDspDidControlSessionRef = DCM_EXTENDED_DIAGNOSTIC_SESSION
              DcmDspDidRead: DcmDspDidReadSessionRef=DCM_EXTENDED_DIAGNOSTIC_SESSION
          DcmDspDidInfo_InputOutputControlbyIdentifier_16
            DcmDspDidAccess
              DcmDspDidControl:
                DcmDspDidFreezeCurrentState = 1
                DcmDspDidReturnControlToEcu = 1
                DcmDspDidShortTermAdjustment = 1
                DcmDspDidControlSessionRef = DCM_EXTENDED_DIAGNOSTIC_SESSION
              DcmDspDidRead: DcmDspDidReadSessionRef=DCM_EXTENDED_DIAGNOSTIC_SESSION
          DcmDspDidInfo_InputOutputControlbyIdentifier_17
            DcmDspDidAccess
              DcmDspDidControl:
                DcmDspDidFreezeCurrentState = 1
                DcmDspDidReturnControlToEcu = 1
                DcmDspDidShortTermAdjustment = 1
                DcmDspDidControlSessionRef = DCM_EXTENDED_DIAGNOSTIC_SESSION
              DcmDspDidRead: DcmDspDidReadSessionRef=DCM_EXTENDED_DIAGNOSTIC_SESSION
          DcmDspDidInfo_InputOutputControlbyIdentifier_18
            DcmDspDidAccess
              DcmDspDidControl:
                DcmDspDidFreezeCurrentState = 1
                DcmDspDidReturnControlToEcu = 1
                DcmDspDidShortTermAdjustment = 1
                DcmDspDidControlSessionRef = DCM_EXTENDED_DIAGNOSTIC_SESSION
              DcmDspDidRead: DcmDspDidReadSessionRef=DCM_EXTENDED_DIAGNOSTIC_SESSION
          DcmDspDidInfo_EcuInfoRead
            DcmDspDidAccess
              DcmDspDidRead
          DcmDspDidInfo_EcuInfoWrite
            DcmDspDidAccess
              DcmDspDidWrite
          DcmDspDidInfo_QRCodeWrite
            DcmDspDidAccess
              DcmDspDidWrite
          DcmDspDidInfo_ChallengeRequest
            DcmDspDidAccess
              DcmDspDidRead
              DcmDspDidWrite
          DcmDspDidInfo_SecureBootEnable
            DcmDspDidAccess
              DcmDspDidRead: DcmDspDidReadSessionRef=DCM_DEFAULT_SESSION, DcmDspDidReadSessionRef=DCM_EXTENDED_DIAGNOSTIC_SESSION
          DcmDspDidInfo_PlatformHardwareVersion
            DcmDspDidAccess
              DcmDspDidRead: DcmDspDidReadSessionRef=DCM_DEFAULT_SESSION, DcmDspDidReadSessionRef=DCM_EXTENDED_DIAGNOSTIC_SESSION
          DcmDspDidInfo_PlatformSoftwareVersion
            DcmDspDidAccess
              DcmDspDidRead: DcmDspDidReadSessionRef=DCM_DEFAULT_SESSION, DcmDspDidReadSessionRef=DCM_EXTENDED_DIAGNOSTIC_SESSION
          DcmDspDidInfo_SystemName
            DcmDspDidAccess
              DcmDspDidRead: DcmDspDidReadSessionRef=DCM_DEFAULT_SESSION, DcmDspDidReadSessionRef=DCM_EXTENDED_DIAGNOSTIC_SESSION
          DcmDspDidInfo_NonSleepCollectedEachEcuDataDataIdentifier
            DcmDspDidAccess
              DcmDspDidRead: DcmDspDidReadSessionRef=DCM_DEFAULT_SESSION, DcmDspDidReadSessionRef=DCM_EXTENDED_DIAGNOSTIC_SESSION
          DcmDspDidInfo_NML_LogData
            DcmDspDidAccess
              DcmDspDidRead
        DcmDspMemory: DcmDspUseMemoryId=0
          3 x DcmDspAddressAndLengthFormatIdentifier:
            ALF_0x14h: DcmDspSupportedAddressAndLengthFormatIdentifier=0x14
            ALF_0x34h: DcmDspSupportedAddressAndLengthFormatIdentifier=0x34
            ALF_0x44h: DcmDspSupportedAddressAndLengthFormatIdentifier=0x44
          MemoryIdInfo (DcmDspMemoryIdInfo)
            RMA_21091968h (DcmDspReadMemoryRangeInfo): DcmDspReadMemoryRangeHigh=0x2109196C, DcmDspReadMemoryRangeLow=0x21091968
            RMA_DataLog (DcmDspReadMemoryRangeInfo): DcmDspReadMemoryRangeHigh=134258771, DcmDspReadMemoryRangeLow=134258768
            WMA_20481309h (DcmDspWriteMemoryRangeInfo): DcmDspWriteMemoryRangeHigh=0x2048130E, DcmDspWriteMemoryRangeLow=0x20481309
            WMA_DataLog (DcmDspWriteMemoryRangeInfo): DcmDspWriteMemoryRangeHigh=134258771, DcmDspWriteMemoryRangeLow=134258768
        8 x DcmDspRoutine, all with DcmDspRequestResultsRoutineSupported=0, DcmDspRoutineUsed=1, DcmDspStopRoutineSupported=0:
          RID_FF01h_CheckProgrammingDependency: DcmDspRoutineFixedLength=0, DcmDspRoutineIdentifier=0xFF01, DcmDspRoutineUsePort=0, DcmDspStartRoutineFnc=Fota_Start_CheckProgrammingDependency, DcmDspRoutineInfoRef=RID_Info_FF01h_CheckProgrammingDependency
          RID_0300h_OTAReady: DcmDspRoutineFixedLength=1, DcmDspRoutineIdentifier=0x0300, DcmDspRoutineUsePort=1, DcmDspStartRoutineFnc=OTAReady_Start, DcmDspRoutineInfoRef=RID_Info_0300h_OTAReady
          RID_0210h_ReadActiveArea: DcmDspRoutineFixedLength=0, DcmDspRoutineIdentifier=0x0210, DcmDspRoutineUsePort=0, DcmDspStartRoutineFnc=Fota_Start_ReadActiveArea, DcmDspRoutineInfoRef=RID_Info_0210h_ReadActiveArea
          RID_0212h_EraseTargetArea: DcmDspRoutineFixedLength=0, DcmDspRoutineIdentifier=0x0212, DcmDspRoutineUsePort=0, DcmDspStartRoutineFnc=Fota_Start_EraseTargetArea, DcmDspRoutineInfoRef=RID_Info_0212h_EraseTargetArea
          RID_0213h_SwapActiveArea: DcmDspRoutineFixedLength=0, DcmDspRoutineIdentifier=0x0213, DcmDspRoutineUsePort=0, DcmDspStartRoutineFnc=Fota_Start_SwapActiveArea, DcmDspRoutineInfoRef=RID_Info_0213h_SwapActiveArea
          RID_FF00h_EraseMemory: DcmDspRoutineFixedLength=0, DcmDspRoutineIdentifier=0xFF00, DcmDspRoutineUsePort=0, DcmDspStartRoutineFnc=Fota_Start_EraseMemory, DcmDspRoutineInfoRef=RID_Info_FF00h_EraseMemory
          RID_0200h_CheckMemory: DcmDspRoutineFixedLength=0, DcmDspRoutineIdentifier=0x0200, DcmDspRoutineUsePort=0, DcmDspStartRoutineFnc=Fota_Start_CheckMemory, DcmDspRoutineInfoRef=RID_Info_0200h_CheckMemory
          RID_0211h_FinishUpdate: DcmDspRoutineFixedLength=0, DcmDspRoutineUsePort=0, DcmDspStartRoutineFnc=Fota_Start_FinishUpdate, DcmDspRoutineIdentifier=0x0211, DcmDspRoutineInfoRef=RID_Info_0211h_FinishUpdate
        8 x DcmDspRoutineInfo:
          RID_Info_FF01h_CheckProgrammingDependency
            DcmDspRoutineAuthorization: DcmDspRoutineSecurityLevelRef=L10, DcmDspRoutineSessionRef=DCM_EXTENDED_DIAGNOSTIC_SESSION, DcmDspRoutineSecurityLevelRef=L9
            DcmDspStartRoutineIn
              In_Block_Area (DcmDspStartRoutineInSignal): DcmDspRoutineStartInEndianness=0, DcmDspRoutineSignalLength=24, DcmDspRoutineSignalPos=0, DcmDspRoutineSignalType=VARIABLE_LENGTH
            DcmDspStartRoutineOut
              Out_MemoryArea (DcmDspStartRoutineOutSignal): DcmDspRoutineStartOutEndianness=0, DcmDspRoutineSignalLength=8, DcmDspRoutineSignalPos=0, DcmDspRoutineSignalType=VARIABLE_LENGTH
          RID_Info_0300h_OTAReady
            DcmDspRoutineAuthorization: DcmDspRoutineSessionRef=DCM_EXTENDED_DIAGNOSTIC_SESSION, DcmDspRoutineSessionRef=DCM_DEFAULT_SESSION
            DcmDspStartRoutineIn
            DcmDspStartRoutineOut
              Out_RoutineStatus (DcmDspStartRoutineOutSignal): DcmDspRoutineSignalLength=8, DcmDspRoutineSignalPos=0, DcmDspRoutineSignalType=UINT8, DcmDspRoutineStartOutEndianness=0
          RID_Info_0210h_ReadActiveArea
            DcmDspRoutineAuthorization: DcmDspRoutineSecurityLevelRef=L10, DcmDspRoutineSessionRef=DCM_EXTENDED_DIAGNOSTIC_SESSION, DcmDspRoutineSecurityLevelRef=L9
            DcmDspStartRoutineIn
              In_SWUnitMemoryArea (DcmDspStartRoutineInSignal): DcmDspRoutineStartInEndianness=0, DcmDspRoutineSignalLength=16, DcmDspRoutineSignalPos=0, DcmDspRoutineSignalType=VARIABLE_LENGTH
            DcmDspStartRoutineOut
              StartOutSignal (DcmDspStartRoutineOutSignal): DcmDspRoutineStartOutEndianness=0, DcmDspRoutineSignalLength=8, DcmDspRoutineSignalPos=0, DcmDspRoutineSignalType=VARIABLE_LENGTH
          RID_Info_0212h_EraseTargetArea
            DcmDspRoutineAuthorization: DcmDspRoutineSecurityLevelRef=L10, DcmDspRoutineSessionRef=DCM_EXTENDED_DIAGNOSTIC_SESSION, DcmDspRoutineSecurityLevelRef=L9
            DcmDspStartRoutineIn
              pRoutineDataIn (DcmDspStartRoutineInSignal): DcmDspRoutineStartInEndianness=0, DcmDspRoutineSignalLength=24, DcmDspRoutineSignalPos=0, DcmDspRoutineSignalType=VARIABLE_LENGTH
            DcmDspStartRoutineOut
              Out_Block_Area (DcmDspStartRoutineOutSignal): DcmDspRoutineStartOutEndianness=0, DcmDspRoutineSignalLength=8, DcmDspRoutineSignalPos=0, DcmDspRoutineSignalType=VARIABLE_LENGTH
          RID_Info_0213h_SwapActiveArea
            DcmDspRoutineAuthorization: DcmDspRoutineSecurityLevelRef=L10, DcmDspRoutineSessionRef=DCM_EXTENDED_DIAGNOSTIC_SESSION, DcmDspRoutineSecurityLevelRef=L9
            DcmDspStartRoutineIn
              pRoutineDataIn (DcmDspStartRoutineInSignal): DcmDspRoutineStartInEndianness=0, DcmDspRoutineSignalLength=24, DcmDspRoutineSignalPos=0, DcmDspRoutineSignalType=VARIABLE_LENGTH
            DcmDspStartRoutineOut
              Out_MemoryArea (DcmDspStartRoutineOutSignal): DcmDspRoutineStartOutEndianness=0, DcmDspRoutineSignalLength=40, DcmDspRoutineSignalType=VARIABLE_LENGTH, DcmDspRoutineSignalPos=0
          RID_Info_FF00h_EraseMemory
            DcmDspRoutineAuthorization: DcmDspRoutineSecurityLevelRef=L9, DcmDspRoutineSessionRef=DCM_EXTENDED_DIAGNOSTIC_SESSION, DcmDspRoutineSecurityLevelRef=L10
            DcmDspStartRoutineIn
              pRoutineDataIn (DcmDspStartRoutineInSignal): DcmDspRoutineStartInEndianness=0, DcmDspRoutineSignalLength=16, DcmDspRoutineSignalPos=0, DcmDspRoutineSignalType=VARIABLE_LENGTH
            DcmDspStartRoutineOut
              Out_Block_Area (DcmDspStartRoutineOutSignal): DcmDspRoutineStartOutEndianness=0, DcmDspRoutineSignalLength=24, DcmDspRoutineSignalPos=0, DcmDspRoutineSignalType=VARIABLE_LENGTH
          RID_Info_0211h_FinishUpdate
            DcmDspRoutineAuthorization
          RID_Info_0200h_CheckMemory
            DcmDspRoutineAuthorization: DcmDspRoutineSecurityLevelRef=L9, DcmDspRoutineSecurityLevelRef=L10, DcmDspRoutineSessionRef=DCM_EXTENDED_DIAGNOSTIC_SESSION
        ES95486_SECURITY (DcmDspSecurity): DcmDspSecurityMaxAttemptCounterReadoutTime=0.01
          L9 (DcmDspSecurityRow):
            DcmDspSecurityDelayTime = 180.0
            DcmDspSecurityDelayTimeOnBoot = 0.0
            DcmDspSecurityKeySize = 8
            DcmDspSecurityLevel = 0x9
            DcmDspSecurityNumAttDelay = 3
            DcmDspSecuritySeedSize = 8
            DcmDspSecurityUsePort = USE_ASYNCH_CLIENT_SERVER
            DcmDspSecurityAttemptCounterEnabled = 0
          L10 (DcmDspSecurityRow):
            DcmDspSecurityDelayTime = 180.0
            DcmDspSecurityDelayTimeOnBoot = 0.0
            DcmDspSecurityKeySize = 256
            DcmDspSecurityLevel = 10
            DcmDspSecurityNumAttDelay = 3
            DcmDspSecuritySeedSize = 8
            DcmDspSecurityUsePort = USE_ASYNCH_CLIENT_SERVER
            DcmDspSecurityAttemptCounterEnabled = 0
        ES95486_SESSION (DcmDspSession)
          7 x DcmDspSessionRow, all with DcmDspSessionP2ServerMax=0.05, DcmDspSessionP2StarServerMax=5.0:
            DCM_DEFAULT_SESSION: DcmDspSessionForBoot=DCM_NO_BOOT, DcmDspSessionLevel=0x01
            DCM_PROGRAMMING_SESSION: DcmDspSessionForBoot=DCM_OEM_BOOT, DcmDspSessionLevel=0x02
            DCM_EXTENDED_DIAGNOSTIC_SESSION: DcmDspSessionForBoot=DCM_NO_BOOT, DcmDspSessionLevel=0x03
            DCM_SAFETY_SYSTEM_DIAGNOSTIC_SESSION: DcmDspSessionForBoot=DCM_NO_BOOT, DcmDspSessionLevel=0x04
            DCM_QUIESCENT_CURRENT_DIAGNOSTIC_MODE: DcmDspSessionForBoot=DCM_NO_BOOT, DcmDspSessionLevel=0x50
            DCM_SLEEP_MODE_START_REQUEST: DcmDspSessionForBoot=DCM_NO_BOOT, DcmDspSessionLevel=0x51
            DCM_ALL_SESSION_LEVEL: DcmDspSessionForBoot=DCM_NO_BOOT, DcmDspSessionLevel=0xFF
      DcmGeneral:
        DcmDevErrorDetect = 1
        DcmRequestManufacturerNotificationEnabled = 0
        DcmRequestSupplierNotificationEnabled = 1
        DcmRespondAllRequest = 1
        DcmTaskTime = 0.01
        DcmVersionInfoApi = 0
        DcmStandardSupport = DCM_ES95486_02_SUPPORT
        DcmHeaderFileInclusion = Fota_Diag.h
        DcmForcedEcuReset = 1
        DemIntegrated = 1
        DcmHeaderFileInclusion = App_Uds.h
        DcmFblUsedType = DCM_AUTOEVER_FBL_USED_RXCONNECTION_ID_UNUSED
        DcmHeaderFileInclusion = Nml_Integration.h
        DcmHeaderFileInclusion = Dcm_Callout_SecureService.h
        DcmNvmIntegrated = 1
      DcmPageBufferCfg: DcmPagedBufferEnabled=0
