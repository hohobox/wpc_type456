AUTOSAR XML (schema 4-0-3)
package /AUTOSAR
  module config Wdg_76_Acw: definition=Wdg, implementation-config-variant=VARIANT-PRE-COMPILE, module-description=BswImplementation_Wdg_76_Acw
    WdgDemEventParameterRefs
    WdgGeneral:
      WdgDevErrorDetect = 1
      WdgDisableAllowed = 1
      WdgIndex = 1
      WdgInitialTimeout = 4.0
      WdgMaxTimeout = 4.2
      WdgRunArea = ROM
      WdgTriggerLocation = (unset)
      WdgVersionInfoApi = 1
      WdgVendorMcalVersion = CYPRESS_Traveo2
    WdgPublishedInformation: WdgTriggerMode=WDG_TOGGLE
    WdgSettingsConfig: WdgDefaultMode=WDGIF_OFF_MODE, WdgDioChannelPrefix=DioConf_DioChannel_, WdgGptChannelPrefix=GptConf_GptChannelConfiguration_
      WdgExternalConfiguration: WdgGptChannelRef=GptChannelConfiguration_WdgExt
        WdgExternalDevice
          WdgDioTrigger: WdgDioTriggerDuty=50, WdgDioTriggerChannelRef=DioChannel_P011_0
      WdgSettingsFast: WdgPeriod=0.02
      WdgSettingsOff
      WdgSettingsSlow: WdgPeriod=0.02
