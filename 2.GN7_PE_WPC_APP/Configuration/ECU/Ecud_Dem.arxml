AUTOSAR XML (schema 4-0-3)
package /AUTOSAR
  module config Dem: implementation-config-variant=VARIANT-PRE-COMPILE, module-description=BswImplementation_Dem
    DemConfigSet
      13 x DemDTCClass:
        UDS_DTC_0xDD01: DemDTCSeverity=DEM_DTC_SEV_IMMEDIATELY, DemImmediateNvStorage=1, DemUdsDTC=0xdd01
        UDS_DTC_0xDD02: DemImmediateNvStorage=1, DemDTCSeverity=DEM_DTC_SEV_IMMEDIATELY, DemUdsDTC=0xdd02
        UDS_DTC_0xDD03: DemImmediateNvStorage=1, DemDTCSeverity=DEM_DTC_SEV_IMMEDIATELY, DemUdsDTC=0xdd03
        UDS_DTC_0xDD04: DemImmediateNvStorage=1, DemDTCFunctionalUnit=0x10, DemDTCSeverity=DEM_DTC_SEV_MAINTENANCE_ONLY, DemUdsDTC=0xdd04
        UDS_DTC_0xDD05: DemDTCSeverity=DEM_DTC_SEV_NO_SEVERITY, DemImmediateNvStorage=1, DemUdsDTC=0xdd05
        UDS_DTC_0xDD06: DemDTCSeverity=DEM_DTC_SEV_NO_SEVERITY, DemImmediateNvStorage=1, DemUdsDTC=0xdd06
        UDS_DTC_0x400F01: DemImmediateNvStorage=1, DemDTCSeverity=DEM_DTC_SEV_IMMEDIATELY, DemUdsDTC=0x400F01
        UDS_DTC_0x800F01: DemImmediateNvStorage=1, DemDTCSeverity=DEM_DTC_SEV_IMMEDIATELY, DemUdsDTC=0x800F01
        DemDTCClass_BCAN_BUSOFF: DemDTCSeverity=DEM_DTC_SEV_IMMEDIATELY, DemImmediateNvStorage=1, DemUdsDTC=0x960300
        DemDTCClass_LCAN_BUSOFF: DemDTCSeverity=DEM_DTC_SEV_IMMEDIATELY, DemImmediateNvStorage=1, DemUdsDTC=0x960F00
        DemDTCClass_ECU_Internal_ERR: DemDTCSeverity=DEM_DTC_SEV_IMMEDIATELY, DemImmediateNvStorage=0, DemUdsDTC=0x962103
        DemDTCClass_Temp_Snsr_Fault: DemDTCSeverity=DEM_DTC_SEV_IMMEDIATELY, DemImmediateNvStorage=0, DemUdsDTC=0x962101
        DemDTCClass_Fan_Fault: DemDTCSeverity=DEM_DTC_SEV_IMMEDIATELY, DemImmediateNvStorage=0, DemUdsDTC=0x962102
      51 x DemEventParameter:
        ADC_E_HARDWARE_ERROR: DemEventId=1, DemEventKind=DEM_EVENT_KIND_BSW, DemMaxNumberFreezeFrameRecords=0
          DemEventClass0 (DemEventClass):
            DemAgingAllowed = 0
            DemConsiderPtoStatus = 0
            DemEventOBDReadinessGroup = DEM_OBD_RDY_NONE
            DemEventPriority = 1
            DemFFPrestorageSupported = 0
            DemOperationCycleRef = DemOperationCycle_PWR
            DemDebounceAlgorithmClass0 (DemDebounceAlgorithmClass)
        CAN_E_HARDWARE_ERROR: DemEventId=2, DemEventKind=DEM_EVENT_KIND_BSW, DemMaxNumberFreezeFrameRecords=0
          DemEventClass0 (DemEventClass):
            DemAgingAllowed = 0
            DemConsiderPtoStatus = 0
            DemEventOBDReadinessGroup = DEM_OBD_RDY_NONE
            DemEventPriority = 1
            DemFFPrestorageSupported = 0
            DemOperationCycleRef = DemOperationCycle_PWR
            DemDebounceAlgorithmClass0 (DemDebounceAlgorithmClass)
        ICU_E_HARDWARE_ERROR: DemEventId=3, DemEventKind=DEM_EVENT_KIND_BSW, DemMaxNumberFreezeFrameRecords=0
          DemEventClass0 (DemEventClass):
            DemAgingAllowed = 0
            DemConsiderPtoStatus = 0
            DemEventOBDReadinessGroup = DEM_OBD_RDY_NONE
            DemEventPriority = 1
            DemFFPrestorageSupported = 0
            DemOperationCycleRef = DemOperationCycle_PWR
            DemDebounceAlgorithmClass0 (DemDebounceAlgorithmClass)
        LIN_E_TIMEOUT: DemEventId=4, DemEventKind=DEM_EVENT_KIND_BSW, DemMaxNumberFreezeFrameRecords=0
          DemEventClass0 (DemEventClass):
            DemAgingAllowed = 0
            DemConsiderPtoStatus = 0
            DemEventOBDReadinessGroup = DEM_OBD_RDY_NONE
            DemEventPriority = 1
            DemFFPrestorageSupported = 0
            DemOperationCycleRef = DemOperationCycle_PWR
            DemDebounceAlgorithmClass0 (DemDebounceAlgorithmClass)
        MCU_E_CLOCK_FAILURE: DemEventId=5, DemEventKind=DEM_EVENT_KIND_BSW, DemMaxNumberFreezeFrameRecords=0
          DemEventClass0 (DemEventClass):
            DemAgingAllowed = 0
            DemConsiderPtoStatus = 0
            DemEventOBDReadinessGroup = DEM_OBD_RDY_NONE
            DemEventPriority = 1
            DemFFPrestorageSupported = 0
            DemOperationCycleRef = DemOperationCycle_PWR
            DemDebounceAlgorithmClass0 (DemDebounceAlgorithmClass)
        MCU_E_RESET_FAILURE: DemEventId=6, DemEventKind=DEM_EVENT_KIND_BSW, DemMaxNumberFreezeFrameRecords=0
          DemEventClass0 (DemEventClass):
            DemAgingAllowed = 0
            DemConsiderPtoStatus = 0
            DemEventOBDReadinessGroup = DEM_OBD_RDY_NONE
            DemEventPriority = 1
            DemFFPrestorageSupported = 0
            DemOperationCycleRef = DemOperationCycle_PWR
            DemDebounceAlgorithmClass0 (DemDebounceAlgorithmClass)
        SPI_E_HARDWARE_ERROR: DemEventId=7, DemEventKind=DEM_EVENT_KIND_BSW, DemMaxNumberFreezeFrameRecords=0
          DemEventClass0 (DemEventClass):
            DemAgingAllowed = 0
            DemConsiderPtoStatus = 0
            DemEventOBDReadinessGroup = DEM_OBD_RDY_NONE
            DemEventPriority = 1
            DemFFPrestorageSupported = 0
            DemOperationCycleRef = DemOperationCycle_PWR
            DemDebounceAlgorithmClass0 (DemDebounceAlgorithmClass)
        WDG_E_DISABLE_REJECTED: DemEventId=8, DemEventKind=DEM_EVENT_KIND_BSW, DemMaxNumberFreezeFrameRecords=0
          DemEventClass0 (DemEventClass):
            DemAgingAllowed = 0
            DemConsiderPtoStatus = 0
            DemEventOBDReadinessGroup = DEM_OBD_RDY_NONE
            DemEventPriority = 1
            DemFFPrestorageSupported = 0
            DemOperationCycleRef = DemOperationCycle_PWR
            DemDebounceAlgorithmClass0 (DemDebounceAlgorithmClass)
        WDG_E_MODE_FAILED: DemEventId=9, DemEventKind=DEM_EVENT_KIND_BSW, DemMaxNumberFreezeFrameRecords=0
          DemEventClass0 (DemEventClass):
            DemAgingAllowed = 0
            DemConsiderPtoStatus = 0
            DemEventOBDReadinessGroup = DEM_OBD_RDY_NONE
            DemEventPriority = 1
            DemFFPrestorageSupported = 0
            DemOperationCycleRef = DemOperationCycle_PWR
            DemDebounceAlgorithmClass0 (DemDebounceAlgorithmClass)
        WDG_E_HW_TIMEOUT: DemEventId=10, DemEventKind=DEM_EVENT_KIND_BSW, DemMaxNumberFreezeFrameRecords=0
          DemEventClass0 (DemEventClass):
            DemAgingAllowed = 0
            DemConsiderPtoStatus = 0
            DemFFPrestorageSupported = 0
            DemEventOBDReadinessGroup = DEM_OBD_RDY_NONE
            DemEventPriority = 1
            DemOperationCycleRef = DemOperationCycle_PWR
            DemDebounceAlgorithmClass0 (DemDebounceAlgorithmClass)
        WDG_E_WDG_STOPPED: DemEventId=11, DemEventKind=DEM_EVENT_KIND_BSW, DemMaxNumberFreezeFrameRecords=0
          DemEventClass0 (DemEventClass):
            DemAgingAllowed = 0
            DemConsiderPtoStatus = 0
            DemFFPrestorageSupported = 0
            DemEventOBDReadinessGroup = DEM_OBD_RDY_NONE
            DemEventPriority = 1
            DemOperationCycleRef = DemOperationCycle_PWR
            DemDebounceAlgorithmClass0 (DemDebounceAlgorithmClass)
        ECUM_E_CONFIGURATION_DATA_INCONSISTENT: DemEventId=12, DemEventKind=DEM_EVENT_KIND_BSW, DemMaxNumberFreezeFrameRecords=0
          DemEventClass0 (DemEventClass):
            DemAgingAllowed = 0
            DemConsiderPtoStatus = 0
            DemEventOBDReadinessGroup = DEM_OBD_RDY_NONE
            DemEventPriority = 1
            DemFFPrestorageSupported = 0
            DemOperationCycleRef = DemOperationCycle_PWR
            DemDebounceAlgorithmClass0 (DemDebounceAlgorithmClass)
        ECUM_E_IMPROPER_CALLER: DemEventId=13, DemEventKind=DEM_EVENT_KIND_BSW, DemMaxNumberFreezeFrameRecords=0
          DemEventClass0 (DemEventClass):
            DemAgingAllowed = 0
            DemConsiderPtoStatus = 0
            DemEventOBDReadinessGroup = DEM_OBD_RDY_NONE
            DemEventPriority = 1
            DemFFPrestorageSupported = 0
            DemOperationCycleRef = DemOperationCycle_PWR
            DemDebounceAlgorithmClass0 (DemDebounceAlgorithmClass)
        ECUM_E_RAM_CHECK_FAILED: DemEventId=14, DemEventKind=DEM_EVENT_KIND_BSW, DemMaxNumberFreezeFrameRecords=0
          DemEventClass0 (DemEventClass):
            DemAgingAllowed = 0
            DemConsiderPtoStatus = 0
            DemEventOBDReadinessGroup = DEM_OBD_RDY_NONE
            DemEventPriority = 1
            DemFFPrestorageSupported = 0
            DemOperationCycleRef = DemOperationCycle_PWR
            DemDebounceAlgorithmClass0 (DemDebounceAlgorithmClass)
        IOHWAB_E_BUSY: DemEventId=15, DemEventKind=DEM_EVENT_KIND_BSW, DemMaxNumberFreezeFrameRecords=0
          DemEventClass:
            DemAgingAllowed = 0
            DemConsiderPtoStatus = 0
            DemEventFailureCycleCounterThreshold = 1
            DemEventOBDReadinessGroup = DEM_OBD_RDY_NONE
            DemEventPriority = 1
            DemFFPrestorageSupported = 0
            DemOperationCycleRef = DemOperationCycle_PWR
            DemDebounceAlgorithmClass
        IOHWAB_E_PROC_FAIL: DemEventId=16, DemEventKind=DEM_EVENT_KIND_BSW, DemMaxNumberFreezeFrameRecords=0
          DemEventClass:
            DemAgingAllowed = 0
            DemConsiderPtoStatus = 0
            DemEventFailureCycleCounterThreshold = 1
            DemEventOBDReadinessGroup = DEM_OBD_RDY_NONE
            DemEventPriority = 1
            DemFFPrestorageSupported = 0
            DemOperationCycleRef = DemOperationCycle_PWR
            DemDebounceAlgorithmClass
        IOHWAB_E_SETUP_FAIL: DemEventId=17, DemEventKind=DEM_EVENT_KIND_BSW, DemMaxNumberFreezeFrameRecords=0
          DemEventClass:
            DemAgingAllowed = 0
            DemConsiderPtoStatus = 0
            DemEventFailureCycleCounterThreshold = 1
            DemEventOBDReadinessGroup = DEM_OBD_RDY_NONE
            DemEventPriority = 1
            DemFFPrestorageSupported = 0
            DemOperationCycleRef = DemOperationCycle_PWR
            DemDebounceAlgorithmClass
        IOHWAB_E_WRONG_PARAM: DemEventId=18, DemEventKind=DEM_EVENT_KIND_BSW, DemMaxNumberFreezeFrameRecords=0
          DemEventClass:
            DemAgingAllowed = 0
            DemConsiderPtoStatus = 0
            DemEventFailureCycleCounterThreshold = 1
            DemEventOBDReadinessGroup = DEM_OBD_RDY_NONE
            DemEventPriority = 1
            DemFFPrestorageSupported = 0
            DemOperationCycleRef = DemOperationCycle_PWR
            DemDebounceAlgorithmClass
        IOHWAB_E_WRONG_SETTING: DemEventId=19, DemEventKind=DEM_EVENT_KIND_BSW, DemMaxNumberFreezeFrameRecords=0
          DemEventClass:
            DemAgingAllowed = 0
            DemConsiderPtoStatus = 0
            DemEventFailureCycleCounterThreshold = 1
            DemEventOBDReadinessGroup = DEM_OBD_RDY_NONE
            DemEventPriority = 1
            DemFFPrestorageSupported = 0
            DemOperationCycleRef = DemOperationCycle_PWR
            DemDebounceAlgorithmClass
        IOHWAB_E_WRONG_STATE: DemEventId=20, DemEventKind=DEM_EVENT_KIND_BSW, DemMaxNumberFreezeFrameRecords=0
          DemEventClass:
            DemAgingAllowed = 0
            DemConsiderPtoStatus = 0
            DemEventFailureCycleCounterThreshold = 1
            DemEventOBDReadinessGroup = DEM_OBD_RDY_NONE
            DemEventPriority = 1
            DemFFPrestorageSupported = 0
            DemOperationCycleRef = DemOperationCycle_PWR
            DemDebounceAlgorithmClass
        NVM_E_INTEGRITY_FAILED: DemEventId=21, DemEventKind=DEM_EVENT_KIND_BSW, DemMaxNumberFreezeFrameRecords=0
          DemEventClass0 (DemEventClass):
            DemAgingAllowed = 0
            DemConsiderPtoStatus = 0
            DemEventOBDReadinessGroup = DEM_OBD_RDY_NONE
            DemEventPriority = 1
            DemFFPrestorageSupported = 0
            DemOperationCycleRef = DemOperationCycle_PWR
            DemDebounceAlgorithmClass0 (DemDebounceAlgorithmClass)
        NVM_E_LOSS_OF_REDUNDANCY: DemEventId=22, DemEventKind=DEM_EVENT_KIND_BSW, DemMaxNumberFreezeFrameRecords=0
          DemEventClass0 (DemEventClass):
            DemAgingAllowed = 0
            DemConsiderPtoStatus = 0
            DemEventOBDReadinessGroup = DEM_OBD_RDY_NONE
            DemEventPriority = 1
            DemFFPrestorageSupported = 0
            DemOperationCycleRef = DemOperationCycle_PWR
            DemDebounceAlgorithmClass0 (DemDebounceAlgorithmClass)
        NVM_E_QUEUE_OVERFLOW: DemEventId=23, DemEventKind=DEM_EVENT_KIND_BSW, DemMaxNumberFreezeFrameRecords=0
          DemEventClass0 (DemEventClass):
            DemAgingAllowed = 0
            DemConsiderPtoStatus = 0
            DemEventOBDReadinessGroup = DEM_OBD_RDY_NONE
            DemEventPriority = 1
            DemFFPrestorageSupported = 0
            DemOperationCycleRef = DemOperationCycle_PWR
            DemDebounceAlgorithmClass0 (DemDebounceAlgorithmClass)
        NVM_E_REQ_FAILED: DemEventId=24, DemEventKind=DEM_EVENT_KIND_BSW, DemMaxNumberFreezeFrameRecords=0
          DemEventClass0 (DemEventClass):
            DemAgingAllowed = 0
            DemConsiderPtoStatus = 0
            DemEventOBDReadinessGroup = DEM_OBD_RDY_NONE
            DemEventPriority = 1
            DemFFPrestorageSupported = 0
            DemOperationCycleRef = DemOperationCycle_PWR
            DemDebounceAlgorithmClass0 (DemDebounceAlgorithmClass)
        NVM_E_VERIFY_FAILED: DemEventId=25, DemEventKind=DEM_EVENT_KIND_BSW, DemMaxNumberFreezeFrameRecords=0
          DemEventClass0 (DemEventClass):
            DemAgingAllowed = 0
            DemConsiderPtoStatus = 0
            DemEventOBDReadinessGroup = DEM_OBD_RDY_NONE
            DemEventPriority = 1
            DemFFPrestorageSupported = 0
            DemOperationCycleRef = DemOperationCycle_PWR
            DemDebounceAlgorithmClass0 (DemDebounceAlgorithmClass)
        NVM_E_WRITE_PROTECTED: DemEventId=26, DemEventKind=DEM_EVENT_KIND_BSW, DemMaxNumberFreezeFrameRecords=0
          DemEventClass0 (DemEventClass):
            DemAgingAllowed = 0
            DemConsiderPtoStatus = 0
            DemEventOBDReadinessGroup = DEM_OBD_RDY_NONE
            DemEventPriority = 1
            DemFFPrestorageSupported = 0
            DemOperationCycleRef = DemOperationCycle_PWR
            DemDebounceAlgorithmClass0 (DemDebounceAlgorithmClass)
        NVM_E_WRONG_BLOCK_ID: DemEventId=27, DemEventKind=DEM_EVENT_KIND_BSW, DemMaxNumberFreezeFrameRecords=0
          DemEventClass0 (DemEventClass):
            DemAgingAllowed = 0
            DemConsiderPtoStatus = 0
            DemEventOBDReadinessGroup = DEM_OBD_RDY_NONE
            DemEventPriority = 1
            DemFFPrestorageSupported = 0
            DemOperationCycleRef = DemOperationCycle_PWR
            DemDebounceAlgorithmClass0 (DemDebounceAlgorithmClass)
        RAMTST_E_RAM_FAILURE: DemEventId=28, DemEventKind=DEM_EVENT_KIND_BSW, DemMaxNumberFreezeFrameRecords=0
          DemEventClass:
            DemAgingAllowed = 0
            DemConsiderPtoStatus = 0
            DemEventOBDReadinessGroup = DEM_OBD_RDY_NONE
            DemEventPriority = 1
            DemFFPrestorageSupported = 0
            DemOperationCycleRef = DemOperationCycle_PWR
        WDG_76_ACW_E_DISABLE_REJECTED: DemEventKind=DEM_EVENT_KIND_BSW, DemMaxNumberFreezeFrameRecords=0, DemEventId=29
          DemEventClass:
            DemAgingAllowed = 0
            DemConsiderPtoStatus = 0
            DemFFPrestorageSupported = 0
            DemEventOBDReadinessGroup = DEM_OBD_RDY_NONE
            DemEventPriority = 1
            DemOperationCycleRef = DemOperationCycle_PWR
        WDG_76_ACW_E_MODE_FAILED: DemEventKind=DEM_EVENT_KIND_BSW, DemMaxNumberFreezeFrameRecords=0, DemEventId=30
          DemEventClass:
            DemAgingAllowed = 0
            DemConsiderPtoStatus = 0
            DemFFPrestorageSupported = 0
            DemEventOBDReadinessGroup = DEM_OBD_RDY_NONE
            DemEventPriority = 1
            DemOperationCycleRef = DemOperationCycle_PWR
        WDGM_E_IMPROPER_CALLER: DemEventId=31, DemEventKind=DEM_EVENT_KIND_BSW, DemMaxNumberFreezeFrameRecords=0
          DemEventClass0 (DemEventClass):
            DemAgingAllowed = 0
            DemConsiderPtoStatus = 0
            DemEventOBDReadinessGroup = DEM_OBD_RDY_NONE
            DemEventPriority = 1
            DemFFPrestorageSupported = 0
            DemOperationCycleRef = DemOperationCycle_PWR
            DemDebounceAlgorithmClass0 (DemDebounceAlgorithmClass)
        WDGM_E_MONITORING: DemEventId=32, DemEventKind=DEM_EVENT_KIND_BSW, DemMaxNumberFreezeFrameRecords=0
          DemEventClass0 (DemEventClass):
            DemAgingAllowed = 0
            DemConsiderPtoStatus = 0
            DemEventOBDReadinessGroup = DEM_OBD_RDY_NONE
            DemEventPriority = 1
            DemFFPrestorageSupported = 0
            DemOperationCycleRef = DemOperationCycle_PWR
            DemDebounceAlgorithmClass0 (DemDebounceAlgorithmClass)
        WDGM_E_SET_MODE: DemEventId=33, DemEventKind=DEM_EVENT_KIND_BSW, DemMaxNumberFreezeFrameRecords=0
          DemEventClass0 (DemEventClass):
            DemAgingAllowed = 0
            DemConsiderPtoStatus = 0
            DemEventOBDReadinessGroup = DEM_OBD_RDY_NONE
            DemEventPriority = 1
            DemFFPrestorageSupported = 0
            DemOperationCycleRef = DemOperationCycle_PWR
            DemDebounceAlgorithmClass0 (DemDebounceAlgorithmClass)
        EEP_E_COMPARE_FAILED: DemEventId=34, DemEventKind=DEM_EVENT_KIND_BSW, DemMaxNumberFreezeFrameRecords=0
          DemEventClass:
            DemAgingAllowed = 0
            DemConsiderPtoStatus = 0
            DemFFPrestorageSupported = 0
            DemEventOBDReadinessGroup = DEM_OBD_RDY_NONE
            DemEventPriority = 1
            DemOperationCycleRef = DemOperationCycle_PWR
        EEP_E_ERASE_FAILED: DemEventId=35, DemEventKind=DEM_EVENT_KIND_BSW, DemMaxNumberFreezeFrameRecords=0
          DemEventClass:
            DemAgingAllowed = 0
            DemConsiderPtoStatus = 0
            DemFFPrestorageSupported = 0
            DemEventOBDReadinessGroup = DEM_OBD_RDY_NONE
            DemEventPriority = 1
            DemOperationCycleRef = DemOperationCycle_PWR
        EEP_E_READ_FAILED: DemEventId=36, DemEventKind=DEM_EVENT_KIND_BSW, DemMaxNumberFreezeFrameRecords=0
          DemEventClass:
            DemAgingAllowed = 0
            DemConsiderPtoStatus = 0
            DemFFPrestorageSupported = 0
            DemEventOBDReadinessGroup = DEM_OBD_RDY_NONE
            DemEventPriority = 1
            DemOperationCycleRef = DemOperationCycle_PWR
        EEP_E_WRITE_FAILED: DemEventId=37, DemEventKind=DEM_EVENT_KIND_BSW, DemMaxNumberFreezeFrameRecords=0
          DemEventClass:
            DemAgingAllowed = 0
            DemConsiderPtoStatus = 0
            DemFFPrestorageSupported = 0
            DemEventOBDReadinessGroup = DEM_OBD_RDY_NONE
            DemEventPriority = 1
            DemOperationCycleRef = DemOperationCycle_PWR
        CANSM_E_BUS_OFF_BCAN: DemEventId=38, DemEventKind=DEM_EVENT_KIND_BSW, DemEventStatusBitStorageTestFailed=1, DemMaxNumberFreezeFrameRecords=2, DemDTCClassRef=DemDTCClass_BCAN_BUSOFF
          DemEventClass0 (DemEventClass):
            DemAgingAllowed = 1
            DemAgingCycleCounterThreshold = 29
            DemConsiderPtoStatus = 0
            DemEventDestination = DEM_DTC_ORIGIN_PRIMARY_MEMORY
            DemEventFailureCycleCounterThreshold = 1
            DemEventOBDReadinessGroup = DEM_OBD_RDY_NONE
            DemEventPriority = 8
            DemEventSignificance = DEM_EVENT_SIGNIFICANCE_FAULT
            DemFFPrestorageSupported = 0
            DemOperationCycleRef = DemOperationCycle_IGN
            DemAgingCycleRef = DemOperationCycle_IGN
        CANSM_E_BUS_OFF_LCAN: DemEventId=39, DemEventKind=DEM_EVENT_KIND_BSW, DemEventStatusBitStorageTestFailed=1, DemMaxNumberFreezeFrameRecords=2, DemDTCClassRef=DemDTCClass_LCAN_BUSOFF
          DemEventClass0 (DemEventClass):
            DemAgingAllowed = 1
            DemAgingCycleCounterThreshold = 29
            DemConsiderPtoStatus = 0
            DemEventDestination = DEM_DTC_ORIGIN_PRIMARY_MEMORY
            DemEventFailureCycleCounterThreshold = 1
            DemEventOBDReadinessGroup = DEM_OBD_RDY_NONE
            DemEventPriority = 8
            DemEventSignificance = DEM_EVENT_SIGNIFICANCE_FAULT
            DemFFPrestorageSupported = 0
            DemOperationCycleRef = DemOperationCycle_IGN
            DemAgingCycleRef = DemOperationCycle_IGN
        CANSM_E_MODE_CHANGE_BCAN: DemEventId=40, DemEventKind=DEM_EVENT_KIND_BSW, DemMaxNumberFreezeFrameRecords=0
          DemCallbackEventStatusChanged0 (DemCallbackEventStatusChanged)
          DemEventClass:
            DemAgingAllowed = 0
            DemConsiderPtoStatus = 0
            DemFFPrestorageSupported = 0
            DemEventOBDReadinessGroup = DEM_OBD_RDY_NONE
            DemEventPriority = 1
            DemOperationCycleRef = DemOperationCycle_PWR
        CANSM_E_MODE_CHANGE_LCAN: DemEventId=41, DemEventKind=DEM_EVENT_KIND_BSW, DemMaxNumberFreezeFrameRecords=0
          DemCallbackEventStatusChanged0 (DemCallbackEventStatusChanged)
          DemEventClass:
            DemAgingAllowed = 0
            DemConsiderPtoStatus = 0
            DemFFPrestorageSupported = 0
            DemEventOBDReadinessGroup = DEM_OBD_RDY_NONE
            DemEventPriority = 1
            DemOperationCycleRef = DemOperationCycle_PWR
        CANCM_E_BAT_FAIL: DemEventId=42, DemEventKind=DEM_EVENT_KIND_BSW, DemMaxNumberFreezeFrameRecords=0
          DemEventClass0 (DemEventClass):
            DemAgingAllowed = 1
            DemAgingCycleCounterThreshold = 3
            DemConsiderPtoStatus = 0
            DemEventDestination = DEM_DTC_ORIGIN_PRIMARY_MEMORY
            DemEventFailureCycleCounterThreshold = 1
            DemEventOBDReadinessGroup = DEM_OBD_RDY_NONE
            DemEventPriority = 8
            DemEventSignificance = DEM_EVENT_SIGNIFICANCE_FAULT
            DemFFPrestorageSupported = 0
            DemOperationCycleRef = DemOperationCycle_PWR
            DemAgingCycleRef = DemOperationCycle_PWR
        DEM_E_TEST_EVENT1: DemEventId=43, DemEventKind=DEM_EVENT_KIND_SWC, DemMaxNumberFreezeFrameRecords=1, DemDTCClassRef=UDS_DTC_0xDD01, DemFreezeFrameClassRef=DemFreezeFrameClass0
          DemCallbackEventStatusChanged0 (DemCallbackEventStatusChanged)
          DemCallbackInitMForE_0 (DemCallbackInitMForE)
          DemEventClass0 (DemEventClass):
            DemAgingAllowed = 1
            DemAgingCycleCounterThreshold = 3
            DemConsiderPtoStatus = 0
            DemEventDestination = DEM_DTC_ORIGIN_PRIMARY_MEMORY
            DemEventFailureCycleCounterThreshold = 1
            DemEventOBDReadinessGroup = DEM_OBD_RDY_NONE
            DemEventPriority = 2
            DemFFPrestorageSupported = 0
            DemOperationCycleRef = DemOperationCycle_PWR
            DemAgingCycleRef = DemOperationCycle_PWR
            DemStorageConditionGroupRef = DemStorageConditionGroup0
            DemDebounceAlgorithmClass0 (DemDebounceAlgorithmClass)
        DEM_E_TEST_EVENT2: DemEventId=44, DemEventKind=DEM_EVENT_KIND_SWC, DemMaxNumberFreezeFrameRecords=2, DemDTCClassRef=UDS_DTC_0xDD02, DemFreezeFrameClassRef=DemFreezeFrameClass1
          DemEventClass0 (DemEventClass):
            DemAgingAllowed = 1
            DemAgingCycleCounterThreshold = 3
            DemConsiderPtoStatus = 0
            DemEventDestination = DEM_DTC_ORIGIN_PRIMARY_MEMORY
            DemEventOBDReadinessGroup = DEM_OBD_RDY_NONE
            DemEventPriority = 2
            DemFFPrestorageSupported = 0
            DemOperationCycleRef = DemOperationCycle_PWR
            DemAgingCycleRef = DemOperationCycle_PWR
            DemDebounceAlgorithmClass0 (DemDebounceAlgorithmClass)
              DemDebounceTimeBase: DemDebounceTimePassedThreshold=0.01, DemDebounceTimeFailedThreshold=0.01
        DEM_E_TEST_EVENT3: DemEventId=45, DemEventKind=DEM_EVENT_KIND_SWC, DemMaxNumberFreezeFrameRecords=0, DemDTCClassRef=UDS_DTC_0xDD03
          DemEventClass0 (DemEventClass):
            DemAgingAllowed = 1
            DemAgingCycleCounterThreshold = 3
            DemConsiderPtoStatus = 0
            DemEventDestination = DEM_DTC_ORIGIN_PRIMARY_MEMORY
            DemEventFailureCycleCounterThreshold = 1
            DemEventOBDReadinessGroup = DEM_OBD_RDY_NONE
            DemEventPriority = 3
            DemFFPrestorageSupported = 0
            DemOperationCycleRef = DemOperationCycle_PWR
            DemAgingCycleRef = DemOperationCycle_PWR
            DemDebounceAlgorithmClass0 (DemDebounceAlgorithmClass)
        DEM_E_TEST_EVENT4: DemEventId=46, DemEventKind=DEM_EVENT_KIND_SWC, DemMaxNumberFreezeFrameRecords=0, DemDTCClassRef=UDS_DTC_0xDD04
          DemEventClass0 (DemEventClass):
            DemAgingAllowed = 1
            DemAgingCycleCounterThreshold = 3
            DemConsiderPtoStatus = 0
            DemEventDestination = DEM_DTC_ORIGIN_PRIMARY_MEMORY
            DemEventFailureCycleCounterThreshold = 1
            DemEventOBDReadinessGroup = DEM_OBD_RDY_NONE
            DemEventPriority = 4
            DemFFPrestorageSupported = 0
            DemOperationCycleRef = DemOperationCycle_PWR
            DemAgingCycleRef = DemOperationCycle_PWR
            DemDebounceAlgorithmClass0 (DemDebounceAlgorithmClass)
        DEM_E_TEST_EVENT5: DemEventId=47, DemEventKind=DEM_EVENT_KIND_SWC, DemMaxNumberFreezeFrameRecords=0, DemDTCClassRef=UDS_DTC_0x400F01
          DemEventClass0 (DemEventClass):
            DemAgingAllowed = 1
            DemAgingCycleCounterThreshold = 3
            DemConsiderPtoStatus = 0
            DemEventDestination = DEM_DTC_ORIGIN_PRIMARY_MEMORY
            DemEventFailureCycleCounterThreshold = 1
            DemEventOBDReadinessGroup = DEM_OBD_RDY_NONE
            DemEventPriority = 4
            DemFFPrestorageSupported = 0
            DemOperationCycleRef = DemOperationCycle_PWR
            DemAgingCycleRef = DemOperationCycle_PWR
            DemDebounceAlgorithmClass0 (DemDebounceAlgorithmClass)
        DEM_E_TEST_EVENT6: DemEventId=48, DemEventKind=DEM_EVENT_KIND_SWC, DemMaxNumberFreezeFrameRecords=0, DemDTCClassRef=UDS_DTC_0x800F01
          DemEventClass0 (DemEventClass):
            DemAgingAllowed = 1
            DemAgingCycleCounterThreshold = 1
            DemConsiderPtoStatus = 0
            DemEventDestination = DEM_DTC_ORIGIN_PRIMARY_MEMORY
            DemEventFailureCycleCounterThreshold = 1
            DemEventOBDReadinessGroup = DEM_OBD_RDY_NONE
            DemEventPriority = 4
            DemFFPrestorageSupported = 0
            DemOperationCycleRef = DemOperationCycle_PWR
            DemAgingCycleRef = DemOperationCycle_PWR
            DemDebounceAlgorithmClass0 (DemDebounceAlgorithmClass)
        DemEventParameter_ECU_Internal_ERR: DemEventId=49, DemEventKind=DEM_EVENT_KIND_SWC, DemEventStatusBitStorageTestFailed=1, DemMaxNumberFreezeFrameRecords=2, DemDTCClassRef=DemDTCClass_ECU_Internal_ERR
          DemCallbackInitMForE
          DemEventClass:
            DemAgingAllowed = 1
            DemConsiderPtoStatus = 0
            DemEventDestination = DEM_DTC_ORIGIN_PRIMARY_MEMORY
            DemEventOBDReadinessGroup = DEM_OBD_RDY_NONE
            DemEventPriority = 2
            DemFFPrestorageSupported = 0
            DemAgingCycleRef = DemOperationCycle_PWR
            DemOperationCycleRef = DemOperationCycle_PWR
            DemDebounceAlgorithmClass
              DemDebounceTimeBase: DemDebounceTimeFailedThreshold=0.01, DemDebounceTimePassedThreshold=0.01
            DemIndicatorAttribute0 (DemIndicatorAttribute):
              DemIndicatorBehaviour = DEM_INDICATOR_BLINKING
              DemIndicatorFailureCycleCounterThreshold = 0
              DemIndicatorHealingCycleCounterThreshold = 0
              DemIndicatorRef = DemIndicator_ECU_Internal_ERR
        DemEventParameter_Temp_Snsr_Fault: DemEventId=50, DemEventKind=DEM_EVENT_KIND_SWC, DemEventStatusBitStorageTestFailed=1, DemMaxNumberFreezeFrameRecords=2, DemDTCClassRef=DemDTCClass_Temp_Snsr_Fault
          DemCallbackInitMForE
          DemEventClass:
            DemAgingAllowed = 1
            DemConsiderPtoStatus = 0
            DemEventDestination = DEM_DTC_ORIGIN_PRIMARY_MEMORY
            DemEventOBDReadinessGroup = DEM_OBD_RDY_NONE
            DemEventPriority = 2
            DemFFPrestorageSupported = 0
            DemAgingCycleRef = DemOperationCycle_PWR
            DemOperationCycleRef = DemOperationCycle_PWR
            DemDebounceAlgorithmClass
              DemDebounceTimeBase: DemDebounceTimeFailedThreshold=0.01, DemDebounceTimePassedThreshold=0.01
            DemIndicatorAttribute0 (DemIndicatorAttribute):
              DemIndicatorBehaviour = DEM_INDICATOR_BLINKING
              DemIndicatorFailureCycleCounterThreshold = 0
              DemIndicatorHealingCycleCounterThreshold = 0
              DemIndicatorRef = DemIndicator_Temp_Snsr_Fault
        DemEventParameter_Fan_Fault: DemEventId=51, DemEventKind=DEM_EVENT_KIND_SWC, DemEventStatusBitStorageTestFailed=1, DemMaxNumberFreezeFrameRecords=2, DemDTCClassRef=DemDTCClass_Fan_Fault
          DemCallbackInitMForE
          DemEventClass:
            DemAgingAllowed = 1
            DemConsiderPtoStatus = 0
            DemEventDestination = DEM_DTC_ORIGIN_PRIMARY_MEMORY
            DemEventOBDReadinessGroup = DEM_OBD_RDY_NONE
            DemEventPriority = 2
            DemFFPrestorageSupported = 0
            DemAgingCycleRef = DemOperationCycle_PWR
            DemOperationCycleRef = DemOperationCycle_PWR
            DemDebounceAlgorithmClass
              DemDebounceTimeBase: DemDebounceTimeFailedThreshold=0.01, DemDebounceTimePassedThreshold=0.01
            DemIndicatorAttribute0 (DemIndicatorAttribute):
              DemIndicatorBehaviour = DEM_INDICATOR_BLINKING
              DemIndicatorFailureCycleCounterThreshold = 0
              DemIndicatorHealingCycleCounterThreshold = 0
              DemIndicatorRef = DemIndicator_Fan_Fault
    DemGeneral:
      DemAgingCycleCounterProcessing = DEM_PROCESS_AGINGCTR_INTERN
      DemBswErrorBufferSize = 25
      DemClearDTCBehavior = DEM_CLRRESP_NONVOLATILE_TRIGGER
      DemDTCSuppressionSupport = 0
      DemDebounceCounterBasedSupport = 0
      DemDebounceTimeBasedSupport = 1
      DemDevErrorDetect = 1
      DemDtcStatusAvailabilityMask = 0x09
      DemEventCombinationSupport = DEM_EVCOMB_DISABLED
      DemEventDisplacementSupport = 0
      DemMaxNumberEventEntryMirror = 0
      DemMaxNumberEventEntryPermanent = 0
      DemMaxNumberEventEntryPrimary = 5
      DemMaxNumberEventEntrySecondary = 0
      DemMaxNumberPrestoredFF = 0
      DemOBDSupport = DEM_OBD_NO_OBD_SUPPORT
      DemOccurrenceCounterProcessing = DEM_PROCESS_OCCCTR_TF
      DemOperationCycleStatusStorage = 0
      DemPTOSupport = 0
      DemStatusBitHandlingTestFailedSinceLastClear = DEM_STATUS_BIT_NORMAL
      DemStatusBitStorageTestFailed = 0
      DemTaskTime = 0.01
      DemTriggerDcmReports = 0
      DemTriggerDltReports = 0
      DemTriggerFiMReports = 0
      DemTriggerMonitorInitBeforeClearOk = 0
      DemTypeOfDTCSupported = DEM_DTC_TRANSLATION_ISO15031_6
      DemTypeOfFreezeFrameRecordNumeration = DEM_FF_RECNUM_CALCULATED
      DemVersionInfoApi = 0
      DemAgingRequieresTestedCycle = 0
      DemHealingRequieresTestedCycle = 1
      DemNvRamBlockAccessOptimizationSupport = 1
      DemFimIntegrated = 0
      DemEnableConditionSupport = 0
      DemStorageConditionSupport = 1
      DemImmediateNvStorageLimit = 5
      DemFreezeFrameCapture = DEM_TRIGGER_TESTFAILED
      DemEventClearSupport = 0
      4 x DemDataElementClass:
        DE_0001
          DemExternalCSDataElementClass_0 (DemExternalCSDataElementClass): DemDataElementDataSize=3, DemDataElementUsePort=1, DemDataElementReadFnc=Rte_Call_DataServices_DE_0001_ReadData
        DE_0002
          DemExternalCSDataElementClass_0 (DemExternalCSDataElementClass): DemDataElementDataSize=3, DemDataElementUsePort=1, DemDataElementReadFnc=Rte_Call_DataServices_DE_0002_ReadData
        AgingCounter
          DemInternalDataElementClass: DemDataElementDataSize=1, DemInternalDataElement=DEM_AGINGCTR
        OccurrenceCounter
          DemInternalDataElementClass: DemDataElementDataSize=1, DemInternalDataElement=DEM_OCCCTR
      DemDidClass0 (DemDidClass): DemDidIdentifier=0x4710, DemDidDataElementClassRef=DE_0001/DemExternalCSDataElementClass_0
      DemDidClass1 (DemDidClass): DemDidIdentifier=0x4711, DemDidDataElementClassRef=DE_0002/DemExternalCSDataElementClass_0
      DemFreezeFrameClass0 (DemFreezeFrameClass): DemDidClassRef=DemDidClass0
      DemFreezeFrameClass1 (DemFreezeFrameClass): DemDidClassRef=DemDidClass1
      4 x DemGroupOfDTC:
        DEM_DTC_GROUP_POWERTRAIN_DTCS: DemGroupDTCs=0xff
        DEM_DTC_GROUP_CHASSIS_DTCS: DemGroupDTCs=0x4000ff
        DEM_DTC_GROUP_BODY_DTCS: DemGroupDTCs=0x8000ff
        DEM_DTC_GROUP_NETWORK_COM_DTCS: DemGroupDTCs=0xc000ff
      5 x DemIndicator:
        DemIndicator_BCAN_BUSOFF: DemIndicatorID=0
        DemIndicator_LCAN_BUSOFF: DemIndicatorID=1
        DemIndicator_ECU_Internal_ERR: DemIndicatorID=2
        DemIndicator_Temp_Snsr_Fault: DemIndicatorID=3
        DemIndicator_Fan_Fault: DemIndicatorID=4
      DemNvRamBlockId
        DemEventStatusNvRamBlock: DemEventStatusNvRamBlockIdRef=NvMBlock_EventStatusNvRamBlock
        DemManagementBlock: DemManagementBlockNvBlockIdRef=NvMBlock_ManagementBlock
        5 x DemPrimaryEventMemory:
          DemPrimaryEventMemory{0..4}: DemPrimaryEventMemoryNvBlockIdRef=NvMBlock_PrimaryEventMemory{0..4}
      DemOperationCycle_PWR (DemOperationCycle): DemOperationCycleType=DEM_OPCYC_POWER
      DemOperationCycle_IGN (DemOperationCycle): DemOperationCycleType=DEM_OPCYC_IGNITION
      DemStorageCondition: DemStorageConditionStatus=1, DemStorageConditionId=0
      DemStorageConditionGroup0 (DemStorageConditionGroup): DemStorageConditionRef=DemStorageCondition
