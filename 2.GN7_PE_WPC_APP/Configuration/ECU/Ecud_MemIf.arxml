AUTOSAR XML (schema 4-0-3)
package /AUTOSAR
  module config MemIf: implementation-config-variant=VARIANT-PRE-COMPILE, module-description=BswImplementation_MemIf
    MemIfGeneral: MemIfDevErrorDetect=1, MemIfNumberOfDevices=1, MemIfVersionInfoApi=1
