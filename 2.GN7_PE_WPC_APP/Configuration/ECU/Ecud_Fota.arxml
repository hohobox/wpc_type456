AUTOSAR XML (schema 00047)
package /EcucModules
  module config Fota: implementation-config-variant=VARIANT-PRE-COMPILE, module-description=BswImplementation_Fota, post-build-variant-used=false
    FotaGeneral:
      FotaDevErrorDetect = 1
      FotaLargeSector = 0
      FotaDownGradeProtection = 1
      FotaARMArchitectureEcu = 1
      FotaVersionInfoAPI = 0
      FotaMainfunctionPeriod = 0.005
      FotaStandardSupport = FOTA_OTA_ES98765_02
      FotaTpBlockLength = 2050
      FotaStartUpCommandValue = 0xA5430911
      FotaCpdKeyValue = 0x19801217
      FotaPartitionFlagSecurityValue = 0x90482442
      FotaVersionLengthMaximum = 0x7F
      FotaMode = APP_MODE
      FotaBootManagerEnable = 0
      FotaCommonRAMAddress = 0x0800A010
      FotaStartUpCommandAddress = 0x0800A000
      FotaMcuMemoryAccessType = FOTA_MMU_TYPE
      FotaSoftwareVersionCheckEnable = 0
    FotaSwUnit_RTSW (FotaSwUnit): FotaSoftwareType=FOTA_RTSW_TYPE, FotaEcuSwUnit=0xF1B1, FotaSwUnitIndex=0, FotaMemDriverRef=MemInstance0
      FotaBlockInfo: ModuleInfoAddress=0x10058800
        5 x FotaBlock:
          FotaBlock0_Meta: BlockType=METADATA, BlockIndex=0, BlockStartAddress=0x1000, BlockEndAddress=0x1047
            MetaDataInfo:
              MetadataWriteToFlash = 0
              MdBlockHeaderLength = 8
              MdBlockMetadataLength = 48
              MdBlockDecKeyMACLength = 16
              CsmMetadataHashJob = Hash_Sha256_Fota
              CsmKeyForKeyDerivationPassword = PBKDF2_Key
              CsmKeyForKeyDerivationResult = PBKDF2_TargetKey
              CsmDecryptKey = Fota_Decrypt0Key
              CsmDecryptKeyVerifyJob = Fota_Decrypt0
          FotaBlock0_Fw0: BlockType=FIRMWARE, BlockIndex=1, BlockStartAddress=0x10058000, BlockEndAddress=0x100588FF
            BlockProcessing: IsEncrypted=1
          FotaBlock0_Fw1: BlockType=FIRMWARE, BlockIndex=2, BlockStartAddress=0x10058C00, BlockEndAddress=0x101F7FFF
            BlockProcessing: IsEncrypted=1
          FotaBlock_Partition: BlockType=PARTITION_FLAG, BlockIndex=4, BlockStartAddress=0x10058B00, BlockEndAddress=0x10058BFF
            PartitionFlagInfo
          FotaBlock0_Signature: BlockType=SIGNATURE, BlockIndex=3, BlockStartAddress=0x10058900, BlockEndAddress=0x10058AFF
            VerificationInfo:
              VerifySizeOfOneCycle = 512
              VerifyBufferUsed = 0
              CsmAlgorithm = SignatureVerify_RSASSA_PKCS1_v1_5_Fota
              TargetBlock = FotaBlock0_Fw0
              TargetBlock = FotaBlock0_Fw1
