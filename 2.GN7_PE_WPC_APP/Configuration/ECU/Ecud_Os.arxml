AUTOSAR XML (schema 4-0-3)
package /AUTOSAR
  module config Os: implementation-config-variant=VARIANT-PRE-COMPILE, module-description=BswImplementation_Os
    10 x OsAlarm, all with OsAlarmCounterRef=OsCounter_0:
      OsAlarm_BSW_5ms_Com
        OsAlarmAction: category=TOOL_CONFIGURED
          OsAlarmActivateTask: category=TOOL_CONFIGURED, OsAlarmActivateTaskRef=OsTask_BSW_FG1_5ms_Com
      OsAlarm_BSW_10ms
        OsAlarmAction: category=TOOL_CONFIGURED
          OsAlarmActivateTask: category=TOOL_CONFIGURED, OsAlarmActivateTaskRef=OsTask_BSW_FG1_10ms
      OsAlarm_BSW_100ms
        OsAlarmAction
          OsAlarmActivateTask: OsAlarmActivateTaskRef=OsTask_BSW_FG1_100ms
      OsAlarm_ASW_10ms
        OsAlarmAction: category=TOOL_CONFIGURED
          OsAlarmActivateTask: category=TOOL_CONFIGURED, OsAlarmActivateTaskRef=OsTask_ASW_FG1_10ms
      OsAlarm_ASW_100ms
        OsAlarmAction: category=TOOL_CONFIGURED
          OsAlarmActivateTask: category=TOOL_CONFIGURED, OsAlarmActivateTaskRef=OsTask_ASW_FG1_100ms
      OsAlarm_BSW_Mem_Process
        OsAlarmAction
          OsAlarmSetEvent: OsAlarmSetEventRef=OsEvent_BSW_Mem_Process, OsAlarmSetEventTaskRef=OsTask_BSW_Mem_Process
      OsAlarm_ASW_5ms
        OsAlarmAction: category=TOOL_CONFIGURED
          OsAlarmActivateTask: category=TOOL_CONFIGURED, OsAlarmActivateTaskRef=OsTask_ASW_5ms
      OsAlarm_BSW_Crypto_Main
        OsAlarmAction
          OsAlarmSetEvent: OsAlarmSetEventRef=OsEvent_BSW_Crypto_Main, OsAlarmSetEventTaskRef=OsTask_BSW_BG_Crypto_Main
      OsAlarm_BG_KeyM
        OsAlarmAction
          OsAlarmSetEvent: OsAlarmSetEventRef=OsEvent_BSW_KeyM, OsAlarmSetEventTaskRef=OsTask_BSW_BG_KeyM
      OsAlarm_BG_Fota
        OsAlarmAction
          OsAlarmSetEvent: OsAlarmSetEventRef=OsEvent_BSW_BG_Fota, OsAlarmSetEventTaskRef=OsTask_BSW_BG_Fota
    OsAppMode0 (OsAppMode)
    OsApplication0 (OsApplication):
      OsApplicationCoreAssignment = 0
      OsTrusted = 1
      OsApplicationStackSize = 1024
      OsAppCounterRef = OsCounter_0
      OsAppResourceRef = OsResource_FG1
      OsAppResourceRef = OsResource_FG2
      OsAppTaskRef = OsTask_ASW_FG1_100ms
      OsAppTaskRef = OsTask_ASW_FG1_10ms
      OsAppTaskRef = OsTask_ASW_FG2_WdgMTestMode
      OsAppTaskRef = OsTask_BSW_ComMModeRequest
      OsAppTaskRef = OsTask_BSW_FG1_10ms
      OsAppTaskRef = OsTask_BSW_FG1_100ms
      OsAppTaskRef = OsTask_BSW_FG1_5ms_Com
      OsAppTaskRef = OsTask_BSW_FG2_WdgMAPI
      OsAppTaskRef = OsTask_BSW_Init
      OsAppTaskRef = OsTask_BSW_Mem_Process
      OsAppTaskRef = OsTask_BSW_FG1_IOManager
      OsAppTaskRef = OsTask_BSW_FG2_IOManager
      OsAppTaskRef = OsTask_BSW_RomTst
      OsAppTaskRef = OsTask_BSW_BG_Fota
      OsAppAlarmRef = OsAlarm_BSW_5ms_Com
      OsAppAlarmRef = OsAlarm_BSW_10ms
      OsAppAlarmRef = OsAlarm_BSW_100ms
      OsAppAlarmRef = OsAlarm_ASW_10ms
      OsAppAlarmRef = OsAlarm_ASW_100ms
      OsAppAlarmRef = OsAlarm_BSW_Mem_Process
      OsAppAlarmRef = OsAlarm_ASW_5ms
      OsAppIsrRef = Can_Interrupt_CANFD02_Cat2
      OsAppIsrRef = Can_Interrupt_CANFD13_Cat2
      OsAppIsrRef = Icu_Isr_Vector_27_Cat2
      OsAppIsrRef = Icu_Isr_Vector_40_Cat2
      OsAppIsrRef = GPT_Isr_Vector_307_Cat2
      OsAppIsrRef = GPT_Isr_Vector_303_Cat2
      OsAppIsrRef = Hsm_Isr_Vector_4_Cat2
      OsAppIsrRef = Os_TimingBudgetIsr
      OsAppIsrRef = Os_TimeFrameIsr
      OsAppIsrRef = Icu_Isr_Vector_29_Cat2
      OsAppIsrRef = Evtgen_Deepsleep_Isr_Vector_18_Cat2
      OsAppIsrRef = Scb_Isr_Vector_94_Cat2
      OsAppTaskRef = OsTask_CAN_DRE_Process
      OsAppTaskRef = OsTask_CAN_DREE_Process
      OsAppTaskRef = OsTask_SWC_BG
      OsAppTaskRef = OsTask_ASW_5ms
      OsAppAlarmRef = OsAlarm_BG_Fota
      OsAppAlarmRef = OsAlarm_BG_KeyM
      OsAppAlarmRef = OsAlarm_BSW_Crypto_Main
      OsAppTaskRef = OsTask_BSW_BG_KeyM
      OsAppTaskRef = OsTask_BSW_BG_Crypto_Main
      OsAppResourceRef = OsResource_BG
      OsAppIsrRef = Scb_Isr_Vector_91_Cat2
      OsApplicationHooks0 (OsApplicationHooks): OsAppErrorHook=0, OsAppShutdownHook=0, OsAppStartupHook=0
    OsCounter_0 (OsCounter):
      OsCounterMaxAllowedValue = 0xFFFFFFFF
      OsCounterMinCycle = 1
      OsCounterTicksPerBase = 1
      OsCounterType = HARDWARE
      OsDrivingInterrupt = SYSTICK
      OsSecondsPerTick = 0.00125
    15 x OsEvent:
      OsEvent_BSW_Mem_Process: OsEventMask=1
      OsEvent_CAN_DRE_RhstaLvlSta: OsEventMask=0x01
      OsEvent_CAN_DRE_DisSpdVal_KPH: OsEventMask=0x02
      OsEvent_CAN_DRE_EMS_02_10ms_1: OsEventMask=0x04
      OsEvent_CAN_DRE_HEV_EngOpSta: OsEventMask=0x08
      OsEvent_CAN_DRE_TP_IAU_C_WPC: OsEventMask=0x10
      OsEvent_CAN_DREE_RhstaLvlSta: OsEventMask=0x01
      OsEvent_CAN_DREE_DisSpdVal_KPH: OsEventMask=0x02
      OsEvent_CAN_DREE_EMS_02_10ms_1: OsEventMask=0x04
      OsEvent_CAN_DREE_HEV_EngOpSta: OsEventMask=0x08
      OsEvent_CAN_DRE_PDC_FD_15_300ms: OsEventMask=0x10
      OsEvent_SWC_BG: OsEventMask=0x1
      OsEvent_BSW_Crypto_Main: OsEventMask=0x8000
      OsEvent_BSW_KeyM: OsEventMask=0x4000
      OsEvent_BSW_BG_Fota: OsEventMask=0x2000
    13 x OsIsr:
      Can_Interrupt_CANFD02_Cat2: OsIsrCategory=CATEGORY_2, OsIsrHardwarePriority=6, OsIsrName=CAN0, Interrupt #0, Channel #2(59)
      Can_Interrupt_CANFD13_Cat2: OsIsrCategory=CATEGORY_2, OsIsrHardwarePriority=6, OsIsrName=CAN1, Interrupt #0, Channel #3(68)
      Icu_Isr_Vector_29_Cat2: OsIsrCategory=CATEGORY_2, OsIsrHardwarePriority=6, OsIsrName=GPIO_STD Port #8 Interrupt(29)
      Icu_Isr_Vector_27_Cat2: OsIsrCategory=CATEGORY_2, OsIsrHardwarePriority=6, OsIsrName=GPIO_STD Port #6 Interrupt(27)
      Icu_Isr_Vector_40_Cat2: OsIsrCategory=CATEGORY_2, OsIsrHardwarePriority=6, OsIsrName=GPIO_STD Port #19 Interrupt(40)
      GPT_Isr_Vector_307_Cat2: OsIsrCategory=CATEGORY_2, OsIsrHardwarePriority=6, OsIsrName=TCPWM0 Group #0, Counter #7 Interrupt(307)
      GPT_Isr_Vector_303_Cat2: OsIsrCategory=CATEGORY_2, OsIsrHardwarePriority=6, OsIsrName=TCPWM0 Group #0, Counter #3 Interrupt(303)
      Evtgen_Deepsleep_Isr_Vector_18_Cat2: OsIsrCategory=CATEGORY_2, OsIsrHardwarePriority=6, OsIsrName=Event gen DeepSleep domain interrupt(18)
      Scb_Isr_Vector_94_Cat2: OsIsrCategory=CATEGORY_2, OsIsrHardwarePriority=6, OsIsrName=SCB6 Interrupt(94)
      Hsm_Isr_Vector_4_Cat2: OsIsrCategory=CATEGORY_2, OsIsrHardwarePriority=6, OsIsrName=CPUSS Inter Process Communication Interrupt #4(4)
      Os_TimingBudgetIsr: OsIsrCategory=CATEGORY_1, OsIsrHardwarePriority=1, OsIsrName=TCPWM0 Group #2, Counter #1 Interrupt(376)
      Os_TimeFrameIsr: OsIsrCategory=CATEGORY_1, OsIsrHardwarePriority=1, OsIsrName=TCPWM0 Group #2, Counter #2 Interrupt(377)
      Scb_Isr_Vector_91_Cat2: OsIsrCategory=CATEGORY_2, OsIsrHardwarePriority=6, OsIsrName=SCB3 Interrupt(91)
    OsOS:
      OsNumberOfCores = 1
      OsScalabilityClass = SC2
      OsStackMonitoring = 1
      OsStatus = EXTENDED
      OsUseGetServiceId = 1
      OsUseResScheduler = 1
      OsProcessor = CYT2BL4CAS
      OsProcessorSeries = CYT2BL
      OsUseParameterAccess = 1
      OsUserStackSize = 4096
      OsStackFrame = StackFrame8
      OsSystemTimerClock = 160
      OsWdgSecondsPerTick = 6.250E-9
      OsFpuSupport = 1
      OsHooks0 (OsHooks): OsErrorHook=1, OsPostTaskHook=0, OsPreTaskHook=0, OsProtectionHook=1, OsStartupHook=1, OsShutdownHook=1, OsProfilingHook=1
    3 x OsResource, all with OsResourceProperty=INTERNAL:
      OsResource_FG1
      OsResource_FG2
      OsResource_BG
    20 x OsTask, all with OsTaskActivation=1, OsTaskSchedule=FULL:
      OsTask_ASW_FG1_100ms: OsTaskPriority=116, OsTaskResourceRef=OsResource_FG1
        OsTaskTimingProtection: OsTaskExecutionBudget=0.001, OsTaskAllInterruptLockBudget=0.001, OsTaskOsInterruptLockBudget=0.001, OsTaskTimeFrame=0.00010
      OsTask_ASW_FG1_10ms: OsTaskPriority=140, OsTaskResourceRef=OsResource_FG1
      OsTask_ASW_FG2_WdgMTestMode: OsTaskPriority=205, OsTaskResourceRef=OsResource_FG2
      OsTask_BSW_ComMModeRequest: OsTaskPriority=253
      OsTask_BSW_FG1_10ms: OsTaskPriority=180, OsTaskResourceRef=OsResource_FG1
      OsTask_BSW_FG1_100ms: OsTaskPriority=120, OsTaskResourceRef=OsResource_FG1
      OsTask_BSW_FG1_5ms_Com: OsTaskPriority=197, OsTaskResourceRef=OsResource_FG1
      OsTask_BSW_FG2_WdgMAPI: OsTaskPriority=210, OsTaskResourceRef=OsResource_FG2
      OsTask_BSW_Init: OsTaskPriority=99
        OsTaskAutostart: OsTaskAppModeRef=OsAppMode0
      OsTask_BSW_Mem_Process: OsTaskPriority=98, OsTaskStackSize=8192, OsTaskEventRef=OsEvent_BSW_Mem_Process
      OsTask_BSW_FG1_IOManager: OsTaskPriority=195, OsTaskResourceRef=OsResource_FG1
      OsTask_BSW_FG2_IOManager: OsTaskPriority=220, OsTaskResourceRef=OsResource_FG2
      OsTask_BSW_RomTst: OsTaskPriority=10
      OsTask_CAN_DRE_Process: OsTaskPriority=200, OsTaskStackSize=1024, OsTaskEventRef=OsEvent_CAN_DRE_DisSpdVal_KPH, OsTaskEventRef=OsEvent_CAN_DRE_HEV_EngOpSta, OsTaskEventRef=OsEvent_CAN_DRE_RhstaLvlSta, OsTaskEventRef=OsEvent_CAN_DRE_TP_IAU_C_WPC
      OsTask_CAN_DREE_Process: OsTaskPriority=201, OsTaskStackSize=1024, OsTaskEventRef=OsEvent_CAN_DREE_DisSpdVal_KPH, OsTaskEventRef=OsEvent_CAN_DREE_HEV_EngOpSta, OsTaskEventRef=OsEvent_CAN_DREE_RhstaLvlSta, OsTaskEventRef=OsEvent_CAN_DRE_PDC_FD_15_300ms
      OsTask_SWC_BG: OsTaskPriority=15, OsTaskStackSize=1024, OsTaskEventRef=OsEvent_SWC_BG
      OsTask_ASW_5ms: OsTaskPriority=100
      OsTask_BSW_BG_KeyM: OsTaskPriority=6, OsTaskStackSize=8192, OsTaskEventRef=OsEvent_BSW_KeyM, OsTaskResourceRef=OsResource_BG
      OsTask_BSW_BG_Fota: OsTaskPriority=2, OsTaskStackSize=8192, OsTaskEventRef=OsEvent_BSW_BG_Fota, OsTaskResourceRef=OsResource_BG
      OsTask_BSW_BG_Crypto_Main: OsTaskPriority=20, OsTaskStackSize=8192, OsTaskEventRef=OsEvent_BSW_Crypto_Main, OsTaskResourceRef=OsResource_BG
