AUTOSAR XML (schema 4-0-3)
package /AUTOSAR
  module config NvM: implementation-config-variant=VARIANT-PRE-COMPILE, module-description=BswImplementation_NvM
    37 x NvMBlockDescriptor, all with NvMBlockJobPriority=1, NvMBlockUseSyncMechanism=0, NvMBlockWriteProt=0, NvMBswMBlockStatusInformation=0, NvMNvramDeviceId=0, NvMResistantToChangedSw=0, NvMStaticBlockIDCheck=0, NvMWriteBlockOnce=0, NvMDefaultROMCRCEnabled=0:
      NvMBlock_ConfigID: NvMBlockCrcType=NVM_CRC16, NvMBlockManagementType=NVM_BLOCK_REDUNDANT, NvMBlockUseCrc=1, NvMCalcRamBlockCrc=1, NvMMaxNumOfReadRetries=1, NvMMaxNumOfWriteRetries=1, NvMNvBlockBaseNumber=1, NvMNvBlockLength=2, NvMNvBlockNum=2, NvMNvramBlockIdentifier=1, NvMRamBlockDataAddress=ConfigIDRamBlock, NvMRomBlockNum=0, NvMSelectBlockForReadAll=1, NvMSelectBlockForWriteAll=1, NvMWriteVerification=1, NvMWriteVerificationDataSize=2
        NvMTargetBlockReference
          NvMFeeRef: NvMNameOfFeeBlock=FeeBlock_ConfigID
      NvMBlock_ManagementBlock: NvMBlockManagementType=NVM_BLOCK_REDUNDANT, NvMBlockUseCrc=1, NvMCalcRamBlockCrc=1, NvMMaxNumOfReadRetries=1, NvMMaxNumOfWriteRetries=1, NvMNvBlockBaseNumber=2, NvMNvBlockLength=8, NvMNvBlockNum=2, NvMNvramBlockIdentifier=2, NvMRamBlockDataAddress=Dem_NonVolatileData, NvMRomBlockNum=0, NvMSelectBlockForReadAll=1, NvMSelectBlockForWriteAll=1, NvMWriteVerification=0, NvMWriteVerificationDataSize=8, NvMBlockCrcType=NVM_CRC16
        NvMTargetBlockReference
          NvMFeeRef: NvMNameOfFeeBlock=FeeBlock_ManagementBlock
      NvMBlock_EventStatusNvRamBlock: NvMBlockCrcType=NVM_CRC16, NvMBlockManagementType=NVM_BLOCK_REDUNDANT, NvMBlockUseCrc=1, NvMCalcRamBlockCrc=1, NvMMaxNumOfReadRetries=1, NvMMaxNumOfWriteRetries=1, NvMNvBlockBaseNumber=3, NvMNvBlockLength=1, NvMNvBlockNum=2, NvMNvramBlockIdentifier=3, NvMRomBlockNum=0, NvMSelectBlockForReadAll=1, NvMSelectBlockForWriteAll=1, NvMWriteVerification=0, NvMWriteVerificationDataSize=1, NvMRamBlockDataAddress=Dem_EventStatusNvRamData
        NvMTargetBlockReference
          NvMFeeRef: NvMNameOfFeeBlock=FeeBlock_EventStatusNvRamBlock
      NvMBlock_PrimaryEventMemory0: NvMBlockUseCrc=1, NvMCalcRamBlockCrc=1, NvMMaxNumOfReadRetries=1, NvMMaxNumOfWriteRetries=1, NvMSelectBlockForReadAll=1, NvMSelectBlockForWriteAll=1, NvMWriteVerification=0, NvMWriteVerificationDataSize=12, NvMBlockManagementType=NVM_BLOCK_REDUNDANT, NvMNvBlockBaseNumber=4, NvMNvBlockLength=12, NvMNvBlockNum=2, NvMNvramBlockIdentifier=4, NvMRamBlockDataAddress=Dem_PrimaryEventMemory[0], NvMRomBlockNum=0, NvMBlockCrcType=NVM_CRC16
        NvMTargetBlockReference
          NvMFeeRef: NvMNameOfFeeBlock=FeeBlock_PrimaryEventMemory0
      NvMBlock_PrimaryEventMemory1: NvMBlockUseCrc=1, NvMCalcRamBlockCrc=1, NvMMaxNumOfReadRetries=1, NvMMaxNumOfWriteRetries=1, NvMSelectBlockForReadAll=1, NvMSelectBlockForWriteAll=1, NvMWriteVerification=0, NvMWriteVerificationDataSize=12, NvMBlockManagementType=NVM_BLOCK_REDUNDANT, NvMNvBlockBaseNumber=5, NvMNvBlockLength=12, NvMNvBlockNum=2, NvMNvramBlockIdentifier=5, NvMRamBlockDataAddress=Dem_PrimaryEventMemory[1], NvMRomBlockNum=0, NvMBlockCrcType=NVM_CRC16
        NvMTargetBlockReference
          NvMFeeRef: NvMNameOfFeeBlock=FeeBlock_PrimaryEventMemory1
      NvMBlock_PrimaryEventMemory2: NvMBlockUseCrc=1, NvMCalcRamBlockCrc=1, NvMMaxNumOfReadRetries=1, NvMMaxNumOfWriteRetries=1, NvMSelectBlockForReadAll=1, NvMSelectBlockForWriteAll=1, NvMWriteVerification=0, NvMWriteVerificationDataSize=12, NvMBlockManagementType=NVM_BLOCK_REDUNDANT, NvMNvBlockBaseNumber=6, NvMNvBlockLength=12, NvMNvBlockNum=2, NvMNvramBlockIdentifier=6, NvMRamBlockDataAddress=Dem_PrimaryEventMemory[2], NvMRomBlockNum=0, NvMBlockCrcType=NVM_CRC16
        NvMTargetBlockReference
          NvMFeeRef: NvMNameOfFeeBlock=FeeBlock_PrimaryEventMemory2
      NvMBlock_PrimaryEventMemory3: NvMBlockCrcType=NVM_CRC16, NvMBlockManagementType=NVM_BLOCK_REDUNDANT, NvMBlockUseCrc=1, NvMCalcRamBlockCrc=1, NvMMaxNumOfReadRetries=3, NvMMaxNumOfWriteRetries=3, NvMNvBlockBaseNumber=7, NvMNvBlockLength=12, NvMNvBlockNum=2, NvMNvramBlockIdentifier=7, NvMRamBlockDataAddress=Dem_PrimaryEventMemory[3], NvMRomBlockNum=0, NvMSelectBlockForReadAll=1, NvMSelectBlockForWriteAll=1, NvMWriteVerification=0, NvMWriteVerificationDataSize=12
        NvMTargetBlockReference
          NvMFeeRef: NvMNameOfFeeBlock=FeeBlock_PrimaryEventMemory3
      NvMBlock_PrimaryEventMemory4: NvMBlockCrcType=NVM_CRC16, NvMBlockManagementType=NVM_BLOCK_REDUNDANT, NvMBlockUseCrc=1, NvMCalcRamBlockCrc=1, NvMMaxNumOfReadRetries=3, NvMMaxNumOfWriteRetries=3, NvMNvBlockBaseNumber=8, NvMNvBlockLength=12, NvMNvBlockNum=2, NvMNvramBlockIdentifier=8, NvMRamBlockDataAddress=Dem_PrimaryEventMemory[4], NvMRomBlockNum=0, NvMSelectBlockForReadAll=1, NvMSelectBlockForWriteAll=1, NvMWriteVerification=0, NvMWriteVerificationDataSize=12
        NvMTargetBlockReference
          NvMFeeRef: NvMNameOfFeeBlock=FeeBlock_PrimaryEventMemory4
      NvMBlock_IntTst_TestBlock1: NvMBlockUseCrc=0, NvMCalcRamBlockCrc=0, NvMMaxNumOfReadRetries=3, NvMMaxNumOfWriteRetries=3, NvMSelectBlockForReadAll=1, NvMSelectBlockForWriteAll=0, NvMWriteVerification=0, NvMWriteVerificationDataSize=7, NvMBlockManagementType=NVM_BLOCK_NATIVE, NvMNvBlockBaseNumber=9, NvMNvBlockLength=7, NvMNvBlockNum=1, NvMNvramBlockIdentifier=9, NvMRamBlockDataAddress=NvMBlock_IntTst_TestBlock1_Ram_Block, NvMRomBlockNum=0, NvMSingleBlockCallback=Rte_Call_NvM_PNJF_NvMBlock_IntTst_TestBlock1_JobFinished
        NvMTargetBlockReference
          NvMFeeRef: NvMNameOfFeeBlock=FeeBlock_IntTst_TestBlock1
      NvMBlock_IntTst_TestBlock2: NvMBlockUseCrc=1, NvMCalcRamBlockCrc=1, NvMMaxNumOfReadRetries=3, NvMMaxNumOfWriteRetries=3, NvMSelectBlockForReadAll=0, NvMSelectBlockForWriteAll=0, NvMWriteVerification=0, NvMWriteVerificationDataSize=7, NvMBlockCrcType=NVM_CRC16, NvMBlockManagementType=NVM_BLOCK_NATIVE, NvMNvBlockBaseNumber=10, NvMNvBlockLength=7, NvMNvBlockNum=1, NvMNvramBlockIdentifier=10, NvMRomBlockNum=0, NvMSingleBlockCallback=Rte_Call_NvM_PNJF_NvMBlock_IntTst_TestBlock2_JobFinished
        NvMTargetBlockReference
          NvMFeeRef: NvMNameOfFeeBlock=FeeBlock_IntTst_TestBlock2
      NvMBlock_IntTst_TestBlock3: NvMBlockUseCrc=0, NvMCalcRamBlockCrc=0, NvMMaxNumOfReadRetries=3, NvMMaxNumOfWriteRetries=3, NvMSelectBlockForReadAll=0, NvMSelectBlockForWriteAll=0, NvMWriteVerification=0, NvMWriteVerificationDataSize=2, NvMBlockManagementType=NVM_BLOCK_NATIVE, NvMNvBlockBaseNumber=11, NvMNvBlockLength=2, NvMNvBlockNum=1, NvMNvramBlockIdentifier=11, NvMRomBlockNum=0, NvMSingleBlockCallback=Rte_Call_NvM_PNJF_NvMBlock_IntTst_TestBlock3_JobFinished
        NvMTargetBlockReference
          NvMFeeRef: NvMNameOfFeeBlock=FeeBlock_IntTst_TestBlock3
      NvMBlock_ProfileGuestWPCUSM0: NvMBlockCrcType=NVM_CRC16, NvMBlockManagementType=NVM_BLOCK_REDUNDANT, NvMBlockUseCrc=1, NvMCalcRamBlockCrc=1, NvMMaxNumOfReadRetries=3, NvMMaxNumOfWriteRetries=3, NvMNvBlockBaseNumber=12, NvMNvBlockLength=1, NvMNvBlockNum=2, NvMNvramBlockIdentifier=12, NvMRamBlockDataAddress=NvMBlk_1B_Data[0], NvMRomBlockDataAddress=NvMBlk_1B_Init_0, NvMRomBlockNum=1, NvMSelectBlockForReadAll=1, NvMSelectBlockForWriteAll=0, NvMWriteVerification=0, NvMWriteVerificationDataSize=1
        NvMTargetBlockReference
          NvMFeeRef: NvMNameOfFeeBlock=FeeBlock_ProfileGuestWPCUSM0
      NvMBlock_ProfileOneWPCUSM0: NvMBlockCrcType=NVM_CRC16, NvMBlockManagementType=NVM_BLOCK_REDUNDANT, NvMBlockUseCrc=1, NvMCalcRamBlockCrc=1, NvMMaxNumOfReadRetries=3, NvMMaxNumOfWriteRetries=3, NvMNvBlockBaseNumber=13, NvMNvBlockLength=1, NvMNvBlockNum=2, NvMNvramBlockIdentifier=13, NvMRamBlockDataAddress=NvMBlk_1B_Data[1], NvMRomBlockDataAddress=NvMBlk_1B_Init_1, NvMRomBlockNum=1, NvMSelectBlockForReadAll=1, NvMSelectBlockForWriteAll=0, NvMWriteVerification=0, NvMWriteVerificationDataSize=1
        NvMTargetBlockReference
          NvMFeeRef: NvMNameOfFeeBlock=FeeBlock_ProfileOneWPCUSM0
      NvMBlock_ProfileTwoWPCUSM0: NvMBlockCrcType=NVM_CRC16, NvMBlockManagementType=NVM_BLOCK_REDUNDANT, NvMBlockUseCrc=1, NvMCalcRamBlockCrc=1, NvMMaxNumOfReadRetries=3, NvMMaxNumOfWriteRetries=3, NvMNvBlockBaseNumber=14, NvMNvBlockLength=1, NvMNvBlockNum=2, NvMNvramBlockIdentifier=14, NvMRamBlockDataAddress=NvMBlk_1B_Data[2], NvMRomBlockDataAddress=NvMBlk_1B_Init_2, NvMRomBlockNum=1, NvMSelectBlockForReadAll=1, NvMSelectBlockForWriteAll=0, NvMWriteVerification=0, NvMWriteVerificationDataSize=1
        NvMTargetBlockReference
          NvMFeeRef: NvMNameOfFeeBlock=FeeBlock_ProfileTwoWPCUSM0
      NvMBlock_ProfileThreeWPCUSM0: NvMBlockCrcType=NVM_CRC16, NvMBlockManagementType=NVM_BLOCK_REDUNDANT, NvMBlockUseCrc=1, NvMCalcRamBlockCrc=1, NvMMaxNumOfReadRetries=3, NvMMaxNumOfWriteRetries=3, NvMNvBlockBaseNumber=15, NvMNvBlockLength=1, NvMNvBlockNum=2, NvMNvramBlockIdentifier=15, NvMRamBlockDataAddress=NvMBlk_1B_Data[3], NvMRomBlockDataAddress=NvMBlk_1B_Init_3, NvMRomBlockNum=1, NvMSelectBlockForReadAll=1, NvMSelectBlockForWriteAll=0, NvMWriteVerification=0, NvMWriteVerificationDataSize=1
        NvMTargetBlockReference
          NvMFeeRef: NvMNameOfFeeBlock=FeeBlock_ProfileThreeWPCUSM0
      NvMBlock_RWPCUSM0: NvMBlockCrcType=NVM_CRC16, NvMBlockManagementType=NVM_BLOCK_REDUNDANT, NvMBlockUseCrc=1, NvMCalcRamBlockCrc=1, NvMMaxNumOfReadRetries=3, NvMMaxNumOfWriteRetries=3, NvMNvBlockBaseNumber=16, NvMNvBlockLength=1, NvMNvBlockNum=2, NvMNvramBlockIdentifier=16, NvMRamBlockDataAddress=NvMBlk_1B_Data[4], NvMRomBlockDataAddress=NvMBlk_1B_Init_4, NvMRomBlockNum=1, NvMSelectBlockForReadAll=1, NvMSelectBlockForWriteAll=0, NvMWriteVerification=0, NvMWriteVerificationDataSize=1
        NvMTargetBlockReference
          NvMFeeRef: NvMNameOfFeeBlock=FeeBlock_RWPCUSM0
      NvMBlock_ProfileGuestWPCUSM1: NvMBlockCrcType=NVM_CRC16, NvMBlockManagementType=NVM_BLOCK_REDUNDANT, NvMBlockUseCrc=1, NvMCalcRamBlockCrc=1, NvMMaxNumOfReadRetries=3, NvMMaxNumOfWriteRetries=3, NvMNvBlockBaseNumber=17, NvMNvBlockLength=1, NvMNvBlockNum=2, NvMNvramBlockIdentifier=17, NvMRamBlockDataAddress=NvMBlk_1B_Data[5], NvMRomBlockDataAddress=NvMBlk_1B_Init_5, NvMRomBlockNum=1, NvMSelectBlockForReadAll=1, NvMSelectBlockForWriteAll=0, NvMWriteVerification=0, NvMWriteVerificationDataSize=1
        NvMTargetBlockReference
          NvMFeeRef: NvMNameOfFeeBlock=FeeBlock_ProfileGuestWPCUSM1
      NvMBlock_ProfileOneWPCUSM1: NvMBlockCrcType=NVM_CRC16, NvMBlockManagementType=NVM_BLOCK_REDUNDANT, NvMBlockUseCrc=1, NvMCalcRamBlockCrc=1, NvMMaxNumOfReadRetries=3, NvMMaxNumOfWriteRetries=3, NvMNvBlockBaseNumber=18, NvMNvBlockLength=1, NvMNvBlockNum=2, NvMNvramBlockIdentifier=18, NvMRamBlockDataAddress=NvMBlk_1B_Data[6], NvMRomBlockDataAddress=NvMBlk_1B_Init_6, NvMRomBlockNum=1, NvMSelectBlockForReadAll=1, NvMSelectBlockForWriteAll=0, NvMWriteVerification=0, NvMWriteVerificationDataSize=1
        NvMTargetBlockReference
          NvMFeeRef: NvMNameOfFeeBlock=FeeBlock_ProfileOneWPCUSM1
      NvMBlock_ProfileTwoWPCUSM1: NvMBlockCrcType=NVM_CRC16, NvMBlockManagementType=NVM_BLOCK_REDUNDANT, NvMBlockUseCrc=1, NvMCalcRamBlockCrc=1, NvMMaxNumOfReadRetries=3, NvMMaxNumOfWriteRetries=3, NvMNvBlockBaseNumber=19, NvMNvBlockLength=1, NvMNvBlockNum=2, NvMNvramBlockIdentifier=19, NvMRamBlockDataAddress=NvMBlk_1B_Data[7], NvMRomBlockDataAddress=NvMBlk_1B_Init_7, NvMRomBlockNum=1, NvMSelectBlockForReadAll=1, NvMSelectBlockForWriteAll=0, NvMWriteVerification=0, NvMWriteVerificationDataSize=1
        NvMTargetBlockReference
          NvMFeeRef: NvMNameOfFeeBlock=FeeBlock_ProfileTwoWPCUSM1
      NvMBlock_ProfileThreeWPCUSM1: NvMBlockCrcType=NVM_CRC16, NvMBlockManagementType=NVM_BLOCK_REDUNDANT, NvMBlockUseCrc=1, NvMCalcRamBlockCrc=1, NvMMaxNumOfReadRetries=3, NvMMaxNumOfWriteRetries=3, NvMNvBlockBaseNumber=20, NvMNvBlockLength=1, NvMNvBlockNum=2, NvMNvramBlockIdentifier=20, NvMRamBlockDataAddress=NvMBlk_1B_Data[8], NvMRomBlockDataAddress=NvMBlk_1B_Init_8, NvMRomBlockNum=1, NvMSelectBlockForReadAll=1, NvMSelectBlockForWriteAll=0, NvMWriteVerification=0, NvMWriteVerificationDataSize=1
        NvMTargetBlockReference
          NvMFeeRef: NvMNameOfFeeBlock=FeeBlock_ProfileThreeWPCUSM1
      NvMBlock_RWPCUSM1: NvMBlockCrcType=NVM_CRC16, NvMBlockManagementType=NVM_BLOCK_REDUNDANT, NvMBlockUseCrc=1, NvMCalcRamBlockCrc=1, NvMMaxNumOfReadRetries=3, NvMMaxNumOfWriteRetries=3, NvMNvBlockBaseNumber=21, NvMNvBlockLength=1, NvMNvBlockNum=2, NvMNvramBlockIdentifier=21, NvMRamBlockDataAddress=NvMBlk_1B_Data[9], NvMRomBlockDataAddress=NvMBlk_1B_Init_9, NvMRomBlockNum=1, NvMSelectBlockForReadAll=1, NvMSelectBlockForWriteAll=0, NvMWriteVerification=0, NvMWriteVerificationDataSize=1
        NvMTargetBlockReference
          NvMFeeRef: NvMNameOfFeeBlock=FeeBlock_RWPCUSM1
      NvMBlock_AutoBrightSta: NvMBlockCrcType=NVM_CRC16, NvMBlockManagementType=NVM_BLOCK_REDUNDANT, NvMBlockUseCrc=1, NvMCalcRamBlockCrc=1, NvMMaxNumOfReadRetries=3, NvMMaxNumOfWriteRetries=3, NvMNvBlockBaseNumber=22, NvMNvBlockLength=1, NvMNvBlockNum=2, NvMNvramBlockIdentifier=22, NvMRamBlockDataAddress=NvMBlk_1B_Data[10], NvMRomBlockDataAddress=NvMBlk_1B_Init_10, NvMRomBlockNum=1, NvMSelectBlockForReadAll=1, NvMSelectBlockForWriteAll=0, NvMWriteVerification=0, NvMWriteVerificationDataSize=1
        NvMTargetBlockReference
          NvMFeeRef: NvMNameOfFeeBlock=FeeBlock_AutoBrightSta
      NvMBlock_PDCReset: NvMBlockCrcType=NVM_CRC16, NvMBlockManagementType=NVM_BLOCK_REDUNDANT, NvMBlockUseCrc=1, NvMCalcRamBlockCrc=1, NvMMaxNumOfReadRetries=3, NvMMaxNumOfWriteRetries=3, NvMNvBlockBaseNumber=23, NvMNvBlockLength=1, NvMNvBlockNum=2, NvMNvramBlockIdentifier=23, NvMRamBlockDataAddress=NvMBlk_1B_Data[11], NvMRomBlockDataAddress=NvMBlk_1B_Init_11, NvMRomBlockNum=1, NvMSelectBlockForReadAll=1, NvMSelectBlockForWriteAll=0, NvMWriteVerification=0, NvMWriteVerificationDataSize=1
        NvMTargetBlockReference
          NvMFeeRef: NvMNameOfFeeBlock=FeeBlock_PDCReset
      NvMBlock_ANT_Calibration: NvMBlockCrcType=NVM_CRC16, NvMBlockManagementType=NVM_BLOCK_REDUNDANT, NvMBlockUseCrc=1, NvMCalcRamBlockCrc=1, NvMMaxNumOfReadRetries=3, NvMMaxNumOfWriteRetries=3, NvMNvBlockBaseNumber=24, NvMNvBlockLength=1, NvMNvBlockNum=2, NvMNvramBlockIdentifier=24, NvMRamBlockDataAddress=NvMBlk_1B_Data[12], NvMRomBlockDataAddress=NvMBlk_1B_Init_12, NvMRomBlockNum=1, NvMSelectBlockForReadAll=1, NvMSelectBlockForWriteAll=0, NvMWriteVerification=0, NvMWriteVerificationDataSize=1
        NvMTargetBlockReference
          NvMFeeRef: NvMNameOfFeeBlock=FeeBlock_ANT_Calibration
      NvMBlock_B0BADisableCnt: NvMBlockCrcType=NVM_CRC16, NvMBlockManagementType=NVM_BLOCK_REDUNDANT, NvMBlockUseCrc=1, NvMCalcRamBlockCrc=1, NvMMaxNumOfReadRetries=3, NvMMaxNumOfWriteRetries=3, NvMNvBlockBaseNumber=25, NvMNvBlockLength=1, NvMNvBlockNum=2, NvMNvramBlockIdentifier=25, NvMRamBlockDataAddress=NvMBlk_1B_Data[13], NvMRomBlockDataAddress=NvMBlk_1B_Init_13, NvMRomBlockNum=1, NvMSelectBlockForReadAll=1, NvMSelectBlockForWriteAll=0, NvMWriteVerification=0, NvMWriteVerificationDataSize=1
        NvMTargetBlockReference
          NvMFeeRef: NvMNameOfFeeBlock=FeeBlock_B0BADisableCnt
      NvMBlock_WctReproRequest: NvMBlockCrcType=NVM_CRC16, NvMBlockManagementType=NVM_BLOCK_REDUNDANT, NvMBlockUseCrc=1, NvMCalcRamBlockCrc=1, NvMMaxNumOfReadRetries=3, NvMMaxNumOfWriteRetries=3, NvMNvBlockBaseNumber=26, NvMNvBlockLength=1, NvMNvBlockNum=2, NvMNvramBlockIdentifier=26, NvMRamBlockDataAddress=NvMBlk_1B_Data[14], NvMRomBlockDataAddress=NvMBlk_1B_Init_14, NvMRomBlockNum=1, NvMSelectBlockForReadAll=1, NvMSelectBlockForWriteAll=0, NvMWriteVerification=0, NvMWriteVerificationDataSize=1
        NvMTargetBlockReference
          NvMFeeRef: NvMNameOfFeeBlock=FeeBlock_WctReproRequest
      NvMBlock_Flag2: NvMBlockCrcType=NVM_CRC16, NvMBlockManagementType=NVM_BLOCK_REDUNDANT, NvMBlockUseCrc=1, NvMCalcRamBlockCrc=1, NvMMaxNumOfReadRetries=3, NvMMaxNumOfWriteRetries=3, NvMNvBlockBaseNumber=27, NvMNvBlockLength=1, NvMNvBlockNum=2, NvMNvramBlockIdentifier=27, NvMRamBlockDataAddress=NvMBlk_1B_Data[15], NvMRomBlockDataAddress=NvMBlk_1B_Init_15, NvMRomBlockNum=1, NvMSelectBlockForReadAll=1, NvMSelectBlockForWriteAll=0, NvMWriteVerification=0, NvMWriteVerificationDataSize=1
        NvMTargetBlockReference
          NvMFeeRef: NvMNameOfFeeBlock=FeeBlock_Flag2
      NvMBlock_Flag3: NvMBlockCrcType=NVM_CRC16, NvMBlockManagementType=NVM_BLOCK_REDUNDANT, NvMBlockUseCrc=1, NvMCalcRamBlockCrc=1, NvMMaxNumOfReadRetries=3, NvMMaxNumOfWriteRetries=3, NvMNvBlockBaseNumber=28, NvMNvBlockLength=1, NvMNvBlockNum=2, NvMNvramBlockIdentifier=28, NvMRamBlockDataAddress=NvMBlk_1B_Data[16], NvMRomBlockDataAddress=NvMBlk_1B_Init_16, NvMRomBlockNum=1, NvMSelectBlockForReadAll=1, NvMSelectBlockForWriteAll=0, NvMWriteVerification=0, NvMWriteVerificationDataSize=1
        NvMTargetBlockReference
          NvMFeeRef: NvMNameOfFeeBlock=FeeBlock_Flag3
      NvMBlock_Flag4: NvMBlockCrcType=NVM_CRC16, NvMBlockManagementType=NVM_BLOCK_REDUNDANT, NvMBlockUseCrc=1, NvMCalcRamBlockCrc=1, NvMMaxNumOfReadRetries=3, NvMMaxNumOfWriteRetries=3, NvMNvBlockBaseNumber=29, NvMNvBlockLength=1, NvMNvBlockNum=2, NvMNvramBlockIdentifier=29, NvMRamBlockDataAddress=NvMBlk_1B_Data[17], NvMRomBlockDataAddress=NvMBlk_1B_Init_17, NvMRomBlockNum=1, NvMSelectBlockForReadAll=1, NvMSelectBlockForWriteAll=0, NvMWriteVerification=0, NvMWriteVerificationDataSize=1
        NvMTargetBlockReference
          NvMFeeRef: NvMNameOfFeeBlock=FeeBlock_Flag4
      NvMBlock_Flag5: NvMBlockCrcType=NVM_CRC16, NvMBlockManagementType=NVM_BLOCK_REDUNDANT, NvMBlockUseCrc=1, NvMCalcRamBlockCrc=1, NvMMaxNumOfReadRetries=3, NvMMaxNumOfWriteRetries=3, NvMNvBlockBaseNumber=30, NvMNvBlockLength=1, NvMNvBlockNum=2, NvMNvramBlockIdentifier=30, NvMRamBlockDataAddress=NvMBlk_1B_Data[18], NvMRomBlockDataAddress=NvMBlk_1B_Init_18, NvMRomBlockNum=1, NvMSelectBlockForReadAll=1, NvMSelectBlockForWriteAll=0, NvMWriteVerification=0, NvMWriteVerificationDataSize=1
        NvMTargetBlockReference
          NvMFeeRef: NvMNameOfFeeBlock=FeeBlock_Flag5
      NvMBlock_Flag6: NvMBlockCrcType=NVM_CRC16, NvMBlockManagementType=NVM_BLOCK_REDUNDANT, NvMBlockUseCrc=1, NvMCalcRamBlockCrc=1, NvMMaxNumOfReadRetries=3, NvMMaxNumOfWriteRetries=3, NvMNvBlockBaseNumber=31, NvMNvBlockLength=1, NvMNvBlockNum=2, NvMNvramBlockIdentifier=31, NvMRamBlockDataAddress=NvMBlk_1B_Data[19], NvMRomBlockDataAddress=NvMBlk_1B_Init_19, NvMRomBlockNum=1, NvMSelectBlockForReadAll=1, NvMSelectBlockForWriteAll=0, NvMWriteVerification=0, NvMWriteVerificationDataSize=1
        NvMTargetBlockReference
          NvMFeeRef: NvMNameOfFeeBlock=FeeBlock_Flag6
      NvMBlock_ECU_Info: NvMBlockCrcType=NVM_CRC16, NvMBlockManagementType=NVM_BLOCK_REDUNDANT, NvMBlockUseCrc=1, NvMCalcRamBlockCrc=1, NvMMaxNumOfReadRetries=3, NvMMaxNumOfWriteRetries=3, NvMNvBlockBaseNumber=32, NvMNvBlockLength=17, NvMNvBlockNum=2, NvMNvramBlockIdentifier=32, NvMRamBlockDataAddress=NvMBlk_ECU_Info, NvMRomBlockNum=1, NvMSelectBlockForReadAll=1, NvMSelectBlockForWriteAll=0, NvMWriteVerification=0, NvMWriteVerificationDataSize=17, NvMRomBlockDataAddress=NvMBlkInitSting_ECUINFO
        NvMTargetBlockReference
          NvMFeeRef: NvMNameOfFeeBlock=FeeBlock_ECU_Info
      NvMBlock_SerialNum: NvMBlockCrcType=NVM_CRC16, NvMBlockManagementType=NVM_BLOCK_REDUNDANT, NvMBlockUseCrc=1, NvMCalcRamBlockCrc=1, NvMMaxNumOfReadRetries=3, NvMMaxNumOfWriteRetries=3, NvMNvBlockBaseNumber=33, NvMNvBlockLength=15, NvMNvBlockNum=2, NvMNvramBlockIdentifier=33, NvMRamBlockDataAddress=NvMBlk_SerialNum, NvMRomBlockNum=1, NvMSelectBlockForReadAll=1, NvMSelectBlockForWriteAll=0, NvMWriteVerification=0, NvMWriteVerificationDataSize=15, NvMRomBlockDataAddress=NvMBlkInitSting_SERNUMB
        NvMTargetBlockReference
          NvMFeeRef: NvMNameOfFeeBlock=FeeBlock_SerialNum
      NvMBlock_QRCode: NvMBlockCrcType=NVM_CRC16, NvMBlockManagementType=NVM_BLOCK_REDUNDANT, NvMBlockUseCrc=1, NvMCalcRamBlockCrc=1, NvMMaxNumOfReadRetries=3, NvMMaxNumOfWriteRetries=3, NvMNvBlockBaseNumber=34, NvMNvBlockLength=21, NvMNvBlockNum=2, NvMNvramBlockIdentifier=34, NvMRamBlockDataAddress=NvMBlk_QRCode, NvMRomBlockNum=1, NvMSelectBlockForReadAll=1, NvMSelectBlockForWriteAll=0, NvMWriteVerification=0, NvMWriteVerificationDataSize=21, NvMRomBlockDataAddress=NvMBlkInitSting_QRCODE
        NvMTargetBlockReference
          NvMFeeRef: NvMNameOfFeeBlock=FeeBlock_QRCode
      NvMBlock_Array1: NvMBlockCrcType=NVM_CRC16, NvMBlockManagementType=NVM_BLOCK_REDUNDANT, NvMBlockUseCrc=1, NvMCalcRamBlockCrc=1, NvMMaxNumOfReadRetries=3, NvMMaxNumOfWriteRetries=3, NvMNvBlockBaseNumber=35, NvMNvBlockLength=8, NvMNvBlockNum=2, NvMNvramBlockIdentifier=35, NvMRamBlockDataAddress=NvMBlk_Array1, NvMRomBlockNum=1, NvMSelectBlockForReadAll=1, NvMSelectBlockForWriteAll=0, NvMWriteVerification=0, NvMWriteVerificationDataSize=8, NvMRomBlockDataAddress=NvMBlkInitSting_Array1
        NvMTargetBlockReference
          NvMFeeRef: NvMNameOfFeeBlock=FeeBlock_Array1
      NvMBlock_Array2: NvMBlockCrcType=NVM_CRC16, NvMBlockManagementType=NVM_BLOCK_REDUNDANT, NvMBlockUseCrc=1, NvMCalcRamBlockCrc=1, NvMMaxNumOfReadRetries=3, NvMMaxNumOfWriteRetries=3, NvMNvBlockBaseNumber=36, NvMNvBlockLength=8, NvMNvBlockNum=2, NvMNvramBlockIdentifier=36, NvMRamBlockDataAddress=NvMBlk_Array2, NvMRomBlockNum=1, NvMSelectBlockForReadAll=1, NvMSelectBlockForWriteAll=0, NvMWriteVerification=0, NvMWriteVerificationDataSize=8, NvMRomBlockDataAddress=NvMBlkInitSting_Array2
        NvMTargetBlockReference
          NvMFeeRef: NvMNameOfFeeBlock=FeeBlock_Array2
      NvMBlock_Array3: NvMBlockCrcType=NVM_CRC16, NvMBlockManagementType=NVM_BLOCK_REDUNDANT, NvMBlockUseCrc=1, NvMCalcRamBlockCrc=1, NvMMaxNumOfReadRetries=3, NvMMaxNumOfWriteRetries=3, NvMNvBlockBaseNumber=37, NvMNvBlockLength=8, NvMNvBlockNum=2, NvMNvramBlockIdentifier=37, NvMRamBlockDataAddress=NvMBlk_Array3, NvMRomBlockNum=1, NvMSelectBlockForReadAll=1, NvMSelectBlockForWriteAll=0, NvMWriteVerification=0, NvMWriteVerificationDataSize=8, NvMRomBlockDataAddress=NvMBlkInitSting_Array3
        NvMTargetBlockReference
          NvMFeeRef: NvMNameOfFeeBlock=FeeBlock_Array3
    NvMCommon:
      NvMApiConfigClass = NVM_API_CONFIG_CLASS_3
      NvMBswMMultiBlockJobStatusInformation = 1
      NvMCompiledConfigId = 20
      NvMCrcNumOfBytes = 4
      NvMDatasetSelectionBits = 2
      NvMDevErrorDetect = 1
      NvMDrvModeSwitch = 1
      NvMDynamicConfiguration = 0
      NvMJobPrioritization = 0
      NvMMultiBlockCallback = BswM_NvM_CurrentJobMode
      NvMPollingMode = 0
      NvMRepeatMirrorOperations = 0
      NvMSetRamBlockStatusApi = 1
      NvMSizeImmediateJobQueue = 20
      NvMSizeStandardJobQueue = 39
      NvMMainFunctionCallCycle = 0.005
      NvMVersionInfoApi = 0
      NvMUserJobFunction = Mem_76_Pfls_MainFunction
      NvMMainfunctionTriggerRef = OsAlarm_BSW_Mem_Process
      NvMUserIncludeFiles:
        NvMUserIncludeFile = Dem_Ram.h
        NvMUserIncludeFile = Mem_Integration.h
        NvMUserIncludeFile = CDD_DataLog.h
        NvMUserIncludeFile = Nml_Integration.h
        NvMUserIncludeFile = Mem_76_Pfls.h
        NvMUserIncludeFile = App_NvM.h
    NvMDemEventParameterRefs_0 (NvMDemEventParameterRefs):
      NVM_E_INTEGRITY_FAILED = NVM_E_INTEGRITY_FAILED
      NVM_E_LOSS_OF_REDUNDANCY = NVM_E_LOSS_OF_REDUNDANCY
      NVM_E_QUEUE_OVERFLOW = NVM_E_QUEUE_OVERFLOW
      NVM_E_REQ_FAILED = NVM_E_REQ_FAILED
      NVM_E_VERIFY_FAILED = NVM_E_VERIFY_FAILED
      NVM_E_WRITE_PROTECTED = NVM_E_WRITE_PROTECTED
      NVM_E_WRONG_BLOCK_ID = NVM_E_WRONG_BLOCK_ID
    NvMBlock_DataLog (NvMBlockDescriptor):
      NvMBlockJobPriority = 1
      NvMBlockManagementType = NVM_BLOCK_NATIVE
      NvMBlockUseCrc = 0
      NvMBlockUseSyncMechanism = 0
      NvMBlockWriteProt = 0
      NvMBswMBlockStatusInformation = 0
      NvMCalcRamBlockCrc = 0
      NvMMaxNumOfReadRetries = 0
      NvMMaxNumOfWriteRetries = 0
      NvMNvBlockBaseNumber = 38
      NvMNvBlockLength = 4
      NvMNvBlockNum = 1
      NvMNvramBlockIdentifier = 38
      NvMRamBlockDataAddress = DataLog_NvLog
      NvMNvramDeviceId = 0
      NvMResistantToChangedSw = 0
      NvMRomBlockNum = 0
      NvMSelectBlockForReadAll = 1
      NvMSelectBlockForWriteAll = 0
      NvMStaticBlockIDCheck = 0
      NvMWriteBlockOnce = 0
      NvMWriteVerification = 0
      NvMWriteVerificationDataSize = 4
      NvMDefaultROMCRCEnabled = 0
      NvMTargetBlockReference
        NvMFeeRef: NvMNameOfFeeBlock=FeeBlock_DataLog
    NvMBlock_NmlLog (NvMBlockDescriptor):
      NvMBlockCrcType = NVM_CRC16
      NvMBlockJobPriority = 1
      NvMBlockManagementType = NVM_BLOCK_NATIVE
      NvMBlockUseCrc = 1
      NvMBlockUseSyncMechanism = 0
      NvMBlockWriteProt = 0
      NvMBswMBlockStatusInformation = 0
      NvMCalcRamBlockCrc = 1
      NvMMaxNumOfReadRetries = 3
      NvMMaxNumOfWriteRetries = 3
      NvMNvBlockBaseNumber = 39
      NvMNvBlockLength = 200
      NvMNvBlockNum = 1
      NvMNvramBlockIdentifier = 39
      NvMRamBlockDataAddress = Nml_LogData
      NvMNvramDeviceId = 0
      NvMResistantToChangedSw = 0
      NvMRomBlockNum = 0
      NvMSelectBlockForReadAll = 1
      NvMSelectBlockForWriteAll = 1
      NvMStaticBlockIDCheck = 0
      NvMWriteBlockOnce = 0
      NvMWriteVerification = 0
      NvMWriteVerificationDataSize = 200
      NvMDefaultROMCRCEnabled = 0
      NvMSingleBlockCallback = Nml_Callback_Nml_LogData_JobFinished
      NvMTargetBlockReference
        NvMFeeRef: NvMNameOfFeeBlock=FeeBlock_NmlLog
