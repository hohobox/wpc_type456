AUTOSAR XML (schema 4-0-3)
package /AUTOSAR
  module config Com: implementation-config-variant=VARIANT-PRE-COMPILE, module-description=BswImplementation_Com
    ComConfig: ComConfigurationId=0
      ComTimeBase: category=TOOL_CONFIGURED, ComGwTimeBase=0.005, ComRxTimeBase=0.005, ComTxTimeBase=0.005
      ComIPduGroupRx_WPC_BCAN_PNC141 (ComIPduGroup): category=TOOL_CONFIGURED, ComIPduGroupHandleId=0
      ComIPduGroupTx_WPC_BCAN_PNC141 (ComIPduGroup): category=TOOL_CONFIGURED, ComIPduGroupHandleId=1
      36 x ComIPdu, all with category=TOOL_CONFIGURED, ComIPduSignalProcessing=DEFERRED:
        ComIPdu_BCAN_VCU_01_10ms: ComIPduDirection=RECEIVE, ComIPduHandleId=0, ComIPduType=NORMAL, ComIPduSignalRef=ComISignal_BCAN_VCU_01_10ms_VCU_EvDrvRdySta, ComIPduSignalRef=ComISignal_BCAN_VCU_01_10ms_VCU_GearPosSta, ComPduIdRef=Pdu_ISignalIPdu_BCAN_VCU_01_10ms, ComIPduGroupRef=ComIPduGroupRx_WPC_BCAN_PNC141, ComIPduGroupRef=ComIPduGroupRx_WPC_BCAN_PNC153, ComIPduGroupRef=ComIPduGroupRx_WPC_BCAN_PNC32
        ComIPdu_BCAN_WPC_FD_VCRM_01_00ms: ComIPduDirection=SEND, ComIPduHandleId=5, ComIPduType=NORMAL, ComIPduSignalGroupRef=ComISignalGroup_MsgGr_E2E_BCAN_WPC_FD_VCRM_01_00ms, ComPduIdRef=Pdu_ISignalIPdu_BCAN_WPC_FD_VCRM_01_00ms, ComIPduGroupRef=ComIPduGroupTx_WPC_BCAN_PNC141, ComIPduGroupRef=ComIPduGroupTx_WPC_BCAN_PNC153, ComIPduGroupRef=ComIPduGroupTx_WPC_BCAN_PNC32
          ComTxIpdu_ComIPdu_BCAN_WPC_FD_VCRM_01_00ms (ComTxIPdu): category=TOOL_CONFIGURED, ComTxIPduUnusedAreasDefault=0, ComMinimumDelayTime=0.02
            ComTxModeTrue_ComTxIpdu_ComIPdu_BCAN_WPC_FD_VCRM_01_00ms (ComTxModeTrue): category=TOOL_CONFIGURED
              ComTxMode_ComTxModeTrue_ComTxIpdu_ComIPdu_BCAN_WPC_FD_VCRM_01_00ms (ComTxMode): category=TOOL_CONFIGURED, ComTxModeNumberOfRepetitions=3, ComTxModeRepetitionPeriod=0.04, ComTxModeMode=DIRECT
        ComIPdu_BCAN_BDC_FD_SMK_02_200ms: ComIPduDirection=RECEIVE, ComIPduHandleId=1, ComIPduType=NORMAL, ComIPduSignalRef=ComISignal_BCAN_BDC_FD_SMK_02_200ms_LFAnt_SrchSta, ComPduIdRef=Pdu_ISignalIPdu_BCAN_BDC_FD_SMK_02_200ms, ComIPduGroupRef=ComIPduGroupRx_WPC_BCAN_PNC141, ComIPduGroupRef=ComIPduGroupRx_WPC_BCAN_PNC153, ComIPduGroupRef=ComIPduGroupRx_WPC_BCAN_PNC32
        ComIPdu_BCAN_CLU_05_00ms: ComIPduDirection=RECEIVE, ComIPduHandleId=2, ComIPduType=NORMAL, ComIPduSignalRef=ComISignal_BCAN_CLU_05_00ms_USM_StaRst1Req, ComPduIdRef=Pdu_ISignalIPdu_BCAN_CLU_05_00ms, ComIPduGroupRef=ComIPduGroupRx_WPC_BCAN_PNC141, ComIPduGroupRef=ComIPduGroupRx_WPC_BCAN_PNC153, ComIPduGroupRef=ComIPduGroupRx_WPC_BCAN_PNC32
        ComIPdu_BCAN_CLU_09_00ms: ComIPduDirection=RECEIVE, ComIPduHandleId=3, ComIPduType=NORMAL, ComIPduSignalRef=ComISignal_BCAN_CLU_09_00ms_USM_WpcSetReq, ComPduIdRef=Pdu_ISignalIPdu_BCAN_CLU_09_00ms, ComIPduGroupRef=ComIPduGroupRx_WPC_BCAN_PNC141, ComIPduGroupRef=ComIPduGroupRx_WPC_BCAN_PNC153, ComIPduGroupRef=ComIPduGroupRx_WPC_BCAN_PNC32
        ComIPdu_BCAN_HCU_03_10ms: ComIPduDirection=RECEIVE, ComIPduHandleId=4, ComIPduType=NORMAL, ComIPduSignalRef=ComISignal_BCAN_HCU_03_10ms_HCU_HevRdySta, ComPduIdRef=Pdu_ISignalIPdu_BCAN_HCU_03_10ms, ComIPduGroupRef=ComIPduGroupRx_WPC_BCAN_PNC141, ComIPduGroupRef=ComIPduGroupRx_WPC_BCAN_PNC153, ComIPduGroupRef=ComIPduGroupRx_WPC_BCAN_PNC32
        ComIPdu_BCAN_HU_USM_02_00ms: ComIPduDirection=RECEIVE, ComIPduHandleId=5, ComIPduType=NORMAL, ComIPduSignalRef=ComISignal_BCAN_HU_USM_02_00ms_CF_AVN_CluUSMReset, ComPduIdRef=Pdu_ISignalIPdu_BCAN_HU_USM_02_00ms, ComIPduGroupRef=ComIPduGroupRx_WPC_BCAN_PNC141, ComIPduGroupRef=ComIPduGroupRx_WPC_BCAN_PNC153, ComIPduGroupRef=ComIPduGroupRx_WPC_BCAN_PNC32
        ComIPdu_BCAN_HU_USM_01_00ms: ComIPduDirection=RECEIVE, ComIPduHandleId=6, ComIPduType=NORMAL, ComIPduSignalRef=ComISignal_BCAN_HU_USM_01_00ms_CF_Gway_WPCNValueSet, ComPduIdRef=Pdu_ISignalIPdu_BCAN_HU_USM_01_00ms, ComIPduGroupRef=ComIPduGroupRx_WPC_BCAN_PNC141, ComIPduGroupRef=ComIPduGroupRx_WPC_BCAN_PNC153, ComIPduGroupRef=ComIPduGroupRx_WPC_BCAN_PNC32
        ComIPdu_BCAN_HU_USM_05_00ms: ComIPduDirection=RECEIVE, ComIPduHandleId=7, ComIPduType=NORMAL, ComIPduSignalRef=ComISignal_BCAN_HU_USM_05_00ms_CF_Gway_WPCAnimationNvalueSet, ComPduIdRef=Pdu_ISignalIPdu_BCAN_HU_USM_05_00ms, ComIPduGroupRef=ComIPduGroupRx_WPC_BCAN_PNC141, ComIPduGroupRef=ComIPduGroupRx_WPC_BCAN_PNC153, ComIPduGroupRef=ComIPduGroupRx_WPC_BCAN_PNC32
        ComIPdu_BCAN_SBCM_RR_FD_01_200ms: ComIPduDirection=RECEIVE, ComIPduHandleId=8, ComIPduType=NORMAL, ComIPduSignalRef=ComISignal_BCAN_SBCM_RR_FD_01_200ms_Warn_RrRtDrSwSta_SBCM, ComPduIdRef=Pdu_ISignalIPdu_BCAN_SBCM_RR_FD_01_200ms, ComIPduGroupRef=ComIPduGroupRx_WPC_BCAN_PNC141, ComIPduGroupRef=ComIPduGroupRx_WPC_BCAN_PNC153, ComIPduGroupRef=ComIPduGroupRx_WPC_BCAN_PNC32
        ComIPdu_BCAN_SBCM_RL_FD_01_200ms: ComIPduDirection=RECEIVE, ComIPduHandleId=9, ComIPduType=NORMAL, ComIPduSignalRef=ComISignal_BCAN_SBCM_RL_FD_01_200ms_Warn_RrLftDrSwSta_SBCM, ComPduIdRef=Pdu_ISignalIPdu_BCAN_SBCM_RL_FD_01_200ms, ComIPduGroupRef=ComIPduGroupRx_WPC_BCAN_PNC141, ComIPduGroupRef=ComIPduGroupRx_WPC_BCAN_PNC153, ComIPduGroupRef=ComIPduGroupRx_WPC_BCAN_PNC32
        ComIPdu_BCAN_EMS_02_10ms: ComIPduDirection=RECEIVE, ComIPduHandleId=10, ComIPduType=NORMAL, ComIPduSignalRef=ComISignal_BCAN_EMS_02_10ms_ENG_EngSta, ComPduIdRef=Pdu_ISignalIPdu_BCAN_EMS_02_10ms, ComIPduGroupRef=ComIPduGroupRx_WPC_BCAN_PNC141, ComIPduGroupRef=ComIPduGroupRx_WPC_BCAN_PNC153, ComIPduGroupRef=ComIPduGroupRx_WPC_BCAN_PNC32
        ComIPdu_BCAN_EMS_07_10ms: ComIPduDirection=RECEIVE, ComIPduHandleId=11, ComIPduType=NORMAL, ComIPduSignalRef=ComISignal_BCAN_EMS_07_10ms_HEV_EngOpSta, ComPduIdRef=Pdu_ISignalIPdu_BCAN_EMS_07_10ms, ComIPduGroupRef=ComIPduGroupRx_WPC_BCAN_PNC141, ComIPduGroupRef=ComIPduGroupRx_WPC_BCAN_PNC153, ComIPduGroupRef=ComIPduGroupRx_WPC_BCAN_PNC32
        ComIPdu_BCAN_SBCM_DRV_FD_01_200ms: ComIPduDirection=RECEIVE, ComIPduHandleId=12, ComIPduType=NORMAL, ComIPduSignalRef=ComISignal_BCAN_SBCM_DRV_FD_01_200ms_Warn_DrvDrSwSta_SBCM, ComIPduSignalRef=ComISignal_BCAN_SBCM_DRV_FD_01_200ms_Latch_TypeOption_DRV, ComPduIdRef=Pdu_ISignalIPdu_BCAN_SBCM_DRV_FD_01_200ms, ComIPduGroupRef=ComIPduGroupRx_WPC_BCAN_PNC141, ComIPduGroupRef=ComIPduGroupRx_WPC_BCAN_PNC153, ComIPduGroupRef=ComIPduGroupRx_WPC_BCAN_PNC32
        ComIPdu_BCAN_SBCM_AST_FD_01_200ms: ComIPduDirection=RECEIVE, ComIPduHandleId=13, ComIPduType=NORMAL, ComIPduSignalRef=ComISignal_BCAN_SBCM_AST_FD_01_200ms_Warn_AsstDrSwSta_SBCM, ComPduIdRef=Pdu_ISignalIPdu_BCAN_SBCM_AST_FD_01_200ms, ComIPduGroupRef=ComIPduGroupRx_WPC_BCAN_PNC141, ComIPduGroupRef=ComIPduGroupRx_WPC_BCAN_PNC153, ComIPduGroupRef=ComIPduGroupRx_WPC_BCAN_PNC32
        ComIPdu_BCAN_CLU_20_200ms: ComIPduDirection=RECEIVE, ComIPduHandleId=14, ComIPduType=NORMAL, ComIPduSignalRef=ComISignal_BCAN_CLU_20_200ms_CLU_ClusterUSM, ComPduIdRef=Pdu_ISignalIPdu_BCAN_CLU_20_200ms, ComIPduGroupRef=ComIPduGroupRx_WPC_BCAN_PNC141, ComIPduGroupRef=ComIPduGroupRx_WPC_BCAN_PNC153, ComIPduGroupRef=ComIPduGroupRx_WPC_BCAN_PNC32
        ComIPdu_BCAN_RWPC_FD_01_200ms: ComIPduDirection=RECEIVE, ComIPduHandleId=15, ComIPduType=NORMAL, ComIPduSignalRef=ComISignal_BCAN_RWPC_FD_01_200ms_RWPC_IndSyncVal, ComPduIdRef=Pdu_ISignalIPdu_BCAN_RWPC_FD_01_200ms, ComIPduGroupRef=ComIPduGroupRx_WPC_BCAN_PNC141, ComIPduGroupRef=ComIPduGroupRx_WPC_BCAN_PNC153, ComIPduGroupRef=ComIPduGroupRx_WPC_BCAN_PNC32
        ComIPdu_BCAN_HU_GW_03_200ms: ComIPduDirection=RECEIVE, ComIPduHandleId=16, ComIPduType=NORMAL, ComIPduSignalRef=ComISignal_BCAN_HU_GW_03_200ms_CF_AVN_ProfileIDRValue, ComPduIdRef=Pdu_ISignalIPdu_BCAN_HU_GW_03_200ms, ComIPduGroupRef=ComIPduGroupRx_WPC_BCAN_PNC141, ComIPduGroupRef=ComIPduGroupRx_WPC_BCAN_PNC153, ComIPduGroupRef=ComIPduGroupRx_WPC_BCAN_PNC32
        ComIPdu_BCAN_IAU_FD_04_200ms: ComIPduDirection=RECEIVE, ComIPduHandleId=17, ComIPduType=NORMAL, ComIPduSignalRef=ComISignal_BCAN_IAU_FD_04_200ms_IAU_ProfileIDRVal, ComIPduSignalRef=ComISignal_BCAN_IAU_FD_04_200ms_IAU_DigitalKey2Opt, ComPduIdRef=Pdu_ISignalIPdu_BCAN_IAU_FD_04_200ms, ComIPduGroupRef=ComIPduGroupRx_WPC_BCAN_PNC141, ComIPduGroupRef=ComIPduGroupRx_WPC_BCAN_PNC153, ComIPduGroupRef=ComIPduGroupRx_WPC_BCAN_PNC32
        ComIPdu_BCAN_WPC2_FD_01_200ms: ComIPduDirection=SEND, ComIPduHandleId=8, ComIPduType=NORMAL, ComIPduSignalGroupRef=ComISignalGroup_MsgGr_E2E_BCAN_WPC2_FD_01_200ms, ComPduIdRef=Pdu_ISignalIPdu_BCAN_WPC2_FD_01_200ms, ComIPduGroupRef=ComIPduGroupTx_WPC_BCAN_PNC141, ComIPduGroupRef=ComIPduGroupTx_WPC_BCAN_PNC153, ComIPduGroupRef=ComIPduGroupTx_WPC_BCAN_PNC32
          ComTxIpdu_ComIPdu_BCAN_WPC2_FD_01_200ms (ComTxIPdu): category=TOOL_CONFIGURED, ComTxIPduUnusedAreasDefault=0, ComMinimumDelayTime=0.02
            ComTxModeTrue_ComTxIpdu_ComIPdu_BCAN_WPC2_FD_01_200ms (ComTxModeTrue): category=TOOL_CONFIGURED
              ComTxMode_ComTxModeTrue_ComTxIpdu_ComIPdu_BCAN_WPC2_FD_01_200ms (ComTxMode):
                category = TOOL_CONFIGURED
                ComTxModeTimeOffset = 0.0
                ComTxModeTimePeriod = 0.2
                ComTxModeNumberOfRepetitions = 3
                ComTxModeRepetitionPeriod = 0.04
                ComTxModeMode = MIXED
        ComIPdu_BCAN_WPC_FD_01_200ms: ComIPduDirection=SEND, ComIPduHandleId=9, ComIPduType=NORMAL, ComIPduSignalGroupRef=ComISignalGroup_MsgGr_E2E_BCAN_WPC_FD_01_200ms, ComPduIdRef=Pdu_ISignalIPdu_BCAN_WPC_FD_01_200ms, ComIPduGroupRef=ComIPduGroupTx_WPC_BCAN_PNC141, ComIPduGroupRef=ComIPduGroupTx_WPC_BCAN_PNC153, ComIPduGroupRef=ComIPduGroupTx_WPC_BCAN_PNC32
          ComTxIpdu_ComIPdu_BCAN_WPC_FD_01_200ms (ComTxIPdu): category=TOOL_CONFIGURED, ComTxIPduUnusedAreasDefault=0, ComMinimumDelayTime=0.02
            ComTxModeTrue_ComTxIpdu_ComIPdu_BCAN_WPC_FD_01_200ms (ComTxModeTrue): category=TOOL_CONFIGURED
              ComTxMode_ComTxModeTrue_ComTxIpdu_ComIPdu_BCAN_WPC_FD_01_200ms (ComTxMode):
                category = TOOL_CONFIGURED
                ComTxModeTimeOffset = 0.0
                ComTxModeTimePeriod = 0.2
                ComTxModeNumberOfRepetitions = 3
                ComTxModeRepetitionPeriod = 0.04
                ComTxModeMode = MIXED
        ComIPdu_BCAN_CLU_01_20ms: ComIPduDirection=RECEIVE, ComIPduHandleId=18, ComIPduType=NORMAL, ComIPduSignalRef=ComISignal_BCAN_CLU_01_20ms_CLU_DtntOutSta, ComIPduSignalRef=ComISignal_BCAN_CLU_01_20ms_CLU_RhstaLvlSta, ComIPduSignalRef=ComISignal_BCAN_CLU_01_20ms_CLU_DisSpdVal_KPH, ComIPduSignalRef=ComISignal_BCAN_CLU_01_20ms_CLU_AutoBrightSta, ComPduIdRef=Pdu_ISignalIPdu_BCAN_CLU_01_20ms, ComIPduGroupRef=ComIPduGroupRx_WPC_BCAN_PNC141, ComIPduGroupRef=ComIPduGroupRx_WPC_BCAN_PNC153, ComIPduGroupRef=ComIPduGroupRx_WPC_BCAN_PNC32
        ComIPdu_BCAN_PDC_FD_03_200ms: ComIPduDirection=RECEIVE, ComIPduHandleId=19, ComIPduType=NORMAL, ComIPduSignalRef=ComISignal_BCAN_PDC_FD_03_200ms_Warn_DrvDrSwSta, ComIPduSignalRef=ComISignal_BCAN_PDC_FD_03_200ms_Warn_AsstDrSwSta, ComIPduSignalRef=ComISignal_BCAN_PDC_FD_03_200ms_Warn_RrLftDrSwSta, ComIPduSignalRef=ComISignal_BCAN_PDC_FD_03_200ms_Warn_RrRtDrSwSta, ComPduIdRef=Pdu_ISignalIPdu_BCAN_PDC_FD_03_200ms, ComIPduGroupRef=ComIPduGroupRx_WPC_BCAN_PNC141, ComIPduGroupRef=ComIPduGroupRx_WPC_BCAN_PNC153, ComIPduGroupRef=ComIPduGroupRx_WPC_BCAN_PNC32
        ComIPdu_BCAN_BDC_FD_02_200ms: ComIPduDirection=RECEIVE, ComIPduHandleId=20, ComIPduType=NORMAL, ComIPduSignalRef=ComISignal_BCAN_BDC_FD_02_200ms_BCM_SmkOptTyp, ComPduIdRef=Pdu_ISignalIPdu_BCAN_BDC_FD_02_200ms, ComIPduGroupRef=ComIPduGroupRx_WPC_BCAN_PNC141, ComIPduGroupRef=ComIPduGroupRx_WPC_BCAN_PNC153, ComIPduGroupRef=ComIPduGroupRx_WPC_BCAN_PNC32
        ComIPdu_BCAN_BDC_FD_05_200ms: ComIPduDirection=RECEIVE, ComIPduHandleId=21, ComIPduType=NORMAL, ComIPduSignalRef=ComISignal_BCAN_BDC_FD_05_200ms_Lamp_IntTailLmpOnReq, ComPduIdRef=Pdu_ISignalIPdu_BCAN_BDC_FD_05_200ms, ComIPduGroupRef=ComIPduGroupRx_WPC_BCAN_PNC141, ComIPduGroupRef=ComIPduGroupRx_WPC_BCAN_PNC153, ComIPduGroupRef=ComIPduGroupRx_WPC_BCAN_PNC32
        ComIPdu_LCAN_L_BDC_FD_IAU_01_00ms: ComIPduDirection=RECEIVE, ComIPduHandleId=22, ComIPduType=NORMAL, ComIPduSignalRef=ComISignal_LCAN_L_BDC_FD_IAU_01_00ms_WPC_NFC_Deselect_Cmd, ComIPduSignalRef=ComISignal_LCAN_L_BDC_FD_IAU_01_00ms_WPC2_NFC_Deselect_Cmd, ComPduIdRef=Pdu_ISignalIPdu_LCAN_L_BDC_FD_IAU_01_00ms, ComIPduGroupRef=ComIPduGroupRx_WPC_LCAN_PNC159, ComIPduGroupRef=ComIPduGroupRx_WPC_LCAN_PNC32
        ComIPdu_LCAN_L_WPC_FD_01_00ms: ComIPduDirection=SEND, ComIPduHandleId=3, ComIPduType=NORMAL, ComIPduSignalGroupRef=ComISignalGroup_MsgGr_E2E_LCAN_L_WPC_FD_01_00ms, ComPduIdRef=Pdu_ISignalIPdu_LCAN_L_WPC_FD_01_00ms, ComIPduGroupRef=ComIPduGroupTx_WPC_LCAN_PNC159, ComIPduGroupRef=ComIPduGroupTx_WPC_LCAN_PNC32
          ComTxIpdu_ComIPdu_LCAN_L_WPC_FD_01_00ms (ComTxIPdu): category=TOOL_CONFIGURED, ComTxIPduUnusedAreasDefault=0, ComMinimumDelayTime=0.02
            ComTxModeTrue_ComTxIpdu_ComIPdu_LCAN_L_WPC_FD_01_00ms (ComTxModeTrue): category=TOOL_CONFIGURED
              ComTxMode_ComTxModeTrue_ComTxIpdu_ComIPdu_LCAN_L_WPC_FD_01_00ms (ComTxMode): category=TOOL_CONFIGURED, ComTxModeNumberOfRepetitions=3, ComTxModeRepetitionPeriod=0.04, ComTxModeMode=DIRECT
        ComIPdu_LCAN_L_BDC_FD_IAU_10_200ms: ComIPduDirection=RECEIVE, ComIPduHandleId=23, ComIPduType=NORMAL, ComIPduSignalRef=ComISignal_LCAN_L_BDC_FD_IAU_10_200ms_BDC_TP_CAN_Sta, ComIPduSignalRef=ComISignal_LCAN_L_BDC_FD_IAU_10_200ms_OPAdv_On_Cmd, ComIPduSignalRef=ComISignal_LCAN_L_BDC_FD_IAU_10_200ms_WPC_Device_On_Cmd, ComPduIdRef=Pdu_ISignalIPdu_LCAN_L_BDC_FD_IAU_10_200ms, ComIPduGroupRef=ComIPduGroupRx_WPC_LCAN_PNC159, ComIPduGroupRef=ComIPduGroupRx_WPC_LCAN_PNC32
        ComIPdu_LCAN_IAU_FD_05_200ms: ComIPduDirection=RECEIVE, ComIPduHandleId=24, ComIPduType=NORMAL, ComIPduSignalRef=ComISignal_LCAN_IAU_FD_05_200ms_IAU_SharedPhnRegStat, ComPduIdRef=Pdu_ISignalIPdu_LCAN_IAU_FD_05_200ms, ComIPduGroupRef=ComIPduGroupRx_WPC_LCAN_PNC159, ComIPduGroupRef=ComIPduGroupRx_WPC_LCAN_PNC32
        ComIPdu_LCAN_IAU_FD_04_200ms: ComIPduDirection=RECEIVE, ComIPduHandleId=25, ComIPduType=NORMAL, ComIPduSignalRef=ComISignal_LCAN_IAU_FD_04_200ms_IAU_OwnerPhnRegRVal, ComIPduSignalRef=ComISignal_LCAN_IAU_FD_04_200ms_IAU_DKOwnerSwapOption, ComPduIdRef=Pdu_ISignalIPdu_LCAN_IAU_FD_04_200ms, ComIPduGroupRef=ComIPduGroupRx_WPC_LCAN_PNC159, ComIPduGroupRef=ComIPduGroupRx_WPC_LCAN_PNC32
        ComIPdu_LCAN_L_WPC_FD_20_200ms: ComIPduDirection=SEND, ComIPduHandleId=7, ComIPduType=NORMAL, ComIPduSignalGroupRef=ComISignalGroup_MsgGr_E2E_LCAN_L_WPC_FD_20_200ms, ComPduIdRef=Pdu_ISignalIPdu_LCAN_L_WPC_FD_20_200ms, ComIPduGroupRef=ComIPduGroupTx_WPC_LCAN_PNC159, ComIPduGroupRef=ComIPduGroupTx_WPC_LCAN_PNC32
          ComTxIpdu_ComIPdu_LCAN_L_WPC_FD_20_200ms (ComTxIPdu): category=TOOL_CONFIGURED, ComTxIPduUnusedAreasDefault=0, ComMinimumDelayTime=0.02
            ComTxModeTrue_ComTxIpdu_ComIPdu_LCAN_L_WPC_FD_20_200ms (ComTxModeTrue): category=TOOL_CONFIGURED
              ComTxMode_ComTxModeTrue_ComTxIpdu_ComIPdu_LCAN_L_WPC_FD_20_200ms (ComTxMode):
                category = TOOL_CONFIGURED
                ComTxModeTimeOffset = 0.0
                ComTxModeTimePeriod = 0.2
                ComTxModeNumberOfRepetitions = 3
                ComTxModeRepetitionPeriod = 0.04
                ComTxModeMode = MIXED
        ComIPdu_LCAN_CCU_01_00ms: ComIPduDirection=RECEIVE, ComIPduHandleId=26, ComIPduType=NORMAL, ComIPduSignalRef=ComISignal_LCAN_CCU_01_00ms_CCU_ForcedPowerOffReq, ComPduIdRef=Pdu_ISignalIPdu_LCAN_CCU_01_00ms, ComIPduGroupRef=ComIPduGroupRx_WPC_LCAN_PNC159, ComIPduGroupRef=ComIPduGroupRx_WPC_LCAN_PNC32
        ComIPdu_LCAN_L_TP_L_WPC_FD_BDC_FD: ComIPduDirection=SEND, ComIPduHandleId=0, ComIPduType=TP, ComIPduSignalRef=ComISignal_LCAN_L_TP_L_WPC_FD_BDC_FD_LCAN_L_TP_L_WPC_FD_BDC_FD_signal, ComPduIdRef=Pdu_ISignalIPdu_LCAN_L_TP_L_WPC_FD_BDC_FD, ComIPduGroupRef=ComIPduGroupTx_WPC_LCAN_PNC159, ComIPduGroupRef=ComIPduGroupTx_WPC_LCAN_PNC32
          ComTxIpdu_ComIPdu_LCAN_L_TP_L_WPC_FD_BDC_FD (ComTxIPdu): category=TOOL_CONFIGURED, ComTxIPduUnusedAreasDefault=0, ComMinimumDelayTime=0.02
            ComTxModeTrue_ComTxIpdu_ComIPdu_LCAN_L_TP_L_WPC_FD_BDC_FD (ComTxModeTrue): category=TOOL_CONFIGURED
              ComTxMode_ComTxModeTrue_ComTxIpdu_ComIPdu_LCAN_L_TP_L_WPC_FD_BDC_FD (ComTxMode): category=TOOL_CONFIGURED, ComTxModeNumberOfRepetitions=0, ComTxModeRepetitionPeriod=0.0, ComTxModeMode=DIRECT
        ComIPdu_LCAN_L_TP_BDC_FD_L_WPC_FD: ComIPduDirection=RECEIVE, ComIPduHandleId=27, ComIPduType=TP, ComIPduSignalRef=ComISignal_LCAN_L_TP_BDC_FD_L_WPC_FD_LCAN_L_TP_BDC_FD_L_WPC_FD_signal, ComPduIdRef=Pdu_ISignalIPdu_LCAN_L_TP_BDC_FD_L_WPC_FD, ComIPduGroupRef=ComIPduGroupRx_WPC_LCAN_PNC159, ComIPduGroupRef=ComIPduGroupRx_WPC_LCAN_PNC32
        ComIPdu_Rx_EIRA_CanNm: ComIPduDirection=RECEIVE, ComIPduHandleId=28, ComIPduType=NORMAL, ComIPduSignalRef=ComISignal_Rx_EIRA_CanNm, ComPduIdRef=Pdu_ComMPdu_Rx_EIRA_CanNm
        ComIPdu_Tx_PncVector_BCAN: ComIPduDirection=SEND, ComIPduHandleId=1, ComIPduType=NORMAL, ComIPduSignalRef=ComISignal_Tx_PncVector_BCAN, ComPduIdRef=Pdu_ComMPdu_Tx_PncVector_BCAN
          ComTxIpdu_ComIPdu_Tx_PncVector_BCAN (ComTxIPdu): category=TOOL_CONFIGURED, ComTxIPduUnusedAreasDefault=0, ComMinimumDelayTime=0.02
            ComTxModeTrue_ComTxIpdu_ComIPdu_Tx_PncVector_BCAN (ComTxModeTrue): category=TOOL_CONFIGURED
              ComTxMode_ComTxModeTrue_ComTxIpdu_ComIPdu_Tx_PncVector_BCAN (ComTxMode): category=TOOL_CONFIGURED, ComTxModeMode=NONE
      20 x ComSignal, all with category=TOOL_CONFIGURED:
        ComISignal_BCAN_CLU_01_20ms_CLU_DtntOutSta: ComBitPosition=28, ComBitSize=2, ComSignalEndianness=LITTLE_ENDIAN, ComSignalInitValue=0, ComSignalLength=1, ComSignalType=UINT8, ComTransferProperty=PENDING, ComSigReportIdsMEnable=0, ComHandleId=21, ComTimeout=1.5, ComNotification=Rte_COMCbk_ComISignal_BCAN_CLU_01_20ms_CLU_DtntOutSta, ComSystemTemplateSystemSignalRef=CLU_DtntOutSta
        ComISignal_BCAN_CLU_01_20ms_CLU_RhstaLvlSta: ComBitPosition=43, ComBitSize=5, ComSignalEndianness=LITTLE_ENDIAN, ComSignalInitValue=0, ComSignalLength=1, ComSignalType=UINT8, ComTransferProperty=PENDING, ComSigReportIdsMEnable=0, ComHandleId=22, ComTimeout=1.5, ComRxDataTimeoutAction=SUBSTITUTE, ComTimeoutSubstitutionValue=10, ComNotification=Rte_COMCbk_ComISignal_BCAN_CLU_01_20ms_CLU_RhstaLvlSta, ComTimeoutNotification=Rte_COMCbkRxTOut_ComISignal_BCAN_CLU_01_20ms_CLU_RhstaLvlSta, ComSystemTemplateSystemSignalRef=CLU_RhstaLvlSta
        ComISignal_BCAN_CLU_01_20ms_CLU_DisSpdVal_KPH: ComBitPosition=64, ComBitSize=9, ComSignalEndianness=LITTLE_ENDIAN, ComSignalInitValue=0, ComSignalLength=2, ComSignalType=UINT16, ComTransferProperty=PENDING, ComSigReportIdsMEnable=0, ComHandleId=23, ComTimeout=1.5, ComRxDataTimeoutAction=SUBSTITUTE, ComTimeoutSubstitutionValue=255, ComNotification=Rte_COMCbk_ComISignal_BCAN_CLU_01_20ms_CLU_DisSpdVal_KPH, ComTimeoutNotification=Rte_COMCbkRxTOut_ComISignal_BCAN_CLU_01_20ms_CLU_DisSpdVal_KPH, ComSystemTemplateSystemSignalRef=CLU_DisSpdVal_KPH
        ComISignal_BCAN_CLU_01_20ms_CLU_AutoBrightSta: ComBitPosition=79, ComBitSize=8, ComSignalEndianness=LITTLE_ENDIAN, ComSignalInitValue=0, ComSignalLength=1, ComSignalType=UINT8, ComTransferProperty=PENDING, ComSigReportIdsMEnable=0, ComHandleId=24, ComTimeout=1.5, ComNotification=Rte_COMCbk_ComISignal_BCAN_CLU_01_20ms_CLU_AutoBrightSta, ComSystemTemplateSystemSignalRef=CLU_AutoBrightSta
        ComISignal_BCAN_CLU_05_00ms_USM_StaRst1Req: ComBitPosition=34, ComBitSize=2, ComSignalEndianness=LITTLE_ENDIAN, ComSignalInitValue=0, ComSignalLength=1, ComSignalType=UINT8, ComTransferProperty=TRIGGERED_ON_CHANGE, ComSigReportIdsMEnable=0, ComHandleId=3, ComTimeout=0.0, ComNotification=Rte_COMCbk_ComISignal_BCAN_CLU_05_00ms_USM_StaRst1Req, ComSystemTemplateSystemSignalRef=USM_StaRst1Req
        ComISignal_BCAN_CLU_09_00ms_USM_WpcSetReq: ComBitPosition=34, ComBitSize=2, ComSignalEndianness=LITTLE_ENDIAN, ComSignalInitValue=0, ComSignalLength=1, ComSignalType=UINT8, ComTransferProperty=TRIGGERED_ON_CHANGE, ComSigReportIdsMEnable=0, ComHandleId=4, ComTimeout=0.0, ComNotification=Rte_COMCbk_ComISignal_BCAN_CLU_09_00ms_USM_WpcSetReq, ComSystemTemplateSystemSignalRef=USM_WpcSetReq
        ComISignal_BCAN_CLU_20_200ms_CLU_ClusterUSM: ComBitPosition=49, ComBitSize=2, ComSignalEndianness=LITTLE_ENDIAN, ComSignalInitValue=0, ComSignalLength=1, ComSignalType=UINT8, ComTransferProperty=PENDING, ComSigReportIdsMEnable=0, ComHandleId=16, ComTimeout=1.5, ComNotification=Rte_COMCbk_ComISignal_BCAN_CLU_20_200ms_CLU_ClusterUSM, ComSystemTemplateSystemSignalRef=CLU_ClusterUSM
        ComISignal_BCAN_EMS_02_10ms_ENG_EngSta: ComBitPosition=61, ComBitSize=3, ComSignalEndianness=LITTLE_ENDIAN, ComSignalInitValue=0, ComSignalLength=1, ComSignalType=UINT8, ComTransferProperty=PENDING, ComSigReportIdsMEnable=0, ComHandleId=11, ComTimeout=0.5, ComNotification=Rte_COMCbk_ComISignal_BCAN_EMS_02_10ms_ENG_EngSta, ComSystemTemplateSystemSignalRef=ENG_EngSta
        ComISignal_BCAN_EMS_07_10ms_HEV_EngOpSta: ComBitPosition=92, ComBitSize=3, ComSignalEndianness=LITTLE_ENDIAN, ComSignalInitValue=0, ComSignalLength=1, ComSignalType=UINT8, ComTransferProperty=PENDING, ComSigReportIdsMEnable=0, ComHandleId=12, ComTimeout=0.5, ComRxDataTimeoutAction=SUBSTITUTE, ComTimeoutSubstitutionValue=7, ComNotification=Rte_COMCbk_ComISignal_BCAN_EMS_07_10ms_HEV_EngOpSta, ComTimeoutNotification=Rte_COMCbkRxTOut_ComISignal_BCAN_EMS_07_10ms_HEV_EngOpSta, ComSystemTemplateSystemSignalRef=HEV_EngOpSta
        ComISignal_BCAN_HCU_03_10ms_HCU_HevRdySta: ComBitPosition=70, ComBitSize=2, ComSignalEndianness=LITTLE_ENDIAN, ComSignalInitValue=0, ComSignalLength=1, ComSignalType=UINT8, ComTransferProperty=PENDING, ComSigReportIdsMEnable=0, ComHandleId=5, ComTimeout=0.5, ComNotification=Rte_COMCbk_ComISignal_BCAN_HCU_03_10ms_HCU_HevRdySta, ComSystemTemplateSystemSignalRef=HCU_HevRdySta
        ComISignal_BCAN_VCU_01_10ms_VCU_EvDrvRdySta: ComBitPosition=28, ComBitSize=2, ComSignalEndianness=LITTLE_ENDIAN, ComSignalInitValue=0, ComSignalLength=1, ComSignalType=UINT8, ComTransferProperty=PENDING, ComSigReportIdsMEnable=0, ComHandleId=0, ComTimeout=0.5, ComNotification=Rte_COMCbk_ComISignal_BCAN_VCU_01_10ms_VCU_EvDrvRdySta, ComSystemTemplateSystemSignalRef=VCU_EvDrvRdySta
        ComISignal_LCAN_CCU_01_00ms_CCU_ForcedPowerOffReq: ComBitPosition=8, ComBitSize=2, ComSignalEndianness=LITTLE_ENDIAN, ComSignalInitValue=0, ComSignalLength=1, ComSignalType=UINT8, ComTransferProperty=TRIGGERED_ON_CHANGE, ComSigReportIdsMEnable=0, ComHandleId=39, ComTimeout=0.0, ComNotification=Rte_COMCbk_ComISignal_LCAN_CCU_01_00ms_CCU_ForcedPowerOffReq, ComSystemTemplateSystemSignalRef=CCU_ForcedPowerOffReq
        ComISignal_LCAN_L_BDC_FD_IAU_01_00ms_WPC_NFC_Deselect_Cmd: ComBitPosition=24, ComBitSize=2, ComSignalEndianness=LITTLE_ENDIAN, ComSignalInitValue=0, ComSignalLength=1, ComSignalType=UINT8, ComTransferProperty=TRIGGERED_ON_CHANGE, ComSigReportIdsMEnable=0, ComHandleId=31, ComTimeout=0.0, ComNotification=Rte_COMCbk_ComISignal_LCAN_L_BDC_FD_IAU_01_00ms_WPC_NFC_Deselect_Cmd, ComSystemTemplateSystemSignalRef=WPC_NFC_Deselect_Cmd
        ComISignal_LCAN_L_BDC_FD_IAU_10_200ms_BDC_TP_CAN_Sta: ComBitPosition=29, ComBitSize=3, ComSignalEndianness=LITTLE_ENDIAN, ComSignalInitValue=0, ComSignalLength=1, ComSignalType=UINT8, ComTransferProperty=TRIGGERED_ON_CHANGE, ComSigReportIdsMEnable=0, ComHandleId=33, ComTimeout=1.5, ComNotification=Rte_COMCbk_ComISignal_LCAN_L_BDC_FD_IAU_10_200ms_BDC_TP_CAN_Sta, ComSystemTemplateSystemSignalRef=BDC_TP_CAN_Sta
        ComISignal_LCAN_L_BDC_FD_IAU_10_200ms_OPAdv_On_Cmd: ComBitPosition=32, ComBitSize=2, ComSignalEndianness=LITTLE_ENDIAN, ComSignalInitValue=0, ComSignalLength=1, ComSignalType=UINT8, ComTransferProperty=TRIGGERED_ON_CHANGE, ComSigReportIdsMEnable=0, ComHandleId=34, ComTimeout=1.5, ComNotification=Rte_COMCbk_ComISignal_LCAN_L_BDC_FD_IAU_10_200ms_OPAdv_On_Cmd, ComSystemTemplateSystemSignalRef=OPAdv_On_Cmd
        ComISignal_LCAN_L_BDC_FD_IAU_10_200ms_WPC_Device_On_Cmd: ComBitPosition=34, ComBitSize=2, ComSignalEndianness=LITTLE_ENDIAN, ComSignalInitValue=0, ComSignalLength=1, ComSignalType=UINT8, ComTransferProperty=TRIGGERED_ON_CHANGE, ComSigReportIdsMEnable=0, ComHandleId=35, ComTimeout=1.5, ComNotification=Rte_COMCbk_ComISignal_LCAN_L_BDC_FD_IAU_10_200ms_WPC_Device_On_Cmd, ComSystemTemplateSystemSignalRef=WPC_Device_On_Cmd
        ComISignal_LCAN_L_TP_BDC_FD_L_WPC_FD_LCAN_L_TP_BDC_FD_L_WPC_FD_signal: ComBitPosition=0, ComSignalEndianness=opaque, ComSignalInitValue=0 0 0 0 0 0 0 0 0 0 0 0 0 0 0 0 0 0 0 0 0 0 0 0 0 0 0 0 0 0 0 0 0 0 0 0 0 0 0 0 0 0 0 0 0 0 0 0 0 0 0 0 0 0 0 0 0 0 0 0 0 0 0 0 0 0 0 0 0 0 0 0 0 0 0 0 0 0 0 0 0 0 0 0 0 0 0 0 0 0 0 0 0 0 0 0 0 0 0 0 0 0 0 0 0 0 0 0 0 0 0 0 0 0 0 0 0 0 0 0 0 0 0 0 0 0 0 0 0 0 0 0 0 0 0 0 0 0 0 0 0 0 0 0 0 0 0 0 0 0 0 0 0 0 0 0 0 0 0 0 0 0 0 0 0 0 0 0 0 0 0 0 0 0 0 0 0 0 0 0 0 0 0 0 0 0 0 0 0 0 0 0 0 0 0 0 0 0 0 0 0 0 0 0 0 0 0 0 0 0 0 0 0 0 0 0 0 0 0 0 0 0 0 0 0 0 0 0 0 0 0 0 0 0 0 0 0 0 0 0 0 0 0 0 0 0 0 0 0 0 0 0 0 0 0 0 0 0 0 0 0 0 0 0 0 0 0 0 0 0 0 0 0 0 0 0 0 0 0 0 0 0 0 0 0 0 0 0 0 0 0 0 0 0 0 0 0 0 0 0 0 0 0 0 0 0 0 0 0 0 0 0 0 0 0 0 0 0 0 0 0 0 0 0 0 0 0 0 0 0 0 0 0 0 0 0 0 0 0 0 0 0 0 0 0 0 0 0 0 0 0 0 0 0 0 0 0 0 0 0 0 0 0 0 0 0 0 0 0 0 0 0 0 0 0 0 0 0 0 0 0 0 0 0 0 0 0 0 0 0 0 0 0 0 0 0 0 0 0 0 0 0 0 0 0 0 0 0 0 0 0 0 0 0 0 0 0 0 0 0 0 0 0 0 0 0 0 0 0 0 0 0 0 0 0 0 0 0 0 0 0 0 0 0 0 0 0 0 0 0 0 0 0 0 0 0 0 0 0 0 0 0 0 0 0 0 0 0 0 0 0 0 0 0 0 0 0 0 0 0 0 0 0 0 0 0 0 0 0 0 0 0 0 0 0 0 0 0 0 0 0 0 0 0 0 0 0 0 0 0 0 0, ComSignalLength=512, ComSignalType=UINT8_DYN, ComTransferProperty=TRIGGERED_WITHOUT_REPETITION, ComSigReportIdsMEnable=0, ComHandleId=40, ComTimeout=0.0, ComNotification=Rte_COMCbk_ComISignal_LCAN_L_TP_BDC_FD_L_WPC_FD_LCAN_L_TP_BDC_FD_L_WPC_FD_signal, ComSystemTemplateSystemSignalRef=LCAN_L_TP_BDC_FD_L_WPC_FD_signal
        ComISignal_LCAN_L_TP_L_WPC_FD_BDC_FD_LCAN_L_TP_L_WPC_FD_BDC_FD_signal: ComBitPosition=0, ComSignalEndianness=opaque, ComSignalInitValue=0 0 0 0 0 0 0 0 0 0 0 0 0 0 0 0 0 0 0 0 0 0 0 0 0 0 0 0 0 0 0 0 0 0 0 0 0 0 0 0 0 0 0 0 0 0 0 0 0 0 0 0 0 0 0 0 0 0 0 0 0 0 0 0 0 0 0 0 0 0 0 0 0 0 0 0 0 0 0 0 0 0 0 0 0 0 0 0 0 0 0 0 0 0 0 0 0 0 0 0 0 0 0 0 0 0 0 0 0 0 0 0 0 0 0 0 0 0 0 0 0 0 0 0 0 0 0 0 0 0 0 0 0 0 0 0 0 0 0 0 0 0 0 0 0 0 0 0 0 0 0 0 0 0 0 0 0 0 0 0 0 0 0 0 0 0 0 0 0 0 0 0 0 0 0 0 0 0 0 0 0 0 0 0 0 0 0 0 0 0 0 0 0 0 0 0 0 0 0 0 0 0 0 0 0 0 0 0 0 0 0 0 0 0 0 0 0 0 0 0 0 0 0 0 0 0 0 0 0 0 0 0 0 0 0 0 0 0 0 0 0 0 0 0 0 0 0 0 0 0 0 0 0 0 0 0 0 0 0 0 0 0 0 0 0 0 0 0 0 0 0 0 0 0 0 0 0 0 0 0 0 0 0 0 0 0 0 0 0 0 0 0 0 0 0 0 0 0 0 0 0 0 0 0 0 0 0 0 0 0 0 0 0 0 0 0 0 0 0 0 0 0 0 0 0 0 0 0 0 0 0 0 0 0 0 0 0 0 0 0 0 0 0 0 0 0 0 0 0 0 0 0 0 0 0 0 0 0 0 0 0 0 0 0 0 0 0 0 0 0 0 0 0 0 0 0 0 0 0 0 0 0 0 0 0 0 0 0 0 0 0 0 0 0 0 0 0 0 0 0 0 0 0 0 0 0 0 0 0 0 0 0 0 0 0 0 0 0 0 0 0 0 0 0 0 0 0 0 0 0 0 0 0 0 0 0 0 0 0 0 0 0 0 0 0 0 0 0 0 0 0 0 0 0 0 0 0 0 0 0 0 0 0 0 0 0 0 0 0 0 0 0 0 0 0 0 0 0 0 0 0 0 0 0 0 0 0 0 0 0 0 0 0 0 0 0 0 0 0 0 0 0 0 0 0 0 0 0 0 0 0 0, ComSignalLength=512, ComSignalType=UINT8_DYN, ComTransferProperty=TRIGGERED_WITHOUT_REPETITION, ComSigReportIdsMEnable=0, ComHandleId=0, ComSystemTemplateSystemSignalRef=LCAN_L_TP_L_WPC_FD_BDC_FD_signal
        ComISignal_Rx_EIRA_CanNm: ComBitPosition=0, ComHandleId=41, ComSignalEndianness=opaque, ComSignalInitValue=0, ComSignalType=UINT8_N, ComTransferProperty=PENDING, ComNotification=ComM_COMCbk_ComISignal_Rx_EIRA_CanNm, ComSignalLength=28, ComSystemTemplateSystemSignalRef=PNI_SHVU_CCS_FD_3
        ComISignal_Tx_PncVector_BCAN: ComBitPosition=0, ComHandleId=1, ComSignalEndianness=opaque, ComSignalInitValue=0, ComSignalType=UINT8_N, ComTransferProperty=PENDING, ComSignalLength=28, ComSystemTemplateSystemSignalRef=PNI_WPC_FD_3
      4 x ComSignalGroup, all with category=TOOL_CONFIGURED, ComSignalGroupArrayAccess=1, ComTransferProperty=TRIGGERED_ON_CHANGE:
        ComISignalGroup_MsgGr_E2E_BCAN_WPC_FD_01_200ms: ComHandleId=5, ComSystemTemplateSignalGroupRef=MsgGr_BCAN_WPC_FD_01_200ms
          12 x ComGroupSignal, all with category=TOOL_CONFIGURED, ComSignalEndianness=LITTLE_ENDIAN:
            BCAN_WPC_FD_01_200ms_WPC_FD_Crc1Val: ComBitPosition=0, ComTransferProperty=TRIGGERED_ON_CHANGE, ComSignalInitValue=65535, ComBitSize=16, ComSignalLength=2, ComSignalType=UINT16, ComHandleId=119, ComSystemTemplateSystemSignalRef=WPC_FD_Crc1Val
            BCAN_WPC_FD_01_200ms_WPC_FD_AlvCnt1Val: ComBitPosition=16, ComTransferProperty=TRIGGERED_ON_CHANGE, ComSignalInitValue=0, ComBitSize=8, ComSignalLength=1, ComSignalType=UINT8, ComHandleId=120, ComSystemTemplateSystemSignalRef=WPC_FD_AlvCnt1Val
            BCAN_WPC_FD_01_200ms_WPC_FD_01_200ms_E2EReserved: ComBitPosition=120, ComSignalInitValue=0, ComBitSize=8, ComSignalLength=1, ComSignalType=UINT8, ComHandleId=130, ComSystemTemplateSystemSignalRef=WPC_FD_01_200ms_E2EReserved
            BCAN_WPC_FD_01_200ms_USM_CmdWPCSta: ComBitPosition=64, ComTransferProperty=TRIGGERED_ON_CHANGE, ComSignalInitValue=0, ComBitSize=2, ComSignalLength=1, ComSignalType=UINT8, ComHandleId=121, ComSystemTemplateSystemSignalRef=USM_CmdWPCSta
            BCAN_WPC_FD_01_200ms_WPC_PhnLftWrngSta: ComBitPosition=66, ComTransferProperty=TRIGGERED_ON_CHANGE, ComSignalInitValue=0, ComBitSize=3, ComSignalLength=1, ComSignalType=UINT8, ComHandleId=122, ComSystemTemplateSystemSignalRef=WPC_PhnLftWrngSta
            BCAN_WPC_FD_01_200ms_WPC_DualWPCOptSta: ComBitPosition=76, ComTransferProperty=TRIGGERED_ON_CHANGE, ComSignalInitValue=0, ComBitSize=2, ComSignalLength=1, ComSignalType=UINT8, ComHandleId=123, ComSystemTemplateSystemSignalRef=WPC_DualWPCOptSta
            BCAN_WPC_FD_01_200ms_WPC_SWVerMajor1: ComBitPosition=80, ComTransferProperty=TRIGGERED_ON_CHANGE, ComSignalInitValue=0, ComBitSize=7, ComSignalLength=1, ComSignalType=UINT8, ComHandleId=124, ComSystemTemplateSystemSignalRef=WPC_SWVerMajor1
            BCAN_WPC_FD_01_200ms_WPC_SWVerMinor1: ComBitPosition=88, ComTransferProperty=TRIGGERED_ON_CHANGE, ComSignalInitValue=0, ComBitSize=7, ComSignalLength=1, ComSignalType=UINT8, ComHandleId=125, ComSystemTemplateSystemSignalRef=WPC_SWVerMinor1
            BCAN_WPC_FD_01_200ms_WPC_SWVerMinor2: ComBitPosition=96, ComTransferProperty=TRIGGERED_ON_CHANGE, ComSignalInitValue=0, ComBitSize=7, ComSignalLength=1, ComSignalType=UINT8, ComHandleId=126, ComSystemTemplateSystemSignalRef=WPC_SWVerMinor2
            BCAN_WPC_FD_01_200ms_WPC_IndSyncVal: ComBitPosition=104, ComTransferProperty=TRIGGERED_ON_CHANGE, ComSignalInitValue=0, ComBitSize=3, ComSignalLength=1, ComSignalType=UINT8, ComHandleId=127, ComSystemTemplateSystemSignalRef=WPC_IndSyncVal
            BCAN_WPC_FD_01_200ms_USM_CmdWPCIndSta: ComBitPosition=107, ComTransferProperty=TRIGGERED_ON_CHANGE, ComSignalInitValue=2, ComBitSize=3, ComSignalLength=1, ComSignalType=UINT8, ComHandleId=128, ComSystemTemplateSystemSignalRef=USM_CmdWPCIndSta
            BCAN_WPC_FD_01_200ms_WPC_ResetOpSta: ComBitPosition=110, ComTransferProperty=TRIGGERED_ON_CHANGE, ComSignalInitValue=0, ComBitSize=2, ComSignalLength=1, ComSignalType=UINT8, ComHandleId=129, ComSystemTemplateSystemSignalRef=WPC_ResetOpSta
        ComISignalGroup_MsgGr_E2E_BCAN_WPC_FD_VCRM_01_00ms: ComHandleId=1, ComSystemTemplateSignalGroupRef=MsgGr_BCAN_WPC_FD_VCRM_01_00ms
          16 x ComGroupSignal, all with category=TOOL_CONFIGURED, ComSignalEndianness=LITTLE_ENDIAN:
            BCAN_WPC_FD_VCRM_01_00ms_WPC_FD_VCRM_Crc1Val: ComBitPosition=0, ComTransferProperty=TRIGGERED_ON_CHANGE, ComSignalInitValue=65535, ComBitSize=16, ComSignalLength=2, ComSignalType=UINT16, ComHandleId=74, ComSystemTemplateSystemSignalRef=WPC_FD_VCRM_Crc1Val
            BCAN_WPC_FD_VCRM_01_00ms_WPC_FD_VCRM_AlvCnt1Val: ComBitPosition=16, ComTransferProperty=TRIGGERED_ON_CHANGE, ComSignalInitValue=0, ComBitSize=8, ComSignalLength=1, ComSignalType=UINT8, ComHandleId=75, ComSystemTemplateSystemSignalRef=WPC_FD_VCRM_AlvCnt1Val
            BCAN_WPC_FD_VCRM_01_00ms_WPC_PhnUsingTime: ComBitPosition=24, ComTransferProperty=TRIGGERED_ON_CHANGE, ComSignalInitValue=0, ComBitSize=8, ComSignalLength=1, ComSignalType=UINT8, ComHandleId=76, ComSystemTemplateSystemSignalRef=WPC_PhnUsingTime
            BCAN_WPC_FD_VCRM_01_00ms_WPC_PhnChargingCompleteCnt: ComBitPosition=32, ComTransferProperty=TRIGGERED_ON_CHANGE, ComSignalInitValue=0, ComBitSize=4, ComSignalLength=1, ComSignalType=UINT8, ComHandleId=77, ComSystemTemplateSystemSignalRef=WPC_PhnChargingCompleteCnt
            BCAN_WPC_FD_VCRM_01_00ms_WPC_EPPChargingCnt: ComBitPosition=36, ComTransferProperty=TRIGGERED_ON_CHANGE, ComSignalInitValue=0, ComBitSize=4, ComSignalLength=1, ComSignalType=UINT8, ComHandleId=78, ComSystemTemplateSystemSignalRef=WPC_EPPChargingCnt
            BCAN_WPC_FD_VCRM_01_00ms_WPC_MPPChargingCnt: ComBitPosition=40, ComTransferProperty=TRIGGERED_ON_CHANGE, ComSignalInitValue=0, ComBitSize=4, ComSignalLength=1, ComSignalType=UINT8, ComHandleId=79, ComSystemTemplateSystemSignalRef=WPC_MPPChargingCnt
            BCAN_WPC_FD_VCRM_01_00ms_WPC_DigitalKeyAuth: ComBitPosition=44, ComTransferProperty=TRIGGERED_ON_CHANGE, ComSignalInitValue=0, ComBitSize=1, ComSignalLength=1, ComSignalType=BOOLEAN, ComHandleId=80, ComSystemTemplateSystemSignalRef=WPC_DigitalKeyAuth
            BCAN_WPC_FD_VCRM_01_00ms_WPC_DigitalKeyDevice: ComBitPosition=45, ComTransferProperty=TRIGGERED_ON_CHANGE, ComSignalInitValue=0, ComBitSize=3, ComSignalLength=1, ComSignalType=UINT8, ComHandleId=81, ComSystemTemplateSystemSignalRef=WPC_DigitalKeyDevice
            BCAN_WPC_FD_VCRM_01_00ms_WPC_PhnChargingErrCnt: ComBitPosition=48, ComTransferProperty=TRIGGERED_ON_CHANGE, ComSignalInitValue=0, ComBitSize=6, ComSignalLength=1, ComSignalType=UINT8, ComHandleId=82, ComSystemTemplateSystemSignalRef=WPC_PhnChargingErrCnt
            BCAN_WPC_FD_VCRM_01_00ms_WPC_ThermalSnsrMaxTemp: ComBitPosition=54, ComTransferProperty=TRIGGERED_ON_CHANGE, ComSignalInitValue=0, ComBitSize=8, ComSignalLength=1, ComSignalType=UINT8, ComHandleId=83, ComSystemTemplateSystemSignalRef=WPC_ThermalSnsrMaxTemp
            BCAN_WPC_FD_VCRM_01_00ms_WPC_CANBusOffDTC: ComBitPosition=62, ComTransferProperty=TRIGGERED_ON_CHANGE, ComSignalInitValue=0, ComBitSize=2, ComSignalLength=1, ComSignalType=UINT8, ComHandleId=84, ComSystemTemplateSystemSignalRef=WPC_CANBusOffDTC
            BCAN_WPC_FD_VCRM_01_00ms_WPC_LocalCANBusOffDTC: ComBitPosition=64, ComTransferProperty=TRIGGERED_ON_CHANGE, ComSignalInitValue=0, ComBitSize=2, ComSignalLength=1, ComSignalType=UINT8, ComHandleId=85, ComSystemTemplateSystemSignalRef=WPC_LocalCANBusOffDTC
            BCAN_WPC_FD_VCRM_01_00ms_WPC_TempSnsrFltDTC: ComBitPosition=66, ComTransferProperty=TRIGGERED_ON_CHANGE, ComSignalInitValue=0, ComBitSize=2, ComSignalLength=1, ComSignalType=UINT8, ComHandleId=86, ComSystemTemplateSystemSignalRef=WPC_TempSnsrFltDTC
            BCAN_WPC_FD_VCRM_01_00ms_WPC_FANFltDTC: ComBitPosition=68, ComTransferProperty=TRIGGERED_ON_CHANGE, ComSignalInitValue=0, ComBitSize=2, ComSignalLength=1, ComSignalType=UINT8, ComHandleId=87, ComSystemTemplateSystemSignalRef=WPC_FANFltDTC
            BCAN_WPC_FD_VCRM_01_00ms_WPC_InternalECUErrDTC: ComBitPosition=70, ComTransferProperty=TRIGGERED_ON_CHANGE, ComSignalInitValue=0, ComBitSize=2, ComSignalLength=1, ComSignalType=UINT8, ComHandleId=88, ComSystemTemplateSystemSignalRef=WPC_InternalECUErrDTC
            BCAN_WPC_FD_VCRM_01_00ms_WPC_FD_VCRM_01_00ms_E2EReserved: ComBitPosition=120, ComSignalInitValue=0, ComBitSize=8, ComSignalLength=1, ComSignalType=UINT8, ComHandleId=89, ComSystemTemplateSystemSignalRef=WPC_FD_VCRM_01_00ms_E2EReserved
        ComISignalGroup_MsgGr_E2E_LCAN_L_WPC_FD_01_00ms: ComHandleId=0, ComSystemTemplateSignalGroupRef=MsgGr_LCAN_L_WPC_FD_01_00ms
          7 x ComGroupSignal, all with category=TOOL_CONFIGURED, ComSignalEndianness=LITTLE_ENDIAN:
            LCAN_L_WPC_FD_01_00ms_L_WPC_FD_Crc1Val: ComBitPosition=0, ComTransferProperty=TRIGGERED_ON_CHANGE, ComSignalInitValue=65535, ComBitSize=16, ComSignalLength=2, ComSignalType=UINT16, ComHandleId=67, ComSystemTemplateSystemSignalRef=L_WPC_FD_Crc1Val
            LCAN_L_WPC_FD_01_00ms_L_WPC_FD_AlvCnt1Val: ComBitPosition=16, ComTransferProperty=TRIGGERED_ON_CHANGE, ComSignalInitValue=0, ComBitSize=8, ComSignalLength=1, ComSignalType=UINT8, ComHandleId=68, ComSystemTemplateSystemSignalRef=L_WPC_FD_AlvCnt1Val
            LCAN_L_WPC_FD_01_00ms_WPC_NFCDetection_Sta: ComBitPosition=24, ComTransferProperty=TRIGGERED_ON_CHANGE, ComSignalInitValue=0, ComBitSize=2, ComSignalLength=1, ComSignalType=UINT8, ComHandleId=69, ComSystemTemplateSystemSignalRef=WPC_NFCDetection_Sta
            LCAN_L_WPC_FD_01_00ms_WPC_NFCReset_Sta: ComBitPosition=26, ComTransferProperty=TRIGGERED_ON_CHANGE, ComSignalInitValue=0, ComBitSize=1, ComSignalLength=1, ComSignalType=BOOLEAN, ComHandleId=70, ComSystemTemplateSystemSignalRef=WPC_NFCReset_Sta
            LCAN_L_WPC_FD_01_00ms_L_WPC_FD_01_00ms_E2EReserved: ComBitPosition=56, ComSignalInitValue=0, ComBitSize=8, ComSignalLength=1, ComSignalType=UINT8, ComHandleId=73, ComSystemTemplateSystemSignalRef=L_WPC_FD_01_00ms_E2EReserved
            LCAN_L_WPC_FD_01_00ms_WPC2_NFCDetection_Sta: ComBitPosition=27, ComTransferProperty=TRIGGERED_ON_CHANGE, ComSignalInitValue=0, ComBitSize=2, ComSignalLength=1, ComSignalType=UINT8, ComHandleId=71, ComSystemTemplateSystemSignalRef=WPC2_NFCDetection_Sta
            LCAN_L_WPC_FD_01_00ms_WPC2_NFCReset_Sta: ComBitPosition=29, ComTransferProperty=TRIGGERED_ON_CHANGE, ComSignalInitValue=0, ComBitSize=1, ComSignalLength=1, ComSignalType=BOOLEAN, ComHandleId=72, ComSystemTemplateSystemSignalRef=WPC2_NFCReset_Sta
        ComISignalGroup_MsgGr_E2E_LCAN_L_WPC_FD_20_200ms: ComHandleId=3, ComSystemTemplateSignalGroupRef=MsgGr_LCAN_L_WPC_FD_20_200ms
          6 x ComGroupSignal, all with category=TOOL_CONFIGURED, ComSignalEndianness=LITTLE_ENDIAN:
            LCAN_L_WPC_FD_20_200ms_L_WPC_FD_Crc20Val: ComBitPosition=0, ComTransferProperty=TRIGGERED_ON_CHANGE, ComSignalInitValue=65535, ComBitSize=16, ComSignalLength=2, ComSignalType=UINT16, ComHandleId=102, ComSystemTemplateSystemSignalRef=L_WPC_FD_Crc20Val
            LCAN_L_WPC_FD_20_200ms_L_WPC_FD_AlvCnt20Val: ComBitPosition=16, ComTransferProperty=TRIGGERED_ON_CHANGE, ComSignalInitValue=0, ComBitSize=8, ComSignalLength=1, ComSignalType=UINT8, ComHandleId=103, ComSystemTemplateSystemSignalRef=L_WPC_FD_AlvCnt20Val
            LCAN_L_WPC_FD_20_200ms_WPC_Status: ComBitPosition=24, ComTransferProperty=TRIGGERED_ON_CHANGE, ComSignalInitValue=0, ComBitSize=3, ComSignalLength=1, ComSignalType=UINT8, ComHandleId=104, ComSystemTemplateSystemSignalRef=WPC_Status
            LCAN_L_WPC_FD_20_200ms_WPC_NFC_Opt: ComBitPosition=32, ComTransferProperty=TRIGGERED_ON_CHANGE, ComSignalInitValue=0, ComBitSize=2, ComSignalLength=1, ComSignalType=UINT8, ComHandleId=106, ComSystemTemplateSystemSignalRef=WPC_NFC_Opt
            LCAN_L_WPC_FD_20_200ms_L_WPC_FD_20_200ms_E2EReserved: ComBitPosition=56, ComSignalInitValue=0, ComBitSize=8, ComSignalLength=1, ComSignalType=UINT8, ComHandleId=107, ComSystemTemplateSystemSignalRef=L_WPC_FD_20_200ms_E2EReserved
            LCAN_L_WPC_FD_20_200ms_WPC2_Status: ComBitPosition=27, ComTransferProperty=TRIGGERED_ON_CHANGE, ComSignalInitValue=0, ComBitSize=3, ComSignalLength=1, ComSignalType=UINT8, ComHandleId=105, ComSystemTemplateSystemSignalRef=WPC2_Status
      4 x ComIPduGroup, all with category=TOOL_CONFIGURED:
        ComIPduGroupRx_WPC_BCAN_PNC153: ComIPduGroupHandleId=2
        ComIPduGroupTx_WPC_BCAN_PNC153: ComIPduGroupHandleId=3
        ComIPduGroupRx_WPC_BCAN_PNC32: ComIPduGroupHandleId=4
        ComIPduGroupTx_WPC_BCAN_PNC32: ComIPduGroupHandleId=5
      ComIPdu_LCAN_PDC_FD_15_300ms (ComIPdu):
        category = TOOL_CONFIGURED
        ComIPduDirection = RECEIVE
        ComIPduHandleId = 29
        ComIPduType = NORMAL
        ComIPduSignalProcessing = DEFERRED
        ComIPduSignalGroupRef = ComISignalGroup_MsgGr_E2E_LCAN_PDC_FD_15_300ms
        ComPduIdRef = Pdu_ISignalIPdu_LCAN_PDC_FD_15_300ms
        ComIPduGroupRef = ComIPduGroupRx_WPC_LCAN_PNC159
        ComIPduGroupRef = ComIPduGroupRx_WPC_LCAN_PNC32
      ComISignal_LCAN_L_BDC_FD_IAU_01_00ms_WPC2_NFC_Deselect_Cmd (ComSignal):
        category = TOOL_CONFIGURED
        ComBitPosition = 26
        ComBitSize = 2
        ComSignalEndianness = LITTLE_ENDIAN
        ComSignalInitValue = 0
        ComSignalLength = 1
        ComSignalType = UINT8
        ComTransferProperty = TRIGGERED_ON_CHANGE
        ComSigReportIdsMEnable = 0
        ComHandleId = 32
        ComTimeout = 0.0
        ComNotification = Rte_COMCbk_ComISignal_LCAN_L_BDC_FD_IAU_01_00ms_WPC2_NFC_Deselect_Cmd
        ComSystemTemplateSystemSignalRef = WPC2_NFC_Deselect_Cmd
      ComISignalGroup_MsgGr_E2E_LCAN_PDC_FD_15_300ms (ComSignalGroup):
        category = TOOL_CONFIGURED
        ComHandleId = 0
        ComSignalGroupArrayAccess = 1
        ComTimeout = 1.5
        ComTransferProperty = TRIGGERED_ON_CHANGE
        ComSystemTemplateSignalGroupRef = MsgGr_LCAN_PDC_FD_15_300ms
        5 x ComGroupSignal, all with category=TOOL_CONFIGURED, ComSignalEndianness=LITTLE_ENDIAN:
          LCAN_PDC_FD_15_300ms_PDC_FD_Crc15Val: ComBitPosition=0, ComTransferProperty=TRIGGERED_ON_CHANGE, ComSignalInitValue=65535, ComBitSize=16, ComSignalLength=2, ComSignalType=UINT16, ComHandleId=43, ComSystemTemplateSystemSignalRef=PDC_FD_Crc15Val
          LCAN_PDC_FD_15_300ms_PDC_FD_AlvCnt15Val: ComBitPosition=16, ComTransferProperty=TRIGGERED_ON_CHANGE, ComSignalInitValue=0, ComBitSize=8, ComSignalLength=1, ComSignalType=UINT8, ComHandleId=44, ComSystemTemplateSystemSignalRef=PDC_FD_AlvCnt15Val
          LCAN_PDC_FD_15_300ms_PDC_FD_15_300ms_E2EReserved: ComBitPosition=248, ComSignalInitValue=0, ComBitSize=8, ComSignalLength=1, ComSignalType=UINT8, ComHandleId=47, ComSystemTemplateSystemSignalRef=PDC_FD_15_300ms_E2EReserved
          LCAN_PDC_FD_15_300ms_PDC_ResetPreWrngForOthers: ComBitPosition=42, ComTransferProperty=TRIGGERED_ON_CHANGE, ComSignalInitValue=0, ComBitSize=2, ComSignalLength=1, ComSignalType=UINT8, ComHandleId=45, ComSystemTemplateSystemSignalRef=PDC_ResetPreWrngForOthers
          LCAN_PDC_FD_15_300ms_PDC_ResetReqForOthers: ComBitPosition=46, ComTransferProperty=TRIGGERED_ON_CHANGE, ComSignalInitValue=0, ComBitSize=2, ComSignalLength=1, ComSignalType=UINT8, ComHandleId=46, ComSystemTemplateSystemSignalRef=PDC_ResetReqForOthers
      ComIPduGroupRx_WPC_LCAN_PNC159 (ComIPduGroup): category=TOOL_CONFIGURED, ComIPduGroupHandleId=6
      ComIPduGroupTx_WPC_LCAN_PNC159 (ComIPduGroup): category=TOOL_CONFIGURED, ComIPduGroupHandleId=7
      ComIPdu_Tx_PncVector_LCAN (ComIPdu):
        category = TOOL_CONFIGURED
        ComIPduDirection = SEND
        ComIPduHandleId = 2
        ComIPduSignalProcessing = DEFERRED
        ComIPduType = NORMAL
        ComIPduSignalRef = ComISignal_Tx_PncVector_LCAN
        ComPduIdRef = Pdu_ComMPdu_Tx_PncVector_LCAN
        ComTxIpdu_ComIPdu_Tx_PncVector_LCAN (ComTxIPdu): category=TOOL_CONFIGURED, ComTxIPduUnusedAreasDefault=0, ComMinimumDelayTime=0.02
          ComTxModeTrue_ComTxIpdu_ComIPdu_Tx_PncVector_LCAN (ComTxModeTrue): category=TOOL_CONFIGURED
            ComTxMode_ComTxModeTrue_ComTxIpdu_ComIPdu_Tx_PncVector_LCAN (ComTxMode): category=TOOL_CONFIGURED, ComTxModeMode=NONE
      ComISignal_Tx_PncVector_LCAN (ComSignal):
        category = TOOL_CONFIGURED
        ComBitPosition = 0
        ComHandleId = 2
        ComSignalEndianness = opaque
        ComSignalInitValue = 0
        ComSignalType = UINT8_N
        ComTransferProperty = PENDING
        ComSignalLength = 28
        ComSystemTemplateSystemSignalRef = PNI_L_WPC_FD_3
      ComIPduGroupRx_WPC_LCAN_PNC32 (ComIPduGroup): category=TOOL_CONFIGURED, ComIPduGroupHandleId=8
      ComIPduGroupTx_WPC_LCAN_PNC32 (ComIPduGroup): category=TOOL_CONFIGURED, ComIPduGroupHandleId=9
      ComIPdu_BCAN_PDC_FD_15_300ms (ComIPdu):
        category = TOOL_CONFIGURED
        ComIPduDirection = RECEIVE
        ComIPduHandleId = 30
        ComIPduType = NORMAL
        ComIPduSignalProcessing = DEFERRED
        ComIPduSignalGroupRef = ComISignalGroup_MsgGr_E2E_BCAN_PDC_FD_15_300ms
        ComPduIdRef = Pdu_ISignalIPdu_BCAN_PDC_FD_15_300ms
        ComIPduGroupRef = ComIPduGroupRx_WPC_BCAN_PNC141
        ComIPduGroupRef = ComIPduGroupRx_WPC_BCAN_PNC153
        ComIPduGroupRef = ComIPduGroupRx_WPC_BCAN_PNC32
      ComIPdu_BCAN_HU_USM_04_00ms (ComIPdu):
        category = TOOL_CONFIGURED
        ComIPduDirection = RECEIVE
        ComIPduHandleId = 31
        ComIPduType = NORMAL
        ComIPduSignalProcessing = DEFERRED
        ComIPduSignalRef = ComISignal_BCAN_HU_USM_04_00ms_CF_Gway_WPC2_NValueSet
        ComPduIdRef = Pdu_ISignalIPdu_BCAN_HU_USM_04_00ms
        ComIPduGroupRef = ComIPduGroupRx_WPC_BCAN_PNC141
        ComIPduGroupRef = ComIPduGroupRx_WPC_BCAN_PNC153
        ComIPduGroupRef = ComIPduGroupRx_WPC_BCAN_PNC32
      ComISignalGroup_MsgGr_E2E_BCAN_PDC_FD_15_300ms (ComSignalGroup):
        category = TOOL_CONFIGURED
        ComHandleId = 1
        ComSignalGroupArrayAccess = 1
        ComTimeout = 1.5
        ComTransferProperty = TRIGGERED_ON_CHANGE
        ComNotification = Rte_COMCbk_ComISignalGroup_MsgGr_E2E_BCAN_PDC_FD_15_300ms
        ComSystemTemplateSignalGroupRef = MsgGr_BCAN_PDC_FD_15_300ms
        6 x ComGroupSignal, all with category=TOOL_CONFIGURED, ComSignalEndianness=LITTLE_ENDIAN:
          BCAN_PDC_FD_15_300ms_PDC_FD_Crc15Val: ComBitPosition=0, ComTransferProperty=TRIGGERED_ON_CHANGE, ComSignalInitValue=65535, ComBitSize=16, ComSignalLength=2, ComSignalType=UINT16, ComHandleId=48, ComSystemTemplateSystemSignalRef=PDC_FD_Crc15Val
          BCAN_PDC_FD_15_300ms_PDC_FD_AlvCnt15Val: ComBitPosition=16, ComTransferProperty=TRIGGERED_ON_CHANGE, ComSignalInitValue=0, ComBitSize=8, ComSignalLength=1, ComSignalType=UINT8, ComHandleId=49, ComSystemTemplateSystemSignalRef=PDC_FD_AlvCnt15Val
          BCAN_PDC_FD_15_300ms_PDC_FD_15_300ms_E2EReserved: ComBitPosition=248, ComSignalInitValue=0, ComBitSize=8, ComSignalLength=1, ComSignalType=UINT8, ComHandleId=53, ComSystemTemplateSystemSignalRef=PDC_FD_15_300ms_E2EReserved
          BCAN_PDC_FD_15_300ms_PDC_ResetPreWrngForOthers: ComBitPosition=42, ComTransferProperty=TRIGGERED_ON_CHANGE, ComSignalInitValue=0, ComBitSize=2, ComSignalLength=1, ComSignalType=UINT8, ComHandleId=50, ComSystemTemplateSystemSignalRef=PDC_ResetPreWrngForOthers
          BCAN_PDC_FD_15_300ms_PDC_ResetReqForOthers: ComBitPosition=46, ComTransferProperty=TRIGGERED_ON_CHANGE, ComSignalInitValue=0, ComBitSize=2, ComSignalLength=1, ComSignalType=UINT8, ComHandleId=51, ComSystemTemplateSystemSignalRef=PDC_ResetReqForOthers
          BCAN_PDC_FD_15_300ms_PDC_ResetFuncOpt: ComBitPosition=48, ComTransferProperty=TRIGGERED_ON_CHANGE, ComSignalInitValue=0, ComBitSize=2, ComSignalLength=1, ComSignalType=UINT8, ComHandleId=52, ComSystemTemplateSystemSignalRef=PDC_ResetFuncOpt
      ComISignalGroup_MsgGr_E2E_BCAN_WPC2_FD_01_200ms (ComSignalGroup):
        category = TOOL_CONFIGURED
        ComHandleId = 4
        ComSignalGroupArrayAccess = 1
        ComTransferProperty = TRIGGERED_ON_CHANGE
        ComSystemTemplateSignalGroupRef = MsgGr_BCAN_WPC2_FD_01_200ms
        11 x ComGroupSignal, all with category=TOOL_CONFIGURED, ComSignalEndianness=LITTLE_ENDIAN:
          BCAN_WPC2_FD_01_200ms_WPC2_FD_Crc1Val: ComBitPosition=0, ComTransferProperty=TRIGGERED_ON_CHANGE, ComSignalInitValue=65535, ComBitSize=16, ComSignalLength=2, ComSignalType=UINT16, ComHandleId=108, ComSystemTemplateSystemSignalRef=WPC2_FD_Crc1Val
          BCAN_WPC2_FD_01_200ms_WPC2_FD_AlvCnt1Val: ComBitPosition=16, ComTransferProperty=TRIGGERED_ON_CHANGE, ComSignalInitValue=0, ComBitSize=8, ComSignalLength=1, ComSignalType=UINT8, ComHandleId=109, ComSystemTemplateSystemSignalRef=WPC2_FD_AlvCnt1Val
          BCAN_WPC2_FD_01_200ms_WPC2_FD_01_200ms_E2EReserved: ComBitPosition=120, ComSignalInitValue=0, ComBitSize=8, ComSignalLength=1, ComSignalType=UINT8, ComHandleId=118, ComSystemTemplateSystemSignalRef=WPC2_FD_01_200ms_E2EReserved
          BCAN_WPC2_FD_01_200ms_USM_CmdWPC2Sta: ComBitPosition=64, ComTransferProperty=TRIGGERED_ON_CHANGE, ComSignalInitValue=0, ComBitSize=2, ComSignalLength=1, ComSignalType=UINT8, ComHandleId=110, ComSystemTemplateSystemSignalRef=USM_CmdWPC2Sta
          BCAN_WPC2_FD_01_200ms_WPC2_PhnLftWrngSta: ComBitPosition=66, ComTransferProperty=TRIGGERED_ON_CHANGE, ComSignalInitValue=0, ComBitSize=3, ComSignalLength=1, ComSignalType=UINT8, ComHandleId=111, ComSystemTemplateSystemSignalRef=WPC2_PhnLftWrngSta
          BCAN_WPC2_FD_01_200ms_WPC2_OptSta: ComBitPosition=76, ComTransferProperty=TRIGGERED_ON_CHANGE, ComSignalInitValue=0, ComBitSize=2, ComSignalLength=1, ComSignalType=UINT8, ComHandleId=112, ComSystemTemplateSystemSignalRef=WPC2_OptSta
          BCAN_WPC2_FD_01_200ms_WPC2_SWVerMajor1: ComBitPosition=80, ComTransferProperty=TRIGGERED_ON_CHANGE, ComSignalInitValue=0, ComBitSize=7, ComSignalLength=1, ComSignalType=UINT8, ComHandleId=113, ComSystemTemplateSystemSignalRef=WPC2_SWVerMajor1
          BCAN_WPC2_FD_01_200ms_WPC2_SWVerMinor1: ComBitPosition=88, ComTransferProperty=TRIGGERED_ON_CHANGE, ComSignalInitValue=0, ComBitSize=7, ComSignalLength=1, ComSignalType=UINT8, ComHandleId=114, ComSystemTemplateSystemSignalRef=WPC2_SWVerMinor1
          BCAN_WPC2_FD_01_200ms_WPC2_SWVerMinor2: ComBitPosition=96, ComTransferProperty=TRIGGERED_ON_CHANGE, ComSignalInitValue=0, ComBitSize=7, ComSignalLength=1, ComSignalType=UINT8, ComHandleId=115, ComSystemTemplateSystemSignalRef=WPC2_SWVerMinor2
          BCAN_WPC2_FD_01_200ms_WPC2_IndSyncVal: ComBitPosition=104, ComTransferProperty=TRIGGERED_ON_CHANGE, ComSignalInitValue=0, ComBitSize=3, ComSignalLength=1, ComSignalType=UINT8, ComHandleId=116, ComSystemTemplateSystemSignalRef=WPC2_IndSyncVal
          BCAN_WPC2_FD_01_200ms_WPC2_ResetOpSta: ComBitPosition=110, ComTransferProperty=TRIGGERED_ON_CHANGE, ComSignalInitValue=0, ComBitSize=2, ComSignalLength=1, ComSignalType=UINT8, ComHandleId=117, ComSystemTemplateSystemSignalRef=WPC2_ResetOpSta
      20 x ComSignal, all with category=TOOL_CONFIGURED, ComSignalEndianness=LITTLE_ENDIAN, ComSignalLength=1, ComSignalType=UINT8, ComTransferProperty=TRIGGERED_ON_CHANGE, ComSigReportIdsMEnable=0:
        ComISignal_BCAN_BDC_FD_02_200ms_BCM_SmkOptTyp: ComBitPosition=42, ComBitSize=2, ComSignalInitValue=0, ComHandleId=29, ComTimeout=1.5, ComNotification=Rte_COMCbk_ComISignal_BCAN_BDC_FD_02_200ms_BCM_SmkOptTyp, ComSystemTemplateSystemSignalRef=BCM_SmkOptTyp
        ComISignal_BCAN_BDC_FD_05_200ms_Lamp_IntTailLmpOnReq: ComBitPosition=62, ComBitSize=2, ComSignalInitValue=0, ComHandleId=30, ComTimeout=1.5, ComNotification=Rte_COMCbk_ComISignal_BCAN_BDC_FD_05_200ms_Lamp_IntTailLmpOnReq, ComSystemTemplateSystemSignalRef=Lamp_IntTailLmpOnReq
        ComISignal_BCAN_BDC_FD_SMK_02_200ms_LFAnt_SrchSta: ComBitPosition=88, ComBitSize=2, ComSignalInitValue=0, ComHandleId=2, ComTimeout=1.5, ComNotification=Rte_COMCbk_ComISignal_BCAN_BDC_FD_SMK_02_200ms_LFAnt_SrchSta, ComSystemTemplateSystemSignalRef=LFAnt_SrchSta
        ComISignal_BCAN_HU_GW_03_200ms_CF_AVN_ProfileIDRValue: ComBitPosition=104, ComBitSize=4, ComSignalInitValue=15, ComHandleId=18, ComTimeout=1.5, ComNotification=Rte_COMCbk_ComISignal_BCAN_HU_GW_03_200ms_CF_AVN_ProfileIDRValue, ComSystemTemplateSystemSignalRef=CF_AVN_ProfileIDRValue
        ComISignal_BCAN_HU_USM_01_00ms_CF_Gway_WPCNValueSet: ComBitPosition=152, ComBitSize=2, ComSignalInitValue=0, ComHandleId=7, ComTimeout=0.0, ComNotification=Rte_COMCbk_ComISignal_BCAN_HU_USM_01_00ms_CF_Gway_WPCNValueSet, ComSystemTemplateSystemSignalRef=CF_Gway_WPCNValueSet
        ComISignal_BCAN_HU_USM_02_00ms_CF_AVN_CluUSMReset: ComBitPosition=126, ComBitSize=2, ComSignalInitValue=0, ComHandleId=6, ComTimeout=0.0, ComNotification=Rte_COMCbk_ComISignal_BCAN_HU_USM_02_00ms_CF_AVN_CluUSMReset, ComSystemTemplateSystemSignalRef=CF_AVN_CluUSMReset
        ComISignal_BCAN_HU_USM_04_00ms_CF_Gway_WPC2_NValueSet: ComBitPosition=245, ComBitSize=2, ComSignalInitValue=0, ComHandleId=42, ComTimeout=0.0, ComNotification=Rte_COMCbk_ComISignal_BCAN_HU_USM_04_00ms_CF_Gway_WPC2_NValueSet, ComSystemTemplateSystemSignalRef=CF_Gway_WPC2_NValueSet
        ComISignal_BCAN_HU_USM_05_00ms_CF_Gway_WPCAnimationNvalueSet: ComBitPosition=168, ComBitSize=3, ComSignalInitValue=0, ComHandleId=8, ComTimeout=0.0, ComNotification=Rte_COMCbk_ComISignal_BCAN_HU_USM_05_00ms_CF_Gway_WPCAnimationNvalueSet, ComSystemTemplateSystemSignalRef=CF_Gway_WPCAnimationNvalueSet
        ComISignal_BCAN_IAU_FD_04_200ms_IAU_ProfileIDRVal: ComBitPosition=74, ComBitSize=4, ComSignalInitValue=0, ComHandleId=19, ComTimeout=1.5, ComNotification=Rte_COMCbk_ComISignal_BCAN_IAU_FD_04_200ms_IAU_ProfileIDRVal, ComSystemTemplateSystemSignalRef=IAU_ProfileIDRVal
        ComISignal_BCAN_IAU_FD_04_200ms_IAU_DigitalKey2Opt: ComBitPosition=120, ComBitSize=3, ComSignalInitValue=0, ComHandleId=20, ComTimeout=1.5, ComNotification=Rte_COMCbk_ComISignal_BCAN_IAU_FD_04_200ms_IAU_DigitalKey2Opt, ComSystemTemplateSystemSignalRef=IAU_DigitalKey2Opt
        ComISignal_BCAN_PDC_FD_03_200ms_Warn_DrvDrSwSta: ComBitPosition=64, ComBitSize=2, ComSignalInitValue=0, ComHandleId=25, ComTimeout=1.5, ComNotification=Rte_COMCbk_ComISignal_BCAN_PDC_FD_03_200ms_Warn_DrvDrSwSta, ComSystemTemplateSystemSignalRef=Warn_DrvDrSwSta
        ComISignal_BCAN_PDC_FD_03_200ms_Warn_AsstDrSwSta: ComBitPosition=66, ComBitSize=2, ComSignalInitValue=0, ComHandleId=26, ComTimeout=1.5, ComNotification=Rte_COMCbk_ComISignal_BCAN_PDC_FD_03_200ms_Warn_AsstDrSwSta, ComSystemTemplateSystemSignalRef=Warn_AsstDrSwSta
        ComISignal_BCAN_PDC_FD_03_200ms_Warn_RrLftDrSwSta: ComBitPosition=68, ComBitSize=2, ComSignalInitValue=0, ComHandleId=27, ComTimeout=1.5, ComNotification=Rte_COMCbk_ComISignal_BCAN_PDC_FD_03_200ms_Warn_RrLftDrSwSta, ComSystemTemplateSystemSignalRef=Warn_RrLftDrSwSta
        ComISignal_BCAN_PDC_FD_03_200ms_Warn_RrRtDrSwSta: ComBitPosition=70, ComBitSize=2, ComSignalInitValue=0, ComHandleId=28, ComTimeout=1.5, ComNotification=Rte_COMCbk_ComISignal_BCAN_PDC_FD_03_200ms_Warn_RrRtDrSwSta, ComSystemTemplateSystemSignalRef=Warn_RrRtDrSwSta
        ComISignal_BCAN_RWPC_FD_01_200ms_RWPC_IndSyncVal: ComBitPosition=104, ComBitSize=3, ComSignalInitValue=0, ComHandleId=17, ComTimeout=1.5, ComNotification=Rte_COMCbk_ComISignal_BCAN_RWPC_FD_01_200ms_RWPC_IndSyncVal, ComSystemTemplateSystemSignalRef=RWPC_IndSyncVal
        ComISignal_BCAN_SBCM_AST_FD_01_200ms_Warn_AsstDrSwSta_SBCM: ComBitPosition=84, ComBitSize=2, ComSignalInitValue=0, ComHandleId=15, ComTimeout=1.5, ComNotification=Rte_COMCbk_ComISignal_BCAN_SBCM_AST_FD_01_200ms_Warn_AsstDrSwSta_SBCM, ComSystemTemplateSystemSignalRef=Warn_AsstDrSwSta_SBCM
        ComISignal_BCAN_SBCM_DRV_FD_01_200ms_Warn_DrvDrSwSta_SBCM: ComBitPosition=84, ComBitSize=2, ComSignalInitValue=0, ComHandleId=13, ComTimeout=1.5, ComNotification=Rte_COMCbk_ComISignal_BCAN_SBCM_DRV_FD_01_200ms_Warn_DrvDrSwSta_SBCM, ComSystemTemplateSystemSignalRef=Warn_DrvDrSwSta_SBCM
        ComISignal_BCAN_SBCM_DRV_FD_01_200ms_Latch_TypeOption_DRV: ComBitPosition=100, ComBitSize=2, ComSignalInitValue=0, ComHandleId=14, ComTimeout=1.5, ComNotification=Rte_COMCbk_ComISignal_BCAN_SBCM_DRV_FD_01_200ms_Latch_TypeOption_DRV, ComSystemTemplateSystemSignalRef=Latch_TypeOption_DRV
        ComISignal_BCAN_SBCM_RL_FD_01_200ms_Warn_RrLftDrSwSta_SBCM: ComBitPosition=80, ComBitSize=2, ComSignalInitValue=0, ComHandleId=10, ComTimeout=1.5, ComNotification=Rte_COMCbk_ComISignal_BCAN_SBCM_RL_FD_01_200ms_Warn_RrLftDrSwSta_SBCM, ComSystemTemplateSystemSignalRef=Warn_RrLftDrSwSta_SBCM
        ComISignal_BCAN_SBCM_RR_FD_01_200ms_Warn_RrRtDrSwSta_SBCM: ComBitPosition=80, ComBitSize=2, ComSignalInitValue=0, ComHandleId=9, ComTimeout=1.5, ComNotification=Rte_COMCbk_ComISignal_BCAN_SBCM_RR_FD_01_200ms_Warn_RrRtDrSwSta_SBCM, ComSystemTemplateSystemSignalRef=Warn_RrRtDrSwSta_SBCM
      ComIPdu_BCAN_WPCmsgDvp1 (ComIPdu):
        category = TOOL_CONFIGURED
        ComIPduDirection = SEND
        ComIPduHandleId = 4
        ComIPduType = NORMAL
        ComIPduSignalProcessing = DEFERRED
        ComIPduSignalRef = ComISignal_BCAN_WPCmsgDvp1_WPCmsgDvp1DataByte{00..63}
        ComPduIdRef = Pdu_ISignalIPdu_BCAN_WPCmsgDvp1
        ComIPduGroupRef = ComIPduGroupTx_WPC_BCAN_PNC141
        ComIPduGroupRef = ComIPduGroupTx_WPC_BCAN_PNC153
        ComIPduGroupRef = ComIPduGroupTx_WPC_BCAN_PNC32
        ComTxIpdu_ComIPdu_BCAN_WPCmsgDvp1 (ComTxIPdu): category=TOOL_CONFIGURED, ComTxIPduUnusedAreasDefault=0, ComMinimumDelayTime=0.02
          ComTxModeTrue_ComTxIpdu_ComIPdu_BCAN_WPCmsgDvp1 (ComTxModeTrue): category=TOOL_CONFIGURED
            ComTxMode_ComTxModeTrue_ComTxIpdu_ComIPdu_BCAN_WPCmsgDvp1 (ComTxMode): category=TOOL_CONFIGURED, ComTxModeNumberOfRepetitions=3, ComTxModeRepetitionPeriod=0.04, ComTxModeMode=DIRECT
      67 x ComSignal, all with category=TOOL_CONFIGURED, ComSignalEndianness=LITTLE_ENDIAN, ComSignalInitValue=0, ComSignalLength=1, ComSignalType=UINT8, ComSigReportIdsMEnable=0:
        ComISignal_BCAN_WPCmsgDvp1_WPCmsgDvp1DataByte00: ComBitPosition=0, ComBitSize=8, ComTransferProperty=PENDING, ComHandleId=3, ComSystemTemplateSystemSignalRef=WPCmsgDvp1DataByte00
        ComISignal_BCAN_WPCmsgDvp1_WPCmsgDvp1DataByte01: ComBitPosition=8, ComBitSize=8, ComTransferProperty=PENDING, ComHandleId=4, ComSystemTemplateSystemSignalRef=WPCmsgDvp1DataByte01
        ComISignal_BCAN_WPCmsgDvp1_WPCmsgDvp1DataByte02: ComBitPosition=16, ComBitSize=8, ComTransferProperty=PENDING, ComHandleId=5, ComSystemTemplateSystemSignalRef=WPCmsgDvp1DataByte02
        ComISignal_BCAN_WPCmsgDvp1_WPCmsgDvp1DataByte03: ComBitPosition=24, ComBitSize=8, ComTransferProperty=PENDING, ComHandleId=6, ComSystemTemplateSystemSignalRef=WPCmsgDvp1DataByte03
        ComISignal_BCAN_WPCmsgDvp1_WPCmsgDvp1DataByte04: ComBitPosition=32, ComBitSize=8, ComTransferProperty=PENDING, ComHandleId=7, ComSystemTemplateSystemSignalRef=WPCmsgDvp1DataByte04
        ComISignal_BCAN_WPCmsgDvp1_WPCmsgDvp1DataByte05: ComBitPosition=40, ComBitSize=8, ComTransferProperty=PENDING, ComHandleId=8, ComSystemTemplateSystemSignalRef=WPCmsgDvp1DataByte05
        ComISignal_BCAN_WPCmsgDvp1_WPCmsgDvp1DataByte06: ComBitPosition=48, ComBitSize=8, ComTransferProperty=PENDING, ComHandleId=9, ComSystemTemplateSystemSignalRef=WPCmsgDvp1DataByte06
        ComISignal_BCAN_WPCmsgDvp1_WPCmsgDvp1DataByte07: ComBitPosition=56, ComBitSize=8, ComTransferProperty=PENDING, ComHandleId=10, ComSystemTemplateSystemSignalRef=WPCmsgDvp1DataByte07
        ComISignal_BCAN_WPCmsgDvp1_WPCmsgDvp1DataByte08: ComBitPosition=64, ComBitSize=8, ComTransferProperty=PENDING, ComHandleId=11, ComSystemTemplateSystemSignalRef=WPCmsgDvp1DataByte08
        ComISignal_BCAN_WPCmsgDvp1_WPCmsgDvp1DataByte09: ComBitPosition=72, ComBitSize=8, ComTransferProperty=PENDING, ComHandleId=12, ComSystemTemplateSystemSignalRef=WPCmsgDvp1DataByte09
        ComISignal_BCAN_WPCmsgDvp1_WPCmsgDvp1DataByte10: ComBitPosition=80, ComBitSize=8, ComTransferProperty=PENDING, ComHandleId=13, ComSystemTemplateSystemSignalRef=WPCmsgDvp1DataByte10
        ComISignal_BCAN_WPCmsgDvp1_WPCmsgDvp1DataByte11: ComBitPosition=88, ComBitSize=8, ComTransferProperty=PENDING, ComHandleId=14, ComSystemTemplateSystemSignalRef=WPCmsgDvp1DataByte11
        ComISignal_BCAN_WPCmsgDvp1_WPCmsgDvp1DataByte12: ComBitPosition=96, ComBitSize=8, ComTransferProperty=PENDING, ComHandleId=15, ComSystemTemplateSystemSignalRef=WPCmsgDvp1DataByte12
        ComISignal_BCAN_WPCmsgDvp1_WPCmsgDvp1DataByte13: ComBitPosition=104, ComBitSize=8, ComTransferProperty=PENDING, ComHandleId=16, ComSystemTemplateSystemSignalRef=WPCmsgDvp1DataByte13
        ComISignal_BCAN_WPCmsgDvp1_WPCmsgDvp1DataByte14: ComBitPosition=112, ComBitSize=8, ComTransferProperty=PENDING, ComHandleId=17, ComSystemTemplateSystemSignalRef=WPCmsgDvp1DataByte14
        ComISignal_BCAN_WPCmsgDvp1_WPCmsgDvp1DataByte15: ComBitPosition=120, ComBitSize=8, ComTransferProperty=PENDING, ComHandleId=18, ComSystemTemplateSystemSignalRef=WPCmsgDvp1DataByte15
        ComISignal_BCAN_WPCmsgDvp1_WPCmsgDvp1DataByte16: ComBitPosition=128, ComBitSize=8, ComTransferProperty=PENDING, ComHandleId=19, ComSystemTemplateSystemSignalRef=WPCmsgDvp1DataByte16
        ComISignal_BCAN_WPCmsgDvp1_WPCmsgDvp1DataByte17: ComBitPosition=136, ComBitSize=8, ComTransferProperty=PENDING, ComHandleId=20, ComSystemTemplateSystemSignalRef=WPCmsgDvp1DataByte17
        ComISignal_BCAN_WPCmsgDvp1_WPCmsgDvp1DataByte18: ComBitPosition=144, ComBitSize=8, ComTransferProperty=PENDING, ComHandleId=21, ComSystemTemplateSystemSignalRef=WPCmsgDvp1DataByte18
        ComISignal_BCAN_WPCmsgDvp1_WPCmsgDvp1DataByte19: ComBitPosition=152, ComBitSize=8, ComTransferProperty=PENDING, ComHandleId=22, ComSystemTemplateSystemSignalRef=WPCmsgDvp1DataByte19
        ComISignal_BCAN_WPCmsgDvp1_WPCmsgDvp1DataByte20: ComBitPosition=160, ComBitSize=8, ComTransferProperty=PENDING, ComHandleId=23, ComSystemTemplateSystemSignalRef=WPCmsgDvp1DataByte20
        ComISignal_BCAN_WPCmsgDvp1_WPCmsgDvp1DataByte21: ComBitPosition=168, ComBitSize=8, ComTransferProperty=PENDING, ComHandleId=24, ComSystemTemplateSystemSignalRef=WPCmsgDvp1DataByte21
        ComISignal_BCAN_WPCmsgDvp1_WPCmsgDvp1DataByte22: ComBitPosition=176, ComBitSize=8, ComTransferProperty=PENDING, ComHandleId=25, ComSystemTemplateSystemSignalRef=WPCmsgDvp1DataByte22
        ComISignal_BCAN_WPCmsgDvp1_WPCmsgDvp1DataByte23: ComBitPosition=184, ComBitSize=8, ComTransferProperty=PENDING, ComHandleId=26, ComSystemTemplateSystemSignalRef=WPCmsgDvp1DataByte23
        ComISignal_BCAN_WPCmsgDvp1_WPCmsgDvp1DataByte24: ComBitPosition=192, ComBitSize=8, ComTransferProperty=PENDING, ComHandleId=27, ComSystemTemplateSystemSignalRef=WPCmsgDvp1DataByte24
        ComISignal_BCAN_WPCmsgDvp1_WPCmsgDvp1DataByte25: ComBitPosition=200, ComBitSize=8, ComTransferProperty=PENDING, ComHandleId=28, ComSystemTemplateSystemSignalRef=WPCmsgDvp1DataByte25
        ComISignal_BCAN_WPCmsgDvp1_WPCmsgDvp1DataByte26: ComBitPosition=208, ComBitSize=8, ComTransferProperty=PENDING, ComHandleId=29, ComSystemTemplateSystemSignalRef=WPCmsgDvp1DataByte26
        ComISignal_BCAN_WPCmsgDvp1_WPCmsgDvp1DataByte27: ComBitPosition=216, ComBitSize=8, ComTransferProperty=PENDING, ComHandleId=30, ComSystemTemplateSystemSignalRef=WPCmsgDvp1DataByte27
        ComISignal_BCAN_WPCmsgDvp1_WPCmsgDvp1DataByte28: ComBitPosition=224, ComBitSize=8, ComTransferProperty=PENDING, ComHandleId=31, ComSystemTemplateSystemSignalRef=WPCmsgDvp1DataByte28
        ComISignal_BCAN_WPCmsgDvp1_WPCmsgDvp1DataByte29: ComBitPosition=232, ComBitSize=8, ComTransferProperty=PENDING, ComHandleId=32, ComSystemTemplateSystemSignalRef=WPCmsgDvp1DataByte29
        ComISignal_BCAN_WPCmsgDvp1_WPCmsgDvp1DataByte30: ComBitPosition=240, ComBitSize=8, ComTransferProperty=PENDING, ComHandleId=33, ComSystemTemplateSystemSignalRef=WPCmsgDvp1DataByte30
        ComISignal_BCAN_WPCmsgDvp1_WPCmsgDvp1DataByte31: ComBitPosition=248, ComBitSize=8, ComTransferProperty=PENDING, ComHandleId=34, ComSystemTemplateSystemSignalRef=WPCmsgDvp1DataByte31
        ComISignal_BCAN_WPCmsgDvp1_WPCmsgDvp1DataByte32: ComBitPosition=256, ComBitSize=8, ComTransferProperty=PENDING, ComHandleId=35, ComSystemTemplateSystemSignalRef=WPCmsgDvp1DataByte32
        ComISignal_BCAN_WPCmsgDvp1_WPCmsgDvp1DataByte33: ComBitPosition=264, ComBitSize=8, ComTransferProperty=PENDING, ComHandleId=36, ComSystemTemplateSystemSignalRef=WPCmsgDvp1DataByte33
        ComISignal_BCAN_WPCmsgDvp1_WPCmsgDvp1DataByte34: ComBitPosition=272, ComBitSize=8, ComTransferProperty=PENDING, ComHandleId=37, ComSystemTemplateSystemSignalRef=WPCmsgDvp1DataByte34
        ComISignal_BCAN_WPCmsgDvp1_WPCmsgDvp1DataByte35: ComBitPosition=280, ComBitSize=8, ComTransferProperty=PENDING, ComHandleId=38, ComSystemTemplateSystemSignalRef=WPCmsgDvp1DataByte35
        ComISignal_BCAN_WPCmsgDvp1_WPCmsgDvp1DataByte36: ComBitPosition=288, ComBitSize=8, ComTransferProperty=PENDING, ComHandleId=39, ComSystemTemplateSystemSignalRef=WPCmsgDvp1DataByte36
        ComISignal_BCAN_WPCmsgDvp1_WPCmsgDvp1DataByte37: ComBitPosition=296, ComBitSize=8, ComTransferProperty=PENDING, ComHandleId=40, ComSystemTemplateSystemSignalRef=WPCmsgDvp1DataByte37
        ComISignal_BCAN_WPCmsgDvp1_WPCmsgDvp1DataByte38: ComBitPosition=304, ComBitSize=8, ComTransferProperty=PENDING, ComHandleId=41, ComSystemTemplateSystemSignalRef=WPCmsgDvp1DataByte38
        ComISignal_BCAN_WPCmsgDvp1_WPCmsgDvp1DataByte39: ComBitPosition=312, ComBitSize=8, ComTransferProperty=PENDING, ComHandleId=42, ComSystemTemplateSystemSignalRef=WPCmsgDvp1DataByte39
        ComISignal_BCAN_WPCmsgDvp1_WPCmsgDvp1DataByte40: ComBitPosition=320, ComBitSize=8, ComTransferProperty=PENDING, ComHandleId=43, ComSystemTemplateSystemSignalRef=WPCmsgDvp1DataByte40
        ComISignal_BCAN_WPCmsgDvp1_WPCmsgDvp1DataByte41: ComBitPosition=328, ComBitSize=8, ComTransferProperty=PENDING, ComHandleId=44, ComSystemTemplateSystemSignalRef=WPCmsgDvp1DataByte41
        ComISignal_BCAN_WPCmsgDvp1_WPCmsgDvp1DataByte42: ComBitPosition=336, ComBitSize=8, ComTransferProperty=PENDING, ComHandleId=45, ComSystemTemplateSystemSignalRef=WPCmsgDvp1DataByte42
        ComISignal_BCAN_WPCmsgDvp1_WPCmsgDvp1DataByte43: ComBitPosition=344, ComBitSize=8, ComTransferProperty=PENDING, ComHandleId=46, ComSystemTemplateSystemSignalRef=WPCmsgDvp1DataByte43
        ComISignal_BCAN_WPCmsgDvp1_WPCmsgDvp1DataByte44: ComBitPosition=352, ComBitSize=8, ComTransferProperty=PENDING, ComHandleId=47, ComSystemTemplateSystemSignalRef=WPCmsgDvp1DataByte44
        ComISignal_BCAN_WPCmsgDvp1_WPCmsgDvp1DataByte45: ComBitPosition=360, ComBitSize=8, ComTransferProperty=PENDING, ComHandleId=48, ComSystemTemplateSystemSignalRef=WPCmsgDvp1DataByte45
        ComISignal_BCAN_WPCmsgDvp1_WPCmsgDvp1DataByte46: ComBitPosition=368, ComBitSize=8, ComTransferProperty=PENDING, ComHandleId=49, ComSystemTemplateSystemSignalRef=WPCmsgDvp1DataByte46
        ComISignal_BCAN_WPCmsgDvp1_WPCmsgDvp1DataByte47: ComBitPosition=376, ComBitSize=8, ComTransferProperty=PENDING, ComHandleId=50, ComSystemTemplateSystemSignalRef=WPCmsgDvp1DataByte47
        ComISignal_BCAN_WPCmsgDvp1_WPCmsgDvp1DataByte48: ComBitPosition=384, ComBitSize=8, ComTransferProperty=PENDING, ComHandleId=51, ComSystemTemplateSystemSignalRef=WPCmsgDvp1DataByte48
        ComISignal_BCAN_WPCmsgDvp1_WPCmsgDvp1DataByte49: ComBitPosition=392, ComBitSize=8, ComTransferProperty=PENDING, ComHandleId=52, ComSystemTemplateSystemSignalRef=WPCmsgDvp1DataByte49
        ComISignal_BCAN_WPCmsgDvp1_WPCmsgDvp1DataByte50: ComBitPosition=400, ComBitSize=8, ComTransferProperty=PENDING, ComHandleId=53, ComSystemTemplateSystemSignalRef=WPCmsgDvp1DataByte50
        ComISignal_BCAN_WPCmsgDvp1_WPCmsgDvp1DataByte51: ComBitPosition=408, ComBitSize=8, ComTransferProperty=PENDING, ComHandleId=54, ComSystemTemplateSystemSignalRef=WPCmsgDvp1DataByte51
        ComISignal_BCAN_WPCmsgDvp1_WPCmsgDvp1DataByte52: ComBitPosition=416, ComBitSize=8, ComTransferProperty=PENDING, ComHandleId=55, ComSystemTemplateSystemSignalRef=WPCmsgDvp1DataByte52
        ComISignal_BCAN_WPCmsgDvp1_WPCmsgDvp1DataByte53: ComBitPosition=424, ComBitSize=8, ComTransferProperty=PENDING, ComHandleId=56, ComSystemTemplateSystemSignalRef=WPCmsgDvp1DataByte53
        ComISignal_BCAN_WPCmsgDvp1_WPCmsgDvp1DataByte54: ComBitPosition=432, ComBitSize=8, ComTransferProperty=PENDING, ComHandleId=57, ComSystemTemplateSystemSignalRef=WPCmsgDvp1DataByte54
        ComISignal_BCAN_WPCmsgDvp1_WPCmsgDvp1DataByte55: ComBitPosition=440, ComBitSize=8, ComTransferProperty=PENDING, ComHandleId=58, ComSystemTemplateSystemSignalRef=WPCmsgDvp1DataByte55
        ComISignal_BCAN_WPCmsgDvp1_WPCmsgDvp1DataByte56: ComBitPosition=448, ComBitSize=8, ComTransferProperty=PENDING, ComHandleId=59, ComSystemTemplateSystemSignalRef=WPCmsgDvp1DataByte56
        ComISignal_BCAN_WPCmsgDvp1_WPCmsgDvp1DataByte57: ComBitPosition=456, ComBitSize=8, ComTransferProperty=PENDING, ComHandleId=60, ComSystemTemplateSystemSignalRef=WPCmsgDvp1DataByte57
        ComISignal_BCAN_WPCmsgDvp1_WPCmsgDvp1DataByte58: ComBitPosition=464, ComBitSize=8, ComTransferProperty=PENDING, ComHandleId=61, ComSystemTemplateSystemSignalRef=WPCmsgDvp1DataByte58
        ComISignal_BCAN_WPCmsgDvp1_WPCmsgDvp1DataByte59: ComBitPosition=472, ComBitSize=8, ComTransferProperty=PENDING, ComHandleId=62, ComSystemTemplateSystemSignalRef=WPCmsgDvp1DataByte59
        ComISignal_BCAN_WPCmsgDvp1_WPCmsgDvp1DataByte60: ComBitPosition=480, ComBitSize=8, ComTransferProperty=PENDING, ComHandleId=63, ComSystemTemplateSystemSignalRef=WPCmsgDvp1DataByte60
        ComISignal_BCAN_WPCmsgDvp1_WPCmsgDvp1DataByte61: ComBitPosition=488, ComBitSize=8, ComTransferProperty=PENDING, ComHandleId=64, ComSystemTemplateSystemSignalRef=WPCmsgDvp1DataByte61
        ComISignal_BCAN_WPCmsgDvp1_WPCmsgDvp1DataByte62: ComBitPosition=496, ComBitSize=8, ComTransferProperty=PENDING, ComHandleId=65, ComSystemTemplateSystemSignalRef=WPCmsgDvp1DataByte62
        ComISignal_BCAN_WPCmsgDvp1_WPCmsgDvp1DataByte63: ComBitPosition=504, ComBitSize=8, ComTransferProperty=TRIGGERED, ComHandleId=66, ComSystemTemplateSystemSignalRef=WPCmsgDvp1DataByte63
        ComISignal_LCAN_IAU_FD_04_200ms_IAU_OwnerPhnRegRVal: ComBitPosition=90, ComBitSize=2, ComTransferProperty=TRIGGERED_ON_CHANGE, ComHandleId=37, ComTimeout=1.5, ComNotification=Rte_COMCbk_ComISignal_LCAN_IAU_FD_04_200ms_IAU_OwnerPhnRegRVal, ComSystemTemplateSystemSignalRef=IAU_OwnerPhnRegRVal
        ComISignal_LCAN_IAU_FD_04_200ms_IAU_DKOwnerSwapOption: ComBitPosition=136, ComBitSize=2, ComTransferProperty=TRIGGERED_ON_CHANGE, ComHandleId=38, ComTimeout=1.5, ComNotification=Rte_COMCbk_ComISignal_LCAN_IAU_FD_04_200ms_IAU_DKOwnerSwapOption, ComSystemTemplateSystemSignalRef=IAU_DKOwnerSwapOption
        ComISignal_LCAN_IAU_FD_05_200ms_IAU_SharedPhnRegStat: ComBitPosition=116, ComBitSize=2, ComTransferProperty=TRIGGERED_ON_CHANGE, ComHandleId=36, ComTimeout=1.5, ComNotification=Rte_COMCbk_ComISignal_LCAN_IAU_FD_05_200ms_IAU_SharedPhnRegStat, ComSystemTemplateSystemSignalRef=IAU_SharedPhnRegStat
      ComIPdu_BCAN_WPC_WU_01_500ms (ComIPdu):
        category = TOOL_CONFIGURED
        ComIPduDirection = SEND
        ComIPduHandleId = 6
        ComIPduType = NORMAL
        ComIPduSignalProcessing = DEFERRED
        ComIPduGroupRef = ComIPduGroupTx_WPC_BCAN_PNC141
        ComIPduGroupRef = ComIPduGroupTx_WPC_BCAN_PNC153
        ComIPduGroupRef = ComIPduGroupTx_WPC_BCAN_PNC32
        ComIPduSignalGroupRef = ComISignalGroup_MsgGr_E2E_BCAN_WPC_WU_01_500ms
        ComPduIdRef = Pdu_ISignalIPdu_BCAN_WPC_WU_01_500ms
        ComTxIpdu_ComIPdu_BCAN_WPC_WU_01_500ms (ComTxIPdu): category=TOOL_CONFIGURED, ComTxIPduUnusedAreasDefault=0, ComMinimumDelayTime=0.02
          ComTxModeTrue_ComTxIpdu_ComIPdu_BCAN_WPC_WU_01_500ms (ComTxModeTrue): category=TOOL_CONFIGURED
            ComTxMode_ComTxModeTrue_ComTxIpdu_ComIPdu_BCAN_WPC_WU_01_500ms (ComTxMode):
              category = TOOL_CONFIGURED
              ComTxModeTimeOffset = 0.0
              ComTxModeTimePeriod = 1.0
              ComTxModeNumberOfRepetitions = 3
              ComTxModeRepetitionPeriod = 0.04
              ComTxModeMode = MIXED
      ComISignal_BCAN_VCU_01_10ms_VCU_GearPosSta (ComSignal):
        category = TOOL_CONFIGURED
        ComBitPosition = 32
        ComBitSize = 4
        ComSignalEndianness = LITTLE_ENDIAN
        ComSignalInitValue = 9
        ComSignalLength = 1
        ComSignalType = UINT8
        ComTransferProperty = PENDING
        ComSigReportIdsMEnable = 0
        ComHandleId = 1
        ComTimeout = 0.5
        ComNotification = Rte_COMCbk_ComISignal_BCAN_VCU_01_10ms_VCU_GearPosSta
        ComSystemTemplateSystemSignalRef = VCU_GearPosSta
      ComISignalGroup_MsgGr_E2E_BCAN_WPC_WU_01_500ms (ComSignalGroup):
        category = TOOL_CONFIGURED
        ComHandleId = 2
        ComSignalGroupArrayAccess = 1
        ComTransferProperty = TRIGGERED_ON_CHANGE
        ComSystemTemplateSignalGroupRef = MsgGr_BCAN_WPC_WU_01_500ms
        12 x ComGroupSignal, all with category=TOOL_CONFIGURED, ComSignalEndianness=LITTLE_ENDIAN:
          BCAN_WPC_WU_01_500ms_WPC_WU_Crc1Val: ComBitPosition=0, ComTransferProperty=TRIGGERED_ON_CHANGE, ComSignalInitValue=65535, ComBitSize=16, ComSignalLength=2, ComSignalType=UINT16, ComHandleId=90, ComSystemTemplateSystemSignalRef=WPC_WU_Crc1Val
          BCAN_WPC_WU_01_500ms_WPC_WU_AlvCnt1Val: ComBitPosition=16, ComTransferProperty=TRIGGERED_ON_CHANGE, ComSignalInitValue=0, ComBitSize=8, ComSignalLength=1, ComSignalType=UINT8, ComHandleId=91, ComSystemTemplateSystemSignalRef=WPC_WU_AlvCnt1Val
          BCAN_WPC_WU_01_500ms_WPC_WU_NM_B2: ComBitPosition=24, ComTransferProperty=TRIGGERED_ON_CHANGE, ComSignalInitValue=0, ComBitSize=1, ComSignalLength=1, ComSignalType=BOOLEAN, ComHandleId=92, ComSystemTemplateSystemSignalRef=WPC_WU_NM_B2
          BCAN_WPC_WU_01_500ms_WPC_WU_NM_BDCLocal: ComBitPosition=25, ComTransferProperty=TRIGGERED_ON_CHANGE, ComSignalInitValue=0, ComBitSize=1, ComSignalLength=1, ComSignalType=BOOLEAN, ComHandleId=93, ComSystemTemplateSystemSignalRef=WPC_WU_NM_BDCLocal
          BCAN_WPC_WU_01_500ms_WPC_WU_PWR_ACC: ComBitPosition=32, ComTransferProperty=TRIGGERED_ON_CHANGE, ComSignalInitValue=0, ComBitSize=1, ComSignalLength=1, ComSignalType=BOOLEAN, ComHandleId=94, ComSystemTemplateSystemSignalRef=WPC_WU_PWR_ACC
          BCAN_WPC_WU_01_500ms_WPC_WU_PWR_IGN1: ComBitPosition=33, ComTransferProperty=TRIGGERED_ON_CHANGE, ComSignalInitValue=0, ComBitSize=1, ComSignalLength=1, ComSignalType=BOOLEAN, ComHandleId=95, ComSystemTemplateSystemSignalRef=WPC_WU_PWR_IGN1
          BCAN_WPC_WU_01_500ms_WPC_WU_R_DrvDoorSw: ComBitPosition=40, ComTransferProperty=TRIGGERED_ON_CHANGE, ComSignalInitValue=0, ComBitSize=1, ComSignalLength=1, ComSignalType=BOOLEAN, ComHandleId=96, ComSystemTemplateSystemSignalRef=WPC_WU_R_DrvDoorSw
          BCAN_WPC_WU_01_500ms_WPC_WU_R_B1CAN: ComBitPosition=41, ComTransferProperty=TRIGGERED_ON_CHANGE, ComSignalInitValue=0, ComBitSize=1, ComSignalLength=1, ComSignalType=BOOLEAN, ComHandleId=97, ComSystemTemplateSystemSignalRef=WPC_WU_R_B1CAN
          BCAN_WPC_WU_01_500ms_WPC_WU_R_BDCLocalCAN: ComBitPosition=42, ComTransferProperty=TRIGGERED_ON_CHANGE, ComSignalInitValue=0, ComBitSize=1, ComSignalLength=1, ComSignalType=BOOLEAN, ComHandleId=98, ComSystemTemplateSystemSignalRef=WPC_WU_R_BDCLocalCAN
          BCAN_WPC_WU_01_500ms_WPC_WU_R_Diag: ComBitPosition=43, ComTransferProperty=TRIGGERED_ON_CHANGE, ComSignalInitValue=0, ComBitSize=1, ComSignalLength=1, ComSignalType=BOOLEAN, ComHandleId=99, ComSystemTemplateSystemSignalRef=WPC_WU_R_Diag
          BCAN_WPC_WU_01_500ms_WPC_WU_R_IGNFallingTimer: ComBitPosition=44, ComTransferProperty=TRIGGERED_ON_CHANGE, ComSignalInitValue=0, ComBitSize=1, ComSignalLength=1, ComSignalType=BOOLEAN, ComHandleId=100, ComSystemTemplateSystemSignalRef=WPC_WU_R_IGNFallingTimer
          BCAN_WPC_WU_01_500ms_WPC_WU_01_500ms_E2EReserved: ComBitPosition=120, ComSignalInitValue=0, ComBitSize=8, ComSignalLength=1, ComSignalType=UINT8, ComHandleId=101, ComSystemTemplateSystemSignalRef=WPC_WU_01_500ms_E2EReserved
    ComGeneral:
      ComSupportedIPduGroups = 10
      ComVersionInfoApi = 0
      ComRetryFailedTransmitRequests = 0
      ComEnableMDTForCyclicTransmission = 1
      ComConfigurationUseDet = 1
      ComMainFunctionBasedTransmit = 1
      ComEnableSignalGroupArrayApi = 1
      ComRxInterruptBased = 0
      ComTxInterruptBased = 0
