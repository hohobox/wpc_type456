AUTOSAR XML (schema 4-1-2)
package /ARRoot
  module config CtrlRam: implementation-config-variant=VARIANT-PRE-COMPILE, module-description=BswImplementation_CtrlRam
    CtrlRamGeneral: CtrlRamDevErrorDetect=1, CtrlRamPlatformArchitecture=LITTLE_ENDIAN_PLATFORM, CtrlRamVerifyAtInit=1, CtrlRamRecovery=1
    CtrlRamConfigSet0 (CtrlRamConfigSet): CtrlRamCallback=CtrlRamConfigSet1_CB, CtrlRamDataTypeSize=30
