AUTOSAR XML (schema 4-0-3)
package /AUTOSAR
  module config Det: implementation-config-variant=VARIANT-PRE-COMPILE, module-description=BswImplementation_Det
    DetGeneral: DetForwardToDlt=0, DetVersionInfoApi=0, DetRamBufferSize=255
    DetNotification_0 (DetNotification)
