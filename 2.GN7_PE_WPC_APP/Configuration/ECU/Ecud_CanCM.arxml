AUTOSAR XML (schema 4-0-3)
package /AUTOSAR
  module config CanCM: implementation-config-variant=VARIANT-PRE-COMPILE, module-description=BswImplementation_CanCM
    CanCMBatMonConfig_Main (CanCMBatMonConfig): CanCMAdcDefault=500, CanCMBatAnalogInputRef=VBAT_ADC
    CanCMChannel_BCAN (CanCMChannelConfig):
      CanCMChannelId = 0
      CanCMVoltageHysteresis = 38
      CanCMNetworkActivationTime = 0.11
      CanCMVoltageErrorDelayTime = 0.18
      CanCMTimeoutMonitoringStartTime = 1
      CanCMVoltageAbnormalUpper = 3076
      CanCMVoltageAbnormalLower = 1730
      CanCMVoltageCriticalUpper = 3499
      CanCMVoltageCriticalLower = 1307
      CanCMComMChannelId = ComMChannel_BCAN
      CanCMDemEventParameterRefs: CANCM_E_BAT_FAIL=CANCM_E_BAT_FAIL
      CanCMWakeupParameterRefs: CanCMEcuMWakeupSourceRef=ECUM_WKSOURCE_BCAN_RX_POLL, CanCMIoHwAbWakeupPinNameRef=BCAN_RX
    CanCMChannel_LCAN (CanCMChannelConfig):
      CanCMChannelId = 1
      CanCMVoltageHysteresis = 38
      CanCMNetworkActivationTime = 0.11
      CanCMVoltageErrorDelayTime = 0.18
      CanCMTimeoutMonitoringStartTime = 1
      CanCMVoltageAbnormalUpper = 3076
      CanCMVoltageAbnormalLower = 1730
      CanCMVoltageCriticalUpper = 3499
      CanCMVoltageCriticalLower = 1307
      CanCMComMChannelId = ComMChannel_LCAN
      CanCMDemEventParameterRefs: CANCM_E_BAT_FAIL=CANCM_E_BAT_FAIL
      CanCMWakeupParameterRefs: CanCMEcuMWakeupSourceRef=ECUM_WKSOURCE_LCAN_RX_POLL, CanCMIoHwAbWakeupPinNameRef=LCAN_RX
    CanCMGlobalConfig:
      CanCMDevErrorDetect = 1
      CanCMMainFunctionPeriod = 0.005
      CanCMVersionInfoApi = 0
      CanCMDemStatusReport = 1
      CanCMDisableDMOnAbnormalVoltage = 0
      CanCMFilteringConstant = 128
      CanCMWakeupSupport = 1
      CanCMHysteresisSupport = 1
