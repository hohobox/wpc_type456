AUTOSAR XML (schema 4-0-3)
package /EcucValueCollection
  ecuc value collection EcucValueCollection: category=MANAGED_ECUC_MODULES, ecu-extract=EcuExtract
    ecuc-values:
      RamTst
      Mcu
      Rte
      Wdg
      CtrlRam
      EcuM
      Os
      Det
      Fee
      Nm
      HwResource
      CanTp
      ComM
      OsProfiler
      Com
      Ocu
      BswM
      IoHwAb
      Crc
      Spi
      WdgM
      Icu
      RomTst
      Port
      MemIf
      EcuC
      ComXf
      Fls
      CanNm
      Pwm
      CanTrcv
      CanSM
      Dcm
      NvM
      Dem
      CanCM
      Dio
      CDD_RouterIF
      CDD_RouterTP
      CDD_IPC_TP
      CDD_IPC_IF
      Can
      IpduM
      Wdg_76_Acw
      CanIf
      PduR
      Gpt
      WdgIf
      OsImp
      E2EXf
      Adc
      Resource
      Crypto_76_HaeModule
