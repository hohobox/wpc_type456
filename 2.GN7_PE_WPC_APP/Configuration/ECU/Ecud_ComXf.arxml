AUTOSAR XML (schema 4-3-0)
package /EcucModules
  module config ComXf: definition=Xfrm, implementation-config-variant=VARIANT-PRE-COMPILE, module-description=BswImplementation_ComXf
    XfrmGeneral: XfrmVersionInfoApi=0, XfrmCpuEndianness=LITTLE_ENDIAN, XfrmUnusedArea=1, XfrmDevErrorDetect=1, XfrmBufferLengthType=uint16
    8 x XfrmImplementationMapping:
      ComXf_MsgGr_E2E_BCAN_WPC_FD_01_200ms: XfrmTransformationTechnologyRef=XfTechTx_ComXf_P5, XfrmVariableDataPrototypeInstanceRef=App_CAN_TX.Gr_MsgGr_E2E_BCAN_WPC_FD_01_200ms.MsgGr_E2E_BCAN_WPC_FD_01_200ms, XfrmTransformerBswModuleEntryRef=ComXf_App_CAN_TX_Gr_MsgGr_E2E_BCAN_WPC_FD_01_200ms_MsgGr_E2E_BCAN_WPC_FD_01_200ms, XfrmSignalGroupRef=ComISignalGroup_MsgGr_E2E_BCAN_WPC_FD_01_200ms
        XfrmSignal: category=TOOL_CONFIGURED
          XfrmSignalChoice: category=TOOL_CONFIGURED
            XfrmISignalGroupRefChoice: category=TOOL_CONFIGURED, XfrmISignalGroupRef=MsgGr_E2E_BCAN_WPC_FD_01_200ms
      ComXf_MsgGr_E2E_BCAN_WPC_FD_VCRM_01_00ms: XfrmTransformationTechnologyRef=XfTechTx_ComXf_P5, XfrmVariableDataPrototypeInstanceRef=App_CAN_TX.Gr_MsgGr_E2E_BCAN_WPC_FD_VCRM_01_00ms.MsgGr_E2E_BCAN_WPC_FD_VCRM_01_00ms, XfrmTransformerBswModuleEntryRef=ComXf_App_CAN_TX_Gr_MsgGr_E2E_BCAN_WPC_FD_VCRM_01_00ms_MsgGr_E2E_BCAN_WPC_FD_VCRM_01_00ms, XfrmSignalGroupRef=ComISignalGroup_MsgGr_E2E_BCAN_WPC_FD_VCRM_01_00ms
        XfrmSignal: category=TOOL_CONFIGURED
          XfrmSignalChoice: category=TOOL_CONFIGURED
            XfrmISignalGroupRefChoice: category=TOOL_CONFIGURED, XfrmISignalGroupRef=MsgGr_E2E_BCAN_WPC_FD_VCRM_01_00ms
      ComXf_MsgGr_E2E_LCAN_L_WPC_FD_01_00ms: XfrmTransformationTechnologyRef=XfTechTx_ComXf_P5, XfrmVariableDataPrototypeInstanceRef=App_CAN_TX.Gr_MsgGr_E2E_LCAN_L_WPC_FD_01_00ms.MsgGr_E2E_LCAN_L_WPC_FD_01_00ms, XfrmTransformerBswModuleEntryRef=ComXf_App_CAN_TX_Gr_MsgGr_E2E_LCAN_L_WPC_FD_01_00ms_MsgGr_E2E_LCAN_L_WPC_FD_01_00ms, XfrmSignalGroupRef=ComISignalGroup_MsgGr_E2E_LCAN_L_WPC_FD_01_00ms
        XfrmSignal: category=TOOL_CONFIGURED
          XfrmSignalChoice: category=TOOL_CONFIGURED
            XfrmISignalGroupRefChoice: category=TOOL_CONFIGURED, XfrmISignalGroupRef=MsgGr_E2E_LCAN_L_WPC_FD_01_00ms
      ComXf_MsgGr_E2E_LCAN_L_WPC_FD_20_200ms: XfrmTransformationTechnologyRef=XfTechTx_ComXf_P5, XfrmVariableDataPrototypeInstanceRef=App_CAN_TX.Gr_MsgGr_E2E_LCAN_L_WPC_FD_20_200ms.MsgGr_E2E_LCAN_L_WPC_FD_20_200ms, XfrmTransformerBswModuleEntryRef=ComXf_App_CAN_TX_Gr_MsgGr_E2E_LCAN_L_WPC_FD_20_200ms_MsgGr_E2E_LCAN_L_WPC_FD_20_200ms, XfrmSignalGroupRef=ComISignalGroup_MsgGr_E2E_LCAN_L_WPC_FD_20_200ms
        XfrmSignal: category=TOOL_CONFIGURED
          XfrmSignalChoice: category=TOOL_CONFIGURED
            XfrmISignalGroupRefChoice: category=TOOL_CONFIGURED, XfrmISignalGroupRef=MsgGr_E2E_LCAN_L_WPC_FD_20_200ms
      ComXf_MsgGr_E2E_LCAN_PDC_FD_15_300ms: XfrmTransformationTechnologyRef=XfTechRx_ComXf_P5, XfrmInvTransformerBswModuleEntryRef=ComXf_Inv_Com_ComISignalGroup_MsgGr_E2E_LCAN_PDC_FD_15_300ms, XfrmSignalGroupRef=ComISignalGroup_MsgGr_E2E_LCAN_PDC_FD_15_300ms
        XfrmSignal: category=TOOL_CONFIGURED
          XfrmSignalChoice: category=TOOL_CONFIGURED
            XfrmISignalGroupRefChoice: category=TOOL_CONFIGURED, XfrmISignalGroupRef=MsgGr_E2E_LCAN_PDC_FD_15_300ms
      ComXf_MsgGr_E2E_BCAN_PDC_FD_15_300ms: XfrmTransformationTechnologyRef=XfTechRx_ComXf_P5, XfrmVariableDataPrototypeInstanceRef=App_CAN_RX.Gr_MsgGr_E2E_BCAN_PDC_FD_15_300ms.MsgGr_E2E_BCAN_PDC_FD_15_300ms, XfrmInvTransformerBswModuleEntryRef=ComXf_Inv_App_CAN_RX_Gr_MsgGr_E2E_BCAN_PDC_FD_15_300ms_MsgGr_E2E_BCAN_PDC_FD_15_300ms, XfrmSignalGroupRef=ComISignalGroup_MsgGr_E2E_BCAN_PDC_FD_15_300ms
        XfrmSignal: category=TOOL_CONFIGURED
          XfrmSignalChoice: category=TOOL_CONFIGURED
            XfrmISignalGroupRefChoice: category=TOOL_CONFIGURED, XfrmISignalGroupRef=MsgGr_E2E_BCAN_PDC_FD_15_300ms
      ComXf_MsgGr_E2E_BCAN_WPC2_FD_01_200ms: XfrmTransformationTechnologyRef=XfTechTx_ComXf_P5, XfrmVariableDataPrototypeInstanceRef=App_CAN_TX.Gr_MsgGr_E2E_BCAN_WPC2_FD_01_200ms.MsgGr_E2E_BCAN_WPC2_FD_01_200ms, XfrmTransformerBswModuleEntryRef=ComXf_App_CAN_TX_Gr_MsgGr_E2E_BCAN_WPC2_FD_01_200ms_MsgGr_E2E_BCAN_WPC2_FD_01_200ms, XfrmSignalGroupRef=ComISignalGroup_MsgGr_E2E_BCAN_WPC2_FD_01_200ms
        XfrmSignal: category=TOOL_CONFIGURED
          XfrmSignalChoice: category=TOOL_CONFIGURED
            XfrmISignalGroupRefChoice: category=TOOL_CONFIGURED, XfrmISignalGroupRef=MsgGr_E2E_BCAN_WPC2_FD_01_200ms
      ComXf_MsgGr_E2E_BCAN_WPC_WU_01_500ms: XfrmTransformationTechnologyRef=XfTechTx_ComXf_P5, XfrmTransformerBswModuleEntryRef=ComXf_Com_ComISignalGroup_MsgGr_E2E_BCAN_WPC_WU_01_500ms, XfrmSignalGroupRef=ComISignalGroup_MsgGr_E2E_BCAN_WPC_WU_01_500ms
        XfrmSignal: category=TOOL_CONFIGURED
          XfrmSignalChoice: category=TOOL_CONFIGURED
            XfrmISignalGroupRefChoice: category=TOOL_CONFIGURED, XfrmISignalGroupRef=MsgGr_E2E_BCAN_WPC_WU_01_500ms
