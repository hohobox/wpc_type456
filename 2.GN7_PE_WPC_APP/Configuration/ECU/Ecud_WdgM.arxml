AUTOSAR XML (schema 4-0-3)
package /AUTOSAR
  module config WdgM: implementation-config-variant=VARIANT-PRE-COMPILE, module-description=BswImplementation_WdgM
    WdgMConfigSet: WdgMDeInitTimeout=4000, WdgMInitialMode=WdgMMode0
      WdgMDemEventParameterRefs: WDGM_E_IMPROPER_CALLER=WDGM_E_IMPROPER_CALLER, WDGM_E_MONITORING=WDGM_E_MONITORING, WDGM_E_SET_MODE=WDGM_E_SET_MODE
      WdgMMode0 (WdgMMode): WdgMExpiredSupervisionCycleTol=0, WdgMModeId=0, WdgMSupervisionCycle=0.010
        WdgMAliveSupervision0 (WdgMAliveSupervision): WdgMExpectedAliveIndications=1, WdgMMaxMargin=0, WdgMMinMargin=0, WdgMSupervisionReferenceCycle=800, WdgMAliveSupervisionCheckpointRef=CP_Init_AS0
        WdgMLocalStatusParams0 (WdgMLocalStatusParams): WdgMFailedAliveSupervisionRefCycleTol=0, WdgMLocalStatusSupervisedEntityRef=SE_Init
        WdgMTrigger_Int (WdgMTrigger): WdgMTriggerConditionValue=500, WdgMWatchdogMode=WDGIF_SLOW_MODE, WdgMTriggerWatchdogRef=WdgMWatchdog_Int
        WdgMTrigger_Ext (WdgMTrigger): WdgMTriggerConditionValue=500, WdgMWatchdogMode=WDGIF_OFF_MODE, WdgMTriggerWatchdogRef=WdgMWatchdog_Ext
      WdgMMode1 (WdgMMode): WdgMExpiredSupervisionCycleTol=2, WdgMModeId=1, WdgMSupervisionCycle=0.010
        WdgMAliveSupervision0 (WdgMAliveSupervision):
          WdgMExpectedAliveIndications = 10
          WdgMMaxMargin = 3
          WdgMMinMargin = 5
          WdgMSupervisionReferenceCycle = 10
          WdgMAliveSupervisionCheckpointRef = CP_WdgMTest_AS0
        WdgMDeadlineSupervision0 (WdgMDeadlineSupervision): WdgMDeadlineMax=0.025, WdgMDeadlineMin=0, WdgMDeadlineStartRef=CP_WdgMTest_DS0, WdgMDeadlineStopRef=CP_WdgMTest_DS1
        WdgMLocalStatusParams0 (WdgMLocalStatusParams): WdgMFailedAliveSupervisionRefCycleTol=1, WdgMLocalStatusSupervisedEntityRef=SE_WdgMTest
        WdgMTrigger_Int (WdgMTrigger): WdgMTriggerConditionValue=100, WdgMWatchdogMode=WDGIF_FAST_MODE, WdgMTriggerWatchdogRef=WdgMWatchdog_Int
        WdgMTrigger_Ext (WdgMTrigger): WdgMTriggerConditionValue=100, WdgMWatchdogMode=WDGIF_OFF_MODE, WdgMTriggerWatchdogRef=WdgMWatchdog_Ext
    WdgMGeneral:
      WdgMDemStoppedSupervisionReport = 1
      WdgMDevErrorDetect = 1
      WdgMVersionInfoApi = 0
      WdgMOsVendor = AUTRON_OS
      WdgMOffModeEnabled = 1
      WdgMDefensiveBehavior = 1
      WdgMErrorInfoApi = 0
      WdgMImmediateReset = 0
      WdgMCallerIds: WdgMCallerId=300
      SE_Init (WdgMSupervisedEntity): WdgMSupervisedEntityId=300, WdgMInternalCheckpointInitialRef=CP_Init_ILS_0, WdgMInternalCheckpointFinalRef=CP_Init_ILS_1
        3 x WdgMCheckpoint:
          CP_Init_AS0: WdgMCheckpointId=0
          CP_Init_ILS_0: WdgMCheckpointId=1
          CP_Init_ILS_1: WdgMCheckpointId=2
      SE_WdgMTest (WdgMSupervisedEntity):
        WdgMSupervisedEntityId = 400
        WdgMInternalCheckpointInitialRef = CP_WdgMTest_ILS_0
        WdgMInternalCheckpointFinalRef = CP_WdgMTest_ILS_2
        WdgMOsCounter = OsCounter_0
        6 x WdgMCheckpoint:
          CP_WdgMTest_AS0: WdgMCheckpointId=0
          CP_WdgMTest_ILS_0: WdgMCheckpointId=1
          CP_WdgMTest_ILS_1: WdgMCheckpointId=2
          CP_WdgMTest_ILS_2: WdgMCheckpointId=3
          CP_WdgMTest_DS0: WdgMCheckpointId=4
          CP_WdgMTest_DS1: WdgMCheckpointId=5
        WdgMInternalTransition0 (WdgMInternalTransition): WdgMInternalTransitionSourceRef=CP_WdgMTest_ILS_0, WdgMInternalTransitionDestRef=CP_WdgMTest_ILS_1
        WdgMInternalTransition1 (WdgMInternalTransition): WdgMInternalTransitionSourceRef=CP_WdgMTest_ILS_1, WdgMInternalTransitionDestRef=CP_WdgMTest_ILS_2
      WdgMWatchdog_Int (WdgMWatchdog): WdgMWatchdogName=Watchdog_Int, WdgMWatchdogDeviceRef=WdgIfDevice_Int
      WdgMWatchdog_Ext (WdgMWatchdog): WdgMWatchdogName=Watchdog_Ext, WdgMWatchdogDeviceRef=WdgIfDevice_Ext
