AUTOSAR XML (schema 4-3-0)
package /AUTRON
  module config Crypto_76_HaeModule: definition=Crypto, ecuc-def-edition=4.4.7, implementation-config-variant=VARIANT-PRE-COMPILE, module-description=BswImplementation_Crypto_76_HaeModule
    CryptoDriverObjects
      HaeHsm (CryptoDriverObject):
        CryptoDriverObjectId = 0
        CryptoQueueSize = 10
        CryptoPrimitiveRef = HaeHsm_Primitive_KeyDerive
        CryptoPrimitiveRef = HaeHsm_Primitive_PseudoRandomGenerate
        CryptoPrimitiveRef = HaeHsm_Primitive_TrueRandomGenerate
      HaeCryptoLib (CryptoDriverObject):
        CryptoDriverObjectId = 1
        CryptoQueueSize = 10
        CryptoPrimitiveRef = HaeCryptoLib_Primitive_AesCmac_Verify
        CryptoPrimitiveRef = HaeCryptoLib_Primitive_AesCtr_Decrypt
        CryptoPrimitiveRef = HaeCryptoLib_Primitive_HashDrbgSha256_Generate
        CryptoPrimitiveRef = HaeCryptoLib_Primitive_HashDrbgSha256_Seed
        CryptoPrimitiveRef = HaeCryptoLib_Primitive_RsassaPkcs15Sha256_Verify
        CryptoPrimitiveRef = HaeCryptoLib_Primitive_Sha256
    CryptoGeneral: CryptoDevErrorDetect=true, CryptoInstanceId=1, CryptoVersionInfoApi=true, CryptoMainFunctionPeriod=0.1
    CryptoKeyElements
      15 x CryptoKeyElement, all with CryptoKeyElementAllowPartialAccess=0, CryptoKeyElementPersist=0, CryptoKeyElementFormat=CRYPTO_KE_FORMAT_BIN_OCTET, CryptoKeyElementReadAccess=CRYPTO_RA_ALLOWED, CryptoKeyElementWriteAccess=CRYPTO_WA_ALLOWED:
        CryptoKeyElement_RandomSeed_L9: CryptoKeyElementId=4, CryptoKeyElementSize=16, CryptoKeyElementInitValue=0x01
        CryptoKeyElement_Hash_Dummy_Fota: CryptoKeyElementId=1, CryptoKeyElementSize=32
        CryptoKeyElement_RSASSA_PKCS1_v1_5_Asims_Public_Key: CryptoKeyElementId=1, CryptoKeyElementSize=260, CryptoKeyElementInitValue=0x00
        CryptoKeyElement_Fota_Decrypt0Cipher: CryptoKeyElementId=1, CryptoKeyElementSize=16
        CryptoKeyElement_Fota_Decrypt0IV: CryptoKeyElementId=5, CryptoKeyElementSize=16
        CryptoKeyElement_Fota_Mac0Key: CryptoKeyElementId=1, CryptoKeyElementSize=16
        CryptoKeyElement_PBKDF2_KeyDerivation_pw_Fota: CryptoKeyElementId=1, CryptoKeyElementSize=16
        CryptoKeyElement_PBKDF2_KeyDerivation_salt_Fota: CryptoKeyElementId=13, CryptoKeyElementSize=48
        CryptoKeyElement_PBKDF2_KeyDerivation_iteration_Fota: CryptoKeyElementId=14, CryptoKeyElementSize=4
        CryptoKeyElement_PBKDF2_KeyDerivation_algorism_Fota: CryptoKeyElementId=15, CryptoKeyElementSize=4, CryptoKeyElementInitValue=0x81
        CryptoKeyElement_PBKDF2_KeyDerivation_TargetKey_key_Fota: CryptoKeyElementId=1, CryptoKeyElementSize=32, CryptoKeyElementInitValue=00 00 00 00 00 00 00 00 00 00 00 00 00 00 00 00
        CryptoKeyElement_Dummy: CryptoKeyElementId=1, CryptoKeyElementInitValue=00 00 00 00 00 00 00 00 00 00 00 00 00 00 00 00, CryptoKeyElementSize=32
        CryptoKeyElement_PBKDF2_KeyDerivation_HSMKeyIdx_Fota: CryptoKeyElementId=1001, CryptoKeyElementSize=1
        CryptoKeyElement_RandomSeed_L10: CryptoKeyElementId=0, CryptoKeyElementSize=16
        CryptoKeyElement_RSASSA_PKCS1_v1_5_OEUK: CryptoKeyElementId=1, CryptoKeyElementSize=260
    CryptoKeyTypes
      10 x CryptoKeyType:
        CryptoKeyType_RandomSeed_L9: CryptoKeyElementRef=CryptoKeyElement_RandomSeed_L9
        CryptoKeyType_Hash_Dummy_Fota: CryptoKeyElementRef=CryptoKeyElement_Hash_Dummy_Fota
        CryptoKeyType_RSASSA_PKCS1_v1_5_Asims_Public_Key: CryptoKeyElementRef=CryptoKeyElement_RSASSA_PKCS1_v1_5_Asims_Public_Key
        CryptoKeyType_Fota_Decrypt0Key_Type: CryptoKeyElementRef=CryptoKeyElement_Fota_Decrypt0Cipher, CryptoKeyElementRef=CryptoKeyElement_Fota_Decrypt0IV
        CryptoKeyType_Fota_MacVerify0Key_Type: CryptoKeyElementRef=CryptoKeyElement_Fota_Mac0Key
        CryptoKeyType_PBKDF2_KeyDerivation_Key_Fota: CryptoKeyElementRef=CryptoKeyElement_PBKDF2_KeyDerivation_iteration_Fota, CryptoKeyElementRef=CryptoKeyElement_PBKDF2_KeyDerivation_salt_Fota, CryptoKeyElementRef=CryptoKeyElement_PBKDF2_KeyDerivation_algorism_Fota, CryptoKeyElementRef=CryptoKeyElement_PBKDF2_KeyDerivation_pw_Fota, CryptoKeyElementRef=CryptoKeyElement_PBKDF2_KeyDerivation_HSMKeyIdx_Fota
        CryptoKeyType_PBKDF2_KeyDerivation_TargetKey_Fota: CryptoKeyElementRef=CryptoKeyElement_PBKDF2_KeyDerivation_TargetKey_key_Fota
        CryptoKeyType_Dummy: CryptoKeyElementRef=CryptoKeyElement_Dummy
        CryptoKeyType_RandomSeed_L10: CryptoKeyElementRef=CryptoKeyElement_RandomSeed_L10
        CryptoKeyType_RSASSA_PKCS1_v1_5_OEUK: CryptoKeyElementRef=CryptoKeyElement_RSASSA_PKCS1_v1_5_OEUK
    CryptoKeys
      10 x CryptoKey:
        CryptoKey_RandomSeed_L9: CryptoKeyId=0, CryptoKeyTypeRef=CryptoKeyType_RandomSeed_L9
        CryptoKey_Hash_Dummy_Fota: CryptoKeyId=1, CryptoKeyTypeRef=CryptoKeyType_Hash_Dummy_Fota
        CryptoKey_RSASSA_PKCS1_v1_5_Asims_Public_Key: CryptoKeyId=2, CryptoKeyTypeRef=CryptoKeyType_RSASSA_PKCS1_v1_5_Asims_Public_Key
        CryptoKey_Fota_Decrypt0Key: CryptoKeyId=3, CryptoKeyTypeRef=CryptoKeyType_Fota_Decrypt0Key_Type
        CryptoKey_Fota_MacVerify0Key: CryptoKeyId=4, CryptoKeyTypeRef=CryptoKeyType_Fota_MacVerify0Key_Type
        CryptoKey_PBKDF2_KeyDerivation_Key_Fota: CryptoKeyId=5, CryptoKeyTypeRef=CryptoKeyType_PBKDF2_KeyDerivation_Key_Fota
        CryptoKey_PBKDF2_KeyDerivation_TargetKey_Fota: CryptoKeyId=6, CryptoKeyTypeRef=CryptoKeyType_PBKDF2_KeyDerivation_TargetKey_Fota
        CryptoKey_Dummy: CryptoKeyId=7, CryptoKeyTypeRef=CryptoKeyType_Dummy
        CryptoKey_RandomSeed_L10: CryptoKeyId=8, CryptoKeyTypeRef=CryptoKeyType_RandomSeed_L10
        CryptoKey_RSASSA_PKCS1_v1_5_OEUK: CryptoKeyId=9, CryptoKeyTypeRef=CryptoKeyType_RSASSA_PKCS1_v1_5_OEUK
    HaeHsmPrimitives (CryptoPrimitives)
      3 x CryptoPrimitive:
        HaeHsm_Primitive_PseudoRandomGenerate: CryptoPrimitiveAlgorithmFamily=CRYPTO_ALGOFAM_RNG, CryptoPrimitiveAlgorithmMode=CRYPTO_ALGOMODE_NOT_SET, CryptoPrimitiveAlgorithmSecondaryFamily=CRYPTO_ALGOFAM_NOT_SET, CryptoPrimitiveService=RANDOM
        HaeHsm_Primitive_TrueRandomGenerate: CryptoPrimitiveAlgorithmFamily=CRYPTO_ALGOFAM_RNG, CryptoPrimitiveAlgorithmMode=CRYPTO_ALGOMODE_CUSTOM, CryptoPrimitiveAlgorithmSecondaryFamily=CRYPTO_ALGOFAM_NOT_SET, CryptoPrimitiveService=RANDOM
        HaeHsm_Primitive_KeyDerive: CryptoPrimitiveAlgorithmFamily=CRYPTO_ALGOFAM_PBKDF2, CryptoPrimitiveAlgorithmMode=CRYPTO_ALGOMODE_HMAC, CryptoPrimitiveAlgorithmSecondaryFamily=CRYPTO_ALGOFAM_SHA2_256, CryptoPrimitiveService=KEY_DERIVE
    HaeCryptoLibPrimitives (CryptoPrimitives)
      6 x CryptoPrimitive:
        HaeCryptoLib_Primitive_Sha256: CryptoPrimitiveAlgorithmFamily=CRYPTO_ALGOFAM_SHA2_256, CryptoPrimitiveAlgorithmMode=CRYPTO_ALGOMODE_NOT_SET, CryptoPrimitiveAlgorithmSecondaryFamily=CRYPTO_ALGOFAM_NOT_SET, CryptoPrimitiveService=HASH
        HaeCryptoLib_Primitive_AesCtr_Decrypt: CryptoPrimitiveAlgorithmFamily=CRYPTO_ALGOFAM_AES, CryptoPrimitiveAlgorithmMode=CRYPTO_ALGOMODE_CTR, CryptoPrimitiveAlgorithmSecondaryFamily=CRYPTO_ALGOFAM_NOT_SET, CryptoPrimitiveService=DECRYPT
        HaeCryptoLib_Primitive_AesCmac_Verify: CryptoPrimitiveAlgorithmFamily=CRYPTO_ALGOFAM_AES, CryptoPrimitiveAlgorithmMode=CRYPTO_ALGOMODE_CMAC, CryptoPrimitiveAlgorithmSecondaryFamily=CRYPTO_ALGOFAM_NOT_SET, CryptoPrimitiveService=MAC_VERIFY
        HaeCryptoLib_Primitive_RsassaPkcs15Sha256_Verify: CryptoPrimitiveAlgorithmMode=CRYPTO_ALGOMODE_RSASSA_PKCS1_v1_5, CryptoPrimitiveAlgorithmFamily=CRYPTO_ALGOFAM_RSA, CryptoPrimitiveAlgorithmSecondaryFamily=CRYPTO_ALGOFAM_SHA2_256, CryptoPrimitiveService=SIGNATURE_VERIFY
        HaeCryptoLib_Primitive_HashDrbgSha256_Generate: CryptoPrimitiveService=RANDOM, CryptoPrimitiveAlgorithmFamily=CRYPTO_ALGOFAM_DRBG, CryptoPrimitiveAlgorithmMode=CRYPTO_ALGOMODE_NOT_SET, CryptoPrimitiveAlgorithmSecondaryFamily=CRYPTO_ALGOFAM_SHA2_256
        HaeCryptoLib_Primitive_HashDrbgSha256_Seed: CryptoPrimitiveAlgorithmFamily=CRYPTO_ALGOFAM_DRBG, CryptoPrimitiveAlgorithmMode=CRYPTO_ALGOMODE_NOT_SET, CryptoPrimitiveAlgorithmSecondaryFamily=CRYPTO_ALGOFAM_SHA2_256, CryptoPrimitiveService=RANDOMSEED
