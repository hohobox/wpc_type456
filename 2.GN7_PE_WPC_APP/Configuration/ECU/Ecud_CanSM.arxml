AUTOSAR XML (schema 4-0-3)
package /AUTOSAR
  module config CanSM: implementation-config-variant=VARIANT-PRE-COMPILE, module-description=BswImplementation_CanSM
    CanSMGeneral: CanSMDevErrorDetect=1, CanSMMainFunctionTimePeriod=0.005, CanSMVersionInfoApi=0, CanSmChangeBaudrateApi=0, CanSMPncSupport=0
    CanSMConfiguration: CanSMModeRequestRepetitionMax=3, CanSMModeRequestRepetitionTime=0.03
      CanSMManagerNetwork_BCAN (CanSMManagerNetwork):
        category = TOOL_CONFIGURED
        CanSMBorTimeTxEnsured = 0.91
        CanSMBorTimeL1 = 0.090
        CanSMBorTimeL2 = 0.090
        CanSMBorCounterL1ToL2 = 125
        CanSMBorTxConfirmationPolling = 0
        CanSMTransceiverId = CanIfTrcvCfg_BCAN
        CanSMComMNetworkHandleRef = ComMChannel_BCAN
        CanSMController_WPC_BCAN (CanSMController): category=TOOL_CONFIGURED, CanSMControllerId=CanIfCtrlCfg_WPC_BCAN
        CanSMDemEventParameterRefs: CANSM_E_BUS_OFF=CANSM_E_BUS_OFF_BCAN, CANSM_E_MODE_CHANGE=CANSM_E_MODE_CHANGE_BCAN
      CanSMManagerNetwork_LCAN (CanSMManagerNetwork):
        category = TOOL_CONFIGURED
        CanSMBorTimeL1 = 0.090
        CanSMBorCounterL1ToL2 = 125
        CanSMBorTxConfirmationPolling = 0
        CanSMBorTimeL2 = 0.090
        CanSMBorTimeTxEnsured = 0.91
        CanSMTransceiverId = CanIfTrcvCfg_LCAN
        CanSMComMNetworkHandleRef = ComMChannel_LCAN
        CanSMController_WPC_LCAN (CanSMController): category=TOOL_CONFIGURED, CanSMControllerId=CanIfCtrlCfg_WPC_LCAN
        CanSMDemEventParameterRefs: CANSM_E_BUS_OFF=CANSM_E_BUS_OFF_LCAN, CANSM_E_MODE_CHANGE=CANSM_E_MODE_CHANGE_LCAN
