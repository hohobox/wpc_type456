AUTOSAR XML (schema 4-0-3)
package /AUTOSAR
  module config ComM: implementation-config-variant=VARIANT-PRE-COMPILE, module-description=BswImplementation_ComM
    ComMGeneral:
      ComMDevErrorDetect = 1
      ComMEcuGroupClassification = 3
      ComMModeLimitationEnabled = 0
      ComMPncSupport = 1
      ComMSynchronousWakeUp = 0
      ComMTMinFullComModeDuration = 0.005
      ComMVersionInfoApi = 1
      ComMWakeupInhibitionEnabled = 0
      ComMDirectUserMapping = 0
      ComMPncGatewayEnabled = 0
      ComMCanCMSupport = 1
      ComMBusloadDetectingApi = 1
      ComMPncPrepareSleepTimer = 0.5
    ComMConfigSet: ComMPncEnabled=1
      ComMUser_PNC141 (ComMUser): category=TOOL_CONFIGURED, ComMUserIdentifier=2
      ComMChannel_BCAN (ComMChannel):
        category = TOOL_CONFIGURED
        ComMBusType = COMM_BUS_TYPE_CAN
        ComMChannelId = 0
        ComMMainFunctionPeriod = 0.005
        ComMFullCommRequestNotificationEnabled = 0
        ComMGlobalNvmBlockDescriptor = 0
        ComMNoCom = 0
        ComMNoWakeup = 0
        ComMNetworkManagement_BCAN (ComMNetworkManagement): category=TOOL_CONFIGURED, ComMNmLightTimeout=0, ComMNmVariant=FULL, ComMPncNmRequest=0
      ComMChannel_LCAN (ComMChannel):
        category = TOOL_CONFIGURED
        ComMBusType = COMM_BUS_TYPE_CAN
        ComMChannelId = 1
        ComMMainFunctionPeriod = 0.005
        ComMFullCommRequestNotificationEnabled = 0
        ComMGlobalNvmBlockDescriptor = 0
        ComMNoWakeup = 0
        ComMNoCom = 0
        ComMNetworkManagement_LCAN (ComMNetworkManagement): category=TOOL_CONFIGURED, ComMNmLightTimeout=0, ComMNmVariant=FULL, ComMPncNmRequest=0
      ComMPnc_PNC141 (ComMPnc): category=TOOL_CONFIGURED, ComMPncId=141, ComMUserPerPnc=ComMUser_PNC141, ComMChannelPerPnc=ComMChannel_BCAN
        ComMPnc_ComSignal_Tx_BCAN_PNC_141 (ComMPncComSignal):
          category = TOOL_CONFIGURED
          ComMPncComSignalKind = EIRA
          ComMPncComSignalDirection = TX
          ComMPncComSignalChannelRef = ComMChannel_BCAN
          ComMPncComSignalRef = ComISignal_Tx_PncVector_BCAN
        ComMPnc_ComSignal_Rx_Can_PNC_141 (ComMPncComSignal): category=TOOL_CONFIGURED, ComMPncComSignalKind=EIRA, ComMPncComSignalDirection=RX, ComMPncComSignalRef=ComISignal_Rx_EIRA_CanNm
      ComMUser_PNC153 (ComMUser): category=TOOL_CONFIGURED, ComMUserIdentifier=3
      ComMPnc_PNC153 (ComMPnc): category=TOOL_CONFIGURED, ComMPncId=153, ComMUserPerPnc=ComMUser_PNC153, ComMChannelPerPnc=ComMChannel_BCAN
        ComMPnc_ComSignal_Tx_BCAN_PNC_153 (ComMPncComSignal):
          category = TOOL_CONFIGURED
          ComMPncComSignalKind = EIRA
          ComMPncComSignalDirection = TX
          ComMPncComSignalChannelRef = ComMChannel_BCAN
          ComMPncComSignalRef = ComISignal_Tx_PncVector_BCAN
        ComMPnc_ComSignal_Rx_Can_PNC_153 (ComMPncComSignal): category=TOOL_CONFIGURED, ComMPncComSignalKind=EIRA, ComMPncComSignalDirection=RX, ComMPncComSignalRef=ComISignal_Rx_EIRA_CanNm
      ComMUser_PNC32 (ComMUser): category=TOOL_CONFIGURED, ComMUserIdentifier=0
      ComMPnc_PNC32 (ComMPnc): category=TOOL_CONFIGURED, ComMPncId=32, ComMUserPerPnc=ComMUser_PNC32, ComMChannelPerPnc=ComMChannel_LCAN, ComMChannelPerPnc=ComMChannel_BCAN
        3 x ComMPncComSignal, all with category=TOOL_CONFIGURED, ComMPncComSignalKind=EIRA:
          ComMPnc_ComSignal_Tx_BCAN_PNC_32: ComMPncComSignalDirection=TX, ComMPncComSignalChannelRef=ComMChannel_BCAN, ComMPncComSignalRef=ComISignal_Tx_PncVector_BCAN
          ComMPnc_ComSignal_Rx_Can_PNC_32: ComMPncComSignalDirection=RX, ComMPncComSignalRef=ComISignal_Rx_EIRA_CanNm
          ComMPnc_ComSignal_Tx_LCAN_PNC_32: ComMPncComSignalDirection=TX, ComMPncComSignalChannelRef=ComMChannel_LCAN, ComMPncComSignalRef=ComISignal_Tx_PncVector_LCAN
      ComMUser_PNC159 (ComMUser): category=TOOL_CONFIGURED, ComMUserIdentifier=1
      ComMPnc_PNC159 (ComMPnc): category=TOOL_CONFIGURED, ComMPncId=159, ComMUserPerPnc=ComMUser_PNC159, ComMChannelPerPnc=ComMChannel_LCAN
        ComMPnc_ComSignal_Tx_LCAN_PNC_159 (ComMPncComSignal):
          category = TOOL_CONFIGURED
          ComMPncComSignalKind = EIRA
          ComMPncComSignalDirection = TX
          ComMPncComSignalChannelRef = ComMChannel_LCAN
          ComMPncComSignalRef = ComISignal_Tx_PncVector_LCAN
        ComMPnc_ComSignal_Rx_Can_PNC_159 (ComMPncComSignal): category=TOOL_CONFIGURED, ComMPncComSignalKind=EIRA, ComMPncComSignalDirection=RX, ComMPncComSignalRef=ComISignal_Rx_EIRA_CanNm
