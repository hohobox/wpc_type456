AUTOSAR XML (schema 4-3-0)
package /AUTOSAR
  module config CanNm: module-description=BswImplementation_CanNm
    CanNmGlobalConfig:
      CanNmBusLoadReductionEnabled = 0
      CanNmBusSynchronizationEnabled = 0
      CanNmComControlEnabled = 1
      CanNmComUserDataSupport = 1
      CanNmCoordinatorSyncSupport = 0
      CanNmDevErrorDetect = 1
      CanNmGlobalPnSupport = 1
      CanNmImmediateRestartEnabled = 0
      CanNmImmediateTxconfEnabled = 0
      CanNmMainFunctionPeriod = 0.01
      CanNmPassiveModeEnabled = 0
      CanNmPduRxIndicationEnabled = 0
      CanNmRemoteSleepIndEnabled = 0
      CanNmStateChangeIndEnabled = 1
      CanNmUserDataEnabled = 1
      CanNmVersionInfoApi = 1
      CanNmNodeDetectionEnabled = 1
      CanNmNodeIdEnabled = 1
      CanNmPnEiraCalcEnabled = 1
      CanNmRepeatMsgIndEnabled = 0
      CanNmForcePnAvailabilityConfEnabled = 1
      CanNmPnResetTime = 0.5
      CanNmChangeTwaitBusSleepEnabled = 0
      CanNmPassiveNodeEnabled = 0
      CanNmPnEiraRxNSduRef = Pdu_ComMPdu_Rx_EIRA_CanNm
      CanNmChannelConfig_BCAN (CanNmChannelConfig):
        category = TOOL_CONFIGURED
        CanNmActiveWakeupBitEnabled = 1
        CanNmAllNmMessagesKeepAwake = 0
        CanNmBusLoadReductionActive = 0
        CanNmCarWakeUpFilterEnabled = 0
        CanNmCarWakeUpRxEnabled = 0
        CanNmImmediateNmCycleTime = 0.01
        CanNmImmediateNmTransmissions = 3
        CanNmMsgCycleOffset = 0.0
        CanNmMsgCycleTime = 0.1
        CanNmMsgReducedTime = 1.0
        CanNmMsgTimeoutTime = 0.1
        CanNmNodeDetectionEnabled = 1
        CanNmNodeId = 158
        CanNmNodeIdEnabled = 1
        CanNmPduCbvPosition = CANNM_PDU_BYTE_1
        CanNmPduNetworkRequestReasonPosition = CANNM_PDU_BYTE_2
        CanNmPduNmStatePosition = CANNM_PDU_BYTE_3
        CanNmPduNidPosition = CANNM_PDU_BYTE_0
        CanNmPnEnabled = 1
        CanNmPnEraCalcEnabled = 0
        CanNmPnHandleMultipleNetworkRequests = 0
        CanNmRemoteSleepIndTime = 5.0
        CanNmRepeatMessageTime = 1.2
        CanNmRepeatMsgIndEnabled = 0
        CanNmTimeoutTime = 1.0
        CanNmWaitBusSleepTime = 1.5
        CanNmComMNetworkHandleRef = ComMChannel_BCAN
        CanNmTxPdu_NmPdu_BCAN_NM_WPC_FD (CanNmTxPdu): category=TOOL_CONFIGURED, CanNmTxConfirmationPduId=0, CanNmTxPduRef=Pdu_NmPdu_BCAN_NM_WPC_FD
        CanNmUserDataTxPdu_BCAN (CanNmUserDataTxPdu): category=TOOL_CONFIGURED, CanNmTxUserDataPduId=0, CanNmTxUserDataPduRef=Pdu_ComMPdu_Tx_PncVector_BCAN
        CanNmRxPdu_IN_WPC_BCAN_CANNM_MESSAGE (CanNmRxPdu): category=TOOL_CONFIGURED, CanNmRxPduId=0, CanNmRxPduRef=Pdu_NmPdu_BCAN_NM_GW_SAU_DRV_FD
      CanNmChannelConfig_LCAN (CanNmChannelConfig):
        category = TOOL_CONFIGURED
        CanNmActiveWakeupBitEnabled = 1
        CanNmAllNmMessagesKeepAwake = 0
        CanNmBusLoadReductionActive = 0
        CanNmCarWakeUpFilterEnabled = 0
        CanNmCarWakeUpRxEnabled = 0
        CanNmImmediateNmCycleTime = 0.01
        CanNmImmediateNmTransmissions = 3
        CanNmMsgCycleOffset = 0.0
        CanNmMsgCycleTime = 0.1
        CanNmMsgReducedTime = 1.0
        CanNmMsgTimeoutTime = 0.1
        CanNmNodeDetectionEnabled = 1
        CanNmNodeId = 30
        CanNmNodeIdEnabled = 1
        CanNmPduCbvPosition = CANNM_PDU_BYTE_1
        CanNmPduNetworkRequestReasonPosition = CANNM_PDU_BYTE_2
        CanNmPduNmStatePosition = CANNM_PDU_BYTE_3
        CanNmPduNidPosition = CANNM_PDU_BYTE_0
        CanNmPnEnabled = 1
        CanNmPnEraCalcEnabled = 0
        CanNmPnHandleMultipleNetworkRequests = 0
        CanNmRemoteSleepIndTime = 5.0
        CanNmRepeatMessageTime = 1.2
        CanNmRepeatMsgIndEnabled = 0
        CanNmTimeoutTime = 1.0
        CanNmWaitBusSleepTime = 1.5
        CanNmComMNetworkHandleRef = ComMChannel_LCAN
        CanNmTxPdu_NmPdu_LCAN_NM_L_WPC_FD (CanNmTxPdu): category=TOOL_CONFIGURED, CanNmTxConfirmationPduId=1, CanNmTxPduRef=Pdu_NmPdu_LCAN_NM_L_WPC_FD
        CanNmUserDataTxPdu_LCAN (CanNmUserDataTxPdu): category=TOOL_CONFIGURED, CanNmTxUserDataPduId=1, CanNmTxUserDataPduRef=Pdu_ComMPdu_Tx_PncVector_LCAN
        CanNmRxPdu_IN_WPC_LCAN_CANNM_MESSAGE (CanNmRxPdu): category=TOOL_CONFIGURED, CanNmRxPduId=1, CanNmRxPduRef=Pdu_NmPdu_LCAN_NM_L_SAL_FD
      CanNmPnInfo: category=TOOL_CONFIGURED, CanNmPnInfoLength=28, CanNmPnInfoOffset=4
        28 x CanNmPnFilterMaskByte, all with category=TOOL_CONFIGURED:
          CanNmPnFilterMaskByte_4: CanNmPnFilterMaskByteIndex=0, CanNmPnFilterMaskByteValue=1
          CanNmPnFilterMaskByte_5: CanNmPnFilterMaskByteIndex=1, CanNmPnFilterMaskByteValue=0
          CanNmPnFilterMaskByte_6: CanNmPnFilterMaskByteIndex=2, CanNmPnFilterMaskByteValue=0
          CanNmPnFilterMaskByte_7: CanNmPnFilterMaskByteIndex=3, CanNmPnFilterMaskByteValue=0
          CanNmPnFilterMaskByte_8: CanNmPnFilterMaskByteIndex=4, CanNmPnFilterMaskByteValue=0
          CanNmPnFilterMaskByte_9: CanNmPnFilterMaskByteIndex=5, CanNmPnFilterMaskByteValue=0
          CanNmPnFilterMaskByte_10: CanNmPnFilterMaskByteIndex=6, CanNmPnFilterMaskByteValue=0
          CanNmPnFilterMaskByte_11: CanNmPnFilterMaskByteIndex=7, CanNmPnFilterMaskByteValue=0
          CanNmPnFilterMaskByte_12: CanNmPnFilterMaskByteIndex=8, CanNmPnFilterMaskByteValue=0
          CanNmPnFilterMaskByte_13: CanNmPnFilterMaskByteIndex=9, CanNmPnFilterMaskByteValue=0
          CanNmPnFilterMaskByte_14: CanNmPnFilterMaskByteIndex=10, CanNmPnFilterMaskByteValue=0
          CanNmPnFilterMaskByte_15: CanNmPnFilterMaskByteIndex=11, CanNmPnFilterMaskByteValue=0
          CanNmPnFilterMaskByte_16: CanNmPnFilterMaskByteIndex=12, CanNmPnFilterMaskByteValue=0
          CanNmPnFilterMaskByte_17: CanNmPnFilterMaskByteIndex=13, CanNmPnFilterMaskByteValue=32
          CanNmPnFilterMaskByte_18: CanNmPnFilterMaskByteIndex=14, CanNmPnFilterMaskByteValue=0
          CanNmPnFilterMaskByte_19: CanNmPnFilterMaskByteIndex=15, CanNmPnFilterMaskByteValue=130
          CanNmPnFilterMaskByte_20: CanNmPnFilterMaskByteIndex=16, CanNmPnFilterMaskByteValue=0
          CanNmPnFilterMaskByte_21: CanNmPnFilterMaskByteIndex=17, CanNmPnFilterMaskByteValue=0
          CanNmPnFilterMaskByte_22: CanNmPnFilterMaskByteIndex=18, CanNmPnFilterMaskByteValue=0
          CanNmPnFilterMaskByte_23: CanNmPnFilterMaskByteIndex=19, CanNmPnFilterMaskByteValue=0
          CanNmPnFilterMaskByte_24: CanNmPnFilterMaskByteIndex=20, CanNmPnFilterMaskByteValue=0
          CanNmPnFilterMaskByte_25: CanNmPnFilterMaskByteIndex=21, CanNmPnFilterMaskByteValue=0
          CanNmPnFilterMaskByte_26: CanNmPnFilterMaskByteIndex=22, CanNmPnFilterMaskByteValue=0
          CanNmPnFilterMaskByte_27: CanNmPnFilterMaskByteIndex=23, CanNmPnFilterMaskByteValue=0
          CanNmPnFilterMaskByte_28: CanNmPnFilterMaskByteIndex=24, CanNmPnFilterMaskByteValue=0
          CanNmPnFilterMaskByte_29: CanNmPnFilterMaskByteIndex=25, CanNmPnFilterMaskByteValue=0
          CanNmPnFilterMaskByte_30: CanNmPnFilterMaskByteIndex=26, CanNmPnFilterMaskByteValue=0
          CanNmPnFilterMaskByte_31: CanNmPnFilterMaskByteIndex=27, CanNmPnFilterMaskByteValue=0
