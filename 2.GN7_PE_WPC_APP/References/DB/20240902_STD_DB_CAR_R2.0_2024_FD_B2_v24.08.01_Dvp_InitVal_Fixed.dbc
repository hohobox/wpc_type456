VERSION ""

NS_ :

BS_:

BU_: ARS_FD SHVU_CCS_FD WPC_FD WPC2_FD SCM_FD SHVU_FRNT_FD GW_SAU_DRV_FD ATS_FD PSB_FD GW_PSU_RR_FD SHVU_RL_FD RWPC_FD CGW_CCU OHCL_FD SHVU_REAR_FD BLTN_CAM_FD GW_PSU_DRV_FD FCS_FD GW_PSU_AST_FD GW_PSU_3RD_FD RCS_FD SHVU_3RD_FD GW_PSU_RL_FD SHVU_RR_FD RCM_FD SGU_FD DCM_FD

BO_ 1670 WPCmsgDvp1: 64 WPC_FD
 SG_ WPCmsgDvp1DataByte63 : 504|8@1+ (1,0) [0|0] "" Vector__XXX
 SG_ WPCmsgDvp1DataByte62 : 496|8@1+ (1,0) [0|0] "" Vector__XXX
 SG_ WPCmsgDvp1DataByte61 : 488|8@1+ (1,0) [0|0] "" Vector__XXX
 SG_ WPCmsgDvp1DataByte60 : 480|8@1+ (1,0) [0|0] "" Vector__XXX
 SG_ WPCmsgDvp1DataByte59 : 472|8@1+ (1,0) [0|0] "" Vector__XXX
 SG_ WPCmsgDvp1DataByte58 : 464|8@1+ (1,0) [0|0] "" Vector__XXX
 SG_ WPCmsgDvp1DataByte57 : 456|8@1+ (1,0) [0|0] "" Vector__XXX
 SG_ WPCmsgDvp1DataByte56 : 448|8@1+ (1,0) [0|0] "" Vector__XXX
 SG_ WPCmsgDvp1DataByte55 : 440|8@1+ (1,0) [0|0] "" Vector__XXX
 SG_ WPCmsgDvp1DataByte54 : 432|8@1+ (1,0) [0|0] "" Vector__XXX
 SG_ WPCmsgDvp1DataByte53 : 424|8@1+ (1,0) [0|0] "" Vector__XXX
 SG_ WPCmsgDvp1DataByte52 : 416|8@1+ (1,0) [0|0] "" Vector__XXX
 SG_ WPCmsgDvp1DataByte51 : 408|8@1+ (1,0) [0|0] "" Vector__XXX
 SG_ WPCmsgDvp1DataByte50 : 400|8@1+ (1,0) [0|0] "" Vector__XXX
 SG_ WPCmsgDvp1DataByte49 : 392|8@1+ (1,0) [0|0] "" Vector__XXX
 SG_ WPCmsgDvp1DataByte48 : 384|8@1+ (1,0) [0|0] "" Vector__XXX
 SG_ WPCmsgDvp1DataByte47 : 376|8@1+ (1,0) [0|0] "" Vector__XXX
 SG_ WPCmsgDvp1DataByte46 : 368|8@1+ (1,0) [0|0] "" Vector__XXX
 SG_ WPCmsgDvp1DataByte45 : 360|8@1+ (1,0) [0|0] "" Vector__XXX
 SG_ WPCmsgDvp1DataByte44 : 352|8@1+ (1,0) [0|0] "" Vector__XXX
 SG_ WPCmsgDvp1DataByte43 : 344|8@1+ (1,0) [0|0] "" Vector__XXX
 SG_ WPCmsgDvp1DataByte42 : 336|8@1+ (1,0) [0|0] "" Vector__XXX
 SG_ WPCmsgDvp1DataByte41 : 328|8@1+ (1,0) [0|0] "" Vector__XXX
 SG_ WPCmsgDvp1DataByte40 : 320|8@1+ (1,0) [0|0] "" Vector__XXX
 SG_ WPCmsgDvp1DataByte39 : 312|8@1+ (1,0) [0|0] "" Vector__XXX
 SG_ WPCmsgDvp1DataByte38 : 304|8@1+ (1,0) [0|0] "" Vector__XXX
 SG_ WPCmsgDvp1DataByte37 : 296|8@1+ (1,0) [0|0] "" Vector__XXX
 SG_ WPCmsgDvp1DataByte36 : 288|8@1+ (1,0) [0|0] "" Vector__XXX
 SG_ WPCmsgDvp1DataByte35 : 280|8@1+ (1,0) [0|0] "" Vector__XXX
 SG_ WPCmsgDvp1DataByte34 : 272|8@1+ (1,0) [0|0] "" Vector__XXX
 SG_ WPCmsgDvp1DataByte33 : 264|8@1+ (1,0) [0|0] "" Vector__XXX
 SG_ WPCmsgDvp1DataByte32 : 256|8@1+ (1,0) [0|0] "" Vector__XXX
 SG_ WPCmsgDvp1DataByte31 : 248|8@1+ (1,0) [0|0] "" Vector__XXX
 SG_ WPCmsgDvp1DataByte30 : 240|8@1+ (1,0) [0|0] "" Vector__XXX
 SG_ WPCmsgDvp1DataByte29 : 232|8@1+ (1,0) [0|0] "" Vector__XXX
 SG_ WPCmsgDvp1DataByte28 : 224|8@1+ (1,0) [0|0] "" Vector__XXX
 SG_ WPCmsgDvp1DataByte27 : 216|8@1+ (1,0) [0|0] "" Vector__XXX
 SG_ WPCmsgDvp1DataByte26 : 208|8@1+ (1,0) [0|0] "" Vector__XXX
 SG_ WPCmsgDvp1DataByte25 : 200|8@1+ (1,0) [0|0] "" Vector__XXX
 SG_ WPCmsgDvp1DataByte24 : 192|8@1+ (1,0) [0|0] "" Vector__XXX
 SG_ WPCmsgDvp1DataByte23 : 184|8@1+ (1,0) [0|0] "" Vector__XXX
 SG_ WPCmsgDvp1DataByte22 : 176|8@1+ (1,0) [0|0] "" Vector__XXX
 SG_ WPCmsgDvp1DataByte21 : 168|8@1+ (1,0) [0|0] "" Vector__XXX
 SG_ WPCmsgDvp1DataByte20 : 160|8@1+ (1,0) [0|0] "" Vector__XXX
 SG_ WPCmsgDvp1DataByte19 : 152|8@1+ (1,0) [0|0] "" Vector__XXX
 SG_ WPCmsgDvp1DataByte18 : 144|8@1+ (1,0) [0|0] "" Vector__XXX
 SG_ WPCmsgDvp1DataByte17 : 136|8@1+ (1,0) [0|0] "" Vector__XXX
 SG_ WPCmsgDvp1DataByte16 : 128|8@1+ (1,0) [0|0] "" Vector__XXX
 SG_ WPCmsgDvp1DataByte15 : 120|8@1+ (1,0) [0|0] "" Vector__XXX
 SG_ WPCmsgDvp1DataByte14 : 112|8@1+ (1,0) [0|0] "" Vector__XXX
 SG_ WPCmsgDvp1DataByte13 : 104|8@1+ (1,0) [0|0] "" Vector__XXX
 SG_ WPCmsgDvp1DataByte12 : 96|8@1+ (1,0) [0|0] "" Vector__XXX
 SG_ WPCmsgDvp1DataByte11 : 88|8@1+ (1,0) [0|0] "" Vector__XXX
 SG_ WPCmsgDvp1DataByte10 : 80|8@1+ (1,0) [0|0] "" Vector__XXX
 SG_ WPCmsgDvp1DataByte09 : 72|8@1+ (1,0) [0|0] "" Vector__XXX
 SG_ WPCmsgDvp1DataByte08 : 64|8@1+ (1,0) [0|0] "" Vector__XXX
 SG_ WPCmsgDvp1DataByte07 : 56|8@1+ (1,0) [0|0] "" Vector__XXX
 SG_ WPCmsgDvp1DataByte06 : 48|8@1+ (1,0) [0|0] "" Vector__XXX
 SG_ WPCmsgDvp1DataByte05 : 40|8@1+ (1,0) [0|0] "" Vector__XXX
 SG_ WPCmsgDvp1DataByte04 : 32|8@1+ (1,0) [0|0] "" Vector__XXX
 SG_ WPCmsgDvp1DataByte03 : 24|8@1+ (1,0) [0|0] "" Vector__XXX
 SG_ WPCmsgDvp1DataByte02 : 16|8@1+ (1,0) [0|0] "" Vector__XXX
 SG_ WPCmsgDvp1DataByte01 : 8|8@1+ (1,0) [0|0] "" Vector__XXX
 SG_ WPCmsgDvp1DataByte00 : 0|8@1+ (1,0) [0|0] "" Vector__XXX

BO_ 274 HU_USM_02_00ms: 32 CGW_CCU
 SG_ HU_USM_Crc2Val : 0|16@1+ (1,0) [0|0] ""  GW_PSU_DRV_FD
 SG_ CF_AVN_CluRheostatLvl : 113|5@1+ (1,0) [0|0] "" Vector__XXX
 SG_ CF_AVN_EVReset : 118|2@1+ (1,0) [0|0] "" Vector__XXX
 SG_ CF_AVN_UnitReset : 120|2@1+ (1,0) [0|0] "" Vector__XXX
 SG_ CF_AVN_IcyRoadWarn : 122|2@1+ (1,0) [0|0] "" Vector__XXX
 SG_ CF_AVN_CluServiceReminderReset : 124|2@1+ (1,0) [0|0] "" Vector__XXX
 SG_ CF_AVN_CluUSMReset : 126|2@1+ (1,0) [0|0] ""  ARS_FD,ATS_FD,BLTN_CAM_FD,GW_PSU_3RD_FD,GW_PSU_AST_FD,GW_PSU_DRV_FD,GW_PSU_RL_FD,GW_PSU_RR_FD,GW_SAU_DRV_FD,RCM_FD,RWPC_FD,SGU_FD,SHVU_FRNT_FD,SHVU_REAR_FD,SHVU_RL_FD,SHVU_RR_FD,WPC2_FD,WPC_FD
 SG_ C_HCIMSWeightNValueSet : 128|4@1+ (1,0) [0|0] "" Vector__XXX
 SG_ C_HCIMSHeightNvalueSet : 132|4@1+ (1,0) [0|0] "" Vector__XXX
 SG_ CF_AVN_HCIMSButtonCommand : 136|4@1+ (1,0) [0|0] "" Vector__XXX
 SG_ C_HCIMSSitHeightNValueSet : 140|4@1+ (1,0) [0|0] "" Vector__XXX
 SG_ CF_AVN_BodySpprtSet : 152|2@1+ (1,0) [0|0] ""  GW_PSU_DRV_FD,GW_SAU_DRV_FD
 SG_ HU_USM_AlvCnt2Val : 16|8@1+ (1,0) [0|0] ""  GW_PSU_DRV_FD
 SG_ CF_AVN_AirSptTimeNValueSet : 161|3@1+ (1,0) [0|0] ""  GW_SAU_DRV_FD
 SG_ CF_AVN_AirSptStrNValue : 164|2@1+ (1,0) [0|0] ""  GW_SAU_DRV_FD
 SG_ CF_AVN_SeatDrvModNValueSet : 166|2@1+ (1,0) [0|0] ""  GW_PSU_DRV_FD,GW_SAU_DRV_FD
 SG_ C_SmrtSldngDrNValueSet : 176|3@1+ (1,0) [0|0] "" Vector__XXX
 SG_ CF_AVN_TurboPressureUnit : 179|3@1+ (1,0) [0|0] "" Vector__XXX
 SG_ CF_AVN_CluTorqueUnit : 182|2@1+ (1,0) [0|0] "" Vector__XXX
 SG_ CF_AVN_MoodLpRedNValueSet : 192|10@1+ (1,0) [0|0] "" Vector__XXX
 SG_ CF_AVN_MoodLpGreenNValueSet : 202|10@1+ (1,0) [0|0] "" Vector__XXX
 SG_ CF_AVN_MoodLpBlueNValueSet : 212|10@1+ (1,0) [0|0] "" Vector__XXX
 SG_ CF_AVN_MoodLpBrightNValueSet : 223|9@1+ (1,0) [0|0] "" Vector__XXX
 SG_ CF_AVN_HBANValueSet : 232|2@1+ (1,0) [0|0] "" Vector__XXX
 SG_ CF_AVN_IFSActVehSpd_Set : 234|4@1+ (1,0) [0|0] "" Vector__XXX
 SG_ C_MoodLpDrivingNValue : 238|2@1+ (1,0) [0|0] "" Vector__XXX
 SG_ HU_DrivingPostureAssistUSMSet : 24|4@1+ (1,0) [0|0] "" Vector__XXX
 SG_ C_MoodLPDrivemodeNValue : 240|2@1+ (1,0) [0|0] "" Vector__XXX
 SG_ CF_AVN_SVMAutoOnNvalueSet : 242|2@1+ (1,0) [0|0] "" Vector__XXX
 SG_ CF_AVN_DAW_LVDANValueSet : 244|2@1+ (1,0) [0|0] "" Vector__XXX
 SG_ CF_AVN_Clu3dDepthSet : 248|3@1+ (1,0) [0|0] "" Vector__XXX
 SG_ C_MoodLpFadeNValue : 251|2@1+ (1,0) [0|0] ""  ATS_FD
 SG_ HU_DrvCushAirSprtUSMSet : 28|3@1+ (1,0) [0|0] "" Vector__XXX
 SG_ HU_AstCushAirSprtUSMSet : 31|3@1+ (1,0) [0|0] "" Vector__XXX
 SG_ HU_DrvStrchMassageSwSet : 34|2@1+ (1,0) [0|0] "" Vector__XXX
 SG_ HU_DrvStrchMassageModeUSMSet : 36|3@1+ (1,0) [0|0] "" Vector__XXX
 SG_ HU_DrvStrchMassageStrengthUSMSet : 39|3@1+ (1,0) [0|0] "" Vector__XXX
 SG_ HU_DrvStrchMassageTimeUSMSet : 42|3@1+ (1,0) [0|0] "" Vector__XXX
 SG_ HU_AstStrchMassageSwSet : 45|2@1+ (1,0) [0|0] "" Vector__XXX
 SG_ HU_AstStrchMassageModeUSMSet : 47|3@1+ (1,0) [0|0] "" Vector__XXX
 SG_ HU_AstStrchMassageStrengthUSMSet : 50|3@1+ (1,0) [0|0] "" Vector__XXX
 SG_ HU_AstStrchMassageTimeUSMSet : 53|3@1+ (1,0) [0|0] "" Vector__XXX
 SG_ HU_DrvMsgPulseUSMSet : 56|2@1+ (1,0) [0|0] "" Vector__XXX
 SG_ HU_AstMsgPulseUSMSet : 58|2@1+ (1,0) [0|0] "" Vector__XXX
 SG_ HU_RLMsgPulseUSMSet : 60|2@1+ (1,0) [0|0] "" Vector__XXX
 SG_ HU_RRMsgPulseUSMSet : 62|2@1+ (1,0) [0|0] "" Vector__XXX
 SG_ CF_AVN_CluWelcomeSnd : 64|2@1+ (1,0) [0|0] "" Vector__XXX
 SG_ CF_AVN_CluServiceReminderSet : 72|2@1+ (1,0) [0|0] "" Vector__XXX
 SG_ CF_AVN_CluTransmissionDisp : 74|2@1+ (1,0) [0|0] "" Vector__XXX
 SG_ CF_AVN_CluWiperLight : 76|2@1+ (1,0) [0|0] "" Vector__XXX
 SG_ CF_AVN_CluRoadInfoGuide : 78|2@1+ (1,0) [0|0] "" Vector__XXX
 SG_ CF_AVN_CluUserSettingPeriod : 81|7@1+ (1,0) [0|0] "" Vector__XXX
 SG_ CF_AVN_CluFuelEconUnit_mi : 91|2@1+ (1,0) [0|0] "" Vector__XXX
 SG_ CF_AVN_CluFuelEconUnit_km : 93|2@1+ (1,0) [0|0] "" Vector__XXX
 SG_ CF_AVN_CluUserSettingDistance : 95|17@1+ (1,0) [0|0] "" Vector__XXX

BO_ 273 HU_USM_01_00ms: 32 CGW_CCU
 SG_ HU_USM_Crc1Val : 0|16@1+ (1,0) [0|0] "" Vector__XXX
 SG_ CF_AVN_RCCWNValueSet : 110|2@1+ (1,0) [0|0] "" Vector__XXX
 SG_ CF_AVN_PDWAutoOnNValueSet : 116|2@1+ (1,0) [0|0] "" Vector__XXX
 SG_ Usm_RpmTERRAINAUTO : 118|2@1+ (1,0) [0|0] "" Vector__XXX
 SG_ Usm_RpmSNOWSet : 120|2@1+ (1,0) [0|0] "" Vector__XXX
 SG_ C_TempUnit : 123|2@1+ (1,0) [0|0] "" Vector__XXX
 SG_ CF_AVN_AdasVolumeNValueSet : 125|3@1+ (1,0) [0|0] "" Vector__XXX
 SG_ C_PTGMNValueSet : 128|2@1+ (1,0) [0|0] "" Vector__XXX
 SG_ CF_AVN_ADrUNValueSet : 130|3@1+ (1,0) [0|0] "" Vector__XXX
 SG_ CF_AVN_EscortHLNValueSet : 136|2@1+ (1,0) [0|0] "" Vector__XXX
 SG_ CF_AVN_PSMNValueSet : 138|3@1+ (1,0) [0|0] "" Vector__XXX
 SG_ C_HfreeTrunkTgNValueSet : 141|3@1+ (1,0) [0|0] "" Vector__XXX
 SG_ CF_AVN_TrfChgSet : 145|2@1+ (1,0) [0|0] "" Vector__XXX
 SG_ CF_AVN_SCMNValueSet : 147|2@1+ (1,0) [0|0] "" Vector__XXX
 SG_ CF_AVN_OTTurnNValueSet : 149|3@1+ (1,0) [0|0] "" Vector__XXX
 SG_ CF_Gway_WPCNValueSet : 152|2@1+ (1,0) [0|0] ""  WPC_FD,WPC2_FD
 SG_ C_AVN_RearWiperNValueSet : 154|2@1+ (1,0) [0|0] "" Vector__XXX
 SG_ C_UnlockWelocomeNValueSet : 156|2@1+ (1,0) [0|0] "" Vector__XXX
 SG_ C_SmartWelocomeNValueSet : 158|2@1+ (1,0) [0|0] "" Vector__XXX
 SG_ HU_USM_AlvCnt1Val : 16|8@1+ (1,0) [0|0] "" Vector__XXX
 SG_ CF_AVN_PTGSpeedNValueSet : 160|2@1+ (1,0) [0|0] "" Vector__XXX
 SG_ CR_Datc_DRSeatWheel_USM_Set : 162|2@1+ (1,0) [0|0] "" Vector__XXX
 SG_ CF_AVN_TTUnlockNValueSet : 166|2@1+ (1,0) [0|0] "" Vector__XXX
 SG_ CF_Gway_RWPCNValueSet : 168|2@1+ (1,0) [0|0] ""  RWPC_FD
 SG_ C_PSDNValueSet : 172|2@1+ (1,0) [0|0] "" Vector__XXX
 SG_ CF_Avn_HAPTICWARNINGNValueSet : 177|3@1+ (1,0) [0|0] "" Vector__XXX
 SG_ CR_Datc_DRSeatHeat_USM_Set : 180|2@1+ (1,0) [0|0] "" Vector__XXX
 SG_ C_WALNValueSet : 182|2@1+ (1,0) [0|0] "" Vector__XXX
 SG_ C_ApprUnlockNValue : 184|2@1+ (1,0) [0|0] "" Vector__XXX
 SG_ CF_AVN_HudSet : 198|2@1+ (1,0) [0|0] "" Vector__XXX
 SG_ CF_AVN_HudContetnsTBT : 200|2@1+ (1,0) [0|0] "" Vector__XXX
 SG_ CF_AVN_HudContetnsSCC : 210|2@1+ (1,0) [0|0] "" Vector__XXX
 SG_ CF_AVN_HudContetnsDIS : 214|2@1+ (1,0) [0|0] "" Vector__XXX
 SG_ CF_AVN_HudContetnsBSD : 222|2@1+ (1,0) [0|0] "" Vector__XXX
 SG_ CF_AVN_HudHeightSet : 225|5@1+ (1,0) [0|0] "" Vector__XXX
 SG_ CF_AVN_HudBrightnessSet : 232|5@1+ (1,0) [0|0] "" Vector__XXX
 SG_ CF_AVN_HudRotationSet : 237|5@1+ (1,0) [0|0] "" Vector__XXX
 SG_ AVN_BPCM_DrvReq : 24|2@1+ (1,0) [0|0] "" Vector__XXX
 SG_ CF_AVN_HudContentsAVInfo : 242|2@1+ (1,0) [0|0] "" Vector__XXX
 SG_ CF_AVN_SportHUD : 246|2@1+ (1,0) [0|0] "" Vector__XXX
 SG_ USM_RpmCOMFORTSet : 251|2@1+ (1,0) [0|0] "" Vector__XXX
 SG_ USM_RpmNORMALSet : 253|2@1+ (1,0) [0|0] "" Vector__XXX
 SG_ AVN_BPCM_AstReq : 26|2@1+ (1,0) [0|0] "" Vector__XXX
 SG_ AVN_BPCM_RLReq : 28|2@1+ (1,0) [0|0] "" Vector__XXX
 SG_ AVN_BPCM_RRReq : 30|2@1+ (1,0) [0|0] "" Vector__XXX
 SG_ AVN_BPCM_Drv1_USMOnReq : 32|2@1+ (1,0) [0|0] "" Vector__XXX
 SG_ AVN_BPCM_Drv2_USMOnReq : 34|2@1+ (1,0) [0|0] "" Vector__XXX
 SG_ AVN_BPCM_Drv3_USMOnReq : 36|2@1+ (1,0) [0|0] "" Vector__XXX
 SG_ AVN_BPCM_Drv4_USMOnReq : 38|2@1+ (1,0) [0|0] "" Vector__XXX
 SG_ AVN_BPCM_Ast1_USMOnReq : 40|2@1+ (1,0) [0|0] "" Vector__XXX
 SG_ AVN_BPCM_Ast2_USMOnReq : 42|2@1+ (1,0) [0|0] "" Vector__XXX
 SG_ AVN_BPCM_Ast3_USMOnReq : 44|2@1+ (1,0) [0|0] "" Vector__XXX
 SG_ AVN_BPCM_Ast4_USMOnReq : 46|2@1+ (1,0) [0|0] "" Vector__XXX
 SG_ AVN_BPCM_RL1_USMOnReq : 48|2@1+ (1,0) [0|0] "" Vector__XXX
 SG_ AVN_BPCM_RL2_USMOnReq : 50|2@1+ (1,0) [0|0] "" Vector__XXX
 SG_ AVN_BPCM_RL3_USMOnReq : 52|2@1+ (1,0) [0|0] "" Vector__XXX
 SG_ AVN_BPCM_RL4_USMOnReq : 54|2@1+ (1,0) [0|0] "" Vector__XXX
 SG_ AVN_BPCM_RR1_USMOnReq : 56|2@1+ (1,0) [0|0] "" Vector__XXX
 SG_ AVN_BPCM_RR2_USMOnReq : 58|2@1+ (1,0) [0|0] "" Vector__XXX
 SG_ AVN_BPCM_RR3_USMOnReq : 60|2@1+ (1,0) [0|0] "" Vector__XXX
 SG_ AVN_BPCM_RR4_USMOnReq : 62|2@1+ (1,0) [0|0] "" Vector__XXX
 SG_ CF_AVN_HDANValueSet : 78|2@1+ (1,0) [0|0] "" Vector__XXX
 SG_ CF_AVN_NSCCCamNValueSet : 84|2@1+ (1,0) [0|0] "" Vector__XXX
 SG_ CF_AVN_ISLWNValueSet : 91|2@1+ (1,0) [0|0] "" Vector__XXX
 SG_ CF_AVN_NCC_USM_set : 96|2@1+ (1,0) [0|0] "" Vector__XXX
 SG_ CF_AVN_TirePressUnitNValueSet : 98|3@1+ (1,0) [0|0] "" Vector__XXX

BO_ 745 PDC_FD_15_300ms: 32 CGW_CCU
 SG_ PDC_FD_Crc15Val : 0|16@1+ (1,0) [0|0] ""  ARS_FD,ATS_FD,BLTN_CAM_FD,FCS_FD,GW_PSU_3RD_FD,GW_PSU_AST_FD,GW_PSU_DRV_FD,GW_PSU_RL_FD,GW_PSU_RR_FD,GW_SAU_DRV_FD,OHCL_FD,PSB_FD,RCM_FD,RCS_FD,RWPC_FD,SCM_FD,SGU_FD,SHVU_3RD_FD,SHVU_FRNT_FD,SHVU_REAR_FD,SHVU_RL_FD,SHVU_RR_FD,WPC2_FD,WPC_FD
 SG_ PDC_CurrAtReset : 104|12@1+ (10,-40940) [-40940|0] "mA" Vector__XXX
 SG_ PDC_AvgCurrAtReset : 120|12@1+ (10,-40940) [-40940|0] "mA" Vector__XXX
 SG_ PDC_ResetReason : 132|3@1+ (1,0) [0|0] "" Vector__XXX
 SG_ PDC_CumulativeCountOf12VReq : 136|10@1+ (1,0) [0|0] "" Vector__XXX
 SG_ PDC_CumulativeCountOfCCUReq : 146|10@1+ (1,0) [0|0] "" Vector__XXX
 SG_ PDC_FD_AlvCnt15Val : 16|8@1+ (1,0) [0|0] ""  ARS_FD,ATS_FD,BLTN_CAM_FD,FCS_FD,GW_PSU_3RD_FD,GW_PSU_AST_FD,GW_PSU_DRV_FD,GW_PSU_RL_FD,GW_PSU_RR_FD,GW_SAU_DRV_FD,OHCL_FD,PSB_FD,RCM_FD,RCS_FD,RWPC_FD,SCM_FD,SGU_FD,SHVU_3RD_FD,SHVU_FRNT_FD,SHVU_REAR_FD,SHVU_RL_FD,SHVU_RR_FD,WPC2_FD,WPC_FD
 SG_ PDC_LDConReq : 184|2@1+ (1,0) [0|0] ""  BLTN_CAM_FD
 SG_ PDC_LDConReq_By_LVBat : 186|2@1+ (1,0) [0|0] ""  BLTN_CAM_FD
 SG_ PDC_LDConReq_By_OTA : 188|2@1+ (1,0) [0|0] "" Vector__XXX
 SG_ PDC_LDConReq_By_Load : 190|2@1+ (1,0) [0|0] "" Vector__XXX
 SG_ PDC_LDConReq_By_ActiveOn : 192|2@1+ (1,0) [0|0] ""  BLTN_CAM_FD
 SG_ PDC_ResetPreWrngForCCU : 40|2@1+ (1,0) [0|0] "" Vector__XXX
 SG_ PDC_ResetPreWrngForOthers : 42|2@1+ (1,0) [0|0] ""  ARS_FD,ATS_FD,BLTN_CAM_FD,FCS_FD,GW_PSU_3RD_FD,GW_PSU_AST_FD,GW_PSU_DRV_FD,GW_PSU_RL_FD,GW_PSU_RR_FD,GW_SAU_DRV_FD,OHCL_FD,PSB_FD,RCM_FD,RCS_FD,RWPC_FD,SCM_FD,SGU_FD,SHVU_3RD_FD,SHVU_FRNT_FD,SHVU_REAR_FD,SHVU_RL_FD,SHVU_RR_FD,WPC2_FD,WPC_FD
 SG_ PDC_ResetReqForCCU : 44|2@1+ (1,0) [0|0] "" Vector__XXX
 SG_ PDC_ResetReqForOthers : 46|2@1+ (1,0) [0|0] ""  ARS_FD,ATS_FD,BLTN_CAM_FD,FCS_FD,GW_PSU_3RD_FD,GW_PSU_AST_FD,GW_PSU_DRV_FD,GW_PSU_RL_FD,GW_PSU_RR_FD,GW_SAU_DRV_FD,OHCL_FD,PSB_FD,RCM_FD,RCS_FD,RWPC_FD,SCM_FD,SGU_FD,SHVU_3RD_FD,SHVU_FRNT_FD,SHVU_REAR_FD,SHVU_RL_FD,SHVU_RR_FD,WPC2_FD,WPC_FD
 SG_ PDC_ResetFuncOpt : 48|2@1+ (1,0) [0|0] "" Vector__XXX
 SG_ PDC_12VRlyCtrl : 50|2@1+ (1,0) [0|0] "" Vector__XXX
 SG_ PDC_CurrentValueForReset : 52|8@1+ (50,0) [0|0] "mA" Vector__XXX
 SG_ PDC_TimeValueForReset : 64|8@1+ (0.5,0) [0|0] "h" Vector__XXX
 SG_ PDC_12VRlyOffHoldingTime : 72|5@1+ (0.5,0) [0|0] "s" Vector__XXX
 SG_ PDC_ResetCountSetting : 77|2@1+ (1,0) [0|0] "" Vector__XXX
 SG_ PDC_ResetCount : 79|2@1+ (1,0) [0|0] "" Vector__XXX
 SG_ PDC_ResetCumulativeCount : 81|10@1+ (1,0) [0|0] "" Vector__XXX
 SG_ PDC_ResetOpsta : 91|2@1+ (1,0) [0|0] "" Vector__XXX
 SG_ PDC_ReadyTimeValueForReset : 96|8@1+ (10,0) [0|255] "Min" Vector__XXX

BO_ 278 HU_USM_05_00ms: 32 CGW_CCU
 SG_ HU_USM_Crc5Val : 0|16@1+ (1,0) [0|0] "" Vector__XXX
 SG_ CF_AVN_AIVoiceMicModNvalue : 101|6@1+ (1,0) [0|0] "" Vector__XXX
 SG_ CF_AVN_AIVoiceTTSModNvalue : 107|6@1+ (1,0) [0|0] "" Vector__XXX
 SG_ CF_AVN_WiperAutoModeSet : 113|3@1+ (1,0) [0|0] "" Vector__XXX
 SG_ CF_AVN_AFCUAutoWashModeSet : 116|3@1+ (1,0) [0|0] "" Vector__XXX
 SG_ CF_AVN_PSDAutoWashModeSet : 119|3@1+ (1,0) [0|0] "" Vector__XXX
 SG_ CF_AVN_PTGAutoWashModeSet : 122|3@1+ (1,0) [0|0] "" Vector__XXX
 SG_ CF_AVN_CDMAutoWashModeSet : 125|3@1+ (1,0) [0|0] "" Vector__XXX
 SG_ CF_AVN_Roof_OprLvSet : 128|3@1+ (1,0) [0|0] ""  SGU_FD
 SG_ CF_AVN_2ndLeftDoor_OptLvSet : 131|3@1+ (1,0) [0|0] ""  SGU_FD
 SG_ CF_AVN_2ndRightDoor_OptLvSet : 134|3@1+ (1,0) [0|0] ""  SGU_FD
 SG_ CF_AVN_3rdLeftDoor_OptLvlSet : 137|3@1+ (1,0) [0|0] ""  SGU_FD
 SG_ CF_AVN_3rdRightDoor_OptLvlSet : 140|3@1+ (1,0) [0|0] ""  SGU_FD
 SG_ CF_AVN_RearDoor_OptLvlSet : 143|3@1+ (1,0) [0|0] ""  SGU_FD
 SG_ CF_AVN_RollBlindOnOffSet : 146|2@1+ (1,0) [0|0] ""  SGU_FD
 SG_ CF_AVN_CluThmAutoSet_New : 148|2@1+ (1,0) [0|0] "" Vector__XXX
 SG_ CF_AVN_CluThmSet_New : 150|3@1+ (1,0) [0|0] "" Vector__XXX
 SG_ CF_AVN_CluThmDtlSet_New : 153|3@1+ (1,0) [0|0] "" Vector__XXX
 SG_ CF_AVN_DWL_SelectNvalueSet : 158|4@1+ (1,0) [0|0] "" Vector__XXX
 SG_ HU_USM_AlvCnt5Val : 16|8@1+ (1,0) [0|0] "" Vector__XXX
 SG_ CF_Gway_WPCAnimationNvalueSet : 168|3@1+ (1,0) [0|0] ""  RWPC_FD,WPC_FD,WPC2_FD
 SG_ USM_BtnIllumiAlwaysOnReq : 177|2@1+ (1,0) [0|0] "" Vector__XXX
 SG_ CF_AVN_LKAWrngVolNvalueSet : 179|2@1+ (1,0) [0|0] "" Vector__XXX
 SG_ DAB_IlluminationVrModeSet : 181|3@1+ (1,0) [0|0] "" Vector__XXX
 SG_ USM_IllAlwaysOnwithPSTNReq : 184|3@1+ (1,0) [0|0] "" Vector__XXX
 SG_ CF_AVN_AutoStopTimerResetSet : 187|3@1+ (1,0) [0|0] "" Vector__XXX
 SG_ USM_RrCurtainSet : 190|2@1+ (1,0) [0|0] "" Vector__XXX
 SG_ USM_AdasISLAEUCntry1Set : 192|8@1+ (1,0) [0|0] "" Vector__XXX
 SG_ USM_AdasISLAEUCntryTglSet : 200|2@1+ (1,0) [0|0] "" Vector__XXX
 SG_ xHEV_SmartRegen_Map_Set : 202|2@1+ (1,0) [0|0] "" Vector__XXX
 SG_ HU_ChgCtrMode : 204|2@1+ (1,0) [0|0] "" Vector__XXX
 SG_ CF_AVN_HudContentsCallPopup : 206|2@1+ (1,0) [0|0] "" Vector__XXX
 SG_ HU_EconStHr_WeekDay : 208|5@1+ (1,0) [0|23] "Hour" Vector__XXX
 SG_ HU_EconStMin_WeekDay : 213|3@1+ (10,0) [0|50] "Min" Vector__XXX
 SG_ HU_EconEndHr_WeekDay : 216|5@1+ (1,0) [0|23] "Hour" Vector__XXX
 SG_ HU_EconEndMin_WeekDay : 221|3@1+ (10,0) [0|50] "Min" Vector__XXX
 SG_ HU_DepartSet_Hour : 224|5@1+ (1,0) [0|23] "Hour" Vector__XXX
 SG_ HU_DepartSet_Min : 229|3@1+ (10,0) [0|50] "Min" Vector__XXX
 SG_ HU_DepartSetDay : 232|8@1+ (1,0) [0|0] "" Vector__XXX
 SG_ HU_DepartSet_TempSet : 240|6@1+ (0.5,15) [15|32] "℃" Vector__XXX
 SG_ HU_DepartSettingValue : 246|2@1+ (1,0) [0|0] "" Vector__XXX
 SG_ HU_NdepartSet : 249|3@1+ (1,0) [0|0] "" Vector__XXX
 SG_ HU_DepartSet_ClimateSet : 252|4@1+ (1,0) [0|0] "" Vector__XXX
 SG_ CF_AVN_MdLpBttmRedNvalueSet : 64|10@1+ (1,0) [0|0] "" Vector__XXX
 SG_ CF_AVN_MdLpBttmGreenNvalueSet : 74|10@1+ (1,0) [0|0] "" Vector__XXX
 SG_ CF_AVN_MdLpBttmBlueNvalueSet : 84|10@1+ (1,0) [0|0] "" Vector__XXX
 SG_ CF_AVN_MdLpSpdModNvalueSet : 94|2@1+ (1,0) [0|0] "" Vector__XXX
 SG_ CF_AVN_MdLpColorModNvalueSet : 96|2@1+ (1,0) [0|0] "" Vector__XXX
 SG_ CF_AVN_AIVoiceModNvalueSet : 98|3@1+ (1,0) [0|0] "" Vector__XXX

BO_ 276 HU_USM_04_00ms: 32 CGW_CCU
 SG_ HU_USM_Crc4Val : 0|16@1+ (1,0) [0|0] "" Vector__XXX
 SG_ USM_CMSNgtBrgtnsLvlRHSetReq : 100|4@1+ (1,0) [0|0] "" Vector__XXX
 SG_ USM_CMSBrgtnsReset : 104|2@1+ (1,0) [0|0] "" Vector__XXX
 SG_ USM_TurnDistLnDispSetReq : 106|2@1+ (1,0) [0|0] "" Vector__XXX
 SG_ PCA_FrSd_NValueSet : 108|2@1+ (1,0) [0|0] "" Vector__XXX
 SG_ CF_AVN_1stRrStRmndNValueSet : 110|2@1+ (1,0) [0|0] "" Vector__XXX
 SG_ C_AllDrOpnNValueSet : 116|3@1+ (1,0) [0|0] "" Vector__XXX
 SG_ USM_RpmECOSet : 119|2@1+ (1,0) [0|0] "" Vector__XXX
 SG_ VESS_ChgGuideMdLvl : 121|3@1+ (1,0) [0|0] "" Vector__XXX
 SG_ Usm_RpmSPORTSet : 124|2@1+ (1,0) [0|0] "" Vector__XXX
 SG_ Usm_RpmSPORTPLUSSet : 126|2@1+ (1,0) [0|0] "" Vector__XXX
 SG_ Usm_RpmMUDSet : 129|2@1+ (1,0) [0|0] "" Vector__XXX
 SG_ Usm_RpmSANDSet : 131|2@1+ (1,0) [0|0] "" Vector__XXX
 SG_ HU_CustomNewMenuSet : 133|4@1+ (1,0) [0|0] "" Vector__XXX
 SG_ CF_AVN_PCA_RrEquipNvalueSet : 137|2@1+ (1,0) [0|0] "" Vector__XXX
 SG_ CF_AVN_HtBlcRLNValueSet : 139|4@1+ (1,0) [0|0] ""  GW_PSU_RL_FD,GW_PSU_RR_FD,SHVU_FRNT_FD,SHVU_REAR_FD,SHVU_RL_FD
 SG_ CF_AVN_BRAKE_PedalfeelNValueSet2 : 143|3@1+ (1,0) [0|0] "" Vector__XXX
 SG_ CF_AVN_ISLA_AutoNModSet : 146|2@1+ (1,0) [0|0] "" Vector__XXX
 SG_ CF_AVN_HtBlcRRNValueSet : 148|4@1+ (1,0) [0|0] ""  GW_PSU_RL_FD,GW_PSU_RR_FD,SHVU_FRNT_FD,SHVU_REAR_FD,SHVU_RR_FD
 SG_ LapTimer_AutoMeasure_Setting : 152|2@1+ (1,0) [0|0] "" Vector__XXX
 SG_ LapTimer_TimeGap_Setting : 154|2@1+ (1,0) [0|0] "" Vector__XXX
 SG_ CF_AVN_RemoteWDWNValueSet : 158|2@1+ (1,0) [0|0] "" Vector__XXX
 SG_ HU_USM_AlvCnt4Val : 16|8@1+ (1,0) [0|0] "" Vector__XXX
 SG_ USM_TowWeight_Set : 160|4@1+ (1,0) [0|0] "" Vector__XXX
 SG_ CF_AVN_PABArbgNValueSet : 164|2@1+ (1,0) [0|0] "" Vector__XXX
 SG_ CF_AVN_SportHUD2 : 166|2@1+ (1,0) [0|0] "" Vector__XXX
 SG_ C_SLB_SmartCtrl_Set_Nvalue : 172|4@1+ (1,0) [0|0] ""  GW_SAU_DRV_FD
 SG_ USM_RpmComfortRearSet : 185|2@1+ (1,0) [0|0] "" Vector__XXX
 SG_ Usm_RpmMyDriveModeSet : 187|2@1+ (1,0) [0|0] "" Vector__XXX
 SG_ LapTimer_MeasuringStatus_HU : 189|3@1+ (1,0) [0|0] "" Vector__XXX
 SG_ CF_AVN_ADrLNValueSet_2 : 192|3@1+ (1,0) [0|0] "" Vector__XXX
 SG_ USM_PwrDrBuzzerNValueSet : 195|2@1+ (1,0) [0|0] "" Vector__XXX
 SG_ CF_AVN_FCA_FrOnOffEquipNvalueSet : 199|2@1+ (1,0) [0|0] "" Vector__XXX
 SG_ CF_AVN_FCA_WarnTimeNvalueSet : 201|3@1+ (1,0) [0|0] "" Vector__XXX
 SG_ CF_AVN_FCA_JC_OnOffEquipNvalueSe : 204|2@1+ (1,0) [0|0] "" Vector__XXX
 SG_ CF_AVN_FCA_FrSdOnOffEquipNvalueS : 206|2@1+ (1,0) [0|0] "" Vector__XXX
 SG_ CF_AVN_LKA_OnOffEquip2NvalueSet : 208|2@1+ (1,0) [0|0] "" Vector__XXX
 SG_ CF_AVN_BCA_OnOffEquip2NvalueSet : 210|2@1+ (1,0) [0|0] "" Vector__XXX
 SG_ CF_AVN_BVM_OnOffEquipNvalueSet : 212|2@1+ (1,0) [0|0] "" Vector__XXX
 SG_ CF_AVN_SEA_OnOffEquip3NvalueSet : 214|2@1+ (1,0) [0|0] "" Vector__XXX
 SG_ CF_AVN_BodySpprtSet_AST : 216|2@1+ (1,0) [0|0] ""  GW_SAU_DRV_FD
 SG_ CF_AVN_SEW_OnOffEquip3NvalueSet : 218|2@1+ (1,0) [0|0] "" Vector__XXX
 SG_ CF_AVN_HudImsAutoSave : 220|2@1+ (1,0) [0|0] "" Vector__XXX
 SG_ CF_AVN_AirSptTimeNValueSet_AST : 225|3@1+ (1,0) [0|0] ""  GW_SAU_DRV_FD
 SG_ CF_AVN_AirSptStrNValue_AST : 228|2@1+ (1,0) [0|0] ""  GW_SAU_DRV_FD
 SG_ CF_AVN_SeatDrvModNvalueSet_AST : 230|2@1+ (1,0) [0|0] ""  GW_SAU_DRV_FD
 SG_ CF_AVN_TPMS_TireReplaceNValueSet : 232|3@1+ (1,0) [0|0] "" Vector__XXX
 SG_ CF_AVN_TowModeSet : 235|3@1+ (1,0) [0|0] "" Vector__XXX
 SG_ USM_PwrDrCloseByBraekNValueSet : 238|2@1+ (1,0) [0|0] "" Vector__XXX
 SG_ AVN_BPCM_RL1_USMLevelReq : 24|3@1+ (1,0) [0|0] "" Vector__XXX
 SG_ CF_AVN_ISLANAOffstNvalueSet : 242|3@1+ (1,0) [0|0] "" Vector__XXX
 SG_ CF_Gway_WPC2_NValueSet : 245|2@1+ (1,0) [0|0] ""  WPC_FD,WPC2_FD
 SG_ USM_DrvGhostDoorReq : 248|2@1+ (1,0) [0|0] "" Vector__XXX
 SG_ USM_AstGhostDoorReq : 250|2@1+ (1,0) [0|0] "" Vector__XXX
 SG_ USM_RLGhostDoorReq : 252|2@1+ (1,0) [0|0] "" Vector__XXX
 SG_ USM_RRGhostDoorReq : 254|2@1+ (1,0) [0|0] "" Vector__XXX
 SG_ AVN_BPCM_RL2_USMLevelReq : 27|3@1+ (1,0) [0|0] "" Vector__XXX
 SG_ AVN_BPCM_RL3_USMLevelReq : 30|3@1+ (1,0) [0|0] "" Vector__XXX
 SG_ AVN_BPCM_RL4_USMLevelReq : 33|3@1+ (1,0) [0|0] "" Vector__XXX
 SG_ AVN_BPCM_RR1_USMLevelReq : 36|3@1+ (1,0) [0|0] "" Vector__XXX
 SG_ AVN_BPCM_RR2_USMLevelReq : 39|3@1+ (1,0) [0|0] "" Vector__XXX
 SG_ AVN_BPCM_RR3_USMLevelReq : 42|3@1+ (1,0) [0|0] "" Vector__XXX
 SG_ AVN_BPCM_RR4_USMLevelReq : 45|3@1+ (1,0) [0|0] "" Vector__XXX
 SG_ USM_SmartRegen_Map_Set : 75|2@1+ (1,0) [0|0] "" Vector__XXX
 SG_ USM_SmartRegen_Sens_Set : 77|3@1+ (1,0) [0|0] "" Vector__XXX
 SG_ AVN_SeatPosMemory_Btn : 80|3@1+ (1,0) [0|0] "" Vector__XXX
 SG_ AVN_SeatPosPlyBck_Btn : 83|3@1+ (1,0) [0|0] "" Vector__XXX
 SG_ USM_RhstaLvlEnaSetReq : 86|2@1+ (1,0) [0|0] "" Vector__XXX
 SG_ USM_CMSDayBrgtnsLvlLHSetReq : 88|4@1+ (1,0) [0|0] "" Vector__XXX
 SG_ USM_CMSNgtBrgtnsLvlLHSetReq : 92|4@1+ (1,0) [0|0] "" Vector__XXX
 SG_ USM_CMSDayBrgtnsLvlRHSetReq : 96|4@1+ (1,0) [0|0] "" Vector__XXX

CM_ BO_ 274 "[EC] On Event and On Change";
CM_ SG_ 274 HU_USM_Crc2Val "HU_USM_CyclicRedundancyCheck2Value";
CM_ SG_ 274 CF_AVN_CluRheostatLvl "Request to set CLU rheostat level";
CM_ SG_ 274 CF_AVN_EVReset "Request to reset EV Service (0x1 : EV USM Reset)";
CM_ SG_ 274 CF_AVN_UnitReset "Request to reset Unit setting";
CM_ SG_ 274 CF_AVN_IcyRoadWarn "Request to set CLU icy road warning";
CM_ SG_ 274 CF_AVN_CluServiceReminderReset "Request to reset CLU service reminder";
CM_ SG_ 274 CF_AVN_CluUSMReset "Request to reset all USM service";
CM_ SG_ 274 C_HCIMSWeightNValueSet "This signal is used for Healthcare IMS to input user's weight";
CM_ SG_ 274 C_HCIMSHeightNvalueSet "This signal is used for Healthcare IMS to input user's height";
CM_ SG_ 274 CF_AVN_HCIMSButtonCommand "User's input value in healthcare IMS mode";
CM_ SG_ 274 C_HCIMSSitHeightNValueSet "This signal is used for Healthcare IMS to input user's sitting height";
CM_ SG_ 274 CF_AVN_BodySpprtSet "This signal is for the seat body support USM";
CM_ SG_ 274 HU_USM_AlvCnt2Val "HU_USM_AliveCounter2Value";
CM_ SG_ 274 CF_AVN_AirSptTimeNValueSet "This signal is for the seat massage function time setting";
CM_ SG_ 274 CF_AVN_AirSptStrNValue "This signal is for the seat massage intensity USM";
CM_ SG_ 274 CF_AVN_SeatDrvModNValueSet "This signal is for the auto seat-drivemode user setting menu";
CM_ SG_ 274 CF_AVN_MoodLpRedNValueSet "Request for mood lamp color(Red)";
CM_ SG_ 274 CF_AVN_MoodLpGreenNValueSet "Request for mood lamp color(Green)";
CM_ SG_ 274 CF_AVN_MoodLpBlueNValueSet "Request for mood lamp color(Blue)";
CM_ SG_ 274 CF_AVN_MoodLpBrightNValueSet "Request for mood lamp bright";
CM_ SG_ 274 CF_AVN_HBANValueSet "USM Request for High Beam Assist";
CM_ SG_ 274 CF_AVN_IFSActVehSpd_Set "USM Request for Intelligent Front Lighting System";
CM_ SG_ 274 C_MoodLpDrivingNValue "USM Request value for mood lamp drivng interlock";
CM_ SG_ 274 C_MoodLPDrivemodeNValue "USM request for Mood Lamp color with Drive Mode";
CM_ SG_ 274 CF_AVN_SVMAutoOnNvalueSet "Request for SVM Auto On";
CM_ SG_ 274 CF_AVN_DAW_LVDANValueSet "Request for Front Vehicle Departure Alert";
CM_ SG_ 274 CF_AVN_Clu3dDepthSet "This signal is used for request to set the depth of 3D";
CM_ SG_ 274 C_MoodLpFadeNValue "This signal indicates MLM Fade in/out control.";
CM_ SG_ 274 CF_AVN_CluWelcomeSnd "Request to set CLU welcome soun";
CM_ SG_ 274 CF_AVN_CluServiceReminderSet "Request to set CLU service notification";
CM_ SG_ 274 CF_AVN_CluTransmissionDisp "Request to set CLU transmission display";
CM_ SG_ 274 CF_AVN_CluWiperLight "Request to set CLU wiper & light mode";
CM_ SG_ 274 CF_AVN_CluRoadInfoGuide "Request to set CLU road info guidance";
CM_ SG_ 274 CF_AVN_CluUserSettingPeriod "Request to set CLU sservice period set by user";
CM_ SG_ 274 CF_AVN_CluFuelEconUnit_mi "Cluster setting status for cluster Fuel Economy Unit (mile)";
CM_ SG_ 274 CF_AVN_CluFuelEconUnit_km "Cluster setting status for cluster Fuel Economy unit (km)";
CM_ SG_ 274 CF_AVN_CluUserSettingDistance "Request to set CLU service distance set by user";
CM_ BO_ 273 "[EC] On Event and On Change";
CM_ SG_ 273 HU_USM_Crc1Val "HU_USM_CyclicRedundancyCheck1Value";
CM_ SG_ 273 CF_AVN_RCCWNValueSet "Reqeust to set RCCW system state";
CM_ SG_ 273 CF_AVN_PDWAutoOnNValueSet "USM Request for PDW Auto On";
CM_ SG_ 273 C_TempUnit "Request for changing Temp Unit";
CM_ SG_ 273 CF_AVN_AdasVolumeNValueSet "Request to set ADAS warning volume level";
CM_ SG_ 273 C_PTGMNValueSet "Request to set PTGM Mode";
CM_ SG_ 273 CF_AVN_ADrUNValueSet "Request to set Auto Door Unlock Mode";
CM_ SG_ 273 CF_AVN_EscortHLNValueSet "Request to set Head Lamp Escort Option";
CM_ SG_ 273 CF_AVN_PSMNValueSet "This signal is used for a request to set the value of UMS Menus. This signal requests to set Seat Easy Access Mode. When this signal change, the message is sent 3 times.";
CM_ SG_ 273 C_HfreeTrunkTgNValueSet "Request to set Smart Trunk/Tailgate Mode";
CM_ SG_ 273 CF_AVN_TrfChgSet "This signal is used for a request to set the value of UMS Menus. This signal requests to set Traffic Change Mode. When this signal change, the message is sent 3 times.";
CM_ SG_ 273 CF_AVN_SCMNValueSet "Request to set Steering Easy Access mode";
CM_ SG_ 273 CF_AVN_OTTurnNValueSet "This signal is used for a request current setting value of USM Menus. When this signal change, the message is sent 3 times.";
CM_ SG_ 273 CF_Gway_WPCNValueSet "Request to set Wireless Phone Charging mode";
CM_ SG_ 273 C_AVN_RearWiperNValueSet "Request to set Rear Wiper operation in reverse";
CM_ SG_ 273 C_UnlockWelocomeNValueSet "Request to set Door Unlock Welcome Setting Option";
CM_ SG_ 273 C_SmartWelocomeNValueSet "Request to set Smart Key Welcome Setting Option";
CM_ SG_ 273 HU_USM_AlvCnt1Val "HU_USM_AliveCounter1Value";
CM_ SG_ 273 CF_AVN_PTGSpeedNValueSet "Setting Value For Power Tailgate Speed";
CM_ SG_ 273 CR_Datc_DRSeatWheel_USM_Set "SteeringWheel USM Set";
CM_ SG_ 273 CF_AVN_TTUnlockNValueSet "Setting Value for Two Turn Unlock";
CM_ SG_ 273 CF_Gway_RWPCNValueSet "Rear Wireless Phone Charger ON/OFF Request";
CM_ SG_ 273 C_PSDNValueSet "Request to set PSD Mode. USM request signal for setting Power Sliding Door.";
CM_ SG_ 273 CF_Avn_HAPTICWARNINGNValueSet "USM request for Steering Wheel Haptic Warning";
CM_ SG_ 273 CR_Datc_DRSeatHeat_USM_Set "Driver Seat Heat/Ventl USM Set";
CM_ SG_ 273 C_WALNValueSet "USM Function for Walk Away Lock(WAL)";
CM_ SG_ 273 C_ApprUnlockNValue "USM request for Approach Unlock";
CM_ SG_ 273 CF_AVN_HudSet "Request to set HUD display.";
CM_ SG_ 273 CF_AVN_HudContetnsTBT "Request to display TBT contents";
CM_ SG_ 273 CF_AVN_HudContetnsSCC "Request to display SCC contents";
CM_ SG_ 273 CF_AVN_HudContetnsDIS "Request to display DIS contents";
CM_ SG_ 273 CF_AVN_HudContetnsBSD "Request to display BSD contents";
CM_ SG_ 273 CF_AVN_HudHeightSet "Reqeust signal for control HUD height";
CM_ SG_ 273 CF_AVN_HudBrightnessSet "Request signal for control HUD brightness";
CM_ SG_ 273 CF_AVN_HudRotationSet "Request signal for control HUD rotation";
CM_ SG_ 273 CF_AVN_HudContentsAVInfo "USM Request for Setting AV Information contents";
CM_ SG_ 273 CF_AVN_SportHUD "Related to HUD Sports mode of Usm";
CM_ SG_ 273 USM_RpmCOMFORTSet "Rerlation to Cluster Gauge Display";
CM_ SG_ 273 USM_RpmNORMALSet "Relation to Cluster Gauge Display";
CM_ SG_ 273 CF_AVN_HDANValueSet "USM request for HDA On/Off";
CM_ SG_ 273 CF_AVN_NSCCCamNValueSet "This signal is used for a request to set the value of USM Menus. This signal requests to change status of SCC interlocked with Navi Camera function.

When this signal change, the message is sent 3 times.";
CM_ SG_ 273 CF_AVN_ISLWNValueSet "This signal is used for a request to set the value of USM Menus. This signal requests to set ISLW status.
When this signal change, the message is sent 3 times.";
CM_ SG_ 273 CF_AVN_NCC_USM_set "Reqeust to set NCC system state";
CM_ SG_ 273 CF_AVN_TirePressUnitNValueSet "Request to set Unit of Tire Air Pressure";
CM_ BO_ 745 "[PE] Periodic and On Event";
CM_ SG_ 745 PDC_FD_Crc15Val "PDC_FD_CyclicRedundancyCheck15Value";
CM_ SG_ 745 PDC_CurrAtReset "This signal indicate the current at reset request";
CM_ SG_ 745 PDC_AvgCurrAtReset "This signal indicate the average current at reset request";
CM_ SG_ 745 PDC_ResetReason "This signal indicate the reason reset is operated";
CM_ SG_ 745 PDC_CumulativeCountOf12VReq "This signal indicates the cumulative number of 12V Controller req.";
CM_ SG_ 745 PDC_CumulativeCountOfCCUReq "This signal indicates the cumulative number of CCU_ForcedPowerOffReq";
CM_ SG_ 745 PDC_FD_AlvCnt15Val "PDC_FD_AliveCounter15Value";
CM_ SG_ 745 PDC_LDConReq "LDC on request signal for High Voltage Battery Discharge";
CM_ SG_ 745 PDC_LDConReq_By_LVBat "LDC on request signal for High Voltage Battery Discharge by Low Voltage Battery";
CM_ SG_ 745 PDC_LDConReq_By_OTA "LDC on request signal for High Voltage Battery Discharge by OTA";
CM_ SG_ 745 PDC_LDConReq_By_Load "LDC on request signal for High Voltage Battery Discharge by Load";
CM_ SG_ 745 PDC_LDConReq_By_ActiveOn "LDC on request signal for High Voltage Battery Discharge by Active On";
CM_ SG_ 745 PDC_ResetPreWrngForCCU "This is a warning signal for reset.  This signal is used for preparing sideeffect of reset by Gateway";
CM_ SG_ 745 PDC_ResetPreWrngForOthers "This is a warning signal for reset.  This signal is used for preparing sideeffect of reset by Receivers";
CM_ SG_ 745 PDC_ResetReqForCCU "This is a request signal for SW reset of Gateway";
CM_ SG_ 745 PDC_ResetReqForOthers "This is a request signal for SW reset except for Gateway";
CM_ SG_ 745 PDC_ResetFuncOpt "This signal inform whether reset fucntion at PDC is appiled or not";
CM_ SG_ 745 PDC_12VRlyCtrl "This signal is request signal to control 12V battery internal relay for HW reset";
CM_ SG_ 745 PDC_CurrentValueForReset "This signal sets the average discharge current value to be measured for PDC_TimevalueForReset to be considered as a situation requiring reset.";
CM_ SG_ 745 PDC_TimeValueForReset "This signal sets the time value to be considered as a situation requiring reset.";
CM_ SG_ 745 PDC_12VRlyOffHoldingTime "This signal sets how long the relay will be turned off when performing an HW reset using a 12 V battery internal relay.";
CM_ SG_ 745 PDC_ResetCountSetting "This signal sets the number of resets performed.";
CM_ SG_ 745 PDC_ResetCount "This signal indicates how much reset has occurred.";
CM_ SG_ 745 PDC_ResetCumulativeCount "This signal indicates the cumulative number of resets performed.";
CM_ SG_ 745 PDC_ResetOpsta "This signal indicates whether the reset operation has been completed or not";
CM_ SG_ 745 PDC_ReadyTimeValueForReset "This signal sets the time value to be considered as a situation of quiescent current";
CM_ BO_ 278 "[EC] On Event and On Change";
CM_ SG_ 278 HU_USM_Crc5Val "HU_USM_CyclicRedundancyCheck5Value";
CM_ SG_ 278 CF_AVN_AIVoiceMicModNvalue "Signal of AI voice size HU to MLM";
CM_ SG_ 278 CF_AVN_AIVoiceTTSModNvalue "Signal TTS Mode HU to MLM";
CM_ SG_ 278 HU_USM_AlvCnt5Val "HU_USM_AliveCounter5Value";
CM_ SG_ 278 DAB_IlluminationVrModeSet "Signal of mood lamp concern about AI voice";
CM_ SG_ 278 xHEV_SmartRegen_Map_Set "Smart Regeneration 2.0 Map information USM User set Signal";
CM_ SG_ 278 HU_ChgCtrMode "standard DB vehicle works Scheduled Charging by using USM setting logics. Connection with departure 1,2 has been romoved.";
CM_ SG_ 278 HU_EconStHr_WeekDay "<For after OS/DE/SK3 EV/PHEV>
Command for setting Start time of economic charge time (Weekday and Weekend)

<For AE EV/PHEV, DE PHEV>
Command for Setting Start hour of economic charge time during weekday
-This signal's Feedback is CR_EV_EconStHr_WeekDay(0x56B)@CGW";
CM_ SG_ 278 HU_EconStMin_WeekDay "<For after OS/DE/SK3 EV/PHEV>
Command for setting Start time of economic charge time (Weekday and Weekend)

<For AE EV/PHEV, DE PHEV>
Command for Setting Start min of economic charge time during weekday
-This signal's Feedback is CR_EV_EconStMin_WeedDay (0x56B)@CGW";
CM_ SG_ 278 HU_EconEndHr_WeekDay "<For after OS/DE/SK3 EV/PHEV>
Command for setting End time of economic charge time (Weekday and Weekend)

<For AE EV/PHEV, DE PHEV>
Command for Setting End hour of economic charge time during weekday
-This signal's Feedback is CR_EV_EconEndHr_WeekDay (0x56B)@CGW";
CM_ SG_ 278 HU_EconEndMin_WeekDay "<For after OS/DE/SK3 EV/PHEV>
Command for setting End time of economic charge time (Weekday and Weekend)

<For AE EV/PHEV, DE PHEV>
Command for Setting End min of economic charge time during weekday
-This signal's Feedback is CR_EV_EconEndMin_Weekday (0x56B)@CGW";
CM_ SG_ 278 HU_DepartSet_Hour "Command for Setting Hour of Departure Set1
-This signal's Feedback is CR_EV_DepartSet1_Hour(0x56C)@CGW";
CM_ SG_ 278 HU_DepartSet_Min "Command for Setting Min of Departure Set1
-This signal's Feedback is CR_EV_DepartSet1_Min(0x56C)@CGW";
CM_ SG_ 278 HU_DepartSetDay "Repeat day of the week value signal for Scheduled Climate";
CM_ SG_ 278 HU_DepartSet_TempSet "<For after OS/DE/SK3 EV>
Command for setting desired air-conditioning temperature both departure set1 and set2

<For AE EV>
Command for Setting for Desired air-conditioning temperature of Depature Set1
-This signal's Feedback is CR_EV_DepartSet1_TempSet (0x56C)@CGW";
CM_ SG_ 278 HU_DepartSettingValue "Signal for Setting value of Depart on/off status";
CM_ SG_ 278 HU_NdepartSet "Departure number to update memory in HCU/VCU shedule.";
CM_ SG_ 278 HU_DepartSet_ClimateSet "Scheduled Climate related setting value integrated signal";
CM_ SG_ 278 CF_AVN_AIVoiceModNvalueSet "Signal of mood lamp concern about AI voice";
CM_ BO_ 276 "[EC] On Event and On Change";
CM_ SG_ 276 HU_USM_Crc4Val "HU_USM_CyclicRedundancyCheck4Value";
CM_ SG_ 276 USM_CMSBrgtnsReset "CMS Brightness Reset (LH/RH)";
CM_ SG_ 276 CF_AVN_1stRrStRmndNValueSet "This signal is for setting the ROA function when IBU control ROA Function.";
CM_ SG_ 276 VESS_ChgGuideMdLvl "Releated to VESS Alarm Sound Level";
CM_ SG_ 276 HU_CustomNewMenuSet "Custom Mode User Setting Signal";
CM_ SG_ 276 CF_AVN_PCA_RrEquipNvalueSet "Headunit Setting signal for Rear Safety of USM";
CM_ SG_ 276 CF_AVN_HtBlcRLNValueSet "Request for 2nd Left seat heater balance";
CM_ SG_ 276 CF_AVN_ISLA_AutoNModSet "USM Set Signal for Activing N Mode Setting when Vehicle enter into Winding Road";
CM_ SG_ 276 CF_AVN_HtBlcRRNValueSet "Request for 2nd Right seat heater balance";
CM_ SG_ 276 CF_AVN_RemoteWDWNValueSet "Remote Window On/Off Set signal of USM for Fob Key";
CM_ SG_ 276 HU_USM_AlvCnt4Val "HU_USM_AliveCounter4Value";
CM_ SG_ 276 USM_TowWeight_Set "Trailer Mode Setting USM: Tow Weight set for User";
CM_ SG_ 276 CF_AVN_PABArbgNValueSet "USM PAB On/Off Set Signal";
CM_ SG_ 276 CF_AVN_SportHUD2 "Related to HUD Sports mode of custom mode2";
CM_ SG_ 276 USM_RpmComfortRearSet "RPM Display Setting When Comfort(Rear) mode Set";
CM_ SG_ 276 Usm_RpmMyDriveModeSet "Cluster MY Drive Mode RPM Set Signal";
CM_ SG_ 276 CF_AVN_BodySpprtSet_AST "This signal is for the Ergo-Motion seat (AST) body support (Smart Posture Assist) USM";
CM_ SG_ 276 CF_AVN_AirSptTimeNValueSet_AST "This signal is for the Ergo-Motion seat (AST) massage function time setting";
CM_ SG_ 276 CF_AVN_AirSptStrNValue_AST "This signal is for the ERGO seat (AST) massage intensity USM";
CM_ SG_ 276 CF_AVN_SeatDrvModNvalueSet_AST "This signal is for the Ergo-Motion seat (AST) smart support (Smart Support) USM";
CM_ SG_ 276 USM_SmartRegen_Map_Set "Smart Regeneration 2.0 Map information USM User set signal";
CM_ SG_ 276 USM_SmartRegen_Sens_Set "Smart Regeneration User Personality of Reduction Set Signal";
CM_ SG_ 276 AVN_SeatPosMemory_Btn "Seat position save signal";
CM_ SG_ 276 AVN_SeatPosPlyBck_Btn "Seat position move signal";
BA_DEF_ BO_  "CANFD_BRS" ENUM  "0","1";
BA_DEF_ BO_  "GenMsgEVName" STRING ;
BA_DEF_ BU_  "NmAsrNodeIdentifier" HEX 0 255;
BA_DEF_ BU_  "NmAsrCanMsgReducedTime" INT 0 1000;
BA_DEF_  "NmAsrWaitBusSleepTime" INT 0 100000;
BA_DEF_  "NmAsrTimeoutTime" INT 0 100000;
BA_DEF_  "NmAsrRepeatMessageTime" INT 0 100000;
BA_DEF_  "NmAsrMessageCount" INT 0 255;
BA_DEF_  "NmAsrCanMsgCycleTime" INT 0 100;
BA_DEF_  "NmAsrBaseAddress" HEX 0 536870911;
BA_DEF_ BO_  "NmAsrMessage" ENUM  "No","Yes";
BA_DEF_ BO_  "DiagState" ENUM  "No","Yes";
BA_DEF_ BO_  "DiagResponse" ENUM  "No","Yes";
BA_DEF_ BO_  "DiagRequest" ENUM  "No","Yes";
BA_DEF_ BO_  "TpMessage" ENUM  "No","Yes";
BA_DEF_ BO_  "UsrMsgIDSforwardDeviation" INT 0 100;
BA_DEF_ BO_  "UsrMsgIDSbackwardDeviation" INT 50 1000;
BA_DEF_  "BusType" STRING ;
BA_DEF_  "DBName" STRING ;
BA_DEF_  "Baudrate" INT 50000 1000000;
BA_DEF_  "BRS" INT 0 1;
BA_DEF_  "GenEnvVarEndingDsp" STRING ;
BA_DEF_  "GenEnvVarEndingSnd" STRING ;
BA_DEF_  "GenEnvVarPrefix" STRING ;
BA_DEF_  "GenNWMApBusSleep" STRING ;
BA_DEF_  "GenNWMApCanNormal" STRING ;
BA_DEF_  "GenNWMApCanOff" STRING ;
BA_DEF_  "GenNWMApCanOn" STRING ;
BA_DEF_  "GenNWMApCanSleep" STRING ;
BA_DEF_  "GenNWMApCanWakeUp" STRING ;
BA_DEF_  "GenNWMGotoMode_Awake" STRING ;
BA_DEF_  "GenNWMGotoMode_BusSleep" STRING ;
BA_DEF_  "GenNWMSleepTime" INT 1375 1650;
BA_DEF_  "GenNWMTalkNM" STRING ;
BA_DEF_  "Manufacturer" STRING ;
BA_DEF_  "NmBaseAddress" HEX 0 2047;
BA_DEF_  "NmMessageCount" INT 0 128;
BA_DEF_  "NmType" STRING ;
BA_DEF_  "SamplePointMax" INT 50 85;
BA_DEF_  "SamplePointMin" INT 55 85;
BA_DEF_  "SyncJumpWidthMax" INT 1 8;
BA_DEF_  "SyncJumpWidthMin" INT 1 4;
BA_DEF_  "VersionDay" INT 1 31;
BA_DEF_  "VersionMonth" INT 1 12;
BA_DEF_  "VersionNumber" INT 0 999999;
BA_DEF_  "VersionNumberInternal" INT 0 9999;
BA_DEF_  "VersionWeek" INT 1 53;
BA_DEF_  "VersionYear" INT 0 9999;
BA_DEF_ BU_  "NmStationAddress" HEX 0 127;
BA_DEF_ BU_  "NmNode" ENUM  "No","Yes";
BA_DEF_ BU_  "GenNodSleepTime" INT 1375 1650;
BA_DEF_ BU_  "ILUsed" ENUM  "No","Yes";
BA_DEF_ BU_  "NmCAN" INT 1 2;
BA_DEF_ BU_  "NodeLayerModules" STRING ;
BA_DEF_ BU_  "NWM_Knoten" ENUM  "No","Yes";
BA_DEF_ BO_  "GenMsgCycleTime" INT 0 2000;
BA_DEF_ BO_  "GenMsgStartDelayTime" INT 0 2000;
BA_DEF_ BO_  "GenMsgSendType" ENUM  "Cyclic","NoMsgSendType";
BA_DEF_ BO_  "GenMsgCycleTimeFast" INT 0 500;
BA_DEF_ BO_  "GenMsgDelayTime" INT 0 20;
BA_DEF_ BO_  "GenMsgILSupport" ENUM  "No","Yes";
BA_DEF_ BO_  "GenMsgNrOfRepetition" INT 0 3;
BA_DEF_ BO_  "TpTxIndex" INT 0 65535;
BA_DEF_ BO_  "VFrameFormat" ENUM  "StandardCAN","ExtendedCAN","reserved","reserved","reserved","reserved","reserved","reserved","reserved","reserved","reserved","reserved","reserved","reserved","StandardCAN_FD","ExtendedCAN_FD";
BA_DEF_ SG_  "UserSigValidity" ENUM  "B+","ACC","IG","IG1","IG2","IG3","IG1 or IG2","IG1 or IG3","Undef";
BA_DEF_ SG_  "TimeoutValue" STRING ;
BA_DEF_ SG_  "UsrSigPurpose" ENUM  "Undef","FN","DIAG","DIAG(Req)","DIAG(Res)","DIAG(Func)","DEV","CCP","NM","TP";
BA_DEF_ SG_  "GenSigStartValue" INT 0 1215752192;
BA_DEF_ SG_  "NetworkRequest" ENUM  "Yes","No";
BA_DEF_ SG_  "NetworkRequestHoldingTime" INT 0 65535;
BA_DEF_ SG_  "Description" STRING ;
BA_DEF_ SG_  "Version" STRING ;
BA_DEF_ SG_  "GenSigEnvVarType" ENUM  "Int","Float","Undef";
BA_DEF_ SG_  "GenSigSendType" ENUM  "Cyclic","OnWrite","OnWriteWithRepetition","OnChange","OnChangeWithRepetition","IfActive","IfActiveWithRepetition","NoSigSendType","OnChangeAndIfActive","OnChangeAndIfActiveWithRepetition";
BA_DEF_ SG_  "GwSigLatencyTime" INT 0 65536;
BA_DEF_ SG_  "GwSigMissingSourceType" ENUM  "Undef","OldValue","DefaultValue","InitialValue";
BA_DEF_ SG_  "NWM-WakeupAllowed" ENUM  "<n.a.>";
BA_DEF_ SG_  "RoutingFactor" INT 1 1215752192;
BA_DEF_  "Datarate" INT 1000000 8000000;
BA_DEF_ SG_  "SystemSignalLongSymbol" STRING ;
BA_DEF_REL_ BU_SG_REL_  "GenSigTimeoutTime" INT 0 7000;
BA_DEF_DEF_  "CANFD_BRS" "1";
BA_DEF_DEF_  "GenMsgEVName" "@Signame";
BA_DEF_DEF_  "NmAsrNodeIdentifier" 0;
BA_DEF_DEF_  "NmAsrCanMsgReducedTime" 1000;
BA_DEF_DEF_  "NmAsrWaitBusSleepTime" 1500;
BA_DEF_DEF_  "NmAsrTimeoutTime" 1000;
BA_DEF_DEF_  "NmAsrRepeatMessageTime" 1200;
BA_DEF_DEF_  "NmAsrMessageCount" 255;
BA_DEF_DEF_  "NmAsrCanMsgCycleTime" 100;
BA_DEF_DEF_  "NmAsrBaseAddress" 402391040;
BA_DEF_DEF_  "NmAsrMessage" "No";
BA_DEF_DEF_  "DiagState" "No";
BA_DEF_DEF_  "DiagResponse" "No";
BA_DEF_DEF_  "DiagRequest" "No";
BA_DEF_DEF_  "TpMessage" "No";
BA_DEF_DEF_  "UsrMsgIDSforwardDeviation" 10;
BA_DEF_DEF_  "UsrMsgIDSbackwardDeviation" 100;
BA_DEF_DEF_  "BusType" "CAN FD";
BA_DEF_DEF_  "DBName" "";
BA_DEF_DEF_  "Baudrate" 500000;
BA_DEF_DEF_  "BRS" 1;
BA_DEF_DEF_  "GenEnvVarEndingDsp" "Dsp_";
BA_DEF_DEF_  "GenEnvVarEndingSnd" "_";
BA_DEF_DEF_  "GenEnvVarPrefix" "Env";
BA_DEF_DEF_  "GenNWMApBusSleep" "AppNmCanBusSleep()";
BA_DEF_DEF_  "GenNWMApCanNormal" "AppNmCanNormal()";
BA_DEF_DEF_  "GenNWMApCanOff" "ApplCanOffline()";
BA_DEF_DEF_  "GenNWMApCanOn" "ApplCanOnline()";
BA_DEF_DEF_  "GenNWMApCanSleep" "ApplNmCanSleep()";
BA_DEF_DEF_  "GenNWMApCanWakeUp" "ApplCanWakeUp()";
BA_DEF_DEF_  "GenNWMGotoMode_Awake" "GotoMode_Awake()";
BA_DEF_DEF_  "GenNWMGotoMode_BusSleep" "GotoMode_BusSleep()";
BA_DEF_DEF_  "GenNWMSleepTime" 1500;
BA_DEF_DEF_  "GenNWMTalkNM" "TalkNM()";
BA_DEF_DEF_  "Manufacturer" "HMC";
BA_DEF_DEF_  "NmBaseAddress" 1280;
BA_DEF_DEF_  "NmMessageCount" 128;
BA_DEF_DEF_  "NmType" "AsrNm";
BA_DEF_DEF_  "SamplePointMax" 80;
BA_DEF_DEF_  "SamplePointMin" 80;
BA_DEF_DEF_  "SyncJumpWidthMax" 3;
BA_DEF_DEF_  "SyncJumpWidthMin" 2;
BA_DEF_DEF_  "VersionDay" 1;
BA_DEF_DEF_  "VersionMonth" 1;
BA_DEF_DEF_  "VersionNumber" 0;
BA_DEF_DEF_  "VersionNumberInternal" 0;
BA_DEF_DEF_  "VersionWeek" 1;
BA_DEF_DEF_  "VersionYear" 0;
BA_DEF_DEF_  "NmStationAddress" 0;
BA_DEF_DEF_  "NmNode" "No";
BA_DEF_DEF_  "GenNodSleepTime" 1500;
BA_DEF_DEF_  "ILUsed" "Yes";
BA_DEF_DEF_  "NmCAN" 1;
BA_DEF_DEF_  "NodeLayerModules" "AsrNM33.DLL,CANoeILNLVector.DLL";
BA_DEF_DEF_  "NWM_Knoten" "Yes";
BA_DEF_DEF_  "GenMsgCycleTime" 200;
BA_DEF_DEF_  "GenMsgStartDelayTime" 0;
BA_DEF_DEF_  "GenMsgSendType" "NoMsgSendType";
BA_DEF_DEF_  "GenMsgCycleTimeFast" 40;
BA_DEF_DEF_  "GenMsgDelayTime" 20;
BA_DEF_DEF_  "GenMsgILSupport" "Yes";
BA_DEF_DEF_  "GenMsgNrOfRepetition" 3;
BA_DEF_DEF_  "TpTxIndex" 0;
BA_DEF_DEF_  "VFrameFormat" "StandardCAN";
BA_DEF_DEF_  "UserSigValidity" "IG";
BA_DEF_DEF_  "TimeoutValue" "";
BA_DEF_DEF_  "UsrSigPurpose" "FN";
BA_DEF_DEF_  "GenSigStartValue" 0;
BA_DEF_DEF_  "NetworkRequest" "No";
BA_DEF_DEF_  "NetworkRequestHoldingTime" 0;
BA_DEF_DEF_  "Description" "";
BA_DEF_DEF_  "Version" "";
BA_DEF_DEF_  "GenSigEnvVarType" "Undef";
BA_DEF_DEF_  "GenSigSendType" "NoSigSendType";
BA_DEF_DEF_  "GwSigLatencyTime" 40;
BA_DEF_DEF_  "GwSigMissingSourceType" "Undef";
BA_DEF_DEF_  "NWM-WakeupAllowed" "<n.a.>";
BA_DEF_DEF_  "RoutingFactor" 1;
BA_DEF_DEF_  "Datarate" 1000000;
BA_DEF_DEF_REL_ "GenSigTimeoutTime" 500;
BA_DEF_DEF_  "SystemSignalLongSymbol" "";
BA_ "VersionYear" 1;
BA_ "VersionNumber" 240801;
BA_ "DBName" "FD_B2";
BA_ "NmStationAddress" BU_ ARS_FD 138;
BA_ "NmNode" BU_ ARS_FD 1;
BA_ "NmAsrNodeIdentifier" BU_ ARS_FD 138;
BA_ "NmStationAddress" BU_ SHVU_CCS_FD 101;
BA_ "NmNode" BU_ SHVU_CCS_FD 1;
BA_ "NmAsrNodeIdentifier" BU_ SHVU_CCS_FD 101;
BA_ "NmStationAddress" BU_ WPC_FD 158;
BA_ "NmNode" BU_ WPC_FD 1;
BA_ "NmAsrNodeIdentifier" BU_ WPC_FD 158;
BA_ "NmStationAddress" BU_ WPC2_FD 149;
BA_ "NmNode" BU_ WPC2_FD 1;
BA_ "NmAsrNodeIdentifier" BU_ WPC2_FD 149;
BA_ "NmStationAddress" BU_ SCM_FD 135;
BA_ "NmNode" BU_ SCM_FD 1;
BA_ "NmAsrNodeIdentifier" BU_ SCM_FD 135;
BA_ "NmStationAddress" BU_ SHVU_FRNT_FD 170;
BA_ "NmNode" BU_ SHVU_FRNT_FD 1;
BA_ "NmAsrNodeIdentifier" BU_ SHVU_FRNT_FD 170;
BA_ "NmStationAddress" BU_ GW_SAU_DRV_FD 217;
BA_ "NmNode" BU_ GW_SAU_DRV_FD 1;
BA_ "NmAsrNodeIdentifier" BU_ GW_SAU_DRV_FD 217;
BA_ "NmStationAddress" BU_ ATS_FD 208;
BA_ "NmNode" BU_ ATS_FD 1;
BA_ "NmAsrNodeIdentifier" BU_ ATS_FD 208;
BA_ "NmStationAddress" BU_ PSB_FD 193;
BA_ "NmNode" BU_ PSB_FD 1;
BA_ "NmAsrNodeIdentifier" BU_ PSB_FD 193;
BA_ "NmStationAddress" BU_ GW_PSU_RR_FD 157;
BA_ "NmNode" BU_ GW_PSU_RR_FD 1;
BA_ "NmAsrNodeIdentifier" BU_ GW_PSU_RR_FD 157;
BA_ "NmStationAddress" BU_ SHVU_RL_FD 180;
BA_ "NmNode" BU_ SHVU_RL_FD 1;
BA_ "NmAsrNodeIdentifier" BU_ SHVU_RL_FD 180;
BA_ "NmStationAddress" BU_ RWPC_FD 159;
BA_ "NmNode" BU_ RWPC_FD 1;
BA_ "NmAsrNodeIdentifier" BU_ RWPC_FD 159;
BA_ "NmStationAddress" BU_ CGW_CCU 112;
BA_ "NmNode" BU_ CGW_CCU 1;
BA_ "NmAsrNodeIdentifier" BU_ CGW_CCU 112;
BA_ "NmStationAddress" BU_ OHCL_FD 212;
BA_ "NmNode" BU_ OHCL_FD 1;
BA_ "NmAsrNodeIdentifier" BU_ OHCL_FD 212;
BA_ "NmStationAddress" BU_ SHVU_REAR_FD 171;
BA_ "NmNode" BU_ SHVU_REAR_FD 1;
BA_ "NmAsrNodeIdentifier" BU_ SHVU_REAR_FD 171;
BA_ "NmStationAddress" BU_ BLTN_CAM_FD 200;
BA_ "NmNode" BU_ BLTN_CAM_FD 1;
BA_ "NmAsrNodeIdentifier" BU_ BLTN_CAM_FD 200;
BA_ "NmStationAddress" BU_ GW_PSU_DRV_FD 184;
BA_ "NmNode" BU_ GW_PSU_DRV_FD 1;
BA_ "NmAsrNodeIdentifier" BU_ GW_PSU_DRV_FD 184;
BA_ "NmStationAddress" BU_ FCS_FD 161;
BA_ "NmNode" BU_ FCS_FD 1;
BA_ "NmAsrNodeIdentifier" BU_ FCS_FD 161;
BA_ "NmStationAddress" BU_ GW_PSU_AST_FD 177;
BA_ "NmNode" BU_ GW_PSU_AST_FD 1;
BA_ "NmAsrNodeIdentifier" BU_ GW_PSU_AST_FD 177;
BA_ "NmStationAddress" BU_ GW_PSU_3RD_FD 173;
BA_ "NmNode" BU_ GW_PSU_3RD_FD 1;
BA_ "NmAsrNodeIdentifier" BU_ GW_PSU_3RD_FD 173;
BA_ "NmStationAddress" BU_ RCS_FD 198;
BA_ "NmNode" BU_ RCS_FD 1;
BA_ "NmAsrNodeIdentifier" BU_ RCS_FD 198;
BA_ "NmStationAddress" BU_ SHVU_3RD_FD 82;
BA_ "NmNode" BU_ SHVU_3RD_FD 1;
BA_ "NmAsrNodeIdentifier" BU_ SHVU_3RD_FD 82;
BA_ "NmStationAddress" BU_ GW_PSU_RL_FD 156;
BA_ "NmNode" BU_ GW_PSU_RL_FD 1;
BA_ "NmAsrNodeIdentifier" BU_ GW_PSU_RL_FD 156;
BA_ "NmStationAddress" BU_ SHVU_RR_FD 181;
BA_ "NmNode" BU_ SHVU_RR_FD 1;
BA_ "NmAsrNodeIdentifier" BU_ SHVU_RR_FD 181;
BA_ "NmStationAddress" BU_ RCM_FD 189;
BA_ "NmNode" BU_ RCM_FD 1;
BA_ "NmAsrNodeIdentifier" BU_ RCM_FD 189;
BA_ "NmStationAddress" BU_ SGU_FD 190;
BA_ "NmNode" BU_ SGU_FD 1;
BA_ "NmAsrNodeIdentifier" BU_ SGU_FD 190;
BA_ "NmStationAddress" BU_ DCM_FD 41;
BA_ "NmNode" BU_ DCM_FD 1;
BA_ "NmAsrNodeIdentifier" BU_ DCM_FD 41;
BA_ "GenMsgCycleTime" BO_ 1670 0;
BA_ "VFrameFormat" BO_ 1670 14;
BA_ "GenMsgCycleTime" BO_ 274 0;
BA_ "VFrameFormat" BO_ 274 14;
BA_ "GenMsgCycleTime" BO_ 273 0;
BA_ "VFrameFormat" BO_ 273 14;
BA_ "GenMsgSendType" BO_ 745 0;
BA_ "GenMsgCycleTime" BO_ 745 300;
BA_ "VFrameFormat" BO_ 745 14;
BA_ "GenMsgCycleTime" BO_ 278 0;
BA_ "VFrameFormat" BO_ 278 14;
BA_ "GenMsgCycleTime" BO_ 276 0;
BA_ "VFrameFormat" BO_ 276 14;
BA_ "GenSigSendType" SG_ 1670 WPCmsgDvp1DataByte63 2;
BA_ "Description" SG_ 274 HU_USM_Crc2Val "The data area for CRC calculation is based on the data length (DLC) of the message DB.

The CRC shall be calculated over the entire data block (excluding the CRC bytes) including the user data, alive counter and Data ID



- CRC Polynomial (0x1021) , Ini";
BA_ "GenSigSendType" SG_ 274 HU_USM_Crc2Val 4;
BA_ "GenSigStartValue" SG_ 274 HU_USM_Crc2Val 65535;
BA_ "UserSigValidity" SG_ 274 HU_USM_Crc2Val 3;
BA_ "Version" SG_ 274 HU_USM_Crc2Val "22.10.20";
BA_ "GenSigSendType" SG_ 274 CF_AVN_CluRheostatLvl 4;
BA_ "GenSigStartValue" SG_ 274 CF_AVN_CluRheostatLvl 31;
BA_ "UserSigValidity" SG_ 274 CF_AVN_CluRheostatLvl 3;
BA_ "Version" SG_ 274 CF_AVN_CluRheostatLvl "18.06.04";
BA_ "GenSigSendType" SG_ 274 CF_AVN_EVReset 4;
BA_ "UserSigValidity" SG_ 274 CF_AVN_EVReset 7;
BA_ "Version" SG_ 274 CF_AVN_EVReset "18.09.04";
BA_ "GenSigSendType" SG_ 274 CF_AVN_UnitReset 4;
BA_ "UserSigValidity" SG_ 274 CF_AVN_UnitReset 3;
BA_ "Version" SG_ 274 CF_AVN_UnitReset "18.09.04";
BA_ "GenSigSendType" SG_ 274 CF_AVN_IcyRoadWarn 4;
BA_ "UserSigValidity" SG_ 274 CF_AVN_IcyRoadWarn 3;
BA_ "Version" SG_ 274 CF_AVN_IcyRoadWarn "18.04.02";
BA_ "GenSigSendType" SG_ 274 CF_AVN_CluServiceReminderReset 4;
BA_ "UserSigValidity" SG_ 274 CF_AVN_CluServiceReminderReset 3;
BA_ "Version" SG_ 274 CF_AVN_CluServiceReminderReset "18.04.02";
BA_ "GenSigSendType" SG_ 274 CF_AVN_CluUSMReset 4;
BA_ "UserSigValidity" SG_ 274 CF_AVN_CluUSMReset 3;
BA_ "Version" SG_ 274 CF_AVN_CluUSMReset "21.01.08";
BA_ "GenSigSendType" SG_ 274 C_HCIMSWeightNValueSet 4;
BA_ "UserSigValidity" SG_ 274 C_HCIMSWeightNValueSet 3;
BA_ "Version" SG_ 274 C_HCIMSWeightNValueSet "18.09.04";
BA_ "GenSigSendType" SG_ 274 C_HCIMSHeightNvalueSet 4;
BA_ "UserSigValidity" SG_ 274 C_HCIMSHeightNvalueSet 3;
BA_ "Version" SG_ 274 C_HCIMSHeightNvalueSet "18.09.04";
BA_ "GenSigSendType" SG_ 274 CF_AVN_HCIMSButtonCommand 4;
BA_ "UserSigValidity" SG_ 274 CF_AVN_HCIMSButtonCommand 3;
BA_ "Version" SG_ 274 CF_AVN_HCIMSButtonCommand "18.09.04";
BA_ "GenSigSendType" SG_ 274 C_HCIMSSitHeightNValueSet 4;
BA_ "UserSigValidity" SG_ 274 C_HCIMSSitHeightNValueSet 3;
BA_ "Version" SG_ 274 C_HCIMSSitHeightNValueSet "18.09.04";
BA_ "GenSigSendType" SG_ 274 CF_AVN_BodySpprtSet 4;
BA_ "GenSigStartValue" SG_ 274 CF_AVN_BodySpprtSet 3;
BA_ "UserSigValidity" SG_ 274 CF_AVN_BodySpprtSet 3;
BA_ "Version" SG_ 274 CF_AVN_BodySpprtSet "18.11.01";
BA_ "Description" SG_ 274 HU_USM_AlvCnt2Val "For the first transmission request for a data element the counter shall be initialized with 0 and shall be incremented by 1 for every subsequent send request. 

When the counter reaches the maximum value(0xFF), then it shall restart with 0 for the next s";
BA_ "GenSigSendType" SG_ 274 HU_USM_AlvCnt2Val 4;
BA_ "UserSigValidity" SG_ 274 HU_USM_AlvCnt2Val 3;
BA_ "Version" SG_ 274 HU_USM_AlvCnt2Val "22.10.20";
BA_ "GenSigSendType" SG_ 274 CF_AVN_AirSptTimeNValueSet 4;
BA_ "GenSigStartValue" SG_ 274 CF_AVN_AirSptTimeNValueSet 7;
BA_ "UserSigValidity" SG_ 274 CF_AVN_AirSptTimeNValueSet 3;
BA_ "Version" SG_ 274 CF_AVN_AirSptTimeNValueSet "18.09.04";
BA_ "GenSigSendType" SG_ 274 CF_AVN_AirSptStrNValue 4;
BA_ "GenSigStartValue" SG_ 274 CF_AVN_AirSptStrNValue 3;
BA_ "UserSigValidity" SG_ 274 CF_AVN_AirSptStrNValue 3;
BA_ "Version" SG_ 274 CF_AVN_AirSptStrNValue "18.09.04";
BA_ "GenSigSendType" SG_ 274 CF_AVN_SeatDrvModNValueSet 4;
BA_ "GenSigStartValue" SG_ 274 CF_AVN_SeatDrvModNValueSet 3;
BA_ "UserSigValidity" SG_ 274 CF_AVN_SeatDrvModNValueSet 3;
BA_ "Version" SG_ 274 CF_AVN_SeatDrvModNValueSet "18.09.04";
BA_ "Description" SG_ 274 C_SmrtSldngDrNValueSet "USM request for Smart Sliding Door";
BA_ "GenSigSendType" SG_ 274 C_SmrtSldngDrNValueSet 4;
BA_ "UserSigValidity" SG_ 274 C_SmrtSldngDrNValueSet 3;
BA_ "Version" SG_ 274 C_SmrtSldngDrNValueSet "19.01.10";
BA_ "Description" SG_ 274 CF_AVN_TurboPressureUnit "USM Request for Turbo Boost Pressure Unit";
BA_ "GenSigSendType" SG_ 274 CF_AVN_TurboPressureUnit 4;
BA_ "UserSigValidity" SG_ 274 CF_AVN_TurboPressureUnit 3;
BA_ "Version" SG_ 274 CF_AVN_TurboPressureUnit "19.06.02";
BA_ "Description" SG_ 274 CF_AVN_CluTorqueUnit "USM Request for Torque Unit Setting";
BA_ "GenSigSendType" SG_ 274 CF_AVN_CluTorqueUnit 4;
BA_ "UserSigValidity" SG_ 274 CF_AVN_CluTorqueUnit 3;
BA_ "Version" SG_ 274 CF_AVN_CluTorqueUnit "19.06.02";
BA_ "GenSigSendType" SG_ 274 CF_AVN_MoodLpRedNValueSet 4;
BA_ "GenSigStartValue" SG_ 274 CF_AVN_MoodLpRedNValueSet 512;
BA_ "UserSigValidity" SG_ 274 CF_AVN_MoodLpRedNValueSet 3;
BA_ "NetworkRequest" SG_ 274 CF_AVN_MoodLpRedNValueSet 0;
BA_ "NetworkRequestHoldingTime" SG_ 274 CF_AVN_MoodLpRedNValueSet 200;
BA_ "Version" SG_ 274 CF_AVN_MoodLpRedNValueSet "20.08.06";
BA_ "GenSigSendType" SG_ 274 CF_AVN_MoodLpGreenNValueSet 4;
BA_ "GenSigStartValue" SG_ 274 CF_AVN_MoodLpGreenNValueSet 512;
BA_ "UserSigValidity" SG_ 274 CF_AVN_MoodLpGreenNValueSet 3;
BA_ "NetworkRequest" SG_ 274 CF_AVN_MoodLpGreenNValueSet 0;
BA_ "NetworkRequestHoldingTime" SG_ 274 CF_AVN_MoodLpGreenNValueSet 200;
BA_ "Version" SG_ 274 CF_AVN_MoodLpGreenNValueSet "20.08.06";
BA_ "GenSigSendType" SG_ 274 CF_AVN_MoodLpBlueNValueSet 4;
BA_ "GenSigStartValue" SG_ 274 CF_AVN_MoodLpBlueNValueSet 512;
BA_ "UserSigValidity" SG_ 274 CF_AVN_MoodLpBlueNValueSet 3;
BA_ "NetworkRequest" SG_ 274 CF_AVN_MoodLpBlueNValueSet 0;
BA_ "NetworkRequestHoldingTime" SG_ 274 CF_AVN_MoodLpBlueNValueSet 200;
BA_ "Version" SG_ 274 CF_AVN_MoodLpBlueNValueSet "20.08.06";
BA_ "GenSigSendType" SG_ 274 CF_AVN_MoodLpBrightNValueSet 4;
BA_ "UserSigValidity" SG_ 274 CF_AVN_MoodLpBrightNValueSet 3;
BA_ "NetworkRequest" SG_ 274 CF_AVN_MoodLpBrightNValueSet 0;
BA_ "NetworkRequestHoldingTime" SG_ 274 CF_AVN_MoodLpBrightNValueSet 200;
BA_ "Version" SG_ 274 CF_AVN_MoodLpBrightNValueSet "20.08.06";
BA_ "GenSigSendType" SG_ 274 CF_AVN_HBANValueSet 4;
BA_ "UserSigValidity" SG_ 274 CF_AVN_HBANValueSet 3;
BA_ "Version" SG_ 274 CF_AVN_HBANValueSet "18.09.04";
BA_ "GenSigSendType" SG_ 274 CF_AVN_IFSActVehSpd_Set 4;
BA_ "UserSigValidity" SG_ 274 CF_AVN_IFSActVehSpd_Set 3;
BA_ "Version" SG_ 274 CF_AVN_IFSActVehSpd_Set "18.09.04";
BA_ "GenSigSendType" SG_ 274 C_MoodLpDrivingNValue 4;
BA_ "UserSigValidity" SG_ 274 C_MoodLpDrivingNValue 3;
BA_ "Version" SG_ 274 C_MoodLpDrivingNValue "18.09.04";
BA_ "Description" SG_ 274 HU_DrivingPostureAssistUSMSet "Driving Posture Assist - USM set on/off Request (R2.0)";
BA_ "GenSigSendType" SG_ 274 HU_DrivingPostureAssistUSMSet 4;
BA_ "GenSigStartValue" SG_ 274 HU_DrivingPostureAssistUSMSet 15;
BA_ "UserSigValidity" SG_ 274 HU_DrivingPostureAssistUSMSet 1;
BA_ "Version" SG_ 274 HU_DrivingPostureAssistUSMSet "23.07.03";
BA_ "GenSigSendType" SG_ 274 C_MoodLPDrivemodeNValue 4;
BA_ "UserSigValidity" SG_ 274 C_MoodLPDrivemodeNValue 3;
BA_ "Version" SG_ 274 C_MoodLPDrivemodeNValue "18.12.03";
BA_ "GenSigSendType" SG_ 274 CF_AVN_SVMAutoOnNvalueSet 4;
BA_ "UserSigValidity" SG_ 274 CF_AVN_SVMAutoOnNvalueSet 3;
BA_ "Version" SG_ 274 CF_AVN_SVMAutoOnNvalueSet "18.09.04";
BA_ "GenSigSendType" SG_ 274 CF_AVN_DAW_LVDANValueSet 4;
BA_ "UserSigValidity" SG_ 274 CF_AVN_DAW_LVDANValueSet 3;
BA_ "Version" SG_ 274 CF_AVN_DAW_LVDANValueSet "18.09.04";
BA_ "Description" SG_ 274 CF_AVN_Clu3dDepthSet "This signal is used for request to set the depth of 3D";
BA_ "GenSigSendType" SG_ 274 CF_AVN_Clu3dDepthSet 4;
BA_ "UserSigValidity" SG_ 274 CF_AVN_Clu3dDepthSet 3;
BA_ "Version" SG_ 274 CF_AVN_Clu3dDepthSet "19.03.08";
BA_ "Description" SG_ 274 C_MoodLpFadeNValue "This signal is for Navigation speed warning related ambient light(MLM) control fucntion.

This signal indicates MLM Fade in/out control.";
BA_ "GenSigSendType" SG_ 274 C_MoodLpFadeNValue 4;
BA_ "UserSigValidity" SG_ 274 C_MoodLpFadeNValue 3;
BA_ "Version" SG_ 274 C_MoodLpFadeNValue "20.01.01";
BA_ "Description" SG_ 274 HU_DrvCushAirSprtUSMSet "Driver seat Cushion air support set On/Off request (R2.0)";
BA_ "GenSigSendType" SG_ 274 HU_DrvCushAirSprtUSMSet 4;
BA_ "GenSigStartValue" SG_ 274 HU_DrvCushAirSprtUSMSet 7;
BA_ "UserSigValidity" SG_ 274 HU_DrvCushAirSprtUSMSet 1;
BA_ "Version" SG_ 274 HU_DrvCushAirSprtUSMSet "23.07.03";
BA_ "Description" SG_ 274 HU_AstCushAirSprtUSMSet "Assist seat Cushion air support set On/Off request (R2.0)";
BA_ "GenSigSendType" SG_ 274 HU_AstCushAirSprtUSMSet 4;
BA_ "GenSigStartValue" SG_ 274 HU_AstCushAirSprtUSMSet 7;
BA_ "UserSigValidity" SG_ 274 HU_AstCushAirSprtUSMSet 1;
BA_ "Version" SG_ 274 HU_AstCushAirSprtUSMSet "23.07.03";
BA_ "Description" SG_ 274 HU_DrvStrchMassageSwSet "Driver Seat massage operation set on/off request (R2.0)";
BA_ "GenSigSendType" SG_ 274 HU_DrvStrchMassageSwSet 4;
BA_ "GenSigStartValue" SG_ 274 HU_DrvStrchMassageSwSet 3;
BA_ "UserSigValidity" SG_ 274 HU_DrvStrchMassageSwSet 1;
BA_ "Version" SG_ 274 HU_DrvStrchMassageSwSet "23.07.03";
BA_ "Description" SG_ 274 HU_DrvStrchMassageModeUSMSet "Driver Seat massage Mode set request (R2.0)";
BA_ "GenSigSendType" SG_ 274 HU_DrvStrchMassageModeUSMSet 4;
BA_ "GenSigStartValue" SG_ 274 HU_DrvStrchMassageModeUSMSet 7;
BA_ "UserSigValidity" SG_ 274 HU_DrvStrchMassageModeUSMSet 1;
BA_ "Version" SG_ 274 HU_DrvStrchMassageModeUSMSet "23.07.03";
BA_ "Description" SG_ 274 HU_DrvStrchMassageStrengthUSMSet "Driver Seat massage Strength set request (R2.0)";
BA_ "GenSigSendType" SG_ 274 HU_DrvStrchMassageStrengthUSMSet 4;
BA_ "GenSigStartValue" SG_ 274 HU_DrvStrchMassageStrengthUSMSet 7;
BA_ "UserSigValidity" SG_ 274 HU_DrvStrchMassageStrengthUSMSet 1;
BA_ "Version" SG_ 274 HU_DrvStrchMassageStrengthUSMSet "23.07.03";
BA_ "Description" SG_ 274 HU_DrvStrchMassageTimeUSMSet "Driver Seat massage Time set request (R2.0)";
BA_ "GenSigSendType" SG_ 274 HU_DrvStrchMassageTimeUSMSet 4;
BA_ "GenSigStartValue" SG_ 274 HU_DrvStrchMassageTimeUSMSet 7;
BA_ "UserSigValidity" SG_ 274 HU_DrvStrchMassageTimeUSMSet 1;
BA_ "Version" SG_ 274 HU_DrvStrchMassageTimeUSMSet "23.07.03";
BA_ "Description" SG_ 274 HU_AstStrchMassageSwSet "Assist Seat massage operation set on/off request (R2.0)";
BA_ "GenSigSendType" SG_ 274 HU_AstStrchMassageSwSet 4;
BA_ "GenSigStartValue" SG_ 274 HU_AstStrchMassageSwSet 3;
BA_ "UserSigValidity" SG_ 274 HU_AstStrchMassageSwSet 1;
BA_ "Version" SG_ 274 HU_AstStrchMassageSwSet "23.07.03";
BA_ "Description" SG_ 274 HU_AstStrchMassageModeUSMSet "Assit Seat massage Mode set request (R2.0)";
BA_ "GenSigSendType" SG_ 274 HU_AstStrchMassageModeUSMSet 4;
BA_ "GenSigStartValue" SG_ 274 HU_AstStrchMassageModeUSMSet 7;
BA_ "UserSigValidity" SG_ 274 HU_AstStrchMassageModeUSMSet 1;
BA_ "Version" SG_ 274 HU_AstStrchMassageModeUSMSet "23.07.03";
BA_ "Description" SG_ 274 HU_AstStrchMassageStrengthUSMSet "Assist Seat massage Strength set request (R2.0)";
BA_ "GenSigSendType" SG_ 274 HU_AstStrchMassageStrengthUSMSet 4;
BA_ "GenSigStartValue" SG_ 274 HU_AstStrchMassageStrengthUSMSet 7;
BA_ "UserSigValidity" SG_ 274 HU_AstStrchMassageStrengthUSMSet 1;
BA_ "Version" SG_ 274 HU_AstStrchMassageStrengthUSMSet "23.07.03";
BA_ "Description" SG_ 274 HU_AstStrchMassageTimeUSMSet "Assist Seat massage Time set request (R2.0)";
BA_ "GenSigSendType" SG_ 274 HU_AstStrchMassageTimeUSMSet 4;
BA_ "GenSigStartValue" SG_ 274 HU_AstStrchMassageTimeUSMSet 7;
BA_ "UserSigValidity" SG_ 274 HU_AstStrchMassageTimeUSMSet 1;
BA_ "Version" SG_ 274 HU_AstStrchMassageTimeUSMSet "23.07.03";
BA_ "Description" SG_ 274 HU_DrvMsgPulseUSMSet "Request to set Diver Seat Massage Pulse";
BA_ "GenSigSendType" SG_ 274 HU_DrvMsgPulseUSMSet 4;
BA_ "UserSigValidity" SG_ 274 HU_DrvMsgPulseUSMSet 3;
BA_ "Version" SG_ 274 HU_DrvMsgPulseUSMSet "24.03.03";
BA_ "Description" SG_ 274 HU_AstMsgPulseUSMSet "Request to set Assit Seat Massage Pulse";
BA_ "GenSigSendType" SG_ 274 HU_AstMsgPulseUSMSet 4;
BA_ "UserSigValidity" SG_ 274 HU_AstMsgPulseUSMSet 3;
BA_ "Version" SG_ 274 HU_AstMsgPulseUSMSet "24.03.03";
BA_ "Description" SG_ 274 HU_RLMsgPulseUSMSet "Request to set Rear Left Seat Massage Pulse";
BA_ "GenSigSendType" SG_ 274 HU_RLMsgPulseUSMSet 4;
BA_ "UserSigValidity" SG_ 274 HU_RLMsgPulseUSMSet 3;
BA_ "Version" SG_ 274 HU_RLMsgPulseUSMSet "24.03.03";
BA_ "Description" SG_ 274 HU_RRMsgPulseUSMSet "Requset to set Rear Right Seat Massage Pulse";
BA_ "GenSigSendType" SG_ 274 HU_RRMsgPulseUSMSet 4;
BA_ "UserSigValidity" SG_ 274 HU_RRMsgPulseUSMSet 3;
BA_ "Version" SG_ 274 HU_RRMsgPulseUSMSet "24.03.03";
BA_ "GenSigSendType" SG_ 274 CF_AVN_CluWelcomeSnd 4;
BA_ "UserSigValidity" SG_ 274 CF_AVN_CluWelcomeSnd 3;
BA_ "Version" SG_ 274 CF_AVN_CluWelcomeSnd "18.04.02";
BA_ "GenSigSendType" SG_ 274 CF_AVN_CluServiceReminderSet 4;
BA_ "UserSigValidity" SG_ 274 CF_AVN_CluServiceReminderSet 3;
BA_ "Version" SG_ 274 CF_AVN_CluServiceReminderSet "18.04.02";
BA_ "GenSigSendType" SG_ 274 CF_AVN_CluTransmissionDisp 4;
BA_ "UserSigValidity" SG_ 274 CF_AVN_CluTransmissionDisp 3;
BA_ "Version" SG_ 274 CF_AVN_CluTransmissionDisp "18.04.02";
BA_ "GenSigSendType" SG_ 274 CF_AVN_CluWiperLight 4;
BA_ "UserSigValidity" SG_ 274 CF_AVN_CluWiperLight 3;
BA_ "Version" SG_ 274 CF_AVN_CluWiperLight "18.04.02";
BA_ "GenSigSendType" SG_ 274 CF_AVN_CluRoadInfoGuide 4;
BA_ "UserSigValidity" SG_ 274 CF_AVN_CluRoadInfoGuide 3;
BA_ "Version" SG_ 274 CF_AVN_CluRoadInfoGuide "18.04.02";
BA_ "GenSigSendType" SG_ 274 CF_AVN_CluUserSettingPeriod 4;
BA_ "GenSigStartValue" SG_ 274 CF_AVN_CluUserSettingPeriod 127;
BA_ "UserSigValidity" SG_ 274 CF_AVN_CluUserSettingPeriod 3;
BA_ "Version" SG_ 274 CF_AVN_CluUserSettingPeriod "19.01.10";
BA_ "GenSigSendType" SG_ 274 CF_AVN_CluFuelEconUnit_mi 4;
BA_ "UserSigValidity" SG_ 274 CF_AVN_CluFuelEconUnit_mi 3;
BA_ "Version" SG_ 274 CF_AVN_CluFuelEconUnit_mi "18.09.04";
BA_ "GenSigSendType" SG_ 274 CF_AVN_CluFuelEconUnit_km 4;
BA_ "UserSigValidity" SG_ 274 CF_AVN_CluFuelEconUnit_km 3;
BA_ "Version" SG_ 274 CF_AVN_CluFuelEconUnit_km "20.08.02";
BA_ "GenSigSendType" SG_ 274 CF_AVN_CluUserSettingDistance 4;
BA_ "GenSigStartValue" SG_ 274 CF_AVN_CluUserSettingDistance 131071;
BA_ "UserSigValidity" SG_ 274 CF_AVN_CluUserSettingDistance 3;
BA_ "Version" SG_ 274 CF_AVN_CluUserSettingDistance "19.01.10";
BA_ "Description" SG_ 273 HU_USM_Crc1Val "The data area for CRC calculation is based on the data length (DLC) of the message DB.

The CRC shall be calculated over the entire data block (excluding the CRC bytes) including the user data, alive counter and Data ID



- CRC Polynomial (0x1021) , Ini";
BA_ "GenSigSendType" SG_ 273 HU_USM_Crc1Val 4;
BA_ "GenSigStartValue" SG_ 273 HU_USM_Crc1Val 65535;
BA_ "UserSigValidity" SG_ 273 HU_USM_Crc1Val 3;
BA_ "Version" SG_ 273 HU_USM_Crc1Val "22.10.20";
BA_ "GenSigSendType" SG_ 273 CF_AVN_RCCWNValueSet 4;
BA_ "UserSigValidity" SG_ 273 CF_AVN_RCCWNValueSet 3;
BA_ "Version" SG_ 273 CF_AVN_RCCWNValueSet "18.09.04";
BA_ "GenSigSendType" SG_ 273 CF_AVN_PDWAutoOnNValueSet 4;
BA_ "UserSigValidity" SG_ 273 CF_AVN_PDWAutoOnNValueSet 3;
BA_ "Version" SG_ 273 CF_AVN_PDWAutoOnNValueSet "18.09.04";
BA_ "Description" SG_ 273 Usm_RpmTERRAINAUTO "Relation to Cluster RPM Gauge Display";
BA_ "GenSigSendType" SG_ 273 Usm_RpmTERRAINAUTO 4;
BA_ "UserSigValidity" SG_ 273 Usm_RpmTERRAINAUTO 3;
BA_ "Version" SG_ 273 Usm_RpmTERRAINAUTO "20.02.04";
BA_ "Description" SG_ 273 Usm_RpmSNOWSet "Relation To Cluster RPM Gauge Display";
BA_ "GenSigSendType" SG_ 273 Usm_RpmSNOWSet 4;
BA_ "UserSigValidity" SG_ 273 Usm_RpmSNOWSet 3;
BA_ "Version" SG_ 273 Usm_RpmSNOWSet "20.02.04";
BA_ "GenSigSendType" SG_ 273 C_TempUnit 4;
BA_ "UserSigValidity" SG_ 273 C_TempUnit 3;
BA_ "Version" SG_ 273 C_TempUnit "18.12.03";
BA_ "GenSigSendType" SG_ 273 CF_AVN_AdasVolumeNValueSet 4;
BA_ "UserSigValidity" SG_ 273 CF_AVN_AdasVolumeNValueSet 3;
BA_ "Version" SG_ 273 CF_AVN_AdasVolumeNValueSet "18.04.02";
BA_ "GenSigSendType" SG_ 273 C_PTGMNValueSet 4;
BA_ "UserSigValidity" SG_ 273 C_PTGMNValueSet 3;
BA_ "Version" SG_ 273 C_PTGMNValueSet "18.09.04";
BA_ "GenSigSendType" SG_ 273 CF_AVN_ADrUNValueSet 4;
BA_ "UserSigValidity" SG_ 273 CF_AVN_ADrUNValueSet 3;
BA_ "Version" SG_ 273 CF_AVN_ADrUNValueSet "18.09.04";
BA_ "GenSigSendType" SG_ 273 CF_AVN_EscortHLNValueSet 4;
BA_ "UserSigValidity" SG_ 273 CF_AVN_EscortHLNValueSet 3;
BA_ "Version" SG_ 273 CF_AVN_EscortHLNValueSet "18.09.04";
BA_ "GenSigSendType" SG_ 273 CF_AVN_PSMNValueSet 4;
BA_ "UserSigValidity" SG_ 273 CF_AVN_PSMNValueSet 3;
BA_ "Version" SG_ 273 CF_AVN_PSMNValueSet "18.09.04";
BA_ "GenSigSendType" SG_ 273 C_HfreeTrunkTgNValueSet 4;
BA_ "UserSigValidity" SG_ 273 C_HfreeTrunkTgNValueSet 3;
BA_ "Version" SG_ 273 C_HfreeTrunkTgNValueSet "18.09.04";
BA_ "GenSigSendType" SG_ 273 CF_AVN_TrfChgSet 4;
BA_ "UserSigValidity" SG_ 273 CF_AVN_TrfChgSet 3;
BA_ "Version" SG_ 273 CF_AVN_TrfChgSet "18.09.04";
BA_ "GenSigSendType" SG_ 273 CF_AVN_SCMNValueSet 4;
BA_ "UserSigValidity" SG_ 273 CF_AVN_SCMNValueSet 3;
BA_ "Version" SG_ 273 CF_AVN_SCMNValueSet "18.09.04";
BA_ "GenSigSendType" SG_ 273 CF_AVN_OTTurnNValueSet 4;
BA_ "UserSigValidity" SG_ 273 CF_AVN_OTTurnNValueSet 3;
BA_ "Version" SG_ 273 CF_AVN_OTTurnNValueSet "18.09.04";
BA_ "GenSigSendType" SG_ 273 CF_Gway_WPCNValueSet 4;
BA_ "UserSigValidity" SG_ 273 CF_Gway_WPCNValueSet 3;
BA_ "Version" SG_ 273 CF_Gway_WPCNValueSet "18.09.04";
BA_ "GenSigSendType" SG_ 273 C_AVN_RearWiperNValueSet 4;
BA_ "UserSigValidity" SG_ 273 C_AVN_RearWiperNValueSet 3;
BA_ "Version" SG_ 273 C_AVN_RearWiperNValueSet "18.09.04";
BA_ "GenSigSendType" SG_ 273 C_UnlockWelocomeNValueSet 4;
BA_ "UserSigValidity" SG_ 273 C_UnlockWelocomeNValueSet 3;
BA_ "Version" SG_ 273 C_UnlockWelocomeNValueSet "18.09.04";
BA_ "GenSigSendType" SG_ 273 C_SmartWelocomeNValueSet 4;
BA_ "UserSigValidity" SG_ 273 C_SmartWelocomeNValueSet 3;
BA_ "Version" SG_ 273 C_SmartWelocomeNValueSet "18.09.04";
BA_ "Description" SG_ 273 HU_USM_AlvCnt1Val "For the first transmission request for a data element the counter shall be initialized with 0 and shall be incremented by 1 for every subsequent send request. 

When the counter reaches the maximum value(0xFF), then it shall restart with 0 for the next s";
BA_ "GenSigSendType" SG_ 273 HU_USM_AlvCnt1Val 4;
BA_ "UserSigValidity" SG_ 273 HU_USM_AlvCnt1Val 3;
BA_ "Version" SG_ 273 HU_USM_AlvCnt1Val "22.10.20";
BA_ "GenSigSendType" SG_ 273 CF_AVN_PTGSpeedNValueSet 4;
BA_ "UserSigValidity" SG_ 273 CF_AVN_PTGSpeedNValueSet 3;
BA_ "Version" SG_ 273 CF_AVN_PTGSpeedNValueSet "18.09.04";
BA_ "GenSigSendType" SG_ 273 CR_Datc_DRSeatWheel_USM_Set 4;
BA_ "UserSigValidity" SG_ 273 CR_Datc_DRSeatWheel_USM_Set 3;
BA_ "Version" SG_ 273 CR_Datc_DRSeatWheel_USM_Set "18.09.04";
BA_ "GenSigSendType" SG_ 273 CF_AVN_TTUnlockNValueSet 4;
BA_ "GenSigStartValue" SG_ 273 CF_AVN_TTUnlockNValueSet 3;
BA_ "UserSigValidity" SG_ 273 CF_AVN_TTUnlockNValueSet 3;
BA_ "Version" SG_ 273 CF_AVN_TTUnlockNValueSet "18.09.04";
BA_ "GenSigSendType" SG_ 273 CF_Gway_RWPCNValueSet 4;
BA_ "UserSigValidity" SG_ 273 CF_Gway_RWPCNValueSet 3;
BA_ "Version" SG_ 273 CF_Gway_RWPCNValueSet "18.09.04";
BA_ "GenSigSendType" SG_ 273 C_PSDNValueSet 4;
BA_ "UserSigValidity" SG_ 273 C_PSDNValueSet 3;
BA_ "Version" SG_ 273 C_PSDNValueSet "18.12.01";
BA_ "GenSigSendType" SG_ 273 CF_Avn_HAPTICWARNINGNValueSet 4;
BA_ "UserSigValidity" SG_ 273 CF_Avn_HAPTICWARNINGNValueSet 3;
BA_ "Version" SG_ 273 CF_Avn_HAPTICWARNINGNValueSet "18.12.01";
BA_ "GenSigSendType" SG_ 273 CR_Datc_DRSeatHeat_USM_Set 4;
BA_ "UserSigValidity" SG_ 273 CR_Datc_DRSeatHeat_USM_Set 3;
BA_ "Version" SG_ 273 CR_Datc_DRSeatHeat_USM_Set "18.09.04";
BA_ "GenSigSendType" SG_ 273 C_WALNValueSet 4;
BA_ "UserSigValidity" SG_ 273 C_WALNValueSet 3;
BA_ "Version" SG_ 273 C_WALNValueSet "18.09.04";
BA_ "GenSigSendType" SG_ 273 C_ApprUnlockNValue 4;
BA_ "UserSigValidity" SG_ 273 C_ApprUnlockNValue 3;
BA_ "Version" SG_ 273 C_ApprUnlockNValue "18.09.04";
BA_ "GenSigSendType" SG_ 273 CF_AVN_HudSet 4;
BA_ "UserSigValidity" SG_ 273 CF_AVN_HudSet 3;
BA_ "Version" SG_ 273 CF_AVN_HudSet "18.06.03";
BA_ "GenSigSendType" SG_ 273 CF_AVN_HudContetnsTBT 4;
BA_ "UserSigValidity" SG_ 273 CF_AVN_HudContetnsTBT 3;
BA_ "Version" SG_ 273 CF_AVN_HudContetnsTBT "18.06.03";
BA_ "GenSigSendType" SG_ 273 CF_AVN_HudContetnsSCC 4;
BA_ "UserSigValidity" SG_ 273 CF_AVN_HudContetnsSCC 3;
BA_ "Version" SG_ 273 CF_AVN_HudContetnsSCC "18.06.03";
BA_ "GenSigSendType" SG_ 273 CF_AVN_HudContetnsDIS 4;
BA_ "UserSigValidity" SG_ 273 CF_AVN_HudContetnsDIS 3;
BA_ "Version" SG_ 273 CF_AVN_HudContetnsDIS "18.06.03";
BA_ "GenSigSendType" SG_ 273 CF_AVN_HudContetnsBSD 4;
BA_ "UserSigValidity" SG_ 273 CF_AVN_HudContetnsBSD 3;
BA_ "Version" SG_ 273 CF_AVN_HudContetnsBSD "18.06.03";
BA_ "GenSigSendType" SG_ 273 CF_AVN_HudHeightSet 4;
BA_ "GenSigStartValue" SG_ 273 CF_AVN_HudHeightSet 31;
BA_ "UserSigValidity" SG_ 273 CF_AVN_HudHeightSet 3;
BA_ "Version" SG_ 273 CF_AVN_HudHeightSet "18.06.03";
BA_ "GenSigSendType" SG_ 273 CF_AVN_HudBrightnessSet 4;
BA_ "GenSigStartValue" SG_ 273 CF_AVN_HudBrightnessSet 31;
BA_ "UserSigValidity" SG_ 273 CF_AVN_HudBrightnessSet 3;
BA_ "Version" SG_ 273 CF_AVN_HudBrightnessSet "18.06.03";
BA_ "GenSigSendType" SG_ 273 CF_AVN_HudRotationSet 4;
BA_ "GenSigStartValue" SG_ 273 CF_AVN_HudRotationSet 31;
BA_ "UserSigValidity" SG_ 273 CF_AVN_HudRotationSet 3;
BA_ "Version" SG_ 273 CF_AVN_HudRotationSet "18.06.03";
BA_ "Description" SG_ 273 AVN_BPCM_DrvReq "Request signal for Driver BPCM(Body Power Converter Module)";
BA_ "GenSigSendType" SG_ 273 AVN_BPCM_DrvReq 4;
BA_ "UserSigValidity" SG_ 273 AVN_BPCM_DrvReq 3;
BA_ "Version" SG_ 273 AVN_BPCM_DrvReq "23.08.01";
BA_ "GenSigSendType" SG_ 273 CF_AVN_HudContentsAVInfo 4;
BA_ "UserSigValidity" SG_ 273 CF_AVN_HudContentsAVInfo 3;
BA_ "Version" SG_ 273 CF_AVN_HudContentsAVInfo "18.06.04";
BA_ "Description" SG_ 273 CF_AVN_SportHUD "Related to HUD Sports mode of Usm";
BA_ "GenSigSendType" SG_ 273 CF_AVN_SportHUD 4;
BA_ "UserSigValidity" SG_ 273 CF_AVN_SportHUD 3;
BA_ "Version" SG_ 273 CF_AVN_SportHUD "20.01.02";
BA_ "Description" SG_ 273 USM_RpmCOMFORTSet "Rerlation to Cluster Gauge Display";
BA_ "GenSigSendType" SG_ 273 USM_RpmCOMFORTSet 4;
BA_ "UserSigValidity" SG_ 273 USM_RpmCOMFORTSet 3;
BA_ "Version" SG_ 273 USM_RpmCOMFORTSet "20.02.04";
BA_ "Description" SG_ 273 USM_RpmNORMALSet "Relation to Cluster Gauge Display";
BA_ "GenSigSendType" SG_ 273 USM_RpmNORMALSet 4;
BA_ "UserSigValidity" SG_ 273 USM_RpmNORMALSet 3;
BA_ "Version" SG_ 273 USM_RpmNORMALSet "20.02.04";
BA_ "Description" SG_ 273 AVN_BPCM_AstReq "Request signal for Assistant BPCM(Body Power Converter Module)";
BA_ "GenSigSendType" SG_ 273 AVN_BPCM_AstReq 4;
BA_ "UserSigValidity" SG_ 273 AVN_BPCM_AstReq 3;
BA_ "Version" SG_ 273 AVN_BPCM_AstReq "23.08.01";
BA_ "Description" SG_ 273 AVN_BPCM_RLReq "Request signal for RL BPCM(Body Power Converter Module)";
BA_ "GenSigSendType" SG_ 273 AVN_BPCM_RLReq 4;
BA_ "UserSigValidity" SG_ 273 AVN_BPCM_RLReq 3;
BA_ "Version" SG_ 273 AVN_BPCM_RLReq "23.08.01";
BA_ "Description" SG_ 273 AVN_BPCM_RRReq "Request signal for RR BPCM(Body Power Converter Module)";
BA_ "GenSigSendType" SG_ 273 AVN_BPCM_RRReq 4;
BA_ "UserSigValidity" SG_ 273 AVN_BPCM_RRReq 3;
BA_ "Version" SG_ 273 AVN_BPCM_RRReq "23.08.01";
BA_ "Description" SG_ 273 AVN_BPCM_Drv1_USMOnReq "Reauest signal for driver's 1st BPCM area setting (On/Off)";
BA_ "GenSigSendType" SG_ 273 AVN_BPCM_Drv1_USMOnReq 4;
BA_ "UserSigValidity" SG_ 273 AVN_BPCM_Drv1_USMOnReq 3;
BA_ "Version" SG_ 273 AVN_BPCM_Drv1_USMOnReq "23.08.01";
BA_ "Description" SG_ 273 AVN_BPCM_Drv2_USMOnReq "Request signal for driver's 2nd BPCM area setting (On/Off)";
BA_ "GenSigSendType" SG_ 273 AVN_BPCM_Drv2_USMOnReq 4;
BA_ "UserSigValidity" SG_ 273 AVN_BPCM_Drv2_USMOnReq 3;
BA_ "Version" SG_ 273 AVN_BPCM_Drv2_USMOnReq "23.08.01";
BA_ "Description" SG_ 273 AVN_BPCM_Drv3_USMOnReq "Request signal for driver's 3rd BPCM area setting (On/Off)";
BA_ "GenSigSendType" SG_ 273 AVN_BPCM_Drv3_USMOnReq 4;
BA_ "UserSigValidity" SG_ 273 AVN_BPCM_Drv3_USMOnReq 3;
BA_ "Version" SG_ 273 AVN_BPCM_Drv3_USMOnReq "23.08.01";
BA_ "Description" SG_ 273 AVN_BPCM_Drv4_USMOnReq "Request signal for driver's 4th BPCM area setting (On/Off)";
BA_ "GenSigSendType" SG_ 273 AVN_BPCM_Drv4_USMOnReq 4;
BA_ "UserSigValidity" SG_ 273 AVN_BPCM_Drv4_USMOnReq 3;
BA_ "Version" SG_ 273 AVN_BPCM_Drv4_USMOnReq "23.08.01";
BA_ "Description" SG_ 273 AVN_BPCM_Ast1_USMOnReq "Reauest signal for Assistant's 1st BPCM area setting (On/Off)";
BA_ "GenSigSendType" SG_ 273 AVN_BPCM_Ast1_USMOnReq 4;
BA_ "UserSigValidity" SG_ 273 AVN_BPCM_Ast1_USMOnReq 3;
BA_ "Version" SG_ 273 AVN_BPCM_Ast1_USMOnReq "23.08.01";
BA_ "Description" SG_ 273 AVN_BPCM_Ast2_USMOnReq "Reauest signal for Assistant's 2nd BPCM area setting (On/Off)";
BA_ "GenSigSendType" SG_ 273 AVN_BPCM_Ast2_USMOnReq 4;
BA_ "UserSigValidity" SG_ 273 AVN_BPCM_Ast2_USMOnReq 3;
BA_ "Version" SG_ 273 AVN_BPCM_Ast2_USMOnReq "23.08.01";
BA_ "Description" SG_ 273 AVN_BPCM_Ast3_USMOnReq "Reauest signal for Assistant's 3rd BPCM area setting (On/Off)";
BA_ "GenSigSendType" SG_ 273 AVN_BPCM_Ast3_USMOnReq 4;
BA_ "UserSigValidity" SG_ 273 AVN_BPCM_Ast3_USMOnReq 3;
BA_ "Version" SG_ 273 AVN_BPCM_Ast3_USMOnReq "23.08.01";
BA_ "Description" SG_ 273 AVN_BPCM_Ast4_USMOnReq "Reauest signal for Assistant's 4st BPCM area setting (On/Off)";
BA_ "GenSigSendType" SG_ 273 AVN_BPCM_Ast4_USMOnReq 4;
BA_ "UserSigValidity" SG_ 273 AVN_BPCM_Ast4_USMOnReq 3;
BA_ "Version" SG_ 273 AVN_BPCM_Ast4_USMOnReq "23.08.01";
BA_ "Description" SG_ 273 AVN_BPCM_RL1_USMOnReq "Reauest signal for RL's 1st BPCM area setting (On/Off)";
BA_ "GenSigSendType" SG_ 273 AVN_BPCM_RL1_USMOnReq 4;
BA_ "UserSigValidity" SG_ 273 AVN_BPCM_RL1_USMOnReq 3;
BA_ "Version" SG_ 273 AVN_BPCM_RL1_USMOnReq "23.08.01";
BA_ "Description" SG_ 273 AVN_BPCM_RL2_USMOnReq "Reauest signal for RL's 2nd BPCM area setting (On/Off)";
BA_ "GenSigSendType" SG_ 273 AVN_BPCM_RL2_USMOnReq 4;
BA_ "UserSigValidity" SG_ 273 AVN_BPCM_RL2_USMOnReq 3;
BA_ "Version" SG_ 273 AVN_BPCM_RL2_USMOnReq "23.08.01";
BA_ "Description" SG_ 273 AVN_BPCM_RL3_USMOnReq "Reauest signal for RL's 3rd BPCM area setting (On/Off)";
BA_ "GenSigSendType" SG_ 273 AVN_BPCM_RL3_USMOnReq 4;
BA_ "UserSigValidity" SG_ 273 AVN_BPCM_RL3_USMOnReq 3;
BA_ "Version" SG_ 273 AVN_BPCM_RL3_USMOnReq "23.08.01";
BA_ "Description" SG_ 273 AVN_BPCM_RL4_USMOnReq "Reauest signal for RL's 4st BPCM area setting (On/Off)";
BA_ "GenSigSendType" SG_ 273 AVN_BPCM_RL4_USMOnReq 4;
BA_ "UserSigValidity" SG_ 273 AVN_BPCM_RL4_USMOnReq 3;
BA_ "Version" SG_ 273 AVN_BPCM_RL4_USMOnReq "23.08.01";
BA_ "Description" SG_ 273 AVN_BPCM_RR1_USMOnReq "Reauest signal for RR's 1st BPCM area setting (On/Off)";
BA_ "GenSigSendType" SG_ 273 AVN_BPCM_RR1_USMOnReq 4;
BA_ "UserSigValidity" SG_ 273 AVN_BPCM_RR1_USMOnReq 3;
BA_ "Version" SG_ 273 AVN_BPCM_RR1_USMOnReq "23.08.01";
BA_ "Description" SG_ 273 AVN_BPCM_RR2_USMOnReq "Reauest signal for RR's 2nd BPCM area setting (On/Off)";
BA_ "GenSigSendType" SG_ 273 AVN_BPCM_RR2_USMOnReq 4;
BA_ "UserSigValidity" SG_ 273 AVN_BPCM_RR2_USMOnReq 3;
BA_ "Version" SG_ 273 AVN_BPCM_RR2_USMOnReq "23.08.01";
BA_ "Description" SG_ 273 AVN_BPCM_RR3_USMOnReq "Reauest signal for RR's 3rd BPCM area setting (On/Off)";
BA_ "GenSigSendType" SG_ 273 AVN_BPCM_RR3_USMOnReq 4;
BA_ "UserSigValidity" SG_ 273 AVN_BPCM_RR3_USMOnReq 3;
BA_ "Version" SG_ 273 AVN_BPCM_RR3_USMOnReq "23.08.01";
BA_ "Description" SG_ 273 AVN_BPCM_RR4_USMOnReq "Reauest signal for RR's 4st BPCM area setting (On/Off)";
BA_ "GenSigSendType" SG_ 273 AVN_BPCM_RR4_USMOnReq 4;
BA_ "UserSigValidity" SG_ 273 AVN_BPCM_RR4_USMOnReq 3;
BA_ "Version" SG_ 273 AVN_BPCM_RR4_USMOnReq "23.08.01";
BA_ "GenSigSendType" SG_ 273 CF_AVN_HDANValueSet 4;
BA_ "UserSigValidity" SG_ 273 CF_AVN_HDANValueSet 3;
BA_ "Version" SG_ 273 CF_AVN_HDANValueSet "18.09.04";
BA_ "GenSigSendType" SG_ 273 CF_AVN_NSCCCamNValueSet 4;
BA_ "UserSigValidity" SG_ 273 CF_AVN_NSCCCamNValueSet 3;
BA_ "Version" SG_ 273 CF_AVN_NSCCCamNValueSet "18.09.04";
BA_ "GenSigSendType" SG_ 273 CF_AVN_ISLWNValueSet 4;
BA_ "UserSigValidity" SG_ 273 CF_AVN_ISLWNValueSet 3;
BA_ "Version" SG_ 273 CF_AVN_ISLWNValueSet "18.09.04";
BA_ "GenSigSendType" SG_ 273 CF_AVN_NCC_USM_set 4;
BA_ "UserSigValidity" SG_ 273 CF_AVN_NCC_USM_set 3;
BA_ "Version" SG_ 273 CF_AVN_NCC_USM_set "18.09.04";
BA_ "GenSigSendType" SG_ 273 CF_AVN_TirePressUnitNValueSet 4;
BA_ "UserSigValidity" SG_ 273 CF_AVN_TirePressUnitNValueSet 3;
BA_ "Version" SG_ 273 CF_AVN_TirePressUnitNValueSet "18.09.04";
BA_ "Description" SG_ 745 PDC_FD_Crc15Val "The data area for CRC calculation is based on the data length (DLC) of the message DB.

The CRC shall be calculated over the entire data block (excluding the CRC bytes) including the user data, alive counter and Data ID



- CRC Polynomial (0x1021) , Ini";
BA_ "GenSigSendType" SG_ 745 PDC_FD_Crc15Val 4;
BA_ "GenSigStartValue" SG_ 745 PDC_FD_Crc15Val 65535;
BA_ "UserSigValidity" SG_ 745 PDC_FD_Crc15Val 3;
BA_ "Version" SG_ 745 PDC_FD_Crc15Val "24.04.08";
BA_ "Description" SG_ 745 PDC_CurrAtReset "This signal indicate the current at reset request";
BA_ "GenSigSendType" SG_ 745 PDC_CurrAtReset 4;
BA_ "UserSigValidity" SG_ 745 PDC_CurrAtReset 0;
BA_ "Version" SG_ 745 PDC_CurrAtReset "24.07.06";
BA_ "Description" SG_ 745 PDC_AvgCurrAtReset "This signal indicate the average current at reset request";
BA_ "GenSigSendType" SG_ 745 PDC_AvgCurrAtReset 4;
BA_ "UserSigValidity" SG_ 745 PDC_AvgCurrAtReset 0;
BA_ "Version" SG_ 745 PDC_AvgCurrAtReset "24.07.06";
BA_ "Description" SG_ 745 PDC_ResetReason "This signal indicate the reason reset is operated";
BA_ "GenSigSendType" SG_ 745 PDC_ResetReason 4;
BA_ "UserSigValidity" SG_ 745 PDC_ResetReason 0;
BA_ "Version" SG_ 745 PDC_ResetReason "24.07.06";
BA_ "Description" SG_ 745 PDC_CumulativeCountOf12VReq "This signal indicates the cumulative number of 12V Controller req.";
BA_ "GenSigSendType" SG_ 745 PDC_CumulativeCountOf12VReq 4;
BA_ "UserSigValidity" SG_ 745 PDC_CumulativeCountOf12VReq 0;
BA_ "Version" SG_ 745 PDC_CumulativeCountOf12VReq "24.07.06";
BA_ "Description" SG_ 745 PDC_CumulativeCountOfCCUReq "This signal indicates the cumulative number of CCU_ForcedPowerOffReq";
BA_ "GenSigSendType" SG_ 745 PDC_CumulativeCountOfCCUReq 4;
BA_ "UserSigValidity" SG_ 745 PDC_CumulativeCountOfCCUReq 0;
BA_ "Version" SG_ 745 PDC_CumulativeCountOfCCUReq "24.07.06";
BA_ "Description" SG_ 745 PDC_FD_AlvCnt15Val "For the first transmission request for a data element the counter shall be initialized with 0 and shall be incremented by 1 for every subsequent send request. 

When the counter reaches the maximum value(0xFF), then it shall restart with 0 for the next s";
BA_ "GenSigSendType" SG_ 745 PDC_FD_AlvCnt15Val 4;
BA_ "UserSigValidity" SG_ 745 PDC_FD_AlvCnt15Val 3;
BA_ "Version" SG_ 745 PDC_FD_AlvCnt15Val "24.04.08";
BA_ "Description" SG_ 745 PDC_LDConReq "LDC on request signal for High Voltage Battery Discharge";
BA_ "GenSigSendType" SG_ 745 PDC_LDConReq 4;
BA_ "UserSigValidity" SG_ 745 PDC_LDConReq 0;
BA_ "Version" SG_ 745 PDC_LDConReq "24.07.05";
BA_ "Description" SG_ 745 PDC_LDConReq_By_LVBat "LDC on request signal for High Voltage Battery Discharge by Low Voltage Battery";
BA_ "GenSigSendType" SG_ 745 PDC_LDConReq_By_LVBat 4;
BA_ "UserSigValidity" SG_ 745 PDC_LDConReq_By_LVBat 0;
BA_ "Version" SG_ 745 PDC_LDConReq_By_LVBat "24.07.05";
BA_ "Description" SG_ 745 PDC_LDConReq_By_OTA "LDC on request signal for High Voltage Battery Discharge by OTA";
BA_ "GenSigSendType" SG_ 745 PDC_LDConReq_By_OTA 4;
BA_ "UserSigValidity" SG_ 745 PDC_LDConReq_By_OTA 0;
BA_ "Version" SG_ 745 PDC_LDConReq_By_OTA "24.07.05";
BA_ "Description" SG_ 745 PDC_LDConReq_By_Load "LDC on request signal for High Voltage Battery Discharge by Load";
BA_ "GenSigSendType" SG_ 745 PDC_LDConReq_By_Load 4;
BA_ "UserSigValidity" SG_ 745 PDC_LDConReq_By_Load 0;
BA_ "Version" SG_ 745 PDC_LDConReq_By_Load "24.07.05";
BA_ "Description" SG_ 745 PDC_LDConReq_By_ActiveOn "LDC on request signal for High Voltage Battery Discharge by Active On";
BA_ "GenSigSendType" SG_ 745 PDC_LDConReq_By_ActiveOn 4;
BA_ "UserSigValidity" SG_ 745 PDC_LDConReq_By_ActiveOn 0;
BA_ "Version" SG_ 745 PDC_LDConReq_By_ActiveOn "24.07.05";
BA_ "Description" SG_ 745 PDC_ResetPreWrngForCCU "This is a warning signal for reset.  This signal is used for preparing sideeffect of reset by Gateway";
BA_ "GenSigSendType" SG_ 745 PDC_ResetPreWrngForCCU 4;
BA_ "UserSigValidity" SG_ 745 PDC_ResetPreWrngForCCU 0;
BA_ "Version" SG_ 745 PDC_ResetPreWrngForCCU "24.05.05";
BA_ "Description" SG_ 745 PDC_ResetPreWrngForOthers "This is a warning signal for reset.  This signal is used for preparing sideeffect of reset by Receivers";
BA_ "GenSigSendType" SG_ 745 PDC_ResetPreWrngForOthers 4;
BA_ "UserSigValidity" SG_ 745 PDC_ResetPreWrngForOthers 0;
BA_ "Version" SG_ 745 PDC_ResetPreWrngForOthers "24.05.05";
BA_ "Description" SG_ 745 PDC_ResetReqForCCU "This is a request signal for SW reset of Gateway";
BA_ "GenSigSendType" SG_ 745 PDC_ResetReqForCCU 4;
BA_ "UserSigValidity" SG_ 745 PDC_ResetReqForCCU 0;
BA_ "Version" SG_ 745 PDC_ResetReqForCCU "24.05.05";
BA_ "Description" SG_ 745 PDC_ResetReqForOthers "This is a request signal for SW reset except for Gateway";
BA_ "GenSigSendType" SG_ 745 PDC_ResetReqForOthers 4;
BA_ "UserSigValidity" SG_ 745 PDC_ResetReqForOthers 0;
BA_ "Version" SG_ 745 PDC_ResetReqForOthers "24.05.05";
BA_ "Description" SG_ 745 PDC_ResetFuncOpt "This signal inform whether reset fucntion at PDC is appiled or not";
BA_ "GenSigSendType" SG_ 745 PDC_ResetFuncOpt 4;
BA_ "UserSigValidity" SG_ 745 PDC_ResetFuncOpt 0;
BA_ "Version" SG_ 745 PDC_ResetFuncOpt "24.05.05";
BA_ "Description" SG_ 745 PDC_12VRlyCtrl "This signal is request signal to control 12V battery internal relay for HW reset";
BA_ "GenSigSendType" SG_ 745 PDC_12VRlyCtrl 4;
BA_ "UserSigValidity" SG_ 745 PDC_12VRlyCtrl 0;
BA_ "Version" SG_ 745 PDC_12VRlyCtrl "24.05.05";
BA_ "Description" SG_ 745 PDC_CurrentValueForReset "This signal sets the average discharge current value to be measured for PDC_TimevalueForReset to be considered as a situation requiring reset.";
BA_ "GenSigSendType" SG_ 745 PDC_CurrentValueForReset 4;
BA_ "UserSigValidity" SG_ 745 PDC_CurrentValueForReset 0;
BA_ "Version" SG_ 745 PDC_CurrentValueForReset "24.07.03";
BA_ "Description" SG_ 745 PDC_TimeValueForReset "This signal sets the time value to be considered as a situation requiring reset.";
BA_ "GenSigSendType" SG_ 745 PDC_TimeValueForReset 4;
BA_ "UserSigValidity" SG_ 745 PDC_TimeValueForReset 0;
BA_ "Version" SG_ 745 PDC_TimeValueForReset "24.07.03";
BA_ "Description" SG_ 745 PDC_12VRlyOffHoldingTime "This signal sets how long the relay will be turned off when performing an HW reset using a 12 V battery internal relay.";
BA_ "GenSigSendType" SG_ 745 PDC_12VRlyOffHoldingTime 4;
BA_ "UserSigValidity" SG_ 745 PDC_12VRlyOffHoldingTime 0;
BA_ "Version" SG_ 745 PDC_12VRlyOffHoldingTime "24.05.05";
BA_ "Description" SG_ 745 PDC_ResetCountSetting "This signal sets the number of resets performed.";
BA_ "GenSigSendType" SG_ 745 PDC_ResetCountSetting 4;
BA_ "UserSigValidity" SG_ 745 PDC_ResetCountSetting 0;
BA_ "Version" SG_ 745 PDC_ResetCountSetting "24.05.05";
BA_ "Description" SG_ 745 PDC_ResetCount "This signal indicates how much reset has occurred.";
BA_ "GenSigSendType" SG_ 745 PDC_ResetCount 4;
BA_ "UserSigValidity" SG_ 745 PDC_ResetCount 0;
BA_ "Version" SG_ 745 PDC_ResetCount "24.05.05";
BA_ "Description" SG_ 745 PDC_ResetCumulativeCount "This signal indicates the cumulative number of resets performed.";
BA_ "GenSigSendType" SG_ 745 PDC_ResetCumulativeCount 4;
BA_ "UserSigValidity" SG_ 745 PDC_ResetCumulativeCount 0;
BA_ "Version" SG_ 745 PDC_ResetCumulativeCount "24.05.05";
BA_ "Description" SG_ 745 PDC_ResetOpsta "This signal indicates whether the reset operation has been completed or not";
BA_ "GenSigSendType" SG_ 745 PDC_ResetOpsta 4;
BA_ "UserSigValidity" SG_ 745 PDC_ResetOpsta 0;
BA_ "Version" SG_ 745 PDC_ResetOpsta "24.05.05";
BA_ "Description" SG_ 745 PDC_ReadyTimeValueForReset "This signal sets the time value to be considered as a situation of quiescent current

if receiver receive the value of no setting, do not operate the logic related to this signal";
BA_ "GenSigSendType" SG_ 745 PDC_ReadyTimeValueForReset 4;
BA_ "UserSigValidity" SG_ 745 PDC_ReadyTimeValueForReset 0;
BA_ "Version" SG_ 745 PDC_ReadyTimeValueForReset "24.07.06";
BA_ "Description" SG_ 278 HU_USM_Crc5Val "The data area for CRC calculation is based on the data length (DLC) of the message DB.

The CRC shall be calculated over the entire data block (excluding the CRC bytes) including the user data, alive counter and Data ID



- CRC Polynomial (0x1021) , Ini";
BA_ "GenSigSendType" SG_ 278 HU_USM_Crc5Val 4;
BA_ "GenSigStartValue" SG_ 278 HU_USM_Crc5Val 65535;
BA_ "UserSigValidity" SG_ 278 HU_USM_Crc5Val 3;
BA_ "Version" SG_ 278 HU_USM_Crc5Val "22.10.20";
BA_ "GenSigSendType" SG_ 278 CF_AVN_AIVoiceMicModNvalue 4;
BA_ "UserSigValidity" SG_ 278 CF_AVN_AIVoiceMicModNvalue 3;
BA_ "Version" SG_ 278 CF_AVN_AIVoiceMicModNvalue "22.01.06";
BA_ "GenSigSendType" SG_ 278 CF_AVN_AIVoiceTTSModNvalue 4;
BA_ "UserSigValidity" SG_ 278 CF_AVN_AIVoiceTTSModNvalue 3;
BA_ "Version" SG_ 278 CF_AVN_AIVoiceTTSModNvalue "22.01.06";
BA_ "Description" SG_ 278 CF_AVN_WiperAutoModeSet "Auto Washer Mode Wiper working set signal";
BA_ "GenSigSendType" SG_ 278 CF_AVN_WiperAutoModeSet 4;
BA_ "UserSigValidity" SG_ 278 CF_AVN_WiperAutoModeSet 3;
BA_ "Version" SG_ 278 CF_AVN_WiperAutoModeSet "21.12.00";
BA_ "Description" SG_ 278 CF_AVN_AFCUAutoWashModeSet "Auto wash set signal for AFCU unit";
BA_ "GenSigSendType" SG_ 278 CF_AVN_AFCUAutoWashModeSet 4;
BA_ "UserSigValidity" SG_ 278 CF_AVN_AFCUAutoWashModeSet 3;
BA_ "Version" SG_ 278 CF_AVN_AFCUAutoWashModeSet "22.01.06";
BA_ "Description" SG_ 278 CF_AVN_PSDAutoWashModeSet "Auto wash mode set signal for PSD Unit";
BA_ "GenSigSendType" SG_ 278 CF_AVN_PSDAutoWashModeSet 4;
BA_ "UserSigValidity" SG_ 278 CF_AVN_PSDAutoWashModeSet 3;
BA_ "Version" SG_ 278 CF_AVN_PSDAutoWashModeSet "22.01.06";
BA_ "Description" SG_ 278 CF_AVN_PTGAutoWashModeSet "Auto Wash Mode Set signal for PTG(PTL) Unit";
BA_ "GenSigSendType" SG_ 278 CF_AVN_PTGAutoWashModeSet 4;
BA_ "UserSigValidity" SG_ 278 CF_AVN_PTGAutoWashModeSet 3;
BA_ "Version" SG_ 278 CF_AVN_PTGAutoWashModeSet "22.01.06";
BA_ "Description" SG_ 278 CF_AVN_CDMAutoWashModeSet "Auto wash mode set signal for CDM";
BA_ "GenSigSendType" SG_ 278 CF_AVN_CDMAutoWashModeSet 4;
BA_ "UserSigValidity" SG_ 278 CF_AVN_CDMAutoWashModeSet 3;
BA_ "Version" SG_ 278 CF_AVN_CDMAutoWashModeSet "22.02.01";
BA_ "Description" SG_ 278 CF_AVN_Roof_OprLvSet "Smart Glass(Roof) usm setting signal";
BA_ "GenSigSendType" SG_ 278 CF_AVN_Roof_OprLvSet 4;
BA_ "UserSigValidity" SG_ 278 CF_AVN_Roof_OprLvSet 3;
BA_ "Version" SG_ 278 CF_AVN_Roof_OprLvSet "21.07.05";
BA_ "Description" SG_ 278 CF_AVN_2ndLeftDoor_OptLvSet "Smart Glass (2nd Left Door) Usm set signal";
BA_ "GenSigSendType" SG_ 278 CF_AVN_2ndLeftDoor_OptLvSet 4;
BA_ "UserSigValidity" SG_ 278 CF_AVN_2ndLeftDoor_OptLvSet 3;
BA_ "Version" SG_ 278 CF_AVN_2ndLeftDoor_OptLvSet "21.07.05";
BA_ "Description" SG_ 278 CF_AVN_2ndRightDoor_OptLvSet "Smart Glass (2nd Right Door) usm set signal";
BA_ "GenSigSendType" SG_ 278 CF_AVN_2ndRightDoor_OptLvSet 4;
BA_ "UserSigValidity" SG_ 278 CF_AVN_2ndRightDoor_OptLvSet 3;
BA_ "Version" SG_ 278 CF_AVN_2ndRightDoor_OptLvSet "21.07.05";
BA_ "Description" SG_ 278 CF_AVN_3rdLeftDoor_OptLvlSet "Smart Glass (3rd left door) usm set signal";
BA_ "GenSigSendType" SG_ 278 CF_AVN_3rdLeftDoor_OptLvlSet 4;
BA_ "UserSigValidity" SG_ 278 CF_AVN_3rdLeftDoor_OptLvlSet 3;
BA_ "Version" SG_ 278 CF_AVN_3rdLeftDoor_OptLvlSet "21.07.05";
BA_ "Description" SG_ 278 CF_AVN_3rdRightDoor_OptLvlSet "Smart Glass (3rd Right Door) usm set signal";
BA_ "GenSigSendType" SG_ 278 CF_AVN_3rdRightDoor_OptLvlSet 4;
BA_ "UserSigValidity" SG_ 278 CF_AVN_3rdRightDoor_OptLvlSet 3;
BA_ "Version" SG_ 278 CF_AVN_3rdRightDoor_OptLvlSet "21.07.05";
BA_ "Description" SG_ 278 CF_AVN_RearDoor_OptLvlSet "Smart Glass (Rear Door) usm set signal";
BA_ "GenSigSendType" SG_ 278 CF_AVN_RearDoor_OptLvlSet 4;
BA_ "UserSigValidity" SG_ 278 CF_AVN_RearDoor_OptLvlSet 3;
BA_ "Version" SG_ 278 CF_AVN_RearDoor_OptLvlSet "21.07.05";
BA_ "Description" SG_ 278 CF_AVN_RollBlindOnOffSet "Related Smar Glass RollBlind On,Off for USM set signal";
BA_ "GenSigSendType" SG_ 278 CF_AVN_RollBlindOnOffSet 4;
BA_ "UserSigValidity" SG_ 278 CF_AVN_RollBlindOnOffSet 3;
BA_ "Version" SG_ 278 CF_AVN_RollBlindOnOffSet "21.07.07";
BA_ "Description" SG_ 278 CF_AVN_CluThmAutoSet_New "this signal is Cluster theme Auto set signal for New cluster theme";
BA_ "GenSigSendType" SG_ 278 CF_AVN_CluThmAutoSet_New 4;
BA_ "UserSigValidity" SG_ 278 CF_AVN_CluThmAutoSet_New 3;
BA_ "Version" SG_ 278 CF_AVN_CluThmAutoSet_New "21.11.07";
BA_ "Description" SG_ 278 CF_AVN_CluThmSet_New "This signal is Cluster theme large category menu select for Cluster New theme";
BA_ "GenSigSendType" SG_ 278 CF_AVN_CluThmSet_New 4;
BA_ "UserSigValidity" SG_ 278 CF_AVN_CluThmSet_New 3;
BA_ "Version" SG_ 278 CF_AVN_CluThmSet_New "21.11.07";
BA_ "Description" SG_ 278 CF_AVN_CluThmDtlSet_New "This signal is Cluster Theme small category menu select for Cluster New Theme";
BA_ "GenSigSendType" SG_ 278 CF_AVN_CluThmDtlSet_New 4;
BA_ "UserSigValidity" SG_ 278 CF_AVN_CluThmDtlSet_New 3;
BA_ "Version" SG_ 278 CF_AVN_CluThmDtlSet_New "23.01.03";
BA_ "Description" SG_ 278 CF_AVN_DWL_SelectNvalueSet "Dynamic welcome light usm set signal";
BA_ "GenSigSendType" SG_ 278 CF_AVN_DWL_SelectNvalueSet 4;
BA_ "UserSigValidity" SG_ 278 CF_AVN_DWL_SelectNvalueSet 3;
BA_ "Version" SG_ 278 CF_AVN_DWL_SelectNvalueSet "22.05.02";
BA_ "Description" SG_ 278 HU_USM_AlvCnt5Val "For the first transmission request for a data element the counter shall be initialized with 0 and shall be incremented by 1 for every subsequent send request. 

When the counter reaches the maximum value(0xFF), then it shall restart with 0 for the next s";
BA_ "GenSigSendType" SG_ 278 HU_USM_AlvCnt5Val 4;
BA_ "UserSigValidity" SG_ 278 HU_USM_AlvCnt5Val 3;
BA_ "Version" SG_ 278 HU_USM_AlvCnt5Val "22.10.20";
BA_ "Description" SG_ 278 CF_Gway_WPCAnimationNvalueSet "USM set signal for wireless charging indicator";
BA_ "GenSigSendType" SG_ 278 CF_Gway_WPCAnimationNvalueSet 4;
BA_ "UserSigValidity" SG_ 278 CF_Gway_WPCAnimationNvalueSet 3;
BA_ "Version" SG_ 278 CF_Gway_WPCAnimationNvalueSet "22.04.01";
BA_ "Description" SG_ 278 USM_BtnIllumiAlwaysOnReq "USM Request for always turning on button illumination.";
BA_ "GenSigSendType" SG_ 278 USM_BtnIllumiAlwaysOnReq 4;
BA_ "UserSigValidity" SG_ 278 USM_BtnIllumiAlwaysOnReq 3;
BA_ "Version" SG_ 278 USM_BtnIllumiAlwaysOnReq "22.04.02";
BA_ "Description" SG_ 278 CF_AVN_LKAWrngVolNvalueSet "LKA Warning Volume USM Set signal";
BA_ "GenSigSendType" SG_ 278 CF_AVN_LKAWrngVolNvalueSet 4;
BA_ "UserSigValidity" SG_ 278 CF_AVN_LKAWrngVolNvalueSet 3;
BA_ "Version" SG_ 278 CF_AVN_LKAWrngVolNvalueSet "22.05.04";
BA_ "GenSigSendType" SG_ 278 DAB_IlluminationVrModeSet 4;
BA_ "UserSigValidity" SG_ 278 DAB_IlluminationVrModeSet 3;
BA_ "Version" SG_ 278 DAB_IlluminationVrModeSet "22.06.00";
BA_ "Description" SG_ 278 USM_IllAlwaysOnwithPSTNReq "USM set signal for Illumination & PSTN";
BA_ "GenSigSendType" SG_ 278 USM_IllAlwaysOnwithPSTNReq 4;
BA_ "UserSigValidity" SG_ 278 USM_IllAlwaysOnwithPSTNReq 3;
BA_ "Version" SG_ 278 USM_IllAlwaysOnwithPSTNReq "22.06.00";
BA_ "Description" SG_ 278 CF_AVN_AutoStopTimerResetSet "USM Set signal for Cluster Auto stop reset menu";
BA_ "GenSigSendType" SG_ 278 CF_AVN_AutoStopTimerResetSet 4;
BA_ "UserSigValidity" SG_ 278 CF_AVN_AutoStopTimerResetSet 3;
BA_ "Version" SG_ 278 CF_AVN_AutoStopTimerResetSet "22.06.05";
BA_ "Description" SG_ 278 USM_RrCurtainSet "USM request for Rear Curtain On/Off setting";
BA_ "GenSigSendType" SG_ 278 USM_RrCurtainSet 4;
BA_ "UserSigValidity" SG_ 278 USM_RrCurtainSet 3;
BA_ "Version" SG_ 278 USM_RrCurtainSet "22.07.01";
BA_ "Description" SG_ 278 USM_AdasISLAEUCntry1Set "USM country selection signal for ISLA Function";
BA_ "GenSigSendType" SG_ 278 USM_AdasISLAEUCntry1Set 4;
BA_ "UserSigValidity" SG_ 278 USM_AdasISLAEUCntry1Set 3;
BA_ "Version" SG_ 278 USM_AdasISLAEUCntry1Set "21.07.05";
BA_ "Description" SG_ 278 USM_AdasISLAEUCntryTglSet "USM toggle set signal for ISLA country changing";
BA_ "GenSigSendType" SG_ 278 USM_AdasISLAEUCntryTglSet 4;
BA_ "UserSigValidity" SG_ 278 USM_AdasISLAEUCntryTglSet 3;
BA_ "Version" SG_ 278 USM_AdasISLAEUCntryTglSet "21.07.05";
BA_ "Description" SG_ 278 xHEV_SmartRegen_Map_Set "Smart Regeneration 2.0 Map information USM User set Signal";
BA_ "GenSigSendType" SG_ 278 xHEV_SmartRegen_Map_Set 4;
BA_ "UserSigValidity" SG_ 278 xHEV_SmartRegen_Map_Set 3;
BA_ "Version" SG_ 278 xHEV_SmartRegen_Map_Set "22.04.01";
BA_ "Description" SG_ 278 HU_ChgCtrMode "0x0: Off

0x1: Charge Economic discount time first

0x2: Charge Economic discount time only

0x3: Invalid";
BA_ "GenSigSendType" SG_ 278 HU_ChgCtrMode 4;
BA_ "GenSigStartValue" SG_ 278 HU_ChgCtrMode 3;
BA_ "UserSigValidity" SG_ 278 HU_ChgCtrMode 7;
BA_ "Version" SG_ 278 HU_ChgCtrMode "22.06.05";
BA_ "Description" SG_ 278 CF_AVN_HudContentsCallPopup "USM Set signal for Hud call pop up";
BA_ "GenSigSendType" SG_ 278 CF_AVN_HudContentsCallPopup 4;
BA_ "UserSigValidity" SG_ 278 CF_AVN_HudContentsCallPopup 3;
BA_ "Version" SG_ 278 CF_AVN_HudContentsCallPopup "22.07.05";
BA_ "Description" SG_ 278 HU_EconStHr_WeekDay "Scheduled charging Econ Start Hour";
BA_ "GenSigSendType" SG_ 278 HU_EconStHr_WeekDay 4;
BA_ "GenSigStartValue" SG_ 278 HU_EconStHr_WeekDay 31;
BA_ "UserSigValidity" SG_ 278 HU_EconStHr_WeekDay 7;
BA_ "Version" SG_ 278 HU_EconStHr_WeekDay "22.06.05";
BA_ "Description" SG_ 278 HU_EconStMin_WeekDay "Scheduled Charging Econ Start minute.";
BA_ "GenSigSendType" SG_ 278 HU_EconStMin_WeekDay 4;
BA_ "GenSigStartValue" SG_ 278 HU_EconStMin_WeekDay 7;
BA_ "UserSigValidity" SG_ 278 HU_EconStMin_WeekDay 7;
BA_ "Version" SG_ 278 HU_EconStMin_WeekDay "22.07.06";
BA_ "Description" SG_ 278 HU_EconEndHr_WeekDay "Scheduled charging Econ End Hour";
BA_ "GenSigSendType" SG_ 278 HU_EconEndHr_WeekDay 4;
BA_ "GenSigStartValue" SG_ 278 HU_EconEndHr_WeekDay 31;
BA_ "UserSigValidity" SG_ 278 HU_EconEndHr_WeekDay 7;
BA_ "Version" SG_ 278 HU_EconEndHr_WeekDay "22.06.05";
BA_ "Description" SG_ 278 HU_EconEndMin_WeekDay "Scheduled Charging Econ End minute.";
BA_ "GenSigSendType" SG_ 278 HU_EconEndMin_WeekDay 4;
BA_ "GenSigStartValue" SG_ 278 HU_EconEndMin_WeekDay 7;
BA_ "UserSigValidity" SG_ 278 HU_EconEndMin_WeekDay 3;
BA_ "Version" SG_ 278 HU_EconEndMin_WeekDay "22.06.05";
BA_ "Description" SG_ 278 HU_DepartSet_Hour "Signal for Departure Hour";
BA_ "GenSigSendType" SG_ 278 HU_DepartSet_Hour 4;
BA_ "GenSigStartValue" SG_ 278 HU_DepartSet_Hour 31;
BA_ "UserSigValidity" SG_ 278 HU_DepartSet_Hour 7;
BA_ "Version" SG_ 278 HU_DepartSet_Hour "22.06.05";
BA_ "Description" SG_ 278 HU_DepartSet_Min "Signal for Departure minute.";
BA_ "GenSigSendType" SG_ 278 HU_DepartSet_Min 4;
BA_ "GenSigStartValue" SG_ 278 HU_DepartSet_Min 7;
BA_ "UserSigValidity" SG_ 278 HU_DepartSet_Min 7;
BA_ "Version" SG_ 278 HU_DepartSet_Min "22.06.05";
BA_ "Description" SG_ 278 HU_DepartSetDay "COMMON RULE: Day checked bit value=1 and day unchecked bit value=0

Each bit value mean checked day of the week status. 

Bit0: Mon

Bit1: Tue

Bit2: Wed

Bit3: Thu

Bit4: Fri

Bit5: Sat

Bit6: Sun

Bit7: Defined for Invalid value(0xFF=invalid)";
BA_ "GenSigSendType" SG_ 278 HU_DepartSetDay 4;
BA_ "UserSigValidity" SG_ 278 HU_DepartSetDay 7;
BA_ "Version" SG_ 278 HU_DepartSetDay "22.10.20";
BA_ "Description" SG_ 278 HU_DepartSet_TempSet "Temperature setting value for the departure.";
BA_ "GenSigSendType" SG_ 278 HU_DepartSet_TempSet 4;
BA_ "GenSigStartValue" SG_ 278 HU_DepartSet_TempSet 63;
BA_ "UserSigValidity" SG_ 278 HU_DepartSet_TempSet 7;
BA_ "Version" SG_ 278 HU_DepartSet_TempSet "22.06.05";
BA_ "Description" SG_ 278 HU_DepartSettingValue "Signal for Setting value of Depart on/off status";
BA_ "GenSigSendType" SG_ 278 HU_DepartSettingValue 4;
BA_ "GenSigStartValue" SG_ 278 HU_DepartSettingValue 3;
BA_ "UserSigValidity" SG_ 278 HU_DepartSettingValue 7;
BA_ "Version" SG_ 278 HU_DepartSettingValue "22.10.20";
BA_ "Description" SG_ 278 HU_NdepartSet "Departure number to update memory in HCU/VCU shedule.";
BA_ "GenSigSendType" SG_ 278 HU_NdepartSet 4;
BA_ "GenSigStartValue" SG_ 278 HU_NdepartSet 7;
BA_ "UserSigValidity" SG_ 278 HU_NdepartSet 7;
BA_ "Version" SG_ 278 HU_NdepartSet "22.06.05";
BA_ "Description" SG_ 278 HU_DepartSet_ClimateSet "Each bit means Scheduled Climate setting value like below. 

Bit0=scheduled climate temp unit(0:Centigrade Mode, 1:Fahrenheit Mode)

Bit1=scheduled climate defrost set (0: unchecked, 1: checked)

Bit2=scheduled climate on/off set (0: unchecked, 1: checke";
BA_ "GenSigSendType" SG_ 278 HU_DepartSet_ClimateSet 4;
BA_ "UserSigValidity" SG_ 278 HU_DepartSet_ClimateSet 7;
BA_ "Version" SG_ 278 HU_DepartSet_ClimateSet "22.10.20";
BA_ "Description" SG_ 278 CF_AVN_MdLpBttmRedNvalueSet "USM Mood Lamp Bottom Red Color Set signal";
BA_ "GenSigSendType" SG_ 278 CF_AVN_MdLpBttmRedNvalueSet 4;
BA_ "GenSigStartValue" SG_ 278 CF_AVN_MdLpBttmRedNvalueSet 512;
BA_ "UserSigValidity" SG_ 278 CF_AVN_MdLpBttmRedNvalueSet 3;
BA_ "Version" SG_ 278 CF_AVN_MdLpBttmRedNvalueSet "21.05.01";
BA_ "Description" SG_ 278 CF_AVN_MdLpBttmGreenNvalueSet "USM Mood Lamp Bottom Green Color Set signal";
BA_ "GenSigSendType" SG_ 278 CF_AVN_MdLpBttmGreenNvalueSet 4;
BA_ "GenSigStartValue" SG_ 278 CF_AVN_MdLpBttmGreenNvalueSet 512;
BA_ "UserSigValidity" SG_ 278 CF_AVN_MdLpBttmGreenNvalueSet 3;
BA_ "Version" SG_ 278 CF_AVN_MdLpBttmGreenNvalueSet "21.05.01";
BA_ "Description" SG_ 278 CF_AVN_MdLpBttmBlueNvalueSet "USM Mood Lamp Bottom Red Color Set Signal";
BA_ "GenSigSendType" SG_ 278 CF_AVN_MdLpBttmBlueNvalueSet 4;
BA_ "GenSigStartValue" SG_ 278 CF_AVN_MdLpBttmBlueNvalueSet 512;
BA_ "UserSigValidity" SG_ 278 CF_AVN_MdLpBttmBlueNvalueSet 3;
BA_ "Version" SG_ 278 CF_AVN_MdLpBttmBlueNvalueSet "22.07.02";
BA_ "Description" SG_ 278 CF_AVN_MdLpSpdModNvalueSet "USM Mood Lamp Speed relation setting Set signal";
BA_ "GenSigSendType" SG_ 278 CF_AVN_MdLpSpdModNvalueSet 4;
BA_ "UserSigValidity" SG_ 278 CF_AVN_MdLpSpdModNvalueSet 3;
BA_ "Version" SG_ 278 CF_AVN_MdLpSpdModNvalueSet "21.05.01";
BA_ "Description" SG_ 278 CF_AVN_MdLpColorModNvalueSet "USM Mood Lamp Mode number Set signal";
BA_ "GenSigSendType" SG_ 278 CF_AVN_MdLpColorModNvalueSet 4;
BA_ "UserSigValidity" SG_ 278 CF_AVN_MdLpColorModNvalueSet 3;
BA_ "Version" SG_ 278 CF_AVN_MdLpColorModNvalueSet "21.05.01";
BA_ "GenSigSendType" SG_ 278 CF_AVN_AIVoiceModNvalueSet 4;
BA_ "UserSigValidity" SG_ 278 CF_AVN_AIVoiceModNvalueSet 3;
BA_ "Version" SG_ 278 CF_AVN_AIVoiceModNvalueSet "21.07.05";
BA_ "Description" SG_ 276 HU_USM_Crc4Val "The data area for CRC calculation is based on the data length (DLC) of the message DB.

The CRC shall be calculated over the entire data block (excluding the CRC bytes) including the user data, alive counter and Data ID



- CRC Polynomial (0x1021) , Ini";
BA_ "GenSigSendType" SG_ 276 HU_USM_Crc4Val 4;
BA_ "GenSigStartValue" SG_ 276 HU_USM_Crc4Val 65535;
BA_ "UserSigValidity" SG_ 276 HU_USM_Crc4Val 3;
BA_ "Version" SG_ 276 HU_USM_Crc4Val "22.10.20";
BA_ "Description" SG_ 276 USM_CMSNgtBrgtnsLvlRHSetReq "USM Request for Night Brightness Level of CMS RH";
BA_ "GenSigSendType" SG_ 276 USM_CMSNgtBrgtnsLvlRHSetReq 4;
BA_ "GenSigStartValue" SG_ 276 USM_CMSNgtBrgtnsLvlRHSetReq 15;
BA_ "UserSigValidity" SG_ 276 USM_CMSNgtBrgtnsLvlRHSetReq 0;
BA_ "Version" SG_ 276 USM_CMSNgtBrgtnsLvlRHSetReq "19.12.00";
BA_ "Description" SG_ 276 USM_CMSBrgtnsReset "CMS Brightness Reset (LH/RH)";
BA_ "GenSigSendType" SG_ 276 USM_CMSBrgtnsReset 4;
BA_ "UserSigValidity" SG_ 276 USM_CMSBrgtnsReset 3;
BA_ "Version" SG_ 276 USM_CMSBrgtnsReset "20.06.01";
BA_ "Description" SG_ 276 USM_TurnDistLnDispSetReq "USM Request for CMS Distance Lane Display";
BA_ "GenSigSendType" SG_ 276 USM_TurnDistLnDispSetReq 4;
BA_ "UserSigValidity" SG_ 276 USM_TurnDistLnDispSetReq 0;
BA_ "Version" SG_ 276 USM_TurnDistLnDispSetReq "19.12.00";
BA_ "Description" SG_ 276 PCA_FrSd_NValueSet "USM Request for PCA Front/Side";
BA_ "GenSigSendType" SG_ 276 PCA_FrSd_NValueSet 4;
BA_ "UserSigValidity" SG_ 276 PCA_FrSd_NValueSet 3;
BA_ "Version" SG_ 276 PCA_FrSd_NValueSet "19.12.00";
BA_ "Description" SG_ 276 CF_AVN_1stRrStRmndNValueSet "This signal is for seting the ROA function when IBU control ROA Function.";
BA_ "GenSigSendType" SG_ 276 CF_AVN_1stRrStRmndNValueSet 4;
BA_ "UserSigValidity" SG_ 276 CF_AVN_1stRrStRmndNValueSet 3;
BA_ "Version" SG_ 276 CF_AVN_1stRrStRmndNValueSet "20.03.05";
BA_ "Description" SG_ 276 C_AllDrOpnNValueSet "ALL Door (PSD PTG) Open Function by FOB Unlock Long Key USM Setting Signal

0x0 : Not Display in USM

0x1 : All Door Open Function Off

0x2 : Only PSD Open By FOB Unlock Long KEY

0x3 : PSD and PTG Open by FOB Unlock Long KEY

0x4 ~ 0x6 : Reserved

0x7 :";
BA_ "GenSigSendType" SG_ 276 C_AllDrOpnNValueSet 4;
BA_ "UserSigValidity" SG_ 276 C_AllDrOpnNValueSet 3;
BA_ "Version" SG_ 276 C_AllDrOpnNValueSet "19.12.07";
BA_ "Description" SG_ 276 USM_RpmECOSet "Relation To cluster Gauge Display";
BA_ "GenSigSendType" SG_ 276 USM_RpmECOSet 4;
BA_ "UserSigValidity" SG_ 276 USM_RpmECOSet 3;
BA_ "Version" SG_ 276 USM_RpmECOSet "20.06.01";
BA_ "Description" SG_ 276 VESS_ChgGuideMdLvl "Charging Guide Volume Level function USM signal";
BA_ "GenSigSendType" SG_ 276 VESS_ChgGuideMdLvl 4;
BA_ "UserSigValidity" SG_ 276 VESS_ChgGuideMdLvl 3;
BA_ "Version" SG_ 276 VESS_ChgGuideMdLvl "20.05.01";
BA_ "Description" SG_ 276 Usm_RpmSPORTSet "Relation to cluster RPM Gauge Display";
BA_ "GenSigSendType" SG_ 276 Usm_RpmSPORTSet 4;
BA_ "UserSigValidity" SG_ 276 Usm_RpmSPORTSet 3;
BA_ "Version" SG_ 276 Usm_RpmSPORTSet "20.02.04";
BA_ "Description" SG_ 276 Usm_RpmSPORTPLUSSet "RElation to Cluster RPM Gauge Display";
BA_ "GenSigSendType" SG_ 276 Usm_RpmSPORTPLUSSet 4;
BA_ "UserSigValidity" SG_ 276 Usm_RpmSPORTPLUSSet 3;
BA_ "Version" SG_ 276 Usm_RpmSPORTPLUSSet "20.02.04";
BA_ "Description" SG_ 276 Usm_RpmMUDSet "Related to Cluster Gauge";
BA_ "GenSigSendType" SG_ 276 Usm_RpmMUDSet 4;
BA_ "UserSigValidity" SG_ 276 Usm_RpmMUDSet 3;
BA_ "Version" SG_ 276 Usm_RpmMUDSet "20.02.04";
BA_ "Description" SG_ 276 Usm_RpmSANDSet "Related to Cluster Gauge";
BA_ "GenSigSendType" SG_ 276 Usm_RpmSANDSet 4;
BA_ "UserSigValidity" SG_ 276 Usm_RpmSANDSet 3;
BA_ "Version" SG_ 276 Usm_RpmSANDSet "20.02.04";
BA_ "Description" SG_ 276 HU_CustomNewMenuSet "Custom Mode User Setting Signal";
BA_ "GenSigSendType" SG_ 276 HU_CustomNewMenuSet 4;
BA_ "UserSigValidity" SG_ 276 HU_CustomNewMenuSet 3;
BA_ "Version" SG_ 276 HU_CustomNewMenuSet "20.09.00";
BA_ "Description" SG_ 276 CF_AVN_PCA_RrEquipNvalueSet "Headunit Setting signal for Rear Safety of USM";
BA_ "GenSigSendType" SG_ 276 CF_AVN_PCA_RrEquipNvalueSet 4;
BA_ "UserSigValidity" SG_ 276 CF_AVN_PCA_RrEquipNvalueSet 3;
BA_ "Version" SG_ 276 CF_AVN_PCA_RrEquipNvalueSet "20.06.04";
BA_ "GenSigSendType" SG_ 276 CF_AVN_HtBlcRLNValueSet 4;
BA_ "UserSigValidity" SG_ 276 CF_AVN_HtBlcRLNValueSet 3;
BA_ "Version" SG_ 276 CF_AVN_HtBlcRLNValueSet "20.06.03";
BA_ "Description" SG_ 276 CF_AVN_BRAKE_PedalfeelNValueSet2 "USM request for Brake Mode (New spec)";
BA_ "GenSigSendType" SG_ 276 CF_AVN_BRAKE_PedalfeelNValueSet2 4;
BA_ "UserSigValidity" SG_ 276 CF_AVN_BRAKE_PedalfeelNValueSet2 3;
BA_ "Version" SG_ 276 CF_AVN_BRAKE_PedalfeelNValueSet2 "20.04.06";
BA_ "Description" SG_ 276 CF_AVN_ISLA_AutoNModSet "USM Set Signal for Activing N Mode Setting when Vehicle enter into Winding Road";
BA_ "GenSigSendType" SG_ 276 CF_AVN_ISLA_AutoNModSet 4;
BA_ "UserSigValidity" SG_ 276 CF_AVN_ISLA_AutoNModSet 3;
BA_ "Version" SG_ 276 CF_AVN_ISLA_AutoNModSet "20.06.00";
BA_ "GenSigSendType" SG_ 276 CF_AVN_HtBlcRRNValueSet 4;
BA_ "UserSigValidity" SG_ 276 CF_AVN_HtBlcRRNValueSet 3;
BA_ "Version" SG_ 276 CF_AVN_HtBlcRRNValueSet "20.06.03";
BA_ "Description" SG_ 276 LapTimer_AutoMeasure_Setting "Setting value for auto-measurement of Laptimer";
BA_ "GenSigSendType" SG_ 276 LapTimer_AutoMeasure_Setting 4;
BA_ "GenSigStartValue" SG_ 276 LapTimer_AutoMeasure_Setting 3;
BA_ "UserSigValidity" SG_ 276 LapTimer_AutoMeasure_Setting 3;
BA_ "Version" SG_ 276 LapTimer_AutoMeasure_Setting "20.07.11";
BA_ "Description" SG_ 276 LapTimer_TimeGap_Setting "setting value for laptimer time gap displaying";
BA_ "GenSigSendType" SG_ 276 LapTimer_TimeGap_Setting 4;
BA_ "GenSigStartValue" SG_ 276 LapTimer_TimeGap_Setting 3;
BA_ "UserSigValidity" SG_ 276 LapTimer_TimeGap_Setting 3;
BA_ "Version" SG_ 276 LapTimer_TimeGap_Setting "20.07.11";
BA_ "Description" SG_ 276 CF_AVN_RemoteWDWNValueSet "Remote Window On/Off Set signal of USM for Fob Key";
BA_ "GenSigSendType" SG_ 276 CF_AVN_RemoteWDWNValueSet 4;
BA_ "UserSigValidity" SG_ 276 CF_AVN_RemoteWDWNValueSet 3;
BA_ "Version" SG_ 276 CF_AVN_RemoteWDWNValueSet "20.07.14";
BA_ "Description" SG_ 276 HU_USM_AlvCnt4Val "For the first transmission request for a data element the counter shall be initialized with 0 and shall be incremented by 1 for every subsequent send request. 

When the counter reaches the maximum value(0xFF), then it shall restart with 0 for the next s";
BA_ "GenSigSendType" SG_ 276 HU_USM_AlvCnt4Val 4;
BA_ "UserSigValidity" SG_ 276 HU_USM_AlvCnt4Val 3;
BA_ "Version" SG_ 276 HU_USM_AlvCnt4Val "22.10.20";
BA_ "Description" SG_ 276 USM_TowWeight_Set "Trailer Mode Setting USM: Tow Weight set for User

-User can select the tow weight value for get the exact DTE value";
BA_ "GenSigSendType" SG_ 276 USM_TowWeight_Set 4;
BA_ "UserSigValidity" SG_ 276 USM_TowWeight_Set 7;
BA_ "Version" SG_ 276 USM_TowWeight_Set "20.10.02";
BA_ "Description" SG_ 276 CF_AVN_PABArbgNValueSet "USM PAB On/Off Set Signal";
BA_ "GenSigSendType" SG_ 276 CF_AVN_PABArbgNValueSet 4;
BA_ "UserSigValidity" SG_ 276 CF_AVN_PABArbgNValueSet 3;
BA_ "Version" SG_ 276 CF_AVN_PABArbgNValueSet "20.08.07";
BA_ "Description" SG_ 276 CF_AVN_SportHUD2 "Related to HUD Sports mode of custom mode2";
BA_ "GenSigSendType" SG_ 276 CF_AVN_SportHUD2 4;
BA_ "UserSigValidity" SG_ 276 CF_AVN_SportHUD2 3;
BA_ "Version" SG_ 276 CF_AVN_SportHUD2 "20.09.00";
BA_ "Description" SG_ 276 C_SLB_SmartCtrl_Set_Nvalue "USM time setting for Smart Posture Care 2.0  Off or 30min or 60min";
BA_ "GenSigSendType" SG_ 276 C_SLB_SmartCtrl_Set_Nvalue 4;
BA_ "UserSigValidity" SG_ 276 C_SLB_SmartCtrl_Set_Nvalue 3;
BA_ "Version" SG_ 276 C_SLB_SmartCtrl_Set_Nvalue "20.09.01";
BA_ "Description" SG_ 276 USM_RpmComfortRearSet "RPM Display Setting When Comfort(Rear) mode Set";
BA_ "GenSigSendType" SG_ 276 USM_RpmComfortRearSet 4;
BA_ "UserSigValidity" SG_ 276 USM_RpmComfortRearSet 3;
BA_ "Version" SG_ 276 USM_RpmComfortRearSet "20.10.02";
BA_ "Description" SG_ 276 Usm_RpmMyDriveModeSet "Cluster MY Drive Mode RPM Set Signal";
BA_ "GenSigSendType" SG_ 276 Usm_RpmMyDriveModeSet 4;
BA_ "UserSigValidity" SG_ 276 Usm_RpmMyDriveModeSet 3;
BA_ "Version" SG_ 276 Usm_RpmMyDriveModeSet "20.11.00";
BA_ "Description" SG_ 276 LapTimer_MeasuringStatus_HU "Lap Timer measuring status shared with Cluster.";
BA_ "GenSigSendType" SG_ 276 LapTimer_MeasuringStatus_HU 4;
BA_ "UserSigValidity" SG_ 276 LapTimer_MeasuringStatus_HU 3;
BA_ "Version" SG_ 276 LapTimer_MeasuringStatus_HU "22.12.04";
BA_ "Description" SG_ 276 CF_AVN_ADrLNValueSet_2 "USM Reqeust for Auto Door Lock";
BA_ "GenSigSendType" SG_ 276 CF_AVN_ADrLNValueSet_2 4;
BA_ "UserSigValidity" SG_ 276 CF_AVN_ADrLNValueSet_2 3;
BA_ "Version" SG_ 276 CF_AVN_ADrLNValueSet_2 "21.01.06";
BA_ "Description" SG_ 276 USM_PwrDrBuzzerNValueSet "USM Request for Power Door Buzzer";
BA_ "GenSigSendType" SG_ 276 USM_PwrDrBuzzerNValueSet 4;
BA_ "UserSigValidity" SG_ 276 USM_PwrDrBuzzerNValueSet 3;
BA_ "Version" SG_ 276 USM_PwrDrBuzzerNValueSet "21.01.06";
BA_ "Description" SG_ 276 CF_AVN_FCA_FrOnOffEquipNvalueSet "USM Set Signal for Forward Safety";
BA_ "GenSigSendType" SG_ 276 CF_AVN_FCA_FrOnOffEquipNvalueSet 4;
BA_ "UserSigValidity" SG_ 276 CF_AVN_FCA_FrOnOffEquipNvalueSet 3;
BA_ "Version" SG_ 276 CF_AVN_FCA_FrOnOffEquipNvalueSet "20.12.00";
BA_ "Description" SG_ 276 CF_AVN_FCA_WarnTimeNvalueSet "USM Set signal for Forward Warntime";
BA_ "GenSigSendType" SG_ 276 CF_AVN_FCA_WarnTimeNvalueSet 4;
BA_ "UserSigValidity" SG_ 276 CF_AVN_FCA_WarnTimeNvalueSet 3;
BA_ "Version" SG_ 276 CF_AVN_FCA_WarnTimeNvalueSet "20.12.00";
BA_ "Description" SG_ 276 CF_AVN_FCA_JC_OnOffEquipNvalueSe "USM Set signal for Forward Corss-traffic";
BA_ "GenSigSendType" SG_ 276 CF_AVN_FCA_JC_OnOffEquipNvalueSe 4;
BA_ "UserSigValidity" SG_ 276 CF_AVN_FCA_JC_OnOffEquipNvalueSe 3;
BA_ "Version" SG_ 276 CF_AVN_FCA_JC_OnOffEquipNvalueSe "20.12.00";
BA_ "SystemSignalLongSymbol" SG_ 276 CF_AVN_FCA_JC_OnOffEquipNvalueSe "CF_AVN_FCA_JC_OnOffEquipNvalueSet";
BA_ "Description" SG_ 276 CF_AVN_FCA_FrSdOnOffEquipNvalueS "USM Set signal for Forward/Side Safety";
BA_ "GenSigSendType" SG_ 276 CF_AVN_FCA_FrSdOnOffEquipNvalueS 4;
BA_ "UserSigValidity" SG_ 276 CF_AVN_FCA_FrSdOnOffEquipNvalueS 3;
BA_ "Version" SG_ 276 CF_AVN_FCA_FrSdOnOffEquipNvalueS "20.12.00";
BA_ "SystemSignalLongSymbol" SG_ 276 CF_AVN_FCA_FrSdOnOffEquipNvalueS "CF_AVN_FCA_FrSdOnOffEquipNvalueSet";
BA_ "Description" SG_ 276 CF_AVN_LKA_OnOffEquip2NvalueSet "USM Set Signal for Lane safety";
BA_ "GenSigSendType" SG_ 276 CF_AVN_LKA_OnOffEquip2NvalueSet 4;
BA_ "UserSigValidity" SG_ 276 CF_AVN_LKA_OnOffEquip2NvalueSet 3;
BA_ "Version" SG_ 276 CF_AVN_LKA_OnOffEquip2NvalueSet "20.12.00";
BA_ "Description" SG_ 276 CF_AVN_BCA_OnOffEquip2NvalueSet "USM Set signal for Side/Rear Safety";
BA_ "GenSigSendType" SG_ 276 CF_AVN_BCA_OnOffEquip2NvalueSet 4;
BA_ "UserSigValidity" SG_ 276 CF_AVN_BCA_OnOffEquip2NvalueSet 3;
BA_ "Version" SG_ 276 CF_AVN_BCA_OnOffEquip2NvalueSet "20.12.00";
BA_ "Description" SG_ 276 CF_AVN_BVM_OnOffEquipNvalueSet "USM Set signal for Blind Spot View";
BA_ "GenSigSendType" SG_ 276 CF_AVN_BVM_OnOffEquipNvalueSet 4;
BA_ "UserSigValidity" SG_ 276 CF_AVN_BVM_OnOffEquipNvalueSet 3;
BA_ "Version" SG_ 276 CF_AVN_BVM_OnOffEquipNvalueSet "20.12.00";
BA_ "Description" SG_ 276 CF_AVN_SEA_OnOffEquip3NvalueSet "Usm Set signal for safety exit assist";
BA_ "GenSigSendType" SG_ 276 CF_AVN_SEA_OnOffEquip3NvalueSet 4;
BA_ "UserSigValidity" SG_ 276 CF_AVN_SEA_OnOffEquip3NvalueSet 3;
BA_ "Version" SG_ 276 CF_AVN_SEA_OnOffEquip3NvalueSet "20.12.00";
BA_ "Description" SG_ 276 CF_AVN_BodySpprtSet_AST "Ergo-Motion Seat Smart Posture Assist";
BA_ "GenSigSendType" SG_ 276 CF_AVN_BodySpprtSet_AST 4;
BA_ "GenSigStartValue" SG_ 276 CF_AVN_BodySpprtSet_AST 3;
BA_ "UserSigValidity" SG_ 276 CF_AVN_BodySpprtSet_AST 3;
BA_ "Version" SG_ 276 CF_AVN_BodySpprtSet_AST "20.10.02";
BA_ "Description" SG_ 276 CF_AVN_SEW_OnOffEquip3NvalueSet "Usm Set signal for Safety exit warning";
BA_ "GenSigSendType" SG_ 276 CF_AVN_SEW_OnOffEquip3NvalueSet 4;
BA_ "UserSigValidity" SG_ 276 CF_AVN_SEW_OnOffEquip3NvalueSet 3;
BA_ "Version" SG_ 276 CF_AVN_SEW_OnOffEquip3NvalueSet "20.12.00";
BA_ "Description" SG_ 276 CF_AVN_HudImsAutoSave "USM request for auto save HUD setting with IMS";
BA_ "GenSigSendType" SG_ 276 CF_AVN_HudImsAutoSave 4;
BA_ "UserSigValidity" SG_ 276 CF_AVN_HudImsAutoSave 3;
BA_ "Version" SG_ 276 CF_AVN_HudImsAutoSave "20.12.05";
BA_ "Description" SG_ 276 CF_AVN_AirSptTimeNValueSet_AST "Ergo-Motion Seat Comfortable Stretch Operational Time";
BA_ "GenSigSendType" SG_ 276 CF_AVN_AirSptTimeNValueSet_AST 4;
BA_ "GenSigStartValue" SG_ 276 CF_AVN_AirSptTimeNValueSet_AST 7;
BA_ "UserSigValidity" SG_ 276 CF_AVN_AirSptTimeNValueSet_AST 3;
BA_ "Version" SG_ 276 CF_AVN_AirSptTimeNValueSet_AST "20.10.02";
BA_ "Description" SG_ 276 CF_AVN_AirSptStrNValue_AST "Ergo-Motion Seat Comfortable Stretch Strong/Normal";
BA_ "GenSigSendType" SG_ 276 CF_AVN_AirSptStrNValue_AST 4;
BA_ "GenSigStartValue" SG_ 276 CF_AVN_AirSptStrNValue_AST 3;
BA_ "UserSigValidity" SG_ 276 CF_AVN_AirSptStrNValue_AST 3;
BA_ "Version" SG_ 276 CF_AVN_AirSptStrNValue_AST "20.10.02";
BA_ "Description" SG_ 276 CF_AVN_SeatDrvModNvalueSet_AST "Ergo-Motion Seat Smart Support";
BA_ "GenSigSendType" SG_ 276 CF_AVN_SeatDrvModNvalueSet_AST 4;
BA_ "GenSigStartValue" SG_ 276 CF_AVN_SeatDrvModNvalueSet_AST 3;
BA_ "UserSigValidity" SG_ 276 CF_AVN_SeatDrvModNvalueSet_AST 3;
BA_ "Version" SG_ 276 CF_AVN_SeatDrvModNvalueSet_AST "20.12.00";
BA_ "Description" SG_ 276 CF_AVN_TPMS_TireReplaceNValueSet "USM Set Signal for Standard Tire to Wnter Tire";
BA_ "GenSigSendType" SG_ 276 CF_AVN_TPMS_TireReplaceNValueSet 4;
BA_ "UserSigValidity" SG_ 276 CF_AVN_TPMS_TireReplaceNValueSet 3;
BA_ "Version" SG_ 276 CF_AVN_TPMS_TireReplaceNValueSet "20.12.04";
BA_ "Description" SG_ 276 CF_AVN_TowModeSet "USM Set signal For TowMode";
BA_ "GenSigSendType" SG_ 276 CF_AVN_TowModeSet 4;
BA_ "UserSigValidity" SG_ 276 CF_AVN_TowModeSet 3;
BA_ "Version" SG_ 276 CF_AVN_TowModeSet "20.12.04";
BA_ "Description" SG_ 276 USM_PwrDrCloseByBraekNValueSet "USM Reqeust for Power Door Close by Brake";
BA_ "GenSigSendType" SG_ 276 USM_PwrDrCloseByBraekNValueSet 4;
BA_ "UserSigValidity" SG_ 276 USM_PwrDrCloseByBraekNValueSet 3;
BA_ "Version" SG_ 276 USM_PwrDrCloseByBraekNValueSet "21.01.06";
BA_ "Description" SG_ 276 AVN_BPCM_RL1_USMLevelReq "Reauest signal for RL's 1st BPCM area setting (level)";
BA_ "GenSigSendType" SG_ 276 AVN_BPCM_RL1_USMLevelReq 4;
BA_ "UserSigValidity" SG_ 276 AVN_BPCM_RL1_USMLevelReq 3;
BA_ "Version" SG_ 276 AVN_BPCM_RL1_USMLevelReq "23.08.01";
BA_ "Description" SG_ 276 CF_AVN_ISLANAOffstNvalueSet "Control ISLA offset on USM Fucntion (North America)";
BA_ "GenSigSendType" SG_ 276 CF_AVN_ISLANAOffstNvalueSet 4;
BA_ "UserSigValidity" SG_ 276 CF_AVN_ISLANAOffstNvalueSet 3;
BA_ "Version" SG_ 276 CF_AVN_ISLANAOffstNvalueSet "21.03.10";
BA_ "Description" SG_ 276 CF_Gway_WPC2_NValueSet "USM Set signal for 2nd WPC setting";
BA_ "GenSigSendType" SG_ 276 CF_Gway_WPC2_NValueSet 4;
BA_ "UserSigValidity" SG_ 276 CF_Gway_WPC2_NValueSet 3;
BA_ "Version" SG_ 276 CF_Gway_WPC2_NValueSet "22.02.05";
BA_ "Description" SG_ 276 USM_DrvGhostDoorReq "USM Request for Driver Door Ghost Door Closing On/Off";
BA_ "GenSigSendType" SG_ 276 USM_DrvGhostDoorReq 4;
BA_ "UserSigValidity" SG_ 276 USM_DrvGhostDoorReq 3;
BA_ "Version" SG_ 276 USM_DrvGhostDoorReq "21.03.11";
BA_ "Description" SG_ 276 USM_AstGhostDoorReq "USM Request for Assistant Ghost Door Closing On/Off";
BA_ "GenSigSendType" SG_ 276 USM_AstGhostDoorReq 4;
BA_ "UserSigValidity" SG_ 276 USM_AstGhostDoorReq 3;
BA_ "Version" SG_ 276 USM_AstGhostDoorReq "21.03.11";
BA_ "Description" SG_ 276 USM_RLGhostDoorReq "USM Request for Rear Left Ghost Door Closing On/Off";
BA_ "GenSigSendType" SG_ 276 USM_RLGhostDoorReq 4;
BA_ "UserSigValidity" SG_ 276 USM_RLGhostDoorReq 3;
BA_ "Version" SG_ 276 USM_RLGhostDoorReq "21.03.11";
BA_ "Description" SG_ 276 USM_RRGhostDoorReq "USM Request for Rear Right Ghost Door Closing On/Off";
BA_ "GenSigSendType" SG_ 276 USM_RRGhostDoorReq 4;
BA_ "UserSigValidity" SG_ 276 USM_RRGhostDoorReq 3;
BA_ "Version" SG_ 276 USM_RRGhostDoorReq "21.03.11";
BA_ "Description" SG_ 276 AVN_BPCM_RL2_USMLevelReq "Reauest signal for RL's 2nd BPCM area setting (level)";
BA_ "GenSigSendType" SG_ 276 AVN_BPCM_RL2_USMLevelReq 4;
BA_ "UserSigValidity" SG_ 276 AVN_BPCM_RL2_USMLevelReq 3;
BA_ "Version" SG_ 276 AVN_BPCM_RL2_USMLevelReq "23.08.01";
BA_ "Description" SG_ 276 AVN_BPCM_RL3_USMLevelReq "Reauest signal for RL's 3rd BPCM area setting (level)";
BA_ "GenSigSendType" SG_ 276 AVN_BPCM_RL3_USMLevelReq 4;
BA_ "UserSigValidity" SG_ 276 AVN_BPCM_RL3_USMLevelReq 3;
BA_ "Version" SG_ 276 AVN_BPCM_RL3_USMLevelReq "23.08.01";
BA_ "Description" SG_ 276 AVN_BPCM_RL4_USMLevelReq "Reauest signal for RL's 4st BPCM area setting (level)";
BA_ "GenSigSendType" SG_ 276 AVN_BPCM_RL4_USMLevelReq 4;
BA_ "UserSigValidity" SG_ 276 AVN_BPCM_RL4_USMLevelReq 3;
BA_ "Version" SG_ 276 AVN_BPCM_RL4_USMLevelReq "23.08.01";
BA_ "Description" SG_ 276 AVN_BPCM_RR1_USMLevelReq "Reauest signal for RR's 1st BPCM area setting (level)";
BA_ "GenSigSendType" SG_ 276 AVN_BPCM_RR1_USMLevelReq 4;
BA_ "UserSigValidity" SG_ 276 AVN_BPCM_RR1_USMLevelReq 3;
BA_ "Version" SG_ 276 AVN_BPCM_RR1_USMLevelReq "23.08.01";
BA_ "Description" SG_ 276 AVN_BPCM_RR2_USMLevelReq "Reauest signal for RR's 2nd BPCM area setting (level)";
BA_ "GenSigSendType" SG_ 276 AVN_BPCM_RR2_USMLevelReq 4;
BA_ "UserSigValidity" SG_ 276 AVN_BPCM_RR2_USMLevelReq 3;
BA_ "Version" SG_ 276 AVN_BPCM_RR2_USMLevelReq "23.08.01";
BA_ "Description" SG_ 276 AVN_BPCM_RR3_USMLevelReq "Reauest signal for RR's 3rd BPCM area setting (level)";
BA_ "GenSigSendType" SG_ 276 AVN_BPCM_RR3_USMLevelReq 4;
BA_ "UserSigValidity" SG_ 276 AVN_BPCM_RR3_USMLevelReq 3;
BA_ "Version" SG_ 276 AVN_BPCM_RR3_USMLevelReq "23.08.01";
BA_ "Description" SG_ 276 AVN_BPCM_RR4_USMLevelReq "Reauest signal for RR's 4st BPCM area setting (level)";
BA_ "GenSigSendType" SG_ 276 AVN_BPCM_RR4_USMLevelReq 4;
BA_ "UserSigValidity" SG_ 276 AVN_BPCM_RR4_USMLevelReq 3;
BA_ "Version" SG_ 276 AVN_BPCM_RR4_USMLevelReq "23.08.01";
BA_ "Description" SG_ 276 USM_SmartRegen_Map_Set "Smart Regeneration 2.0 Map information USM User set signal";
BA_ "GenSigSendType" SG_ 276 USM_SmartRegen_Map_Set 4;
BA_ "UserSigValidity" SG_ 276 USM_SmartRegen_Map_Set 3;
BA_ "Version" SG_ 276 USM_SmartRegen_Map_Set "19.11.05";
BA_ "Description" SG_ 276 USM_SmartRegen_Sens_Set "Smart Regeneration User Personality of Reduction Set Signal";
BA_ "GenSigSendType" SG_ 276 USM_SmartRegen_Sens_Set 4;
BA_ "UserSigValidity" SG_ 276 USM_SmartRegen_Sens_Set 3;
BA_ "Version" SG_ 276 USM_SmartRegen_Sens_Set "19.11.05";
BA_ "Description" SG_ 276 AVN_SeatPosMemory_Btn "Seat position save signal";
BA_ "GenSigSendType" SG_ 276 AVN_SeatPosMemory_Btn 4;
BA_ "UserSigValidity" SG_ 276 AVN_SeatPosMemory_Btn 3;
BA_ "Version" SG_ 276 AVN_SeatPosMemory_Btn "19.11.11";
BA_ "Description" SG_ 276 AVN_SeatPosPlyBck_Btn "Seat position move signal";
BA_ "GenSigSendType" SG_ 276 AVN_SeatPosPlyBck_Btn 4;
BA_ "UserSigValidity" SG_ 276 AVN_SeatPosPlyBck_Btn 3;
BA_ "Version" SG_ 276 AVN_SeatPosPlyBck_Btn "19.11.11";
BA_ "Description" SG_ 276 USM_RhstaLvlEnaSetReq "USM Request for CMS Brightness with Rheostat";
BA_ "GenSigSendType" SG_ 276 USM_RhstaLvlEnaSetReq 4;
BA_ "UserSigValidity" SG_ 276 USM_RhstaLvlEnaSetReq 0;
BA_ "Version" SG_ 276 USM_RhstaLvlEnaSetReq "19.12.00";
BA_ "Description" SG_ 276 USM_CMSDayBrgtnsLvlLHSetReq "USM Request for Day Brightness Level of CMS LH";
BA_ "GenSigSendType" SG_ 276 USM_CMSDayBrgtnsLvlLHSetReq 4;
BA_ "GenSigStartValue" SG_ 276 USM_CMSDayBrgtnsLvlLHSetReq 15;
BA_ "UserSigValidity" SG_ 276 USM_CMSDayBrgtnsLvlLHSetReq 0;
BA_ "Version" SG_ 276 USM_CMSDayBrgtnsLvlLHSetReq "19.12.00";
BA_ "Description" SG_ 276 USM_CMSNgtBrgtnsLvlLHSetReq "USM Request for Night Brightness Level of CMS LH";
BA_ "GenSigSendType" SG_ 276 USM_CMSNgtBrgtnsLvlLHSetReq 4;
BA_ "GenSigStartValue" SG_ 276 USM_CMSNgtBrgtnsLvlLHSetReq 15;
BA_ "UserSigValidity" SG_ 276 USM_CMSNgtBrgtnsLvlLHSetReq 0;
BA_ "Version" SG_ 276 USM_CMSNgtBrgtnsLvlLHSetReq "19.12.00";
BA_ "Description" SG_ 276 USM_CMSDayBrgtnsLvlRHSetReq "USM Request for Day Brightness Level of CMS RH";
BA_ "GenSigSendType" SG_ 276 USM_CMSDayBrgtnsLvlRHSetReq 4;
BA_ "GenSigStartValue" SG_ 276 USM_CMSDayBrgtnsLvlRHSetReq 15;
BA_ "UserSigValidity" SG_ 276 USM_CMSDayBrgtnsLvlRHSetReq 0;
BA_ "Version" SG_ 276 USM_CMSDayBrgtnsLvlRHSetReq "19.12.00";
BA_REL_ "GenSigTimeoutTime" BU_SG_REL_ GW_PSU_DRV_FD SG_ 274 HU_USM_Crc2Val 0;
BA_REL_ "GenSigTimeoutTime" BU_SG_REL_ ARS_FD SG_ 274 CF_AVN_CluUSMReset 0;
BA_REL_ "GenSigTimeoutTime" BU_SG_REL_ ATS_FD SG_ 274 CF_AVN_CluUSMReset 0;
BA_REL_ "GenSigTimeoutTime" BU_SG_REL_ BLTN_CAM_FD SG_ 274 CF_AVN_CluUSMReset 0;
BA_REL_ "GenSigTimeoutTime" BU_SG_REL_ GW_PSU_3RD_FD SG_ 274 CF_AVN_CluUSMReset 0;
BA_REL_ "GenSigTimeoutTime" BU_SG_REL_ GW_PSU_AST_FD SG_ 274 CF_AVN_CluUSMReset 0;
BA_REL_ "GenSigTimeoutTime" BU_SG_REL_ GW_PSU_DRV_FD SG_ 274 CF_AVN_CluUSMReset 0;
BA_REL_ "GenSigTimeoutTime" BU_SG_REL_ GW_PSU_RL_FD SG_ 274 CF_AVN_CluUSMReset 0;
BA_REL_ "GenSigTimeoutTime" BU_SG_REL_ GW_PSU_RR_FD SG_ 274 CF_AVN_CluUSMReset 0;
BA_REL_ "GenSigTimeoutTime" BU_SG_REL_ GW_SAU_DRV_FD SG_ 274 CF_AVN_CluUSMReset 0;
BA_REL_ "GenSigTimeoutTime" BU_SG_REL_ RCM_FD SG_ 274 CF_AVN_CluUSMReset 0;
BA_REL_ "GenSigTimeoutTime" BU_SG_REL_ RWPC_FD SG_ 274 CF_AVN_CluUSMReset 0;
BA_REL_ "GenSigTimeoutTime" BU_SG_REL_ SGU_FD SG_ 274 CF_AVN_CluUSMReset 0;
BA_REL_ "GenSigTimeoutTime" BU_SG_REL_ SHVU_FRNT_FD SG_ 274 CF_AVN_CluUSMReset 0;
BA_REL_ "GenSigTimeoutTime" BU_SG_REL_ SHVU_REAR_FD SG_ 274 CF_AVN_CluUSMReset 0;
BA_REL_ "GenSigTimeoutTime" BU_SG_REL_ SHVU_RL_FD SG_ 274 CF_AVN_CluUSMReset 0;
BA_REL_ "GenSigTimeoutTime" BU_SG_REL_ SHVU_RR_FD SG_ 274 CF_AVN_CluUSMReset 0;
BA_REL_ "GenSigTimeoutTime" BU_SG_REL_ WPC2_FD SG_ 274 CF_AVN_CluUSMReset 0;
BA_REL_ "GenSigTimeoutTime" BU_SG_REL_ WPC_FD SG_ 274 CF_AVN_CluUSMReset 0;
BA_REL_ "GenSigTimeoutTime" BU_SG_REL_ GW_PSU_DRV_FD SG_ 274 CF_AVN_BodySpprtSet 0;
BA_REL_ "GenSigTimeoutTime" BU_SG_REL_ GW_SAU_DRV_FD SG_ 274 CF_AVN_BodySpprtSet 0;
BA_REL_ "GenSigTimeoutTime" BU_SG_REL_ GW_PSU_DRV_FD SG_ 274 HU_USM_AlvCnt2Val 0;
BA_REL_ "GenSigTimeoutTime" BU_SG_REL_ GW_SAU_DRV_FD SG_ 274 CF_AVN_AirSptTimeNValueSet 0;
BA_REL_ "GenSigTimeoutTime" BU_SG_REL_ GW_SAU_DRV_FD SG_ 274 CF_AVN_AirSptStrNValue 0;
BA_REL_ "GenSigTimeoutTime" BU_SG_REL_ GW_PSU_DRV_FD SG_ 274 CF_AVN_SeatDrvModNValueSet 0;
BA_REL_ "GenSigTimeoutTime" BU_SG_REL_ GW_SAU_DRV_FD SG_ 274 CF_AVN_SeatDrvModNValueSet 0;
BA_REL_ "GenSigTimeoutTime" BU_SG_REL_ ATS_FD SG_ 274 C_MoodLpFadeNValue 0;
BA_REL_ "GenSigTimeoutTime" BU_SG_REL_ WPC_FD SG_ 273 CF_Gway_WPCNValueSet 0;
BA_REL_ "GenSigTimeoutTime" BU_SG_REL_ WPC2_FD SG_ 273 CF_Gway_WPCNValueSet 0;
BA_REL_ "GenSigTimeoutTime" BU_SG_REL_ RWPC_FD SG_ 273 CF_Gway_RWPCNValueSet 0;
BA_REL_ "GenSigTimeoutTime" BU_SG_REL_ ARS_FD SG_ 745 PDC_FD_Crc15Val 1500;
BA_REL_ "GenSigTimeoutTime" BU_SG_REL_ ATS_FD SG_ 745 PDC_FD_Crc15Val 1500;
BA_REL_ "GenSigTimeoutTime" BU_SG_REL_ BLTN_CAM_FD SG_ 745 PDC_FD_Crc15Val 1500;
BA_REL_ "GenSigTimeoutTime" BU_SG_REL_ FCS_FD SG_ 745 PDC_FD_Crc15Val 1500;
BA_REL_ "GenSigTimeoutTime" BU_SG_REL_ GW_PSU_3RD_FD SG_ 745 PDC_FD_Crc15Val 1500;
BA_REL_ "GenSigTimeoutTime" BU_SG_REL_ GW_PSU_AST_FD SG_ 745 PDC_FD_Crc15Val 1500;
BA_REL_ "GenSigTimeoutTime" BU_SG_REL_ GW_PSU_DRV_FD SG_ 745 PDC_FD_Crc15Val 1500;
BA_REL_ "GenSigTimeoutTime" BU_SG_REL_ GW_PSU_RL_FD SG_ 745 PDC_FD_Crc15Val 1500;
BA_REL_ "GenSigTimeoutTime" BU_SG_REL_ GW_PSU_RR_FD SG_ 745 PDC_FD_Crc15Val 1500;
BA_REL_ "GenSigTimeoutTime" BU_SG_REL_ GW_SAU_DRV_FD SG_ 745 PDC_FD_Crc15Val 1500;
BA_REL_ "GenSigTimeoutTime" BU_SG_REL_ OHCL_FD SG_ 745 PDC_FD_Crc15Val 1500;
BA_REL_ "GenSigTimeoutTime" BU_SG_REL_ PSB_FD SG_ 745 PDC_FD_Crc15Val 1500;
BA_REL_ "GenSigTimeoutTime" BU_SG_REL_ RCM_FD SG_ 745 PDC_FD_Crc15Val 1500;
BA_REL_ "GenSigTimeoutTime" BU_SG_REL_ RCS_FD SG_ 745 PDC_FD_Crc15Val 1500;
BA_REL_ "GenSigTimeoutTime" BU_SG_REL_ RWPC_FD SG_ 745 PDC_FD_Crc15Val 1500;
BA_REL_ "GenSigTimeoutTime" BU_SG_REL_ SCM_FD SG_ 745 PDC_FD_Crc15Val 1500;
BA_REL_ "GenSigTimeoutTime" BU_SG_REL_ SGU_FD SG_ 745 PDC_FD_Crc15Val 1500;
BA_REL_ "GenSigTimeoutTime" BU_SG_REL_ SHVU_3RD_FD SG_ 745 PDC_FD_Crc15Val 1500;
BA_REL_ "GenSigTimeoutTime" BU_SG_REL_ SHVU_FRNT_FD SG_ 745 PDC_FD_Crc15Val 1500;
BA_REL_ "GenSigTimeoutTime" BU_SG_REL_ SHVU_REAR_FD SG_ 745 PDC_FD_Crc15Val 1500;
BA_REL_ "GenSigTimeoutTime" BU_SG_REL_ SHVU_RL_FD SG_ 745 PDC_FD_Crc15Val 1500;
BA_REL_ "GenSigTimeoutTime" BU_SG_REL_ SHVU_RR_FD SG_ 745 PDC_FD_Crc15Val 1500;
BA_REL_ "GenSigTimeoutTime" BU_SG_REL_ WPC2_FD SG_ 745 PDC_FD_Crc15Val 1500;
BA_REL_ "GenSigTimeoutTime" BU_SG_REL_ WPC_FD SG_ 745 PDC_FD_Crc15Val 1500;
BA_REL_ "GenSigTimeoutTime" BU_SG_REL_ ARS_FD SG_ 745 PDC_FD_AlvCnt15Val 1500;
BA_REL_ "GenSigTimeoutTime" BU_SG_REL_ ATS_FD SG_ 745 PDC_FD_AlvCnt15Val 1500;
BA_REL_ "GenSigTimeoutTime" BU_SG_REL_ BLTN_CAM_FD SG_ 745 PDC_FD_AlvCnt15Val 1500;
BA_REL_ "GenSigTimeoutTime" BU_SG_REL_ FCS_FD SG_ 745 PDC_FD_AlvCnt15Val 1500;
BA_REL_ "GenSigTimeoutTime" BU_SG_REL_ GW_PSU_3RD_FD SG_ 745 PDC_FD_AlvCnt15Val 1500;
BA_REL_ "GenSigTimeoutTime" BU_SG_REL_ GW_PSU_AST_FD SG_ 745 PDC_FD_AlvCnt15Val 1500;
BA_REL_ "GenSigTimeoutTime" BU_SG_REL_ GW_PSU_DRV_FD SG_ 745 PDC_FD_AlvCnt15Val 1500;
BA_REL_ "GenSigTimeoutTime" BU_SG_REL_ GW_PSU_RL_FD SG_ 745 PDC_FD_AlvCnt15Val 1500;
BA_REL_ "GenSigTimeoutTime" BU_SG_REL_ GW_PSU_RR_FD SG_ 745 PDC_FD_AlvCnt15Val 1500;
BA_REL_ "GenSigTimeoutTime" BU_SG_REL_ GW_SAU_DRV_FD SG_ 745 PDC_FD_AlvCnt15Val 1500;
BA_REL_ "GenSigTimeoutTime" BU_SG_REL_ OHCL_FD SG_ 745 PDC_FD_AlvCnt15Val 1500;
BA_REL_ "GenSigTimeoutTime" BU_SG_REL_ PSB_FD SG_ 745 PDC_FD_AlvCnt15Val 1500;
BA_REL_ "GenSigTimeoutTime" BU_SG_REL_ RCM_FD SG_ 745 PDC_FD_AlvCnt15Val 1500;
BA_REL_ "GenSigTimeoutTime" BU_SG_REL_ RCS_FD SG_ 745 PDC_FD_AlvCnt15Val 1500;
BA_REL_ "GenSigTimeoutTime" BU_SG_REL_ RWPC_FD SG_ 745 PDC_FD_AlvCnt15Val 1500;
BA_REL_ "GenSigTimeoutTime" BU_SG_REL_ SCM_FD SG_ 745 PDC_FD_AlvCnt15Val 1500;
BA_REL_ "GenSigTimeoutTime" BU_SG_REL_ SGU_FD SG_ 745 PDC_FD_AlvCnt15Val 1500;
BA_REL_ "GenSigTimeoutTime" BU_SG_REL_ SHVU_3RD_FD SG_ 745 PDC_FD_AlvCnt15Val 1500;
BA_REL_ "GenSigTimeoutTime" BU_SG_REL_ SHVU_FRNT_FD SG_ 745 PDC_FD_AlvCnt15Val 1500;
BA_REL_ "GenSigTimeoutTime" BU_SG_REL_ SHVU_REAR_FD SG_ 745 PDC_FD_AlvCnt15Val 1500;
BA_REL_ "GenSigTimeoutTime" BU_SG_REL_ SHVU_RL_FD SG_ 745 PDC_FD_AlvCnt15Val 1500;
BA_REL_ "GenSigTimeoutTime" BU_SG_REL_ SHVU_RR_FD SG_ 745 PDC_FD_AlvCnt15Val 1500;
BA_REL_ "GenSigTimeoutTime" BU_SG_REL_ WPC2_FD SG_ 745 PDC_FD_AlvCnt15Val 1500;
BA_REL_ "GenSigTimeoutTime" BU_SG_REL_ WPC_FD SG_ 745 PDC_FD_AlvCnt15Val 1500;
BA_REL_ "GenSigTimeoutTime" BU_SG_REL_ BLTN_CAM_FD SG_ 745 PDC_LDConReq 1500;
BA_REL_ "GenSigTimeoutTime" BU_SG_REL_ BLTN_CAM_FD SG_ 745 PDC_LDConReq_By_LVBat 1500;
BA_REL_ "GenSigTimeoutTime" BU_SG_REL_ BLTN_CAM_FD SG_ 745 PDC_LDConReq_By_ActiveOn 1500;
BA_REL_ "GenSigTimeoutTime" BU_SG_REL_ ARS_FD SG_ 745 PDC_ResetPreWrngForOthers 1500;
BA_REL_ "GenSigTimeoutTime" BU_SG_REL_ ATS_FD SG_ 745 PDC_ResetPreWrngForOthers 1500;
BA_REL_ "GenSigTimeoutTime" BU_SG_REL_ BLTN_CAM_FD SG_ 745 PDC_ResetPreWrngForOthers 1500;
BA_REL_ "GenSigTimeoutTime" BU_SG_REL_ FCS_FD SG_ 745 PDC_ResetPreWrngForOthers 1500;
BA_REL_ "GenSigTimeoutTime" BU_SG_REL_ GW_PSU_3RD_FD SG_ 745 PDC_ResetPreWrngForOthers 1500;
BA_REL_ "GenSigTimeoutTime" BU_SG_REL_ GW_PSU_AST_FD SG_ 745 PDC_ResetPreWrngForOthers 1500;
BA_REL_ "GenSigTimeoutTime" BU_SG_REL_ GW_PSU_DRV_FD SG_ 745 PDC_ResetPreWrngForOthers 1500;
BA_REL_ "GenSigTimeoutTime" BU_SG_REL_ GW_PSU_RL_FD SG_ 745 PDC_ResetPreWrngForOthers 1500;
BA_REL_ "GenSigTimeoutTime" BU_SG_REL_ GW_PSU_RR_FD SG_ 745 PDC_ResetPreWrngForOthers 1500;
BA_REL_ "GenSigTimeoutTime" BU_SG_REL_ GW_SAU_DRV_FD SG_ 745 PDC_ResetPreWrngForOthers 1500;
BA_REL_ "GenSigTimeoutTime" BU_SG_REL_ OHCL_FD SG_ 745 PDC_ResetPreWrngForOthers 1500;
BA_REL_ "GenSigTimeoutTime" BU_SG_REL_ PSB_FD SG_ 745 PDC_ResetPreWrngForOthers 1500;
BA_REL_ "GenSigTimeoutTime" BU_SG_REL_ RCM_FD SG_ 745 PDC_ResetPreWrngForOthers 1500;
BA_REL_ "GenSigTimeoutTime" BU_SG_REL_ RCS_FD SG_ 745 PDC_ResetPreWrngForOthers 1500;
BA_REL_ "GenSigTimeoutTime" BU_SG_REL_ RWPC_FD SG_ 745 PDC_ResetPreWrngForOthers 1500;
BA_REL_ "GenSigTimeoutTime" BU_SG_REL_ SCM_FD SG_ 745 PDC_ResetPreWrngForOthers 1500;
BA_REL_ "GenSigTimeoutTime" BU_SG_REL_ SGU_FD SG_ 745 PDC_ResetPreWrngForOthers 1500;
BA_REL_ "GenSigTimeoutTime" BU_SG_REL_ SHVU_3RD_FD SG_ 745 PDC_ResetPreWrngForOthers 1500;
BA_REL_ "GenSigTimeoutTime" BU_SG_REL_ SHVU_FRNT_FD SG_ 745 PDC_ResetPreWrngForOthers 1500;
BA_REL_ "GenSigTimeoutTime" BU_SG_REL_ SHVU_REAR_FD SG_ 745 PDC_ResetPreWrngForOthers 1500;
BA_REL_ "GenSigTimeoutTime" BU_SG_REL_ SHVU_RL_FD SG_ 745 PDC_ResetPreWrngForOthers 1500;
BA_REL_ "GenSigTimeoutTime" BU_SG_REL_ SHVU_RR_FD SG_ 745 PDC_ResetPreWrngForOthers 1500;
BA_REL_ "GenSigTimeoutTime" BU_SG_REL_ WPC2_FD SG_ 745 PDC_ResetPreWrngForOthers 1500;
BA_REL_ "GenSigTimeoutTime" BU_SG_REL_ WPC_FD SG_ 745 PDC_ResetPreWrngForOthers 1500;
BA_REL_ "GenSigTimeoutTime" BU_SG_REL_ ARS_FD SG_ 745 PDC_ResetReqForOthers 1500;
BA_REL_ "GenSigTimeoutTime" BU_SG_REL_ ATS_FD SG_ 745 PDC_ResetReqForOthers 1500;
BA_REL_ "GenSigTimeoutTime" BU_SG_REL_ BLTN_CAM_FD SG_ 745 PDC_ResetReqForOthers 1500;
BA_REL_ "GenSigTimeoutTime" BU_SG_REL_ FCS_FD SG_ 745 PDC_ResetReqForOthers 1500;
BA_REL_ "GenSigTimeoutTime" BU_SG_REL_ GW_PSU_3RD_FD SG_ 745 PDC_ResetReqForOthers 1500;
BA_REL_ "GenSigTimeoutTime" BU_SG_REL_ GW_PSU_AST_FD SG_ 745 PDC_ResetReqForOthers 1500;
BA_REL_ "GenSigTimeoutTime" BU_SG_REL_ GW_PSU_DRV_FD SG_ 745 PDC_ResetReqForOthers 1500;
BA_REL_ "GenSigTimeoutTime" BU_SG_REL_ GW_PSU_RL_FD SG_ 745 PDC_ResetReqForOthers 1500;
BA_REL_ "GenSigTimeoutTime" BU_SG_REL_ GW_PSU_RR_FD SG_ 745 PDC_ResetReqForOthers 1500;
BA_REL_ "GenSigTimeoutTime" BU_SG_REL_ GW_SAU_DRV_FD SG_ 745 PDC_ResetReqForOthers 1500;
BA_REL_ "GenSigTimeoutTime" BU_SG_REL_ OHCL_FD SG_ 745 PDC_ResetReqForOthers 1500;
BA_REL_ "GenSigTimeoutTime" BU_SG_REL_ PSB_FD SG_ 745 PDC_ResetReqForOthers 1500;
BA_REL_ "GenSigTimeoutTime" BU_SG_REL_ RCM_FD SG_ 745 PDC_ResetReqForOthers 1500;
BA_REL_ "GenSigTimeoutTime" BU_SG_REL_ RCS_FD SG_ 745 PDC_ResetReqForOthers 1500;
BA_REL_ "GenSigTimeoutTime" BU_SG_REL_ RWPC_FD SG_ 745 PDC_ResetReqForOthers 1500;
BA_REL_ "GenSigTimeoutTime" BU_SG_REL_ SCM_FD SG_ 745 PDC_ResetReqForOthers 1500;
BA_REL_ "GenSigTimeoutTime" BU_SG_REL_ SGU_FD SG_ 745 PDC_ResetReqForOthers 1500;
BA_REL_ "GenSigTimeoutTime" BU_SG_REL_ SHVU_3RD_FD SG_ 745 PDC_ResetReqForOthers 1500;
BA_REL_ "GenSigTimeoutTime" BU_SG_REL_ SHVU_FRNT_FD SG_ 745 PDC_ResetReqForOthers 1500;
BA_REL_ "GenSigTimeoutTime" BU_SG_REL_ SHVU_REAR_FD SG_ 745 PDC_ResetReqForOthers 1500;
BA_REL_ "GenSigTimeoutTime" BU_SG_REL_ SHVU_RL_FD SG_ 745 PDC_ResetReqForOthers 1500;
BA_REL_ "GenSigTimeoutTime" BU_SG_REL_ SHVU_RR_FD SG_ 745 PDC_ResetReqForOthers 1500;
BA_REL_ "GenSigTimeoutTime" BU_SG_REL_ WPC2_FD SG_ 745 PDC_ResetReqForOthers 1500;
BA_REL_ "GenSigTimeoutTime" BU_SG_REL_ WPC_FD SG_ 745 PDC_ResetReqForOthers 1500;
BA_REL_ "GenSigTimeoutTime" BU_SG_REL_ SGU_FD SG_ 278 CF_AVN_Roof_OprLvSet 0;
BA_REL_ "GenSigTimeoutTime" BU_SG_REL_ SGU_FD SG_ 278 CF_AVN_2ndLeftDoor_OptLvSet 0;
BA_REL_ "GenSigTimeoutTime" BU_SG_REL_ SGU_FD SG_ 278 CF_AVN_2ndRightDoor_OptLvSet 0;
BA_REL_ "GenSigTimeoutTime" BU_SG_REL_ SGU_FD SG_ 278 CF_AVN_3rdLeftDoor_OptLvlSet 0;
BA_REL_ "GenSigTimeoutTime" BU_SG_REL_ SGU_FD SG_ 278 CF_AVN_3rdRightDoor_OptLvlSet 0;
BA_REL_ "GenSigTimeoutTime" BU_SG_REL_ SGU_FD SG_ 278 CF_AVN_RearDoor_OptLvlSet 0;
BA_REL_ "GenSigTimeoutTime" BU_SG_REL_ SGU_FD SG_ 278 CF_AVN_RollBlindOnOffSet 0;
BA_REL_ "GenSigTimeoutTime" BU_SG_REL_ RWPC_FD SG_ 278 CF_Gway_WPCAnimationNvalueSet 0;
BA_REL_ "GenSigTimeoutTime" BU_SG_REL_ WPC_FD SG_ 278 CF_Gway_WPCAnimationNvalueSet 0;
BA_REL_ "GenSigTimeoutTime" BU_SG_REL_ WPC2_FD SG_ 278 CF_Gway_WPCAnimationNvalueSet 0;
BA_REL_ "GenSigTimeoutTime" BU_SG_REL_ GW_PSU_RL_FD SG_ 276 CF_AVN_HtBlcRLNValueSet 0;
BA_REL_ "GenSigTimeoutTime" BU_SG_REL_ GW_PSU_RR_FD SG_ 276 CF_AVN_HtBlcRLNValueSet 0;
BA_REL_ "GenSigTimeoutTime" BU_SG_REL_ SHVU_FRNT_FD SG_ 276 CF_AVN_HtBlcRLNValueSet 0;
BA_REL_ "GenSigTimeoutTime" BU_SG_REL_ SHVU_REAR_FD SG_ 276 CF_AVN_HtBlcRLNValueSet 0;
BA_REL_ "GenSigTimeoutTime" BU_SG_REL_ SHVU_RL_FD SG_ 276 CF_AVN_HtBlcRLNValueSet 0;
BA_REL_ "GenSigTimeoutTime" BU_SG_REL_ GW_PSU_RL_FD SG_ 276 CF_AVN_HtBlcRRNValueSet 0;
BA_REL_ "GenSigTimeoutTime" BU_SG_REL_ GW_PSU_RR_FD SG_ 276 CF_AVN_HtBlcRRNValueSet 0;
BA_REL_ "GenSigTimeoutTime" BU_SG_REL_ SHVU_FRNT_FD SG_ 276 CF_AVN_HtBlcRRNValueSet 0;
BA_REL_ "GenSigTimeoutTime" BU_SG_REL_ SHVU_REAR_FD SG_ 276 CF_AVN_HtBlcRRNValueSet 0;
BA_REL_ "GenSigTimeoutTime" BU_SG_REL_ SHVU_RR_FD SG_ 276 CF_AVN_HtBlcRRNValueSet 0;
BA_REL_ "GenSigTimeoutTime" BU_SG_REL_ GW_SAU_DRV_FD SG_ 276 C_SLB_SmartCtrl_Set_Nvalue 0;
BA_REL_ "GenSigTimeoutTime" BU_SG_REL_ GW_SAU_DRV_FD SG_ 276 CF_AVN_BodySpprtSet_AST 0;
BA_REL_ "GenSigTimeoutTime" BU_SG_REL_ GW_SAU_DRV_FD SG_ 276 CF_AVN_AirSptTimeNValueSet_AST 0;
BA_REL_ "GenSigTimeoutTime" BU_SG_REL_ GW_SAU_DRV_FD SG_ 276 CF_AVN_AirSptStrNValue_AST 0;
BA_REL_ "GenSigTimeoutTime" BU_SG_REL_ GW_SAU_DRV_FD SG_ 276 CF_AVN_SeatDrvModNvalueSet_AST 0;
BA_REL_ "GenSigTimeoutTime" BU_SG_REL_ WPC_FD SG_ 276 CF_Gway_WPC2_NValueSet 0;
BA_REL_ "GenSigTimeoutTime" BU_SG_REL_ WPC2_FD SG_ 276 CF_Gway_WPC2_NValueSet 0;
VAL_ 274 HU_USM_Crc2Val 0 "0x0x0~0xFFFF:CRCValue" 65535 "0x0x0~0xFFFF:CRCValue" ;
VAL_ 274 CF_AVN_CluRheostatLvl 0 "Reserved" 1 "Step 1" 2 "Step 2" 3 "Step 3" 4 "Step 4" 5 "Step 5" 6 "Step 6" 7 "Step 7" 8 "Step 8" 9 "Step 9" 10 "Step 10" 11 "Step 11" 12 "Step 12" 13 "Step 13" 14 "Step 14" 15 "Step 15" 16 "Step 16" 17 "Step 17" 18 "Step 18" 19 "Step 19" 20 "Step 20(Reset Value)" 21 "Step 21(Detent)" 22 "Reserved" 23 "Reserved" 24 "Reserved" 25 "Reserved" 26 "Reserved" 27 "Reserved" 28 "Reserved" 29 "Reserved" 30 "Reserved" 31 "Invalid" ;
VAL_ 274 CF_AVN_EVReset 0 "Default" 1 "USM Reset" 2 "Reserved" 3 "Invalid" ;
VAL_ 274 CF_AVN_UnitReset 0 "Default" 1 "Unit Reset" 2 "Reserved" 3 "Invalid" ;
VAL_ 274 CF_AVN_IcyRoadWarn 0 "Default" 1 "Off" 2 "On" 3 "Invalid" ;
VAL_ 274 CF_AVN_CluServiceReminderReset 0 "Default" 1 "Service Reminder Reset" 2 "Reserved" 3 "Invalid" ;
VAL_ 274 CF_AVN_CluUSMReset 0 "Default" 1 "USM Reset" 2 "RESERVED" 3 "Invalid" ;
VAL_ 274 C_HCIMSWeightNValueSet 0 "Default" 1 "Under 49.4kg" 2 "49.5~59.4kg" 3 "59.5~69.4kg" 4 "69.5~79.4kg" 5 "79.5~89.4kg" 6 "89.5~99.4kg" 7 "99.5~109.4kg" 8 "109.5~119.4kg" 9 "More than 119.5kg" 10 "Reserved" 11 "Reserved" 12 "Reserved" 13 "Reserved" 14 "Reserved" 15 "Invalid" ;
VAL_ 274 C_HCIMSHeightNvalueSet 0 "Default" 1 "Less than 147.5cm" 2 "147.5~152.4cm" 3 "152.5~157.4cm" 4 "157.5~162.4cm" 5 "162.5~167.4cm" 6 "167.5~172.4cm" 7 "172.5~177.4cm" 8 "177.5~182.4cm" 9 "182.5~187.4cm" 10 "187.5~192.4cm" 11 "192.5~197.4cm" 12 "more than 197.5cm" 13 "Reserved" 14 "Reserved" 15 "Invalid" ;
VAL_ 274 CF_AVN_HCIMSButtonCommand 0 "Default" 1 "Health Care IMS Exit" 2 "Detail View" 3 "Move to recommend position" 4 "Current position Analysis" 5 "Move to setting page" 6 "Save view" 7 "IMS1 saved" 8 "IMS2 saved" 9 "Summary view" 10 "Smart IMS On" 11 "Reserved" 12 "Reserved" 13 "Reserved" 14 "Reserved" 15 "Invalid" ;
VAL_ 274 C_HCIMSSitHeightNValueSet 0 "Default" 1 "Tall" 2 "Middle" 3 "Short" 4 "Reserved" 5 "Reserved" 6 "Reserved" 7 "Reserved" 8 "Reserved" 9 "Reserved" 10 "Reserved" 11 "Reserved" 12 "Reserved" 13 "Reserved" 14 "Reserved" 15 "Invalid" ;
VAL_ 274 CF_AVN_BodySpprtSet 0 "Default" 1 "Off" 2 "On" 3 "Invalid" ;
VAL_ 274 HU_USM_AlvCnt2Val 0 "0x0x0~0xFF:AlvCntValue" 255 "0x0x0~0xFF:AlvCntValue" ;
VAL_ 274 CF_AVN_AirSptTimeNValueSet 0 "Default" 1 "Short" 2 "Normal" 3 "Long" 4 "Reserved" 5 "Reserved" 6 "Reserved" 7 "Invalid" ;
VAL_ 274 CF_AVN_AirSptStrNValue 0 "Default" 1 "Normal" 2 "Intense" 3 "Invalid" ;
VAL_ 274 CF_AVN_SeatDrvModNValueSet 0 "Default" 1 "Off" 2 "On" 3 "Invalid" ;
VAL_ 274 C_SmrtSldngDrNValueSet 0 "Default" 1 "Off" 2 "On" 3 "Reserved" 4 "Reserved" 5 "Reserved" 6 "Reserved" 7 "Invalid" ;
VAL_ 274 CF_AVN_TurboPressureUnit 0 "Default" 1 "Psi" 2 "kPa" 3 "bar" 4 "Reserved" 5 "Reserved" 6 "Reserved" 7 "Invalid" ;
VAL_ 274 CF_AVN_CluTorqueUnit 0 "Default" 1 "Nm" 2 "lb_ft" 3 "Invalid" ;
VAL_ 274 CF_AVN_MoodLpRedNValueSet 0 "0x0x000~0x0FF:Red Color 0~255 (User Selection)" 255 "0x0x000~0x0FF:Red Color 0~255 (User Selection)" 256 "0x100~0x1FF:Red Color 0~255 (Expert Recommendation)" 511 "0x100~0x1FF:Red Color 0~255 (Expert Recommendation)" 512 "Default" 1023 "Invalid" ;
VAL_ 274 CF_AVN_MoodLpGreenNValueSet 0 "0x0x000~0x0FF:Green Color 0~255 (User Selection)" 255 "0x0x000~0x0FF:Green Color 0~255 (User Selection)" 256 "0x100~0x1FF:Green Color 0~255 (Expert Recommendation)" 511 "0x100~0x1FF:Green Color 0~255 (Expert Recommendation)" 512 "Default" 1023 "Invalid" ;
VAL_ 274 CF_AVN_MoodLpBlueNValueSet 0 "0x0x000~0x0FF:Blue Color 0~255 (User Selection)" 255 "0x0x000~0x0FF:Blue Color 0~255 (User Selection)" 256 "0x100~0x1FF:Blue Color 0~255 (Expert Recommendation)" 511 "0x100~0x1FF:Blue Color 0~255 (Expert Recommendation)" 512 "Default" 1023 "Invalid" ;
VAL_ 274 CF_AVN_MoodLpBrightNValueSet 0 "Default" 1 "Off" 2 "Level 1" 3 "Level 2" 4 "Level 3" 5 "Level 4" 6 "Level 5" 7 "Level 6" 8 "Level 7" 9 "Level 8" 10 "Level 9" 11 "Level 10" 12 "Reserved" 13 "Reserved" 14 "Reserved" 15 "Invalid" ;
VAL_ 274 CF_AVN_HBANValueSet 0 "Default" 1 "Off" 2 "On" 3 "Invalid" ;
VAL_ 274 CF_AVN_IFSActVehSpd_Set 0 "Default" 1 "Vehicle Speed Function Off" 2 "10km_h" 3 "20km_h" 4 "30km_h" 5 "40km_h" 6 "50km_h" 7 "60km_h" 8 "70km_h" 9 "80km_h" 10 "90km_h" 11 "100km_h" 12 "Reserved" 13 "Reserved" 14 "Reserved" 15 "Invalid" ;
VAL_ 274 C_MoodLpDrivingNValue 0 "Default" 1 "OFF" 2 "ON" 3 "Invalid" ;
VAL_ 274 HU_DrivingPostureAssistUSMSet 0 "Default" 1 "Off" 2 "10min" 3 "20min" 4 "30min" 5 "40min" 6 "50min" 7 "60min" 8 "RESERVED" 9 "RESERVED" 10 "RESERVED" 11 "RESERVED" 12 "RESERVED" 13 "RESERVED" 14 "RESERVED" 15 "Invalid" ;
VAL_ 274 C_MoodLPDrivemodeNValue 0 "Default" 1 "Off" 2 "On" 3 "Invalid" ;
VAL_ 274 CF_AVN_SVMAutoOnNvalueSet 0 "Default" 1 "Off" 2 "On" 3 "Invalid" ;
VAL_ 274 CF_AVN_DAW_LVDANValueSet 0 "Default" 1 "Off" 2 "On" 3 "Invalid" ;
VAL_ 274 CF_AVN_Clu3dDepthSet 0 "Default" 1 "Off" 2 "Weak" 3 "Mid" 4 "Strong" 5 "Reserved" 6 "Reserved" 7 "Invalid" ;
VAL_ 274 C_MoodLpFadeNValue 0 "Default" 1 "Off" 2 "On" 3 "Invalid" ;
VAL_ 274 HU_DrvCushAirSprtUSMSet 0 "Default" 1 "Off" 2 "Low" 3 "Mid" 4 "High" 5 "RESERVED" 6 "RESERVED" 7 "Invalid" ;
VAL_ 274 HU_AstCushAirSprtUSMSet 0 "Default" 1 "Off" 2 "Low" 3 "Mid" 4 "High" 5 "RESERVED" 6 "RESERVED" 7 "Invalid" ;
VAL_ 274 HU_DrvStrchMassageSwSet 0 "Default" 1 "Off" 2 "On" 3 "Invalid" ;
VAL_ 274 HU_DrvStrchMassageModeUSMSet 0 "Default" 1 "Mode 1" 2 "Mode 2" 3 "Mode 3" 4 "Mode 4" 5 "Mode 5" 6 "RESERVED" 7 "Invalid" ;
VAL_ 274 HU_DrvStrchMassageStrengthUSMSet 0 "Default" 1 "Weak" 2 "Normal" 3 "Strong" 4 "RESERVED" 5 "RESERVED" 6 "RESERVED" 7 "Invalid" ;
VAL_ 274 HU_DrvStrchMassageTimeUSMSet 0 "Default" 1 "Short" 2 "Normal" 3 "Long" 4 "RESERVED" 5 "RESERVED" 6 "RESERVED" 7 "Invalid" ;
VAL_ 274 HU_AstStrchMassageSwSet 0 "Default" 1 "Off" 2 "On" 3 "Invalid" ;
VAL_ 274 HU_AstStrchMassageModeUSMSet 0 "Default" 1 "Mode 1" 2 "Mode 2" 3 "Mode 3" 4 "Mode 4" 5 "Mode 5" 6 "RESERVED" 7 "Invalid" ;
VAL_ 274 HU_AstStrchMassageStrengthUSMSet 0 "Default" 1 "Weak" 2 "Normal" 3 "Strong" 4 "RESERVED" 5 "RESERVED" 6 "RESERVED" 7 "Invalid" ;
VAL_ 274 HU_AstStrchMassageTimeUSMSet 0 "Default" 1 "Short" 2 "Normal" 3 "Long" 4 "RESERVED" 5 "RESERVED" 6 "RESERVED" 7 "Invalid" ;
VAL_ 274 HU_DrvMsgPulseUSMSet 0 "Default" 1 "Off" 2 "On" 3 "Invalid" ;
VAL_ 274 HU_AstMsgPulseUSMSet 0 "Default" 1 "Off" 2 "On" 3 "Invalid" ;
VAL_ 274 HU_RLMsgPulseUSMSet 0 "Default" 1 "Off" 2 "On" 3 "Invalid" ;
VAL_ 274 HU_RRMsgPulseUSMSet 0 "Default" 1 "Off" 2 "On" 3 "Invalid" ;
VAL_ 274 CF_AVN_CluWelcomeSnd 0 "Default" 1 "Off" 2 "On" 3 "Invalid" ;
VAL_ 274 CF_AVN_CluServiceReminderSet 0 "Default" 1 "Off" 2 "On" 3 "Invalid" ;
VAL_ 274 CF_AVN_CluTransmissionDisp 0 "Default" 1 "Off" 2 "On" 3 "Invalid" ;
VAL_ 274 CF_AVN_CluWiperLight 0 "Default" 1 "Off" 2 "On" 3 "Invalid" ;
VAL_ 274 CF_AVN_CluRoadInfoGuide 0 "Default" 1 "Off" 2 "On" 3 "Invalid" ;
VAL_ 274 CF_AVN_CluUserSettingPeriod 0 "0~99month" 1 "0~99month" 2 "0~99month" 3 "0~99month" 4 "0~99month" 5 "0~99month" 6 "0~99month" 7 "0~99month" 8 "0~99month" 9 "0~99month" 10 "0~99month" 11 "0~99month" 12 "0~99month" 13 "0~99month" 14 "0~99month" 15 "0~99month" 16 "0~99month" 17 "0~99month" 18 "0~99month" 19 "0~99month" 20 "0~99month" 21 "0~99month" 22 "0~99month" 23 "0~99month" 24 "0~99month" 25 "0~99month" 26 "0~99month" 27 "0~99month" 28 "0~99month" 29 "0~99month" 30 "0~99month" 31 "0~99month" 32 "0~99month" 33 "0~99month" 34 "0~99month" 35 "0~99month" 36 "0~99month" 37 "0~99month" 38 "0~99month" 39 "0~99month" 40 "0~99month" 41 "0~99month" 42 "0~99month" 43 "0~99month" 44 "0~99month" 45 "0~99month" 46 "0~99month" 47 "0~99month" 48 "0~99month" 49 "0~99month" 50 "0~99month" 51 "0~99month" 52 "0~99month" 53 "0~99month" 54 "0~99month" 55 "0~99month" 56 "0~99month" 57 "0~99month" 58 "0~99month" 59 "0~99month" 60 "0~99month" 61 "0~99month" 62 "0~99month" 63 "0~99month" 64 "0~99month" 65 "0~99month" 66 "0~99month" 67 "0~99month" 68 "0~99month" 69 "0~99month" 70 "0~99month" 71 "0~99month" 72 "0~99month" 73 "0~99month" 74 "0~99month" 75 "0~99month" 76 "0~99month" 77 "0~99month" 78 "0~99month" 79 "0~99month" 80 "0~99month" 81 "0~99month" 82 "0~99month" 83 "0~99month" 84 "0~99month" 85 "0~99month" 86 "0~99month" 87 "0~99month" 88 "0~99month" 89 "0~99month" 90 "0~99month" 91 "0~99month" 92 "0~99month" 93 "0~99month" 94 "0~99month" 95 "0~99month" 96 "0~99month" 97 "0~99month" 98 "0~99month" 99 "0~99month" 100 "Reserved" 101 "Reserved" 102 "Reserved" 103 "Reserved" 104 "Reserved" 105 "Reserved" 106 "Reserved" 107 "Reserved" 108 "Reserved" 109 "Reserved" 110 "Reserved" 111 "Reserved" 112 "Reserved" 113 "Reserved" 114 "Reserved" 115 "Reserved" 116 "Reserved" 117 "Reserved" 118 "Reserved" 119 "Reserved" 120 "Reserved" 121 "Reserved" 122 "Reserved" 123 "Reserved" 124 "Reserved" 125 "Reserved" 126 "Reserved" 127 "Invalid" ;
VAL_ 274 CF_AVN_CluFuelEconUnit_mi 0 "Default" 1 "US gallon" 2 "UK gallon" 3 "Reserved" ;
VAL_ 274 CF_AVN_CluFuelEconUnit_km 0 "Default" 1 "km/L, km/kg, km/kWh" 2 "L/100km, kg/100km, kWh/100km" 3 "Reserved" ;
VAL_ 274 CF_AVN_CluUserSettingDistance 0 "0x0x0~0x1869F:0~9999km_mi" 99999 "0x0x0~0x1869F:0~9999km_mi" 131071 "Invalid" ;
VAL_ 273 HU_USM_Crc1Val 0 "0x0x0~0xFFFF:CRCValue" 65535 "0x0x0~0xFFFF:CRCValue" ;
VAL_ 273 CF_AVN_RCCWNValueSet 0 "Default" 1 "Off" 2 "Warning" 3 "Invalid" ;
VAL_ 273 CF_AVN_PDWAutoOnNValueSet 0 "Default" 1 "Off" 2 "On" 3 "Invalid" ;
VAL_ 273 Usm_RpmTERRAINAUTO 0 "Default" 1 "Off" 2 "On(RPM Gauge Display)" 3 "Invalid" ;
VAL_ 273 Usm_RpmSNOWSet 0 "Default" 1 "Off" 2 "On(RPM Gauge Display)" 3 "Invalid" ;
VAL_ 273 C_TempUnit 0 "Default" 1 "Celsius" 2 "Fahrenheit" 3 "Invalid" ;
VAL_ 273 CF_AVN_AdasVolumeNValueSet 0 "Default" 1 "Level 1" 2 "Level 2" 3 "Level 3" 4 "Reserved" 5 "Reserved" 6 "Off" 7 "Invalid" ;
VAL_ 273 C_PTGMNValueSet 0 "Default" 1 "Power Mode" 2 "Manual Mode" 3 "Invalid" ;
VAL_ 273 CF_AVN_ADrUNValueSet 0 "Default" 1 "Off" 2 "Key Out On(All Doors)" 3 "Shift Lever On(All Doors)" 4 "Override" 5 "Invalid" 6 "Key Out On(Driver Door)" 7 "Shift Lever On(Driver Door)" ;
VAL_ 273 CF_AVN_EscortHLNValueSet 0 "Default" 1 "Escort Off" 2 "Escort On" 3 "Invalid" ;
VAL_ 273 CF_AVN_PSMNValueSet 0 "Default" 1 "Off(Disable)" 2 "50mm On(Enable)" 3 "75mm On(Enable)" 4 "Reserved" 5 "Reserved" 6 "Reserved" 7 "Invalid" ;
VAL_ 273 C_HfreeTrunkTgNValueSet 0 "Default" 1 "HandsFree Off" 2 "HandsFree On" 3 "Reserved" 4 "Invalid" 5 "Reserved" 6 "Reserved" 7 "Reserved" ;
VAL_ 273 CF_AVN_TrfChgSet 0 "Default" 1 "Disable(Off)" 2 "Enable(On)" 3 "Invalid" ;
VAL_ 273 CF_AVN_SCMNValueSet 0 "Default" 1 "Steering Off" 2 "Steering On" 3 "Invalid" ;
VAL_ 273 CF_AVN_OTTurnNValueSet 0 "Default" 1 "One Touch Turn Off" 2 "3 Flashing" 3 "5 Flashing" 4 "7 Flashing" 5 "Invalid" 6 "Reserved" 7 "Reserved" ;
VAL_ 273 CF_Gway_WPCNValueSet 0 "Default" 1 "Off(Disable)" 2 "On(Enable)" 3 "Invalid" ;
VAL_ 273 C_AVN_RearWiperNValueSet 0 "Default" 1 "Rear Wiper(Reverse) Off" 2 "Rear Wiper(Reverse) On" 3 "Invalid" ;
VAL_ 273 C_UnlockWelocomeNValueSet 0 "Default" 1 "Off" 2 "On" 3 "Invalid" ;
VAL_ 273 C_SmartWelocomeNValueSet 0 "Default" 1 "Off" 2 "On" 3 "Invalid" ;
VAL_ 273 HU_USM_AlvCnt1Val 0 "0x0x0~0xFF:AlvCntValue" 255 "0x0x0~0xFF:AlvCntValue" ;
VAL_ 273 CF_AVN_PTGSpeedNValueSet 0 "Default" 1 "Fast" 2 "Slow" 3 "Invalid" ;
VAL_ 273 CR_Datc_DRSeatWheel_USM_Set 0 "Default" 1 "Off" 2 "On" 3 "Invalid" ;
VAL_ 273 CF_AVN_TTUnlockNValueSet 0 "Default" 1 "Off" 2 "On" 3 "Invalid" ;
VAL_ 273 CF_Gway_RWPCNValueSet 0 "Default" 1 "Off" 2 "On" 3 "Invalid" ;
VAL_ 273 C_PSDNValueSet 0 "Default" 1 "Power Mode" 2 "Manual Mode" 3 "Invalid" ;
VAL_ 273 CF_Avn_HAPTICWARNINGNValueSet 0 "Default" 1 "Weak" 2 "Medium" 3 "Strong" 4 "Reserved" 5 "Reserved" 6 "Off" 7 "Invalid" ;
VAL_ 273 CR_Datc_DRSeatHeat_USM_Set 0 "Default" 1 "Off" 2 "On" 3 "Invalid" ;
VAL_ 273 C_WALNValueSet 0 "Default" 1 "Off" 2 "On" 3 "Invalid" ;
VAL_ 273 C_ApprUnlockNValue 0 "Defualt" 1 "Approach Unlock OFF" 2 "Approach Unlock ON" 3 "Invalid" ;
VAL_ 273 CF_AVN_HudSet 0 "Default" 1 "Off" 2 "On" 3 "Invalid" ;
VAL_ 273 CF_AVN_HudContetnsTBT 0 "Default" 1 "Off" 2 "On" 3 "Invalid" ;
VAL_ 273 CF_AVN_HudContetnsSCC 0 "Default" 1 "Off" 2 "On" 3 "Invalid" ;
VAL_ 273 CF_AVN_HudContetnsDIS 0 "Default" 1 "Off" 2 "On" 3 "Invalid" ;
VAL_ 273 CF_AVN_HudContetnsBSD 0 "Default" 1 "Off" 2 "On" 3 "Invalid" ;
VAL_ 273 CF_AVN_HudHeightSet 0 "Level 1" 1 "Level 2" 2 "Level 3" 3 "Level 4" 4 "Level 5" 5 "Level 6" 6 "Level 7" 7 "Level 8" 8 "Level 9" 9 "Level 10" 10 "Level 11" 11 "Level 12" 12 "Level 13" 13 "Level 14" 14 "Level 15" 15 "Level 16" 16 "Level 17" 17 "Level 18" 18 "Level 19" 19 "Level 20" 20 "Reserved" 21 "Reserved" 22 "Reserved" 23 "Reserved" 24 "Reserved" 25 "Reserved" 26 "Reserved" 27 "Reserved" 28 "Reserved" 29 "Reserved" 30 "Reserved" 31 "Invalid" ;
VAL_ 273 CF_AVN_HudBrightnessSet 0 "Level 1" 1 "Level 2" 2 "Level 3" 3 "Level 4" 4 "Level 5" 5 "Level 6" 6 "Level 7" 7 "Level 8" 8 "Level 9" 9 "Level 10" 10 "Level 11" 11 "Level 12" 12 "Level 13" 13 "Level 14" 14 "Level 15" 15 "Level 16" 16 "Level 17" 17 "Level 18" 18 "Level 19" 19 "Level 20" 20 "Reserved" 21 "Reserved" 22 "Reserved" 23 "Reserved" 24 "Reserved" 25 "Reserved" 26 "Reserved" 27 "Reserved" 28 "Reserved" 29 "Reserved" 30 "Reserved" 31 "Invalid" ;
VAL_ 273 CF_AVN_HudRotationSet 0 "Center" 1 "CCW1" 2 "CCW2" 3 "CCW3" 4 "CCW4" 5 "CCW5" 6 "CCW6" 7 "CCW7" 8 "CCW8" 9 "CCW9" 10 "CCW10" 11 "Reserved" 12 "Reserved" 13 "Reserved" 14 "Reserved" 15 "Reserved" 16 "Reserved" 17 "CW1" 18 "CW2" 19 "CW3" 20 "CW4" 21 "CW5" 22 "CW6" 23 "CW7" 24 "CW8" 25 "CW9" 26 "CW10" 27 "Reserved" 28 "Reserved" 29 "Reserved" 30 "Reserved" 31 "Invalid" ;
VAL_ 273 AVN_BPCM_DrvReq 0 "Default" 1 "Off" 2 "On" 3 "Invalid" ;
VAL_ 273 CF_AVN_HudContentsAVInfo 0 "Default" 1 "Off" 2 "On" 3 "Invalid" ;
VAL_ 273 CF_AVN_SportHUD 0 "Default" 1 "Off" 2 "Sport HUD" 3 "Invalid" ;
VAL_ 273 USM_RpmCOMFORTSet 0 "Default" 1 "Off" 2 "On(RPM Gauge Display)" 3 "Invalid" ;
VAL_ 273 USM_RpmNORMALSet 0 "Default" 1 "Off" 2 "On(RPM Gauge Display)" 3 "Invalid" ;
VAL_ 273 AVN_BPCM_AstReq 0 "Default" 1 "Off" 2 "On" 3 "Invalid" ;
VAL_ 273 AVN_BPCM_RLReq 0 "Default" 1 "Off" 2 "On" 3 "Invalid" ;
VAL_ 273 AVN_BPCM_RRReq 0 "Default" 1 "Off" 2 "On" 3 "Invalid" ;
VAL_ 273 AVN_BPCM_Drv1_USMOnReq 0 "Default" 1 "Off" 2 "On" 3 "Invalid" ;
VAL_ 273 AVN_BPCM_Drv2_USMOnReq 0 "Default" 1 "Off" 2 "On" 3 "Invalid" ;
VAL_ 273 AVN_BPCM_Drv3_USMOnReq 0 "Default" 1 "Off" 2 "On" 3 "Invalid" ;
VAL_ 273 AVN_BPCM_Drv4_USMOnReq 0 "Default" 1 "Off" 2 "On" 3 "Invalid" ;
VAL_ 273 AVN_BPCM_Ast1_USMOnReq 0 "Default" 1 "Off" 2 "On" 3 "Invalid" ;
VAL_ 273 AVN_BPCM_Ast2_USMOnReq 0 "Default" 1 "Off" 2 "On" 3 "Invalid" ;
VAL_ 273 AVN_BPCM_Ast3_USMOnReq 0 "Default" 1 "Off" 2 "On" 3 "Invalid" ;
VAL_ 273 AVN_BPCM_Ast4_USMOnReq 0 "Default" 1 "Off" 2 "On" 3 "Invalid" ;
VAL_ 273 AVN_BPCM_RL1_USMOnReq 0 "Default" 1 "Off" 2 "On" 3 "Invalid" ;
VAL_ 273 AVN_BPCM_RL2_USMOnReq 0 "Default" 1 "Off" 2 "On" 3 "Invalid" ;
VAL_ 273 AVN_BPCM_RL3_USMOnReq 0 "Default" 1 "Off" 2 "On" 3 "Invalid" ;
VAL_ 273 AVN_BPCM_RL4_USMOnReq 0 "Default" 1 "Off" 2 "On" 3 "Invalid" ;
VAL_ 273 AVN_BPCM_RR1_USMOnReq 0 "Default" 1 "Off" 2 "On" 3 "Invalid" ;
VAL_ 273 AVN_BPCM_RR2_USMOnReq 0 "Default" 1 "Off" 2 "On" 3 "Invalid" ;
VAL_ 273 AVN_BPCM_RR3_USMOnReq 0 "Default" 1 "Off" 2 "On" 3 "Invalid" ;
VAL_ 273 AVN_BPCM_RR4_USMOnReq 0 "Default" 1 "Off" 2 "On" 3 "Invalid" ;
VAL_ 273 CF_AVN_HDANValueSet 0 "Default" 1 "Off" 2 "On" 3 "Invalid" ;
VAL_ 273 CF_AVN_NSCCCamNValueSet 0 "Default" 1 "Disable" 2 "Enable" 3 "Invalid" ;
VAL_ 273 CF_AVN_ISLWNValueSet 0 "Default" 1 "Off" 2 "Warning" 3 "Invalid" ;
VAL_ 273 CF_AVN_NCC_USM_set 0 "Default" 1 "On" 2 "Off" 3 "Invalid" ;
VAL_ 273 CF_AVN_TirePressUnitNValueSet 0 "Default" 1 "Psi" 2 "Kpa" 3 "Bar" 4 "Reserved" 5 "Reserved" 6 "Reserved" 7 "Invalid" ;
VAL_ 745 PDC_FD_Crc15Val 0 "0x0x0~0xFFFF:CRCValue" 65535 "0x0x0~0xFFFF:CRCValue" ;
VAL_ 745 PDC_CurrAtReset 0 "0x0x0~0xFFE:-40,940mA ~ 0mA" 4094 "0x0x0~0xFFE:-40,940mA ~ 0mA" 4095 "Error" ;
VAL_ 745 PDC_AvgCurrAtReset 0 "0x0x0~0xFFE:-40,940mA ~ 0mA" 4094 "0x0x0~0xFFE:-40,940mA ~ 0mA" 4095 "Error" ;
VAL_ 745 PDC_ResetReason 0 "No Reset" 1 "Reset By Non-Sleep" 2 "Reset By Current" 3 "RESERVED" 4 "RESERVED" 5 "RESERVED" 6 "RESERVED" 7 "RESERVED" ;
VAL_ 745 PDC_CumulativeCountOf12VReq 0 "0x0x0~0x3FF:0~1023" 1023 "0x0x0~0x3FF:0~1023" ;
VAL_ 745 PDC_CumulativeCountOfCCUReq 0 "0x0x0~0x3FF:0~1023" 1023 "0x0x0~0x3FF:0~1023" ;
VAL_ 745 PDC_FD_AlvCnt15Val 0 "0x0x0~0xFF:AlvCntValue" 255 "0x0x0~0xFF:AlvCntValue" ;
VAL_ 745 PDC_LDConReq 0 "Off (Default)" 1 "On" 2 "RESERVED" 3 "RESERVED" ;
VAL_ 745 PDC_LDConReq_By_LVBat 0 "Off (Default)" 1 "On" 2 "RESERVED" 3 "RESERVED" ;
VAL_ 745 PDC_LDConReq_By_OTA 0 "Off (Default)" 1 "On" 2 "RESERVED" 3 "RESERVED" ;
VAL_ 745 PDC_LDConReq_By_Load 0 "Off (Default)" 1 "On" 2 "RESERVED" 3 "RESERVED" ;
VAL_ 745 PDC_LDConReq_By_ActiveOn 0 "Off (Default)" 1 "On" 2 "RESERVED" 3 "RESERVED" ;
VAL_ 745 PDC_ResetPreWrngForCCU 0 "No Warning" 1 "Warning" 2 "RESERVED" 3 "Invalid" ;
VAL_ 745 PDC_ResetPreWrngForOthers 0 "No Warning" 1 "Warning" 2 "RESERVED" 3 "Invalid" ;
VAL_ 745 PDC_ResetReqForCCU 0 "No Requeset" 1 "Reset Requeset" 2 "RESERVED" 3 "Invalid" ;
VAL_ 745 PDC_ResetReqForOthers 0 "No Requeset" 1 "Reset Requeset" 2 "RESERVED" 3 "Invalid" ;
VAL_ 745 PDC_ResetFuncOpt 0 "Not Applied" 1 "Applied" 2 "RESERVED" 3 "Invalid" ;
VAL_ 745 PDC_12VRlyCtrl 0 "No Request" 1 "Relay On request" 2 "Relay Off request" 3 "Invalid" ;
VAL_ 745 PDC_CurrentValueForReset 0 "No Setting" 1 "0x1~0xFE:50mA ~ 12700mA" 254 "0x1~0xFE:50mA ~ 12700mA" 255 "Invalid" ;
VAL_ 745 PDC_TimeValueForReset 0 "No Setting" 1 "0x1~0xFE:0.5h ~ 127h" 254 "0x1~0xFE:0.5h ~ 127h" 255 "Invalid" ;
VAL_ 745 PDC_12VRlyOffHoldingTime 0 "No Setting" 1 "0.5s ~ 15s" 2 "0.5s ~ 15s" 3 "0.5s ~ 15s" 4 "0.5s ~ 15s" 5 "0.5s ~ 15s" 6 "0.5s ~ 15s" 7 "0.5s ~ 15s" 8 "0.5s ~ 15s" 9 "0.5s ~ 15s" 10 "0.5s ~ 15s" 11 "0.5s ~ 15s" 12 "0.5s ~ 15s" 13 "0.5s ~ 15s" 14 "0.5s ~ 15s" 15 "0.5s ~ 15s" 16 "0.5s ~ 15s" 17 "0.5s ~ 15s" 18 "0.5s ~ 15s" 19 "0.5s ~ 15s" 20 "0.5s ~ 15s" 21 "0.5s ~ 15s" 22 "0.5s ~ 15s" 23 "0.5s ~ 15s" 24 "0.5s ~ 15s" 25 "0.5s ~ 15s" 26 "0.5s ~ 15s" 27 "0.5s ~ 15s" 28 "0.5s ~ 15s" 29 "0.5s ~ 15s" 30 "0.5s ~ 15s" 31 "Invalid" ;
VAL_ 745 PDC_ResetCountSetting 0 "No Setting" 1 "1~3" 2 "1~3" 3 "1~3" ;
VAL_ 745 PDC_ResetCount 0 "No Setting" 1 "1~3" 2 "1~3" 3 "1~3" ;
VAL_ 745 PDC_ResetCumulativeCount 0 "0x0x0~0x3FF:0~1023" 1023 "0x0x0~0x3FF:0~1023" ;
VAL_ 745 PDC_ResetOpsta 0 "Normal" 1 "Reset Complete" 2 "Reset Fail" 3 "RESERVED" ;
VAL_ 745 PDC_ReadyTimeValueForReset 0 "No Setting" 1 "0x1~0xFE:10min~254min/0XFF: Invalid" 254 "0x1~0xFE:10min~254min/0XFF: Invalid" ;
VAL_ 278 HU_USM_Crc5Val 0 "0x0x0~0xFFFF:CRCValue" 65535 "0x0x0~0xFFFF:CRCValue" ;
VAL_ 278 CF_AVN_AIVoiceMicModNvalue 0 "Default" 1 "MiCModLVL 1" 16 "MiCModLVL 16" 17 "MiCModLVL 17" 18 "MiCModLVL 18" 19 "MiCModLVL 19" 20 "MiCModLVL 20" 21 "MiCModLVL 21" 22 "MiCModLVL 22" 23 "MiCModLVL 23" 24 "MiCModLVL 24" 25 "MiCModLVL 25" 26 "MiCModLVL 26" 27 "MiCModLVL 27" 28 "MiCModLVL 28" 29 "MiCModLVL 29" 30 "MiCModLVL 30" 31 "MiCModLVL 31" 2 "MiCModLVL 2" 32 "MiCModLVL 32" 33 "MiCModLVL 33" 34 "MiCModLVL 34" 35 "MiCModLVL 35" 36 "MiCModLVL 36" 37 "MiCModLVL 37" 38 "MiCModLVL 38" 39 "MiCModLVL 39" 40 "MiCModLVL 40" 41 "MiCModLVL 41" 42 "MiCModLVL 42" 43 "MiCModLVL 43" 44 "MiCModLVL 44" 45 "MiCModLVL 45" 46 "MiCModLVL 46" 47 "MiCModLVL 47" 3 "MiCModLVL 3" 48 "MiCModLVL 48" 49 "MiCModLVL 49" 50 "MiCModLVL 50" 51 "MiCModLVL 51" 52 "MiCModLVL 52" 53 "MiCModLVL 53" 54 "MiCModLVL 54" 55 "MiCModLVL 55" 56 "MiCModLVL 56" 57 "MiCModLVL 57" 58 "MiCModLVL 58" 59 "MiCModLVL 59" 60 "MiCModLVL 60" 61 "MiCModLVL 61" 62 "MiCModLVL 62" 63 "Invalid" 4 "MiCModLVL 4" 5 "MiCModLVL 5" 6 "MiCModLVL 6" 7 "MiCModLVL 7" 8 "MiCModLVL 8" 9 "MiCModLVL 9" 10 "MiCModLVL 10" 11 "MiCModLVL 11" 12 "MiCModLVL 12" 13 "MiCModLVL 13" 14 "MiCModLVL 14" 15 "MiCModLVL 15" ;
VAL_ 278 CF_AVN_AIVoiceTTSModNvalue 0 "Default" 1 "TTSModLVL 1" 16 "TTSModLVL 16" 17 "TTSModLVL 17" 18 "TTSModLVL 18" 19 "TTSModLVL 19" 20 "TTSModLVL 20" 21 "TTSModLVL 21" 22 "TTSModLVL 22" 23 "TTSModLVL 23" 24 "TTSModLVL 24" 25 "TTSModLVL 25" 26 "TTSModLVL 26" 27 "TTSModLVL 27" 28 "TTSModLVL 28" 29 "TTSModLVL 29" 30 "TTSModLVL 30" 31 "TTSModLVL 31" 2 "TTSModLVL 2" 32 "TTSModLVL 32" 33 "TTSModLVL 33" 34 "TTSModLVL 34" 35 "TTSModLVL 35" 36 "TTSModLVL 36" 37 "TTSModLVL 37" 38 "TTSModLVL 38" 39 "TTSModLVL 39" 40 "TTSModLVL 40" 41 "TTSModLVL 41" 42 "TTSModLVL 42" 43 "TTSModLVL 43" 44 "TTSModLVL 44" 45 "TTSModLVL 45" 46 "TTSModLVL 46" 47 "TTSModLVL 47" 3 "TTSModLVL 3" 48 "TTSModLVL 48" 49 "TTSModLVL 49" 50 "TTSModLVL 50" 51 "TTSModLVL 51" 52 "TTSModLVL 52" 53 "TTSModLVL 53" 54 "TTSModLVL 54" 55 "TTSModLVL 55" 56 "TTSModLVL 56" 57 "TTSModLVL 57" 58 "TTSModLVL 58" 59 "TTSModLVL 59" 60 "TTSModLVL 60" 61 "TTSModLVL 61" 62 "TTSModLVL 62" 63 "Invalid" 4 "TTSModLVL 4" 5 "TTSModLVL 5" 6 "TTSModLVL 6" 7 "TTSModLVL 7" 8 "TTSModLVL 8" 9 "TTSModLVL 9" 10 "TTSModLVL 10" 11 "TTSModLVL 11" 12 "TTSModLVL 12" 13 "TTSModLVL 13" 14 "TTSModLVL 14" 15 "TTSModLVL 15" ;
VAL_ 278 CF_AVN_WiperAutoModeSet 0 "Default" 1 "Auto Wash Mode Off" 2 "Auto Wash Mode On" 3 "RESERVED" 4 "RESERVED" 5 "RESERVED" 6 "RESERVED" 7 "Invalid" ;
VAL_ 278 CF_AVN_AFCUAutoWashModeSet 0 "Default" 1 "AFCU Auto Wash Mode Off" 2 "AFCU Auto Wash Mode On" 3 "RESERVED" 4 "RESERVED" 5 "RESERVED" 6 "RESERVED" 7 "Invalid" ;
VAL_ 278 CF_AVN_PSDAutoWashModeSet 0 "Default" 1 "PSD Auto Wash Mode Off" 2 "PSD Auto Wash Mode On" 3 "RESERVED" 4 "RESERVED" 5 "RESERVED" 6 "RESERVED" 7 "Invalid" ;
VAL_ 278 CF_AVN_PTGAutoWashModeSet 0 "Default" 1 "PTG Auto Wash Mode Off" 2 "PTG AUto Wash Mode On" 3 "RESERVED" 4 "RESERVED" 5 "RESERVED" 6 "RESERVED" 7 "Invalid" ;
VAL_ 278 CF_AVN_CDMAutoWashModeSet 0 "Default" 1 "CDM Auto Wash Mode Off" 2 "CDM Auto Wash Mode On" 3 "RESERVED" 4 "RESERVED" 5 "RESERVED" 6 "RESERVED" 7 "Invalid" ;
VAL_ 278 CF_AVN_Roof_OprLvSet 0 "Default" 1 "Off" 2 "Level1" 3 "Level2" 4 "Level3" 5 "Level4" 6 "Level5" 7 "Invalid" ;
VAL_ 278 CF_AVN_2ndLeftDoor_OptLvSet 0 "Default" 1 "Off" 2 "Level1" 3 "Level2" 4 "Level3" 5 "Level4" 6 "Level5" 7 "Invalid" ;
VAL_ 278 CF_AVN_2ndRightDoor_OptLvSet 0 "Default" 1 "Off" 2 "Level1" 3 "Level2" 4 "Level3" 5 "Level4" 6 "Level5" 7 "Invalid" ;
VAL_ 278 CF_AVN_3rdLeftDoor_OptLvlSet 0 "Default" 1 "Off" 2 "Level1" 3 "Level2" 4 "Level3" 5 "Level4" 6 "Level5" 7 "Invalid" ;
VAL_ 278 CF_AVN_3rdRightDoor_OptLvlSet 0 "Default" 1 "Off" 2 "Level1" 3 "Level2" 4 "Level3" 5 "Level4" 6 "Level5" 7 "Invalid" ;
VAL_ 278 CF_AVN_RearDoor_OptLvlSet 0 "Default" 1 "Off" 2 "Level1" 3 "Level2" 4 "Level3" 5 "Level4" 6 "Level5" 7 "Invalid" ;
VAL_ 278 CF_AVN_RollBlindOnOffSet 0 "Default" 1 "Off" 2 "On" 3 "Invalid" ;
VAL_ 278 CF_AVN_CluThmAutoSet_New 0 "Default" 1 "Disable" 2 "Enable" 3 "Invalid" ;
VAL_ 278 CF_AVN_CluThmSet_New 0 "Default" 1 "Select Theme 1" 2 "Select Theme 2" 3 "Select Theme 3" 4 "Select Theme 4" 5 "Select Theme 5" 6 "Select Theme 6" 7 "Invalid" ;
VAL_ 278 CF_AVN_CluThmDtlSet_New 0 "Default" 1 "Select Theme 1" 2 "Select Theme 2" 3 "Select Theme 3" 4 "Select Theme 4" 5 "Select Theme 5" 6 "Select Theme 6 (Link to Drive Mode)" 7 "Invalid" ;
VAL_ 278 CF_AVN_DWL_SelectNvalueSet 0 "Default" 1 "Select Concept A" 2 "Select Concept B" 3 "Select Concept C" 4 "Select Concept D" 5 "Select Concept E" 6 "Select Concept F" 7 "Select Concept G" 8 "Select Concept H" 9 "Select Concept I" 10 "Select Concept J" 11 "RESERVED" 12 "RESERVED" 13 "RESERVED" 14 "RESERVED" 15 "Invalid" ;
VAL_ 278 HU_USM_AlvCnt5Val 0 "0x0x0~0xFF:AlvCntValue" 255 "0x0x0~0xFF:AlvCntValue" ;
VAL_ 278 CF_Gway_WPCAnimationNvalueSet 0 "Default" 1 "Type 1 (Animation Off)" 2 "Type 2 (Animation On)" 3 "Reserved" 4 "Reserved" 5 "Reserved" 6 "Reserved" 7 "Invalid" ;
VAL_ 278 USM_BtnIllumiAlwaysOnReq 0 "Default" 1 "Off" 2 "On" 3 "Invalid" ;
VAL_ 278 CF_AVN_LKAWrngVolNvalueSet 0 "Default" 1 "Off" 2 "On" 3 "Invalid" ;
VAL_ 278 DAB_IlluminationVrModeSet 0 "Default" 1 "AI Voice Start" 2 "User Response" 3 "User No Response" 4 "Processing" 5 "AI Voice Response" 6 "AI Voice End" 7 "Invalid" ;
VAL_ 278 USM_IllAlwaysOnwithPSTNReq 0 "Default" 1 "OFF" 2 "illumination Always On" 3 "illumination Always On with PSTN" 4 "RESERVED" 5 "RESERVED" 6 "RESERVED" 7 "Invalid" ;
VAL_ 278 CF_AVN_AutoStopTimerResetSet 0 "Default" 1 "Manual Reset" 2 "Link to Current Trip" 3 "Since Refueling" 4 "Since Reset" 5 "RESERVED" 6 "RESERVED" 7 "Invalid" ;
VAL_ 278 USM_RrCurtainSet 0 "Default" 1 "Off" 2 "On" 3 "Invalid" ;
VAL_ 278 USM_AdasISLAEUCntry1Set 0 "Default" 1 "Show Numerical Signs Only" 2 "Austria" 3 "Belgium" 4 "Bulgaria" 5 "Croatia" 6 "Cyprus" 7 "Czech Republic" 8 "Denmark" 9 "Estonia" 10 "Finland" 11 "France" 12 "Germany" 13 "Greece" 14 "Hungary" 15 "Iceland" 16 "Ireland" 17 "Italy" 18 "Latvia" 19 "Liechtenstein" 20 "Lithuania" 21 "Luxembourg" 22 "Malta" 23 "Netherlands" 24 "Norway" 25 "Poland" 26 "Portugal" 27 "Romania" 28 "Slovakia" 29 "Slovenia" 30 "Spain" 31 "Sweden" 32 "Switzerland" 33 "United Kingdom" 34 "French Guiana" 35 "Guadeloupe" 36 "Martinique" 37 "Reunion" 38 "Mayotte" 39 "New Caledonia" 40 "Canary Islands" 41 "Ceuta" 42 "Melilla" 43 "Andorra" 44 "Monaco" 45 "San Marino" 46 "Vatican City" 47 "Israel" 48 "Palestine" 49 "Iran" 50 "Turkey" 51 "North Macedonia" 52 "Serbia" 53 "Montenegro" 54 "Bosnia and Herzegovina" 55 "Albania" 56 "0x38~0xFE:Reserved" 254 "0x38~0xFE:Reserved" 255 "Invalid" ;
VAL_ 278 USM_AdasISLAEUCntryTglSet 0 "Default" 1 "Toggle" 2 "Reserved" 3 "Invalid" ;
VAL_ 278 xHEV_SmartRegen_Map_Set 0 "Default" 1 "Off(Disbaled)" 2 "On(Enabled)" 3 "Invalid" ;
VAL_ 278 HU_ChgCtrMode 0 "Not setting" 1 "Scheduled charging_Econ" 2 "Scheduled charging_EconOnly" 3 "Invalid" ;
VAL_ 278 CF_AVN_HudContentsCallPopup 0 "Default" 1 "Off" 2 "On" 3 "Invalid" ;
VAL_ 278 HU_EconStHr_WeekDay 0 "0~23" 1 "0~23" 2 "0~23" 3 "0~23" 4 "0~23" 5 "0~23" 6 "0~23" 7 "0~23" 8 "0~23" 9 "0~23" 10 "0~23" 11 "0~23" 12 "0~23" 13 "0~23" 14 "0~23" 15 "0~23" 16 "0~23" 17 "0~23" 18 "0~23" 19 "0~23" 20 "0~23" 21 "0~23" 22 "0~23" 23 "0~23" 24 "RESERVED" 25 "RESERVED" 26 "RESERVED" 27 "RESERVED" 28 "RESERVED" 29 "RESERVED" 30 "RESERVED" 31 "Invalid" ;
VAL_ 278 HU_EconStMin_WeekDay 0 "Refer to Fomula" 1 "Refer to Fomula" 2 "Refer to Fomula" 3 "Refer to Fomula" 4 "Refer to Fomula" 5 "Refer to Fomula" 6 "RESERVED" 7 "Invalid" ;
VAL_ 278 HU_EconEndHr_WeekDay 0 "0~23" 1 "0~23" 2 "0~23" 3 "0~23" 4 "0~23" 5 "0~23" 6 "0~23" 7 "0~23" 8 "0~23" 9 "0~23" 10 "0~23" 11 "0~23" 12 "0~23" 13 "0~23" 14 "0~23" 15 "0~23" 16 "0~23" 17 "0~23" 18 "0~23" 19 "0~23" 20 "0~23" 21 "0~23" 22 "0~23" 23 "0~23" 24 "RESERVED" 25 "RESERVED" 26 "RESERVED" 27 "RESERVED" 28 "RESERVED" 29 "RESERVED" 30 "RESERVED" 31 "Invalid" ;
VAL_ 278 HU_EconEndMin_WeekDay 0 "Refer to Fomula" 1 "Refer to Fomula" 2 "Refer to Fomula" 3 "Refer to Fomula" 4 "Refer to Fomula" 5 "Refer to Fomula" 6 "RESERVED" 7 "Invalid" ;
VAL_ 278 HU_DepartSet_Hour 0 "0~23" 1 "0~23" 2 "0~23" 3 "0~23" 4 "0~23" 5 "0~23" 6 "0~23" 7 "0~23" 8 "0~23" 9 "0~23" 10 "0~23" 11 "0~23" 12 "0~23" 13 "0~23" 14 "0~23" 15 "0~23" 16 "0~23" 17 "0~23" 18 "0~23" 19 "0~23" 20 "0~23" 21 "0~23" 22 "0~23" 23 "0~23" 24 "RESERVED" 25 "RESERVED" 26 "RESERVED" 27 "RESERVED" 28 "RESERVED" 29 "RESERVED" 30 "RESERVED" 31 "invalid" ;
VAL_ 278 HU_DepartSet_Min 0 "Refer to Fomula" 1 "Refer to Fomula" 2 "Refer to Fomula" 3 "Refer to Fomula" 4 "Refer to Fomula" 5 "Refer to Fomula" 6 "reserved" 7 "invalid" ;
VAL_ 278 HU_DepartSetDay 0 "0x0x0~0xFE:value" 254 "0x0x0~0xFE:value" 255 "Invalid" ;
VAL_ 278 HU_DepartSet_TempSet 0 "Refer to Fomula" 1 "Refer to Fomula" 2 "Refer to Fomula" 3 "Refer to Fomula" 4 "Refer to Fomula" 5 "Refer to Fomula" 6 "Refer to Fomula" 7 "Refer to Fomula" 8 "Refer to Fomula" 9 "Refer to Fomula" 10 "Refer to Fomula" 11 "Refer to Fomula" 12 "Refer to Fomula" 13 "Refer to Fomula" 14 "Refer to Fomula" 15 "Refer to Fomula" 16 "Refer to Fomula" 17 "Refer to Fomula" 18 "Refer to Fomula" 19 "Refer to Fomula" 20 "Refer to Fomula" 21 "Refer to Fomula" 22 "Refer to Fomula" 23 "Refer to Fomula" 24 "Refer to Fomula" 25 "Refer to Fomula" 26 "Refer to Fomula" 27 "Refer to Fomula" 28 "Refer to Fomula" 29 "Refer to Fomula" 30 "Refer to Fomula" 31 "Refer to Fomula" 32 "Refer to Fomula" 33 "Refer to Fomula" 34 "Refer to Fomula" 35 "Refer to Fomula" 36 "Refer to Fomula" 37 "Refer to Fomula" 38 "Refer to Fomula" 39 "Refer to Fomula" 40 "Refer to Fomula" 41 "Refer to Fomula" 42 "Refer to Fomula" 43 "Refer to Fomula" 44 "Refer to Fomula" 45 "Refer to Fomula" 46 "Refer to Fomula" 47 "Refer to Fomula" 48 "Refer to Fomula" 49 "Refer to Fomula" 50 "Refer to Fomula" 51 "Refer to Fomula" 52 "Refer to Fomula" 53 "Refer to Fomula" 54 "Refer to Fomula" 55 "Refer to Fomula" 56 "Refer to Fomula" 57 "Refer to Fomula" 58 "Refer to Fomula" 59 "Refer to Fomula" 60 "Refer to Fomula" 61 "Refer to Fomula" 62 "Refer to Fomula" 63 "Invalid" ;
VAL_ 278 HU_DepartSettingValue 0 "None" 1 "Set" 2 "Not Used" 3 "Invalid" ;
VAL_ 278 HU_NdepartSet 0 "Default" 1 "Departure Number" 2 "Departure Number" 3 "Departure Number" 4 "Departure Number" 5 "Departure Number" 6 "Departure Number" 7 "invalid" ;
VAL_ 278 HU_DepartSet_ClimateSet 0 "value" 1 "value" 2 "value" 3 "value" 4 "value" 5 "value" 6 "value" 7 "value" 8 "value" 9 "value" 10 "value" 11 "value" 12 "value" 13 "value" 14 "value" 15 "invalid" ;
VAL_ 278 CF_AVN_MdLpBttmRedNvalueSet 0 "0x0x000~0x0FF:Red Color 0~255 (User selection)" 255 "0x0x000~0x0FF:Red Color 0~255 (User selection)" 256 "0x100~0x1FF:Red Color 0~255 (Expert Recommendation)" 511 "0x100~0x1FF:Red Color 0~255 (Expert Recommendation)" 512 "Default" 1023 "Invalid" ;
VAL_ 278 CF_AVN_MdLpBttmGreenNvalueSet 0 "0x0x000~0x0FF:0~255 (User selection)" 255 "0x0x000~0x0FF:0~255 (User selection)" 256 "0x100~0x1FF:0~255 (Expert Recommendation)" 511 "0x100~0x1FF:0~255 (Expert Recommendation)" 512 "Default" 1023 "Invalid" ;
VAL_ 278 CF_AVN_MdLpBttmBlueNvalueSet 0 "0x0x000~0x0FF:0~255 (User Selection)" 255 "0x0x000~0x0FF:0~255 (User Selection)" 256 "0x100~0x1FF:0~255 (Expert Recommendation)" 511 "0x100~0x1FF:0~255 (Expert Recommendation)" 512 "Default" 1023 "Invalid" ;
VAL_ 278 CF_AVN_MdLpSpdModNvalueSet 0 "Default" 1 "Off" 2 "On" 3 "Invalid" ;
VAL_ 278 CF_AVN_MdLpColorModNvalueSet 0 "Default" 1 "Single" 2 "Multi" 3 "Invalid" ;
VAL_ 278 CF_AVN_AIVoiceModNvalueSet 0 "Default" 1 "AI Voice Start" 2 "User Response" 3 "User No Response" 4 "Processing" 5 "AI Voice Response" 6 "AI Voice End" 7 "Invalid" ;
VAL_ 276 HU_USM_Crc4Val 0 "0x0x0~0xFFFF:CRCValue" 65535 "0x0x0~0xFFFF:CRCValue" ;
VAL_ 276 USM_CMSNgtBrgtnsLvlRHSetReq 0 "-5 Level" 1 "-4 Level" 2 "-3 Level" 3 "-2 Level" 4 "-1 Level" 5 "0 Level" 6 "1 Level" 7 "2 Level" 8 "3 Level" 9 "4 Level" 10 "5 Level" 11 "Not Used" 12 "Not Used" 13 "Not Used" 14 "Error Indicator" 15 "Invalid" ;
VAL_ 276 USM_CMSBrgtnsReset 0 "Default" 1 "Reset" 2 "Reserved" 3 "Invalid" ;
VAL_ 276 USM_TurnDistLnDispSetReq 0 "Default" 1 "Off" 2 "On" 3 "Invalid" ;
VAL_ 276 PCA_FrSd_NValueSet 0 "Default" 1 "Off" 2 "On" 3 "Invalid" ;
VAL_ 276 CF_AVN_1stRrStRmndNValueSet 0 "Default" 1 "Off" 2 "On" 3 "Invalid" ;
VAL_ 276 C_AllDrOpnNValueSet 0 "Default" 1 "Off" 2 "PSD Open" 3 "PSD PTG Open" 4 "Reserved" 5 "Reserved" 6 "Reserved" 7 "Invalid" ;
VAL_ 276 USM_RpmECOSet 0 "Default" 1 "Off" 2 "On(RPM Gauge Display)" 3 "Invalid" ;
VAL_ 276 VESS_ChgGuideMdLvl 0 "Default" 1 "Level 1(약하게)" 2 "Level 2(중간)" 3 "Level 3(강하게)" 4 "Reserved" 5 "Reserved" 6 "Off" 7 "Invalid" ;
VAL_ 276 Usm_RpmSPORTSet 0 "Default" 1 "Off" 2 "On(RPM Gauge Display)" 3 "Invalid" ;
VAL_ 276 Usm_RpmSPORTPLUSSet 0 "Default" 1 "Off" 2 "On(RPM Gauge Display)" 3 "Invalid" ;
VAL_ 276 Usm_RpmMUDSet 0 "Default" 1 "Off" 2 "On(RPM Gauge Display)" 3 "Invalid" ;
VAL_ 276 Usm_RpmSANDSet 0 "Default" 1 "Off" 2 "On(RPM Gauge Display)" 3 "Invalid" ;
VAL_ 276 HU_CustomNewMenuSet 0 "Default" 1 "MY Drive Mode (Custom)" 2 "Smart (Custom)" 3 "Baby (Custom)" 4 "Retro(Custom)" 5 "Snow(CUSTOM) - Not Terrain" 6 "Comfort(Rear) - Custom" 7 "Reserved" 8 "Reserved" 9 "Reserved" 10 "Reserved" 11 "Reserved" 12 "Reserved" 13 "Reserved" 14 "Off(Custom)" 15 "Invalid" ;
VAL_ 276 CF_AVN_PCA_RrEquipNvalueSet 0 "Default" 1 "Off" 2 "On" 3 "Invalid(Gray)" ;
VAL_ 276 CF_AVN_HtBlcRLNValueSet 0 "Default" 1 "Normal" 2 "Back 1" 3 "Back 2" 4 "Back 3" 5 "Cush 1" 6 "Cush 2" 7 "Cush 3" 8 "Reserved" 9 "Reserved" 10 "Reserved" 11 "Reserved" 12 "Reserved" 13 "Reserved" 14 "Reserved" 15 "Invalid" ;
VAL_ 276 CF_AVN_BRAKE_PedalfeelNValueSet2 0 "Default" 1 "Normal" 2 "Sport" 3 "Chauffeur" 4 "Reserved" 5 "Reserved" 6 "Reserved" 7 "Invalid" ;
VAL_ 276 CF_AVN_ISLA_AutoNModSet 0 "Default" 1 "Off" 2 "On" 3 "Invalid(Gray)" ;
VAL_ 276 CF_AVN_HtBlcRRNValueSet 0 "Default" 1 "Normal" 2 "Back 1" 3 "Back 2" 4 "Back 3" 5 "Cush 1" 6 "Cush 2" 7 "Cush 3" 8 "Reserved" 9 "Reserved" 10 "Reserved" 11 "Reserved" 12 "Reserved" 13 "Reserved" 14 "Reserved" 15 "Invalid" ;
VAL_ 276 LapTimer_AutoMeasure_Setting 0 "default" 1 "off" 2 "on (auto-measure)" 3 "invalid" ;
VAL_ 276 LapTimer_TimeGap_Setting 0 "default" 1 "compare with best lap" 2 "compare with last lap" 3 "invalid" ;
VAL_ 276 CF_AVN_RemoteWDWNValueSet 0 "Default" 1 "Disable (Off)" 2 "Enable (On)" 3 "Invalid" ;
VAL_ 276 HU_USM_AlvCnt4Val 0 "0x0x0~0xFF:AlvCntValue" 255 "0x0x0~0xFF:AlvCntValue" ;
VAL_ 276 USM_TowWeight_Set 0 "Default" 1 "Off" 2 "Auto" 3 "Small" 4 "Medium" 5 "Maximum" 6 "Reserved" 7 "Reserved" 8 "Reserved" 9 "Reserved" 10 "Reserved" 11 "Reserved" 12 "Reserved" 13 "Reserved" 14 "Reserved" 15 "Invalid" ;
VAL_ 276 CF_AVN_PABArbgNValueSet 0 "Default" 1 "PAB Off" 2 "PAB On" 3 "Invalid" ;
VAL_ 276 CF_AVN_SportHUD2 0 "Default" 1 "Off(Normal)" 2 "Sport HUD" 3 "Invalid" ;
VAL_ 276 C_SLB_SmartCtrl_Set_Nvalue 0 "Init" 1 "Off" 2 "10min" 3 "20min" 4 "30min" 5 "40min" 6 "50min" 7 "60min" 8 "Unused" 9 "Unused" 10 "Unused" 11 "Unused" 12 "Unused" 13 "Unused" 14 "Unused" 15 "Invalid" ;
VAL_ 276 USM_RpmComfortRearSet 0 "Default (Not configured)" 1 "Off" 2 "On (Display RPM guage)" 3 "Invalid" ;
VAL_ 276 Usm_RpmMyDriveModeSet 0 "Default" 1 "Off" 2 "On(RPM Gauge Display)" 3 "Invalid" ;
VAL_ 276 LapTimer_MeasuringStatus_HU 0 "Default" 1 "Start Lap Timer request" 2 "Stop/Reset Lap Timer request" 3 "RESERVED" 4 "RESERVED" 5 "RESERVED" 6 "RESERVED" 7 "Invalid" ;
VAL_ 276 CF_AVN_ADrLNValueSet_2 0 "Default" 1 "Off" 2 "Vehicle Speed On (15km/h)" 3 "Vehicle Speed On and Shift Lever On" 4 "Invalid" 5 "Reserved" 6 "Reserved" 7 "Reserved" ;
VAL_ 276 USM_PwrDrBuzzerNValueSet 0 "Default" 1 "Off" 2 "On" 3 "Invalid" ;
VAL_ 276 CF_AVN_FCA_FrOnOffEquipNvalueSet 0 "Default" 1 "Off" 2 "On" 3 "Invalid" ;
VAL_ 276 CF_AVN_FCA_WarnTimeNvalueSet 0 "Default" 1 "Late" 2 "Normal" 3 "Reserved" 4 "Reserved" 5 "Reserved" 6 "Reserved" 7 "Invalid" ;
VAL_ 276 CF_AVN_FCA_JC_OnOffEquipNvalueSe 0 "Default" 1 "Off" 2 "On" 3 "Invalid" ;
VAL_ 276 CF_AVN_FCA_FrSdOnOffEquipNvalueS 0 "Default" 1 "Off" 2 "On" 3 "Invalid" ;
VAL_ 276 CF_AVN_LKA_OnOffEquip2NvalueSet 0 "Default" 1 "Off" 2 "On" 3 "Invalid" ;
VAL_ 276 CF_AVN_BCA_OnOffEquip2NvalueSet 0 "Default" 1 "Off" 2 "On" 3 "Invalid" ;
VAL_ 276 CF_AVN_BVM_OnOffEquipNvalueSet 0 "Default" 1 "Off" 2 "On" 3 "Invalid" ;
VAL_ 276 CF_AVN_SEA_OnOffEquip3NvalueSet 0 "Default" 1 "Off" 2 "On" 3 "Invalid" ;
VAL_ 276 CF_AVN_BodySpprtSet_AST 0 "Default" 1 "Off" 2 "On" 3 "Invalid" ;
VAL_ 276 CF_AVN_SEW_OnOffEquip3NvalueSet 0 "Default" 1 "Off" 2 "On" 3 "Invalid" ;
VAL_ 276 CF_AVN_HudImsAutoSave 0 "Default" 1 "Off" 2 "On" 3 "Invalid" ;
VAL_ 276 CF_AVN_AirSptTimeNValueSet_AST 0 "Default" 1 "Short" 2 "Normal" 3 "Long" 4 "Reserved" 5 "Reserved" 6 "Reserved" 7 "Invalid" ;
VAL_ 276 CF_AVN_AirSptStrNValue_AST 0 "Default" 1 "Normal" 2 "Intense" 3 "Invalid" ;
VAL_ 276 CF_AVN_SeatDrvModNvalueSet_AST 0 "Default" 1 "Off" 2 "On" 3 "Invalid" ;
VAL_ 276 CF_AVN_TPMS_TireReplaceNValueSet 0 "Default" 1 "Off(Standard)" 2 "ON(SnowChain)" 3 "Reserved" 4 "Reserved" 5 "Reserved" 6 "Not Used(Gray)" 7 "Error Indicator" ;
VAL_ 276 CF_AVN_TowModeSet 0 "Default" 1 "Off" 2 "Small Weight" 3 "Medium Weight" 4 "Maximum Weight" 5 "Reserved" 6 "Reserved" 7 "Invalid" ;
VAL_ 276 USM_PwrDrCloseByBraekNValueSet 0 "Default" 1 "Off" 2 "On" 3 "Invalid" ;
VAL_ 276 AVN_BPCM_RL1_USMLevelReq 0 "Default" 1 "Custom1" 2 "Custom2" 3 "Custom3" 4 "Reserved" 5 "Reserved" 6 "Reserved" 7 "Invalid" ;
VAL_ 276 CF_AVN_ISLANAOffstNvalueSet 0 "Default" 1 "-10kph -10mph" 2 "-5kph -5mph" 3 "0kph 0mph" 4 "5kph 5mph" 5 "10kph 10mph" 6 "Reserved" 7 "Invalid" ;
VAL_ 276 CF_Gway_WPC2_NValueSet 0 "Default" 1 "Off (Disable)" 2 "On (Enable)" 3 "Invalid" ;
VAL_ 276 USM_DrvGhostDoorReq 0 "Default" 1 "Off" 2 "On" 3 "Invalid" ;
VAL_ 276 USM_AstGhostDoorReq 0 "Default" 1 "Off" 2 "On" 3 "Invalid" ;
VAL_ 276 USM_RLGhostDoorReq 0 "Default" 1 "Off" 2 "On" 3 "Invalid" ;
VAL_ 276 AVN_BPCM_RL2_USMLevelReq 0 "Default" 1 "Custom1" 2 "Custom2" 3 "Custom3" 4 "Reserved" 5 "Reserved" 6 "Reserved" 7 "Invalid" ;
VAL_ 276 AVN_BPCM_RL3_USMLevelReq 0 "Default" 1 "Custom1" 2 "Custom2" 3 "Custom3" 4 "Reserved" 5 "Reserved" 6 "Reserved" 7 "Invalid" ;
VAL_ 276 AVN_BPCM_RL4_USMLevelReq 0 "Default" 1 "Custom1" 2 "Custom2" 3 "Custom3" 4 "Reserved" 5 "Reserved" 6 "Reserved" 7 "Invalid" ;
VAL_ 276 AVN_BPCM_RR1_USMLevelReq 0 "Default" 1 "Custom1" 2 "Custom2" 3 "Custom3" 4 "Reserved" 5 "Reserved" 6 "Reserved" 7 "Invalid" ;
VAL_ 276 AVN_BPCM_RR2_USMLevelReq 0 "Default" 1 "Custom1" 2 "Custom2" 3 "Custom3" 4 "Reserved" 5 "Reserved" 6 "Reserved" 7 "Invalid" ;
VAL_ 276 AVN_BPCM_RR3_USMLevelReq 0 "Default" 1 "Custom1" 2 "Custom2" 3 "Custom3" 4 "Reserved" 5 "Reserved" 6 "Reserved" 7 "Invalid" ;
VAL_ 276 AVN_BPCM_RR4_USMLevelReq 0 "Default" 1 "Custom1" 2 "Custom2" 3 "Custom3" 4 "Reserved" 5 "Reserved" 6 "Reserved" 7 "Invalid" ;
VAL_ 276 USM_SmartRegen_Map_Set 0 "Default" 1 "Off(Disbaled)" 2 "On(Enabled)" 3 "Invalid" ;
VAL_ 276 USM_SmartRegen_Sens_Set 0 "Default" 1 "Slow" 2 "Normal" 3 "Fast" 4 "Reserved" 5 "Reserved" 6 "Reserved" 7 "Invalid" ;
VAL_ 276 AVN_SeatPosMemory_Btn 0 "Default" 1 "Memory 1" 2 "Memory 2" 3 "Memory 3" 4 "Reserved" 5 "Reserved" 6 "Reserved" 7 "Invalid" ;
VAL_ 276 AVN_SeatPosPlyBck_Btn 0 "Default" 1 "Memory 1" 2 "Memory 2" 3 "Memory 3" 4 "Reserved" 5 "Reserved" 6 "Stop" 7 "Invalid" ;
VAL_ 276 USM_RhstaLvlEnaSetReq 0 "Default" 1 "Off" 2 "On" 3 "Invalid" ;
VAL_ 276 USM_CMSDayBrgtnsLvlLHSetReq 0 "-5 Level" 1 "-4 Level" 2 "-3 Level" 3 "-2 Level" 4 "-1 Level" 5 "0 Level" 6 "1 Level" 7 "2 Level" 8 "3 Level" 9 "4 Level" 10 "5 Level" 11 "Not Used" 12 "Not Used" 13 "Not Used" 14 "Error Indicator" 15 "Invalid" ;
VAL_ 276 USM_CMSNgtBrgtnsLvlLHSetReq 0 "-5 Level" 1 "-4 Level" 2 "-3 Level" 3 "-2 Level" 4 "-1 Level" 5 "0 Level" 6 "1 Level" 7 "2 Level" 8 "3 Level" 9 "4 Level" 10 "5 Level" 11 "Not Used" 12 "Not Used" 13 "Not Used" 14 "Error Indicator" 15 "Invalid" ;
VAL_ 276 USM_CMSDayBrgtnsLvlRHSetReq 0 "-5 Level" 1 "-4 Level" 2 "-3 Level" 3 "-2 Level" 4 "-1 Level" 5 "0 Level" 6 "1 Level" 7 "2 Level" 8 "3 Level" 9 "4 Level" 10 "5 Level" 11 "Not Used" 12 "Not Used" 13 "Not Used" 14 "Error Indicator" 15 "Invalid" ;
