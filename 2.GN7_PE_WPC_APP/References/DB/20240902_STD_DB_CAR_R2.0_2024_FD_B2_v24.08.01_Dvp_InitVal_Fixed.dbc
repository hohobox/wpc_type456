VERSION ""

NS_ :

BS_:

BU_: ARS_FD SHVU_CCS_FD WPC_FD WPC2_FD SCM_FD SHVU_FRNT_FD GW_SAU_DRV_FD ATS_FD PSB_FD GW_PSU_RR_FD SHVU_RL_FD RWPC_FD CGW_CCU OHCL_FD SHVU_REAR_FD BLTN_CAM_FD GW_PSU_DRV_FD FCS_FD GW_PSU_AST_FD GW_PSU_3RD_FD RCS_FD SHVU_3RD_FD GW_PSU_RL_FD SHVU_RR_FD RCM_FD SGU_FD DCM_FD

BO_ 980 BDC_FD_05_200ms: 32 CGW_CCU
 SG_ BDC_FD_Crc5Val : 0|16@1+ (1,0) [0|0] ""  GW_PSU_DRV_FD
 SG_ AutoLt_HorRes_STD : 107|2@1+ (1,0) [0|0] ""  ATS_FD
 SG_ AutoLt_VerVal_STD : 109|11@1+ (1,0) [0|0] ""  ATS_FD
 SG_ AutoLt_VerRes_STD : 120|2@1+ (1,0) [0|0] ""  ATS_FD
 SG_ MoodLamp_SlvColor_X : 128|8@1+ (1,0) [0|0] "" Vector__XXX
 SG_ MoodLamp_SlvColor_Y : 136|8@1+ (1,0) [0|0] "" Vector__XXX
 SG_ MoodLamp_SlvBrgtnsVal : 144|8@1+ (1,0) [0|0] "" Vector__XXX
 SG_ MoodLamp_SlvFadeInTimetVal : 152|8@1+ (1,0) [0|0] "" Vector__XXX
 SG_ BDC_FD_AlvCnt5Val : 16|8@1+ (1,0) [0|0] ""  GW_PSU_DRV_FD
 SG_ MoodLamp_SlvFadeOutTimetVal : 160|8@1+ (1,0) [0|0] "" Vector__XXX
 SG_ Lamp_LftTrnLmpCmdSta : 168|2@1+ (1,0) [0|0] "" Vector__XXX
 SG_ Lamp_RtTrnLmpCmdSta : 170|2@1+ (1,0) [0|0] "" Vector__XXX
 SG_ Lamp_LftTrnLmpCmd : 172|2@1+ (1,0) [0|0] ""  BLTN_CAM_FD
 SG_ Lamp_RtTrnLmpCmd : 174|2@1+ (1,0) [0|0] ""  BLTN_CAM_FD
 SG_ Lamp_TrnLmpMode : 176|3@1+ (1,0) [0|0] "" Vector__XXX
 SG_ Lamp_HzrdSwIND : 182|2@1+ (1,0) [0|0] "" Vector__XXX
 SG_ Lamp_HdLmpEscortShortCmd : 184|2@1+ (1,0) [0|0] "" Vector__XXX
 SG_ Lamp_LightPopUpMsgType : 186|2@1+ (1,0) [0|0] "" Vector__XXX
 SG_ Lamp_LightPopUpReq : 188|2@1+ (1,0) [0|0] "" Vector__XXX
 SG_ Lamp_HdLmpLoOffPopUpReq : 190|2@1+ (1,0) [0|0] "" Vector__XXX
 SG_ MoodLamp_SpeechRecogPosSta : 192|3@1+ (1,0) [0|0] "" Vector__XXX
 SG_ MoodLamp_BttmSlvColor_X : 195|8@1+ (1,0) [0|0] "" Vector__XXX
 SG_ MoodLamp_BttmSlvColor_Y : 203|8@1+ (1,0) [0|0] "" Vector__XXX
 SG_ MoodLamp_BttmSlvBrgtnsVal : 211|8@1+ (1,0) [0|0] "" Vector__XXX
 SG_ MoodLamp_BttmSlvFadeInTimetVal : 219|8@1+ (1,0) [0|0] "" Vector__XXX
 SG_ MoodLamp_BttmSlvFadeOutTimetVal : 227|8@1+ (1,0) [0|0] "" Vector__XXX
 SG_ Lamp_FrontGroundLightOnReq : 235|2@1+ (1,0) [0|0] "" Vector__XXX
 SG_ Lamp_SideGroundLightOnReq : 237|2@1+ (1,0) [0|0] "" Vector__XXX
 SG_ Lamp_RearGroundLightOnReq : 239|2@1+ (1,0) [0|0] "" Vector__XXX
 SG_ Lamp_HiPrioHzrdReq : 24|3@1+ (1,0) [0|0] "" Vector__XXX
 SG_ Lamp_FrFogLmpEnable : 241|2@1+ (1,0) [0|0] "" Vector__XXX
 SG_ Lamp_RrFogLmpEnable : 243|2@1+ (1,0) [0|0] "" Vector__XXX
 SG_ Lamp_LoPrioHzrdReq : 27|3@1+ (1,0) [0|0] "" Vector__XXX
 SG_ Lamp_ExtrnlTailLmpOnReq : 30|2@1+ (1,0) [0|0] ""  BLTN_CAM_FD
 SG_ Lamp_HdLmpLoOnReq : 32|2@1+ (1,0) [0|0] "" Vector__XXX
 SG_ Lamp_HdLmpHiOnReq : 34|2@1+ (1,0) [0|0] "" Vector__XXX
 SG_ Lamp_DrlOnReq : 36|2@1+ (1,0) [0|0] "" Vector__XXX
 SG_ Lamp_BckUpLmpCmd : 38|2@1+ (1,0) [0|0] "" Vector__XXX
 SG_ Lamp_FrFogLmpOnReq : 40|2@1+ (1,0) [0|0] "" Vector__XXX
 SG_ Lamp_RrFogLmpOnReq : 42|2@1+ (1,0) [0|0] "" Vector__XXX
 SG_ Lamp_StcBendingLmpLftOnReq : 44|2@1+ (1,0) [0|0] "" Vector__XXX
 SG_ Lamp_StcBendingLmpRtOnReq : 46|2@1+ (1,0) [0|0] "" Vector__XXX
 SG_ Lamp_CornerLmpLftOnReq : 48|2@1+ (1,0) [0|0] "" Vector__XXX
 SG_ Lamp_CornerLmpRtOnReq : 50|2@1+ (1,0) [0|0] "" Vector__XXX
 SG_ Lamp_HbaCtrlModTyp : 52|2@1+ (1,0) [0|0] "" Vector__XXX
 SG_ Lamp_IFSCtrlModTyp : 54|2@1+ (1,0) [0|0] "" Vector__XXX
 SG_ Lamp_HdLmpWlcmCmd : 56|2@1+ (1,0) [0|0] "" Vector__XXX
 SG_ Lamp_PuddleLmpOnReq : 58|2@1+ (1,0) [0|0] "" Vector__XXX
 SG_ Lamp_ExtLampRSPAMode : 60|2@1+ (1,0) [0|0] "" Vector__XXX
 SG_ Lamp_IntTailLmpOnReq : 62|2@1+ (1,0) [0|0] ""  FCS_FD,GW_PSU_3RD_FD,GW_PSU_AST_FD,GW_PSU_DRV_FD,GW_PSU_RL_FD,GW_PSU_RR_FD,RWPC_FD,SHVU_3RD_FD,SHVU_FRNT_FD,SHVU_REAR_FD,SHVU_RL_FD,SHVU_RR_FD,WPC2_FD,WPC_FD
 SG_ Lamp_AvTailLmpSta : 64|2@1+ (1,0) [0|0] ""  ATS_FD,GW_PSU_AST_FD
 SG_ Lamp_AutoLtSnsrNightSta : 66|2@1+ (1,0) [0|0] ""  ATS_FD,GW_PSU_AST_FD,PSB_FD
 SG_ Lamp_VendorInfo : 68|3@1+ (1,0) [0|0] ""  ATS_FD
 SG_ Lamp_AutoLtSnsrHorVal : 72|10@1+ (1,0) [0|0] ""  ATS_FD
 SG_ MoodLamp_AIVoiceOptSta : 82|2@1+ (1,0) [0|0] "" Vector__XXX
 SG_ MoodLamp_DualColorOptSta : 84|2@1+ (1,0) [0|0] ""  ATS_FD
 SG_ MoodLamp_MdLmpFadeSta : 86|2@1+ (1,0) [0|0] "" Vector__XXX
 SG_ MoodLamp_NumRecommendColor : 88|4@1+ (1,0) [0|0] ""  ATS_FD
 SG_ AutoLt_HorVal_STD : 96|11@1+ (1,0) [0|0] ""  ATS_FD

BO_ 913 WPC_FD_01_200ms: 16 WPC_FD
 SG_ WPC_FD_Crc1Val : 0|16@1+ (1,0) [0|0] "" Vector__XXX
 SG_ WPC_IndSyncVal : 104|3@1+ (1,0) [0|0] ""  RWPC_FD,WPC2_FD
 SG_ USM_CmdWPCIndSta : 107|3@1+ (1,0) [0|0] ""  RWPC_FD,WPC2_FD,CGW_CCU
 SG_ WPC_ResetOpSta : 110|2@1+ (1,0) [0|0] "" Vector__XXX
 SG_ WPC_FD_AlvCnt1Val : 16|8@1+ (1,0) [0|0] "" Vector__XXX
 SG_ USM_CmdWPCSta : 64|2@1+ (1,0) [0|0] ""  CGW_CCU
 SG_ WPC_PhnLftWrngSta : 66|3@1+ (1,0) [0|0] ""  CGW_CCU
 SG_ WPC_DualWPCOptSta : 76|2@1+ (1,0) [0|0] ""  CGW_CCU
 SG_ WPC_SWVerMajor1 : 80|7@1+ (1,0) [0|0] ""  CGW_CCU
 SG_ WPC_SWVerMinor1 : 88|7@1+ (1,0) [0|0] ""  CGW_CCU
 SG_ WPC_SWVerMinor2 : 96|7@1+ (1,0) [0|0] ""  CGW_CCU

BO_ 426 CLU_01_20ms: 16 CGW_CCU
 SG_ CLU_Crc1Val : 0|16@1+ (1,0) [0|0] ""  ATS_FD,GW_PSU_DRV_FD,RCM_FD,SHVU_3RD_FD,SHVU_REAR_FD
 SG_ CLU_FuelSenderRstReq : 110|2@1+ (1,0) [0|0] "" Vector__XXX
 SG_ CLU_AlvCnt1Val : 16|8@1+ (1,0) [0|0] ""  ATS_FD,GW_PSU_DRV_FD,RCM_FD,SHVU_3RD_FD,SHVU_REAR_FD
 SG_ CLU_DtntOutSta : 28|2@1+ (1,0) [0|0] ""  ARS_FD,ATS_FD,FCS_FD,GW_PSU_3RD_FD,GW_PSU_AST_FD,GW_PSU_DRV_FD,GW_PSU_RL_FD,GW_PSU_RR_FD,GW_SAU_DRV_FD,OHCL_FD,RCS_FD,RWPC_FD,SHVU_3RD_FD,SHVU_FRNT_FD,SHVU_REAR_FD,SHVU_RL_FD,SHVU_RR_FD,WPC2_FD,WPC_FD
 SG_ CLU_SpdUnitTyp : 30|2@1+ (1,0) [0|0] ""  BLTN_CAM_FD,GW_PSU_DRV_FD,WPC2_FD
 SG_ CLU_DisSpdDcmlVal : 32|2@1+ (0.125,0) [0|0] "" Vector__XXX
 SG_ CLU_SWRCCrsMainSwSta : 34|2@1+ (1,0) [0|0] "" Vector__XXX
 SG_ CLU_SWRCCrsSwSta : 36|3@1+ (1,0) [0|0] "" Vector__XXX
 SG_ CLU_SWRCLFASwSta : 39|2@1+ (1,0) [0|0] "" Vector__XXX
 SG_ CLU_SWRCSldMainSwSta : 41|2@1+ (1,0) [0|0] "" Vector__XXX
 SG_ CLU_RhstaLvlSta : 43|5@1+ (1,0) [0|0] ""  ARS_FD,ATS_FD,FCS_FD,GW_PSU_3RD_FD,GW_PSU_AST_FD,GW_PSU_DRV_FD,GW_PSU_RL_FD,GW_PSU_RR_FD,GW_SAU_DRV_FD,OHCL_FD,RCS_FD,RWPC_FD,SHVU_3RD_FD,SHVU_FRNT_FD,SHVU_REAR_FD,SHVU_RL_FD,SHVU_RR_FD,WPC2_FD,WPC_FD
 SG_ CLU_DisSpdVal : 48|10@1+ (0.5,0) [0|0] "km/h or MPH"  BLTN_CAM_FD,GW_PSU_AST_FD,GW_PSU_DRV_FD,WPC2_FD
 SG_ CLU_OKSwSta : 62|2@1+ (1,0) [0|0] "" Vector__XXX
 SG_ CLU_DisSpdVal_KPH : 64|9@1+ (1,0) [0|0] "km/h"  ATS_FD,DCM_FD,GW_PSU_3RD_FD,GW_PSU_AST_FD,GW_PSU_DRV_FD,GW_PSU_RL_FD,GW_PSU_RR_FD,GW_SAU_DRV_FD,RCM_FD,RWPC_FD,SHVU_3RD_FD,SHVU_FRNT_FD,SHVU_REAR_FD,SHVU_RL_FD,SHVU_RR_FD,WPC2_FD,WPC_FD
 SG_ CLU_PwrAutoOffResetReq_HCU : 73|2@1+ (1,0) [0|0] "" Vector__XXX
 SG_ CLU_CUSTOMSta_NEW : 75|4@1+ (1,0) [0|0] "" Vector__XXX
 SG_ CLU_AutoBrightSta : 79|8@1+ (1,0) [0|0] ""  ATS_FD,BLTN_CAM_FD,FCS_FD,GW_PSU_3RD_FD,GW_PSU_AST_FD,GW_PSU_DRV_FD,GW_PSU_RL_FD,GW_PSU_RR_FD,GW_SAU_DRV_FD,OHCL_FD,RCS_FD,RWPC_FD,SHVU_3RD_FD,SHVU_FRNT_FD,SHVU_REAR_FD,SHVU_RL_FD,SHVU_RR_FD,WPC2_FD,WPC_FD
 SG_ CLU_NotMinModeBrightSta : 87|8@1+ (1,0) [0|0] "" Vector__XXX
 SG_ CLU_FuelSenderResistVal : 97|13@1+ (0.1,0) [0|0] "" Vector__XXX

BO_ 250 HCU_03_10ms: 32 CGW_CCU
 SG_ HCU_Crc3Val : 0|16@1+ (1,0) [0|0] ""  GW_PSU_DRV_FD
 SG_ HCU_SpdLimDeviceActSta : 100|2@1+ (1,0) [0|0] "" Vector__XXX
 SG_ HCU_SpdLimDeviceOperSta : 102|2@1+ (1,0) [0|0] "" Vector__XXX
 SG_ HCU_SpdLimDeviceVehSpdVal : 104|8@1+ (1,0) [0|0] "" Vector__XXX
 SG_ HCU_SrvModSta : 112|2@1+ (1,0) [0|0] "" Vector__XXX
 SG_ HCU_StrtInhbt2Sta : 114|2@1+ (1,0) [0|0] "" Vector__XXX
 SG_ HCU_StrtInhbtSta : 116|2@1+ (1,0) [0|0] "" Vector__XXX
 SG_ HCU_PdlRgnCmpnRear : 118|2@1+ (1,0) [0|0] "flag" Vector__XXX
 SG_ HCU_VehStrtEnblSta : 120|2@1+ (1,0) [0|0] "" Vector__XXX
 SG_ HCU_BrkLmpOnReq : 122|2@1+ (1,0) [0|0] "" Vector__XXX
 SG_ HCU_CcDrvAlrtDis : 124|2@1+ (1,0) [0|0] "" Vector__XXX
 SG_ HCU_SldDrvAlrtDis : 126|2@1+ (1,0) [0|0] "" Vector__XXX
 SG_ HCU_WhlCrpCrpTqNmVal : 128|16@1- (1,0) [0|0] "Nm" Vector__XXX
 SG_ LHCU_EngCltchTrnsfrTqPcVal_Copy_ : 144|10@1- (0.1953125,0) [0|0] "%" Vector__XXX
 SG_ HCU_RspaAlvCntVal : 154|2@1+ (1,0) [0|0] "Step" Vector__XXX
 SG_ HCU_RspaSta : 156|4@1+ (1,0) [0|0] "" Vector__XXX
 SG_ HCU_AlvCnt3Val : 16|8@1+ (1,0) [0|0] ""  GW_PSU_DRV_FD
 SG_ HCU_RspaCanFailSta : 160|2@1+ (1,0) [0|0] "" Vector__XXX
 SG_ HCU_PdlStopCtrlSta : 162|2@1+ (1,0) [0|0] "" Vector__XXX
 SG_ HCU_PdlRgnCmpn : 164|2@1+ (1,0) [0|0] "flag" Vector__XXX
 SG_ HCU_RForwardRq : 166|2@1+ (1,0) [0|0] "" Vector__XXX
 SG_ HCU_PdlStopReqTqNmVal : 168|16@1+ (1,0) [0|0] "Nm" Vector__XXX
 SG_ HCU_GearRInhbtSta : 184|2@1+ (1,0) [0|0] "" Vector__XXX
 SG_ HCU_GreenzoneDistinctGen : 186|4@1+ (1,0) [0|0] "" Vector__XXX
 SG_ HCU_Mg3SpdCmdVal : 192|14@1+ (1,0) [0|0] "rpm" Vector__XXX
 SG_ HCU_Mg3TqPcReq : 206|10@1- (0.1953125,0) [0|0] "%" Vector__XXX
 SG_ HCU_Mg3DisChrgTqCmdPcVal_FS : 216|10@1- (0.1953125,0) [0|0] "%" Vector__XXX
 SG_ HCU_Mg3ChrgTqCmdPcVal_FS : 226|10@1- (0.1953125,0) [0|0] "%" Vector__XXX
 SG_ HCU_11sMaxSpdLimOperSta : 236|2@1+ (1,0) [0|0] "" Vector__XXX
 SG_ HCU_DrvWhlDmndTqNmVal : 24|16@1- (1,0) [0|0] "Nm" Vector__XXX
 SG_ HCU_STAYModSta : 244|3@1+ (1,0) [0|0] "" Vector__XXX
 SG_ HCU_STAYModWarnSta : 247|3@1+ (1,0) [0|0] "" Vector__XXX
 SG_ HCU_STAYModReservationSta : 250|2@1+ (1,0) [0|0] "" Vector__XXX
 SG_ HCU_STAYModBattMngmntSta : 252|2@1+ (1,0) [0|0] "" Vector__XXX
 SG_ HCU_Mg3AntJrkInhbtReq : 40|2@1+ (1,0) [0|0] "" Vector__XXX
 SG_ HCU_Mg3CtrlModReq : 42|2@1+ (1,0) [0|0] "" Vector__XXX
 SG_ HCU_Mg3PwmOffInhbtSta : 44|2@1+ (1,0) [0|0] "" Vector__XXX
 SG_ HCU_Mg3PwrEnaSta : 46|2@1+ (1,0) [0|0] "" Vector__XXX
 SG_ HCU_EstAccelPdlPcVal : 51|8@1+ (0.390625,0) [0|0] "%" Vector__XXX
 SG_ HCU_EstApsSelSta : 59|2@1+ (1,0) [0|0] "" Vector__XXX
 SG_ HCU_GreenZoneDrvModSta : 61|2@1+ (1,0) [0|0] "" Vector__XXX
 SG_ HCU_GreenZoneLmpDis : 64|2@1+ (1,0) [0|0] "" Vector__XXX
 SG_ HCU_HcuRdySta : 66|2@1+ (1,0) [0|0] "" Vector__XXX
 SG_ HCU_HEVRdyDis : 68|2@1+ (1,0) [0|0] "" Vector__XXX
 SG_ HCU_HevRdySta : 70|2@1+ (1,0) [0|0] ""  BLTN_CAM_FD,GW_PSU_3RD_FD,GW_PSU_AST_FD,GW_PSU_DRV_FD,GW_PSU_RL_FD,GW_PSU_RR_FD,GW_SAU_DRV_FD,PSB_FD,RCM_FD,RWPC_FD,SCM_FD,SHVU_3RD_FD,SHVU_CCS_FD,SHVU_FRNT_FD,SHVU_REAR_FD,SHVU_RL_FD,SHVU_RR_FD,WPC2_FD,WPC_FD
 SG_ HCU_LimpOffSta : 72|2@1+ (1,0) [0|0] "" Vector__XXX
 SG_ HCU_MILOnReq : 74|2@1+ (1,0) [0|0] "" Vector__XXX
 SG_ HCU_PhevAutoModOnSta : 76|2@1+ (1,0) [0|0] "flag" Vector__XXX
 SG_ HCU_SccDrvOvrdReq : 78|2@1+ (1,0) [0|0] "" Vector__XXX
 SG_ HCU_SccEnblSta : 80|2@1+ (1,0) [0|0] "" Vector__XXX
 SG_ HCU_SlwDnSta : 82|2@1+ (1,0) [0|0] "" Vector__XXX
 SG_ HCU_SmrtEcoGdDis : 84|2@1+ (1,0) [0|0] "" Vector__XXX
 SG_ HCU_SmrtEcoLvlDis : 86|7@1+ (1,0) [0|0] "" Vector__XXX
 SG_ HCU_SmrtEcoRngDis : 93|7@1+ (1,0) [0|0] "" Vector__XXX

BO_ 53 VCU_01_10ms: 32 CGW_CCU
 SG_ VCU_Crc1Val : 0|16@1+ (1,0) [0|0] ""  GW_PSU_DRV_FD
 SG_ VCU_ScuKeepWakeReq : 110|2@1+ (1,0) [0|0] "flag" Vector__XXX
 SG_ VCU_MotTqCmdRearVal : 112|14@1- (0.125,0) [-1024|1023.875] "Nm" Vector__XXX
 SG_ VCU_FmcuZeroTqOfsReq : 126|2@1+ (1,0) [0|0] "flag" Vector__XXX
 SG_ VCU_EcmSeqSta : 128|8@1+ (1,0) [0|255] "" Vector__XXX
 SG_ VCU_EcmDiagSta : 136|8@1+ (1,0) [0|255] "" Vector__XXX
 SG_ VCU_CltActDiagSta : 144|8@1+ (1,0) [0|255] "" Vector__XXX
 SG_ VCU_CltActDrvCrntVal : 152|12@1- (0.025,0) [-51.2|51.175] "A" Vector__XXX
 SG_ VCU_AlvCnt1Val : 16|8@1+ (1,0) [0|0] ""  GW_PSU_DRV_FD
 SG_ VCU_CltActPosStrokeVal : 164|12@1- (0.0125,0) [-25.6|25.5875] "mm" Vector__XXX
 SG_ VCU_MainBattTypeSta : 176|2@1+ (1,0) [0|3] "" Vector__XXX
 SG_ VCU_MainBattTypeLrnSta : 178|2@1+ (1,0) [0|3] "" Vector__XXX
 SG_ VCU_WarmupCycSta : 180|2@1+ (1,0) [0|3] "" Vector__XXX
 SG_ VCU_FatcPermPwrVal : 182|10@1+ (20,0) [0|12700] "W" Vector__XXX
 SG_ VCU_GearPosStaDisp : 192|4@1+ (1,0) [0|0] ""  BLTN_CAM_FD,FCS_FD,DCM_FD
 SG_ VCU_PdlStopCtrlSta : 196|2@1+ (1,0) [0|0] "" Vector__XXX
 SG_ VCU_PdlStopReqTqNmVal : 198|16@1+ (1,0) [0|0] "" Vector__XXX
 SG_ VCU_PMPDActSta : 214|2@1+ (1,0) [0|0] "" Vector__XXX
 SG_ VCU_PMPDWarnSta : 216|2@1+ (1,0) [0|0] "" Vector__XXX
 SG_ VCU_VgsVirSoundBackFireIndex : 218|5@1+ (1,0) [0|0] "" Vector__XXX
 SG_ VCU_VgsVirEngSpdRpmVal : 224|16@1- (1,0) [0|0] ""  BLTN_CAM_FD
 SG_ VCU_RdySta : 24|2@1+ (1,0) [0|3] "" Vector__XXX
 SG_ VCU_VgsVirSoundVolume : 240|8@1+ (0.392156863,0) [0|0] "" Vector__XXX
 SG_ VCU_VgsVirGearStep : 248|4@1+ (1,0) [0|0] ""  BLTN_CAM_FD
 SG_ VCU_StandbyModSta : 252|2@1+ (1,0) [0|0] "" Vector__XXX
 SG_ VCU_HVIntLkDischrgReq : 254|2@1+ (1,0) [0|0] "" Vector__XXX
 SG_ VCU_StartKeyHoldSta : 26|2@1+ (1,0) [0|3] "" Vector__XXX
 SG_ VCU_EvDrvRdySta : 28|2@1+ (1,0) [0|3] ""  BLTN_CAM_FD,FCS_FD,GW_PSU_3RD_FD,GW_PSU_AST_FD,GW_PSU_DRV_FD,GW_PSU_RL_FD,GW_PSU_RR_FD,GW_SAU_DRV_FD,PSB_FD,RCM_FD,RWPC_FD,SCM_FD,SGU_FD,SHVU_3RD_FD,SHVU_CCS_FD,SHVU_FRNT_FD,SHVU_REAR_FD,SHVU_RL_FD,SHVU_RR_FD,WPC2_FD,WPC_FD
 SG_ VCU_MotPwrEnReq : 30|2@1+ (1,0) [0|3] "" Vector__XXX
 SG_ VCU_GearPosSta : 32|4@1+ (1,0) [0|15] ""  BLTN_CAM_FD,DCM_FD,GW_PSU_3RD_FD,GW_PSU_AST_FD,GW_PSU_DRV_FD,GW_PSU_RL_FD,GW_PSU_RR_FD,SGU_FD,WPC2_FD
 SG_ VCU_LdcInhReq : 36|2@1+ (1,0) [0|3] "" Vector__XXX
 SG_ VCU_MainRlyOffReq : 38|2@1+ (1,0) [0|3] "" Vector__XXX
 SG_ VCU_AccPedDepVal : 40|8@1+ (0.3921568627,0) [0|100] "%"  BLTN_CAM_FD
 SG_ VCU_FatcOperPermSta : 48|2@1+ (1,0) [0|3] "" Vector__XXX
 SG_ VCU_DrvCycSta : 50|2@1+ (1,0) [0|3] "" Vector__XXX
 SG_ VCU_CltActOpSta : 52|4@1+ (1,0) [0|15] "" Vector__XXX
 SG_ VCU_WhlSpdSnsrAlvReq : 56|2@1+ (1,0) [0|0] "flag" Vector__XXX
 SG_ VCU_DrvModOpSta : 58|4@1+ (1,0) [0|0] "" Vector__XXX
 SG_ VCU_HydBrkFcHoldRq : 62|2@1+ (1,0) [0|0] "" Vector__XXX
 SG_ VCU_FatcPwrUseVal : 64|8@1+ (10,0) [0|2550] "W" Vector__XXX
 SG_ VCU_WhlDemTqVal : 72|16@1- (1,0) [-32768|32767] "Nm" Vector__XXX
 SG_ VCU_McuAntiJerkInhFrntSta : 88|2@1+ (1,0) [0|3] "" Vector__XXX
 SG_ VCU_McuAntiJerkInhRearSta : 90|2@1+ (1,0) [0|3] "" Vector__XXX
 SG_ VCU_McuPwrLatchHoldReq : 92|2@1+ (1,0) [0|0] "" Vector__XXX
 SG_ VCU_ScuParkReq : 94|2@1+ (1,0) [0|0] "flag" Vector__XXX
 SG_ VCU_MotTqCmdFrntVal : 96|14@1- (0.125,0) [-1024|1023.875] "Nm" Vector__XXX

BO_ 543 WPC_FD_VCRM_01_00ms: 16 WPC_FD
 SG_ WPC_FD_VCRM_Crc1Val : 0|16@1+ (1,0) [0|0] "" Vector__XXX
 SG_ WPC_FD_VCRM_AlvCnt1Val : 16|8@1+ (1,0) [0|0] "" Vector__XXX
 SG_ WPC_PhnUsingTime : 24|8@1+ (1,0) [0|0] "Min" Vector__XXX
 SG_ WPC_PhnChargingCompleteCnt : 32|4@1+ (1,0) [0|0] "" Vector__XXX
 SG_ WPC_EPPChargingCnt : 36|4@1+ (1,0) [0|0] "" Vector__XXX
 SG_ WPC_MPPChargingCnt : 40|4@1+ (1,0) [0|0] "" Vector__XXX
 SG_ WPC_DigitalKeyAuth : 44|1@1+ (1,0) [0|0] "" Vector__XXX
 SG_ WPC_DigitalKeyDevice : 45|3@1+ (1,0) [0|0] "" Vector__XXX
 SG_ WPC_PhnChargingErrCnt : 48|6@1+ (1,0) [0|0] "" Vector__XXX
 SG_ WPC_ThermalSnsrMaxTemp : 54|8@1+ (1,0) [0|0] "" Vector__XXX
 SG_ WPC_CANBusOffDTC : 62|2@1+ (1,0) [0|0] "" Vector__XXX
 SG_ WPC_LocalCANBusOffDTC : 64|2@1+ (1,0) [0|0] "" Vector__XXX
 SG_ WPC_TempSnsrFltDTC : 66|2@1+ (1,0) [0|0] "" Vector__XXX
 SG_ WPC_FANFltDTC : 68|2@1+ (1,0) [0|0] "" Vector__XXX
 SG_ WPC_InternalECUErrDTC : 70|2@1+ (1,0) [0|0] "" Vector__XXX

BO_ 2549874826 NM_ARS_FD: 32 ARS_FD
 SG_ SNI_ARS_FD : 0|8@1+ (1,0) [0|0] ""  ATS_FD,BLTN_CAM_FD,CGW_CCU,DCM_FD,FCS_FD,GW_PSU_3RD_FD,GW_PSU_AST_FD,GW_PSU_DRV_FD,GW_PSU_RL_FD,GW_PSU_RR_FD,GW_SAU_DRV_FD,OHCL_FD,PSB_FD,RCM_FD,RCS_FD,RWPC_FD,SCM_FD,SGU_FD,SHVU_3RD_FD,SHVU_CCS_FD,SHVU_FRNT_FD,SHVU_REAR_FD,SHVU_RL_FD,SHVU_RR_FD,WPC2_FD,WPC_FD
 SG_ CBV_RMR_ARS_FD : 8|1@1+ (1,0) [0|0] ""  ATS_FD,BLTN_CAM_FD,CGW_CCU,DCM_FD,FCS_FD,GW_PSU_3RD_FD,GW_PSU_AST_FD,GW_PSU_DRV_FD,GW_PSU_RL_FD,GW_PSU_RR_FD,GW_SAU_DRV_FD,OHCL_FD,PSB_FD,RCM_FD,RCS_FD,RWPC_FD,SCM_FD,SGU_FD,SHVU_3RD_FD,SHVU_CCS_FD,SHVU_FRNT_FD,SHVU_REAR_FD,SHVU_RL_FD,SHVU_RR_FD,WPC2_FD,WPC_FD
 SG_ CBV_NMCoID_ARS_FD : 9|2@1+ (1,0) [0|0] ""  ATS_FD,BLTN_CAM_FD,CGW_CCU,DCM_FD,FCS_FD,GW_PSU_3RD_FD,GW_PSU_AST_FD,GW_PSU_DRV_FD,GW_PSU_RL_FD,GW_PSU_RR_FD,GW_SAU_DRV_FD,OHCL_FD,PSB_FD,RCM_FD,RCS_FD,RWPC_FD,SCM_FD,SGU_FD,SHVU_3RD_FD,SHVU_CCS_FD,SHVU_FRNT_FD,SHVU_REAR_FD,SHVU_RL_FD,SHVU_RR_FD,WPC2_FD,WPC_FD
 SG_ CBV_NMCoSRB_ARS_FD : 11|1@1+ (1,0) [0|0] ""  ATS_FD,BLTN_CAM_FD,CGW_CCU,DCM_FD,FCS_FD,GW_PSU_3RD_FD,GW_PSU_AST_FD,GW_PSU_DRV_FD,GW_PSU_RL_FD,GW_PSU_RR_FD,GW_SAU_DRV_FD,OHCL_FD,PSB_FD,RCM_FD,RCS_FD,RWPC_FD,SCM_FD,SGU_FD,SHVU_3RD_FD,SHVU_CCS_FD,SHVU_FRNT_FD,SHVU_REAR_FD,SHVU_RL_FD,SHVU_RR_FD,WPC2_FD,WPC_FD
 SG_ CBV_AWB_ARS_FD : 12|1@1+ (1,0) [0|0] ""  ATS_FD,BLTN_CAM_FD,CGW_CCU,DCM_FD,FCS_FD,GW_PSU_3RD_FD,GW_PSU_AST_FD,GW_PSU_DRV_FD,GW_PSU_RL_FD,GW_PSU_RR_FD,GW_SAU_DRV_FD,OHCL_FD,PSB_FD,RCM_FD,RCS_FD,RWPC_FD,SCM_FD,SGU_FD,SHVU_3RD_FD,SHVU_CCS_FD,SHVU_FRNT_FD,SHVU_REAR_FD,SHVU_RL_FD,SHVU_RR_FD,WPC2_FD,WPC_FD
 SG_ CBV_PNIB_ARS_FD : 14|1@1+ (1,0) [0|0] ""  ATS_FD,BLTN_CAM_FD,CGW_CCU,DCM_FD,FCS_FD,GW_PSU_3RD_FD,GW_PSU_AST_FD,GW_PSU_DRV_FD,GW_PSU_RL_FD,GW_PSU_RR_FD,GW_SAU_DRV_FD,OHCL_FD,PSB_FD,RCM_FD,RCS_FD,RWPC_FD,SCM_FD,SGU_FD,SHVU_3RD_FD,SHVU_CCS_FD,SHVU_FRNT_FD,SHVU_REAR_FD,SHVU_RL_FD,SHVU_RR_FD,WPC2_FD,WPC_FD
 SG_ NRR_ARS_FD : 16|8@1+ (1,0) [0|0] ""  ATS_FD,BLTN_CAM_FD,CGW_CCU,DCM_FD,FCS_FD,GW_PSU_3RD_FD,GW_PSU_AST_FD,GW_PSU_DRV_FD,GW_PSU_RL_FD,GW_PSU_RR_FD,GW_SAU_DRV_FD,OHCL_FD,PSB_FD,RCM_FD,RCS_FD,RWPC_FD,SCM_FD,SGU_FD,SHVU_3RD_FD,SHVU_CCS_FD,SHVU_FRNT_FD,SHVU_REAR_FD,SHVU_RL_FD,SHVU_RR_FD,WPC2_FD,WPC_FD
 SG_ NM_State_ARS_FD : 24|8@1+ (1,0) [0|0] ""  ATS_FD,BLTN_CAM_FD,CGW_CCU,DCM_FD,FCS_FD,GW_PSU_3RD_FD,GW_PSU_AST_FD,GW_PSU_DRV_FD,GW_PSU_RL_FD,GW_PSU_RR_FD,GW_SAU_DRV_FD,OHCL_FD,PSB_FD,RCM_FD,RCS_FD,RWPC_FD,SCM_FD,SGU_FD,SHVU_3RD_FD,SHVU_CCS_FD,SHVU_FRNT_FD,SHVU_REAR_FD,SHVU_RL_FD,SHVU_RR_FD,WPC2_FD,WPC_FD
 SG_ PNI_ARS_FD : 32|32@1+ (1,0) [0|0] ""  ATS_FD,BLTN_CAM_FD,CGW_CCU,DCM_FD,FCS_FD,GW_PSU_3RD_FD,GW_PSU_AST_FD,GW_PSU_DRV_FD,GW_PSU_RL_FD,GW_PSU_RR_FD,GW_SAU_DRV_FD,OHCL_FD,PSB_FD,RCM_FD,RCS_FD,RWPC_FD,SCM_FD,SGU_FD,SHVU_3RD_FD,SHVU_CCS_FD,SHVU_FRNT_FD,SHVU_REAR_FD,SHVU_RL_FD,SHVU_RR_FD,WPC2_FD,WPC_FD
 SG_ PNI_ARS_FD_1 : 64|64@1+ (1,0) [0|0] ""  ATS_FD,BLTN_CAM_FD,CGW_CCU,DCM_FD,FCS_FD,GW_PSU_3RD_FD,GW_PSU_AST_FD,GW_PSU_DRV_FD,GW_PSU_RL_FD,GW_PSU_RR_FD,GW_SAU_DRV_FD,OHCL_FD,PSB_FD,RCM_FD,RCS_FD,RWPC_FD,SCM_FD,SGU_FD,SHVU_3RD_FD,SHVU_CCS_FD,SHVU_FRNT_FD,SHVU_REAR_FD,SHVU_RL_FD,SHVU_RR_FD,WPC2_FD,WPC_FD
 SG_ PNI_ARS_FD_2 : 128|64@1+ (1,0) [0|0] ""  ATS_FD,BLTN_CAM_FD,CGW_CCU,DCM_FD,FCS_FD,GW_PSU_3RD_FD,GW_PSU_AST_FD,GW_PSU_DRV_FD,GW_PSU_RL_FD,GW_PSU_RR_FD,GW_SAU_DRV_FD,OHCL_FD,PSB_FD,RCM_FD,RCS_FD,RWPC_FD,SCM_FD,SGU_FD,SHVU_3RD_FD,SHVU_CCS_FD,SHVU_FRNT_FD,SHVU_REAR_FD,SHVU_RL_FD,SHVU_RR_FD,WPC2_FD,WPC_FD
 SG_ PNI_ARS_FD_3 : 192|64@1+ (1,0) [0|0] ""  ATS_FD,BLTN_CAM_FD,CGW_CCU,DCM_FD,FCS_FD,GW_PSU_3RD_FD,GW_PSU_AST_FD,GW_PSU_DRV_FD,GW_PSU_RL_FD,GW_PSU_RR_FD,GW_SAU_DRV_FD,OHCL_FD,PSB_FD,RCM_FD,RCS_FD,RWPC_FD,SCM_FD,SGU_FD,SHVU_3RD_FD,SHVU_CCS_FD,SHVU_FRNT_FD,SHVU_REAR_FD,SHVU_RL_FD,SHVU_RR_FD,WPC2_FD,WPC_FD

BO_ 2549874789 NM_SHVU_CCS_FD: 32 SHVU_CCS_FD
 SG_ SNI_SHVU_CCS_FD : 0|8@1+ (1,0) [0|0] ""  ARS_FD,ATS_FD,BLTN_CAM_FD,CGW_CCU,DCM_FD,FCS_FD,GW_PSU_3RD_FD,GW_PSU_AST_FD,GW_PSU_DRV_FD,GW_PSU_RL_FD,GW_PSU_RR_FD,GW_SAU_DRV_FD,OHCL_FD,PSB_FD,RCM_FD,RCS_FD,RWPC_FD,SCM_FD,SGU_FD,SHVU_3RD_FD,SHVU_FRNT_FD,SHVU_REAR_FD,SHVU_RL_FD,SHVU_RR_FD,WPC2_FD,WPC_FD
 SG_ CBV_RMR_SHVU_CCS_FD : 8|1@1+ (1,0) [0|0] ""  ARS_FD,ATS_FD,BLTN_CAM_FD,CGW_CCU,DCM_FD,FCS_FD,GW_PSU_3RD_FD,GW_PSU_AST_FD,GW_PSU_DRV_FD,GW_PSU_RL_FD,GW_PSU_RR_FD,GW_SAU_DRV_FD,OHCL_FD,PSB_FD,RCM_FD,RCS_FD,RWPC_FD,SCM_FD,SGU_FD,SHVU_3RD_FD,SHVU_FRNT_FD,SHVU_REAR_FD,SHVU_RL_FD,SHVU_RR_FD,WPC2_FD,WPC_FD
 SG_ CBV_NMCoID_SHVU_CCS_FD : 9|2@1+ (1,0) [0|0] ""  ARS_FD,ATS_FD,BLTN_CAM_FD,CGW_CCU,DCM_FD,FCS_FD,GW_PSU_3RD_FD,GW_PSU_AST_FD,GW_PSU_DRV_FD,GW_PSU_RL_FD,GW_PSU_RR_FD,GW_SAU_DRV_FD,OHCL_FD,PSB_FD,RCM_FD,RCS_FD,RWPC_FD,SCM_FD,SGU_FD,SHVU_3RD_FD,SHVU_FRNT_FD,SHVU_REAR_FD,SHVU_RL_FD,SHVU_RR_FD,WPC2_FD,WPC_FD
 SG_ CBV_NMCoSRB_SHVU_CCS_FD : 11|1@1+ (1,0) [0|0] ""  ARS_FD,ATS_FD,BLTN_CAM_FD,CGW_CCU,DCM_FD,FCS_FD,GW_PSU_3RD_FD,GW_PSU_AST_FD,GW_PSU_DRV_FD,GW_PSU_RL_FD,GW_PSU_RR_FD,GW_SAU_DRV_FD,OHCL_FD,PSB_FD,RCM_FD,RCS_FD,RWPC_FD,SCM_FD,SGU_FD,SHVU_3RD_FD,SHVU_FRNT_FD,SHVU_REAR_FD,SHVU_RL_FD,SHVU_RR_FD,WPC2_FD,WPC_FD
 SG_ CBV_AWB_SHVU_CCS_FD : 12|1@1+ (1,0) [0|0] ""  ARS_FD,ATS_FD,BLTN_CAM_FD,CGW_CCU,DCM_FD,FCS_FD,GW_PSU_3RD_FD,GW_PSU_AST_FD,GW_PSU_DRV_FD,GW_PSU_RL_FD,GW_PSU_RR_FD,GW_SAU_DRV_FD,OHCL_FD,PSB_FD,RCM_FD,RCS_FD,RWPC_FD,SCM_FD,SGU_FD,SHVU_3RD_FD,SHVU_FRNT_FD,SHVU_REAR_FD,SHVU_RL_FD,SHVU_RR_FD,WPC2_FD,WPC_FD
 SG_ CBV_PNIB_SHVU_CCS_FD : 14|1@1+ (1,0) [0|0] ""  ARS_FD,ATS_FD,BLTN_CAM_FD,CGW_CCU,DCM_FD,FCS_FD,GW_PSU_3RD_FD,GW_PSU_AST_FD,GW_PSU_DRV_FD,GW_PSU_RL_FD,GW_PSU_RR_FD,GW_SAU_DRV_FD,OHCL_FD,PSB_FD,RCM_FD,RCS_FD,RWPC_FD,SCM_FD,SGU_FD,SHVU_3RD_FD,SHVU_FRNT_FD,SHVU_REAR_FD,SHVU_RL_FD,SHVU_RR_FD,WPC2_FD,WPC_FD
 SG_ NRR_SHVU_CCS_FD : 16|8@1+ (1,0) [0|0] ""  ARS_FD,ATS_FD,BLTN_CAM_FD,CGW_CCU,DCM_FD,FCS_FD,GW_PSU_3RD_FD,GW_PSU_AST_FD,GW_PSU_DRV_FD,GW_PSU_RL_FD,GW_PSU_RR_FD,GW_SAU_DRV_FD,OHCL_FD,PSB_FD,RCM_FD,RCS_FD,RWPC_FD,SCM_FD,SGU_FD,SHVU_3RD_FD,SHVU_FRNT_FD,SHVU_REAR_FD,SHVU_RL_FD,SHVU_RR_FD,WPC2_FD,WPC_FD
 SG_ NM_State_SHVU_CCS_FD : 24|8@1+ (1,0) [0|0] ""  ARS_FD,ATS_FD,BLTN_CAM_FD,CGW_CCU,DCM_FD,FCS_FD,GW_PSU_3RD_FD,GW_PSU_AST_FD,GW_PSU_DRV_FD,GW_PSU_RL_FD,GW_PSU_RR_FD,GW_SAU_DRV_FD,OHCL_FD,PSB_FD,RCM_FD,RCS_FD,RWPC_FD,SCM_FD,SGU_FD,SHVU_3RD_FD,SHVU_FRNT_FD,SHVU_REAR_FD,SHVU_RL_FD,SHVU_RR_FD,WPC2_FD,WPC_FD
 SG_ PNI_SHVU_CCS_FD : 32|32@1+ (1,0) [0|0] ""  ARS_FD,ATS_FD,BLTN_CAM_FD,CGW_CCU,DCM_FD,FCS_FD,GW_PSU_3RD_FD,GW_PSU_AST_FD,GW_PSU_DRV_FD,GW_PSU_RL_FD,GW_PSU_RR_FD,GW_SAU_DRV_FD,OHCL_FD,PSB_FD,RCM_FD,RCS_FD,RWPC_FD,SCM_FD,SGU_FD,SHVU_3RD_FD,SHVU_FRNT_FD,SHVU_REAR_FD,SHVU_RL_FD,SHVU_RR_FD,WPC2_FD,WPC_FD
 SG_ PNI_SHVU_CCS_FD_1 : 64|64@1+ (1,0) [0|0] ""  ARS_FD,ATS_FD,BLTN_CAM_FD,CGW_CCU,DCM_FD,FCS_FD,GW_PSU_3RD_FD,GW_PSU_AST_FD,GW_PSU_DRV_FD,GW_PSU_RL_FD,GW_PSU_RR_FD,GW_SAU_DRV_FD,OHCL_FD,PSB_FD,RCM_FD,RCS_FD,RWPC_FD,SCM_FD,SGU_FD,SHVU_3RD_FD,SHVU_FRNT_FD,SHVU_REAR_FD,SHVU_RL_FD,SHVU_RR_FD,WPC2_FD,WPC_FD
 SG_ PNI_SHVU_CCS_FD_2 : 128|64@1+ (1,0) [0|0] ""  ARS_FD,ATS_FD,BLTN_CAM_FD,CGW_CCU,DCM_FD,FCS_FD,GW_PSU_3RD_FD,GW_PSU_AST_FD,GW_PSU_DRV_FD,GW_PSU_RL_FD,GW_PSU_RR_FD,GW_SAU_DRV_FD,OHCL_FD,PSB_FD,RCM_FD,RCS_FD,RWPC_FD,SCM_FD,SGU_FD,SHVU_3RD_FD,SHVU_FRNT_FD,SHVU_REAR_FD,SHVU_RL_FD,SHVU_RR_FD,WPC2_FD,WPC_FD
 SG_ PNI_SHVU_CCS_FD_3 : 192|64@1+ (1,0) [0|0] ""  ARS_FD,ATS_FD,BLTN_CAM_FD,CGW_CCU,DCM_FD,FCS_FD,GW_PSU_3RD_FD,GW_PSU_AST_FD,GW_PSU_DRV_FD,GW_PSU_RL_FD,GW_PSU_RR_FD,GW_SAU_DRV_FD,OHCL_FD,PSB_FD,RCM_FD,RCS_FD,RWPC_FD,SCM_FD,SGU_FD,SHVU_3RD_FD,SHVU_FRNT_FD,SHVU_REAR_FD,SHVU_RL_FD,SHVU_RR_FD,WPC2_FD,WPC_FD

BO_ 2549874846 NM_WPC_FD: 32 WPC_FD
 SG_ SNI_WPC_FD : 0|8@1+ (1,0) [0|0] ""  ARS_FD,ATS_FD,BLTN_CAM_FD,CGW_CCU,DCM_FD,FCS_FD,GW_PSU_3RD_FD,GW_PSU_AST_FD,GW_PSU_DRV_FD,GW_PSU_RL_FD,GW_PSU_RR_FD,GW_SAU_DRV_FD,OHCL_FD,PSB_FD,RCM_FD,RCS_FD,RWPC_FD,SCM_FD,SGU_FD,SHVU_3RD_FD,SHVU_CCS_FD,SHVU_FRNT_FD,SHVU_REAR_FD,SHVU_RL_FD,SHVU_RR_FD,WPC2_FD
 SG_ CBV_RMR_WPC_FD : 8|1@1+ (1,0) [0|0] ""  ARS_FD,ATS_FD,BLTN_CAM_FD,CGW_CCU,DCM_FD,FCS_FD,GW_PSU_3RD_FD,GW_PSU_AST_FD,GW_PSU_DRV_FD,GW_PSU_RL_FD,GW_PSU_RR_FD,GW_SAU_DRV_FD,OHCL_FD,PSB_FD,RCM_FD,RCS_FD,RWPC_FD,SCM_FD,SGU_FD,SHVU_3RD_FD,SHVU_CCS_FD,SHVU_FRNT_FD,SHVU_REAR_FD,SHVU_RL_FD,SHVU_RR_FD,WPC2_FD
 SG_ CBV_NMCoID_WPC_FD : 9|2@1+ (1,0) [0|0] ""  ARS_FD,ATS_FD,BLTN_CAM_FD,CGW_CCU,DCM_FD,FCS_FD,GW_PSU_3RD_FD,GW_PSU_AST_FD,GW_PSU_DRV_FD,GW_PSU_RL_FD,GW_PSU_RR_FD,GW_SAU_DRV_FD,OHCL_FD,PSB_FD,RCM_FD,RCS_FD,RWPC_FD,SCM_FD,SGU_FD,SHVU_3RD_FD,SHVU_CCS_FD,SHVU_FRNT_FD,SHVU_REAR_FD,SHVU_RL_FD,SHVU_RR_FD,WPC2_FD
 SG_ CBV_NMCoSRB_WPC_FD : 11|1@1+ (1,0) [0|0] ""  ARS_FD,ATS_FD,BLTN_CAM_FD,CGW_CCU,DCM_FD,FCS_FD,GW_PSU_3RD_FD,GW_PSU_AST_FD,GW_PSU_DRV_FD,GW_PSU_RL_FD,GW_PSU_RR_FD,GW_SAU_DRV_FD,OHCL_FD,PSB_FD,RCM_FD,RCS_FD,RWPC_FD,SCM_FD,SGU_FD,SHVU_3RD_FD,SHVU_CCS_FD,SHVU_FRNT_FD,SHVU_REAR_FD,SHVU_RL_FD,SHVU_RR_FD,WPC2_FD
 SG_ CBV_AWB_WPC_FD : 12|1@1+ (1,0) [0|0] ""  ARS_FD,ATS_FD,BLTN_CAM_FD,CGW_CCU,DCM_FD,FCS_FD,GW_PSU_3RD_FD,GW_PSU_AST_FD,GW_PSU_DRV_FD,GW_PSU_RL_FD,GW_PSU_RR_FD,GW_SAU_DRV_FD,OHCL_FD,PSB_FD,RCM_FD,RCS_FD,RWPC_FD,SCM_FD,SGU_FD,SHVU_3RD_FD,SHVU_CCS_FD,SHVU_FRNT_FD,SHVU_REAR_FD,SHVU_RL_FD,SHVU_RR_FD,WPC2_FD
 SG_ CBV_PNIB_WPC_FD : 14|1@1+ (1,0) [0|0] ""  ARS_FD,ATS_FD,BLTN_CAM_FD,CGW_CCU,DCM_FD,FCS_FD,GW_PSU_3RD_FD,GW_PSU_AST_FD,GW_PSU_DRV_FD,GW_PSU_RL_FD,GW_PSU_RR_FD,GW_SAU_DRV_FD,OHCL_FD,PSB_FD,RCM_FD,RCS_FD,RWPC_FD,SCM_FD,SGU_FD,SHVU_3RD_FD,SHVU_CCS_FD,SHVU_FRNT_FD,SHVU_REAR_FD,SHVU_RL_FD,SHVU_RR_FD,WPC2_FD
 SG_ NRR_WPC_FD : 16|8@1+ (1,0) [0|0] ""  ARS_FD,ATS_FD,BLTN_CAM_FD,CGW_CCU,DCM_FD,FCS_FD,GW_PSU_3RD_FD,GW_PSU_AST_FD,GW_PSU_DRV_FD,GW_PSU_RL_FD,GW_PSU_RR_FD,GW_SAU_DRV_FD,OHCL_FD,PSB_FD,RCM_FD,RCS_FD,RWPC_FD,SCM_FD,SGU_FD,SHVU_3RD_FD,SHVU_CCS_FD,SHVU_FRNT_FD,SHVU_REAR_FD,SHVU_RL_FD,SHVU_RR_FD,WPC2_FD
 SG_ NM_State_WPC_FD : 24|8@1+ (1,0) [0|0] ""  ARS_FD,ATS_FD,BLTN_CAM_FD,CGW_CCU,DCM_FD,FCS_FD,GW_PSU_3RD_FD,GW_PSU_AST_FD,GW_PSU_DRV_FD,GW_PSU_RL_FD,GW_PSU_RR_FD,GW_SAU_DRV_FD,OHCL_FD,PSB_FD,RCM_FD,RCS_FD,RWPC_FD,SCM_FD,SGU_FD,SHVU_3RD_FD,SHVU_CCS_FD,SHVU_FRNT_FD,SHVU_REAR_FD,SHVU_RL_FD,SHVU_RR_FD,WPC2_FD
 SG_ PNI_WPC_FD : 32|32@1+ (1,0) [0|0] ""  ARS_FD,ATS_FD,BLTN_CAM_FD,CGW_CCU,DCM_FD,FCS_FD,GW_PSU_3RD_FD,GW_PSU_AST_FD,GW_PSU_DRV_FD,GW_PSU_RL_FD,GW_PSU_RR_FD,GW_SAU_DRV_FD,OHCL_FD,PSB_FD,RCM_FD,RCS_FD,RWPC_FD,SCM_FD,SGU_FD,SHVU_3RD_FD,SHVU_CCS_FD,SHVU_FRNT_FD,SHVU_REAR_FD,SHVU_RL_FD,SHVU_RR_FD,WPC2_FD
 SG_ PNI_WPC_FD_1 : 64|64@1+ (1,0) [0|0] ""  ARS_FD,ATS_FD,BLTN_CAM_FD,CGW_CCU,DCM_FD,FCS_FD,GW_PSU_3RD_FD,GW_PSU_AST_FD,GW_PSU_DRV_FD,GW_PSU_RL_FD,GW_PSU_RR_FD,GW_SAU_DRV_FD,OHCL_FD,PSB_FD,RCM_FD,RCS_FD,RWPC_FD,SCM_FD,SGU_FD,SHVU_3RD_FD,SHVU_CCS_FD,SHVU_FRNT_FD,SHVU_REAR_FD,SHVU_RL_FD,SHVU_RR_FD,WPC2_FD
 SG_ PNI_WPC_FD_2 : 128|64@1+ (1,0) [0|0] ""  ARS_FD,ATS_FD,BLTN_CAM_FD,CGW_CCU,DCM_FD,FCS_FD,GW_PSU_3RD_FD,GW_PSU_AST_FD,GW_PSU_DRV_FD,GW_PSU_RL_FD,GW_PSU_RR_FD,GW_SAU_DRV_FD,OHCL_FD,PSB_FD,RCM_FD,RCS_FD,RWPC_FD,SCM_FD,SGU_FD,SHVU_3RD_FD,SHVU_CCS_FD,SHVU_FRNT_FD,SHVU_REAR_FD,SHVU_RL_FD,SHVU_RR_FD,WPC2_FD
 SG_ PNI_WPC_FD_3 : 192|64@1+ (1,0) [0|0] ""  ARS_FD,ATS_FD,BLTN_CAM_FD,CGW_CCU,DCM_FD,FCS_FD,GW_PSU_3RD_FD,GW_PSU_AST_FD,GW_PSU_DRV_FD,GW_PSU_RL_FD,GW_PSU_RR_FD,GW_SAU_DRV_FD,OHCL_FD,PSB_FD,RCM_FD,RCS_FD,RWPC_FD,SCM_FD,SGU_FD,SHVU_3RD_FD,SHVU_CCS_FD,SHVU_FRNT_FD,SHVU_REAR_FD,SHVU_RL_FD,SHVU_RR_FD,WPC2_FD

BO_ 2549874837 NM_WPC2_FD: 32 WPC2_FD
 SG_ SNI_WPC2_FD : 0|8@1+ (1,0) [0|0] ""  ARS_FD,ATS_FD,BLTN_CAM_FD,CGW_CCU,DCM_FD,FCS_FD,GW_PSU_3RD_FD,GW_PSU_AST_FD,GW_PSU_DRV_FD,GW_PSU_RL_FD,GW_PSU_RR_FD,GW_SAU_DRV_FD,OHCL_FD,PSB_FD,RCM_FD,RCS_FD,RWPC_FD,SCM_FD,SGU_FD,SHVU_3RD_FD,SHVU_CCS_FD,SHVU_FRNT_FD,SHVU_REAR_FD,SHVU_RL_FD,SHVU_RR_FD,WPC_FD
 SG_ CBV_RMR_WPC2_FD : 8|1@1+ (1,0) [0|0] ""  ARS_FD,ATS_FD,BLTN_CAM_FD,CGW_CCU,DCM_FD,FCS_FD,GW_PSU_3RD_FD,GW_PSU_AST_FD,GW_PSU_DRV_FD,GW_PSU_RL_FD,GW_PSU_RR_FD,GW_SAU_DRV_FD,OHCL_FD,PSB_FD,RCM_FD,RCS_FD,RWPC_FD,SCM_FD,SGU_FD,SHVU_3RD_FD,SHVU_CCS_FD,SHVU_FRNT_FD,SHVU_REAR_FD,SHVU_RL_FD,SHVU_RR_FD,WPC_FD
 SG_ CBV_NMCoID_WPC2_FD : 9|2@1+ (1,0) [0|0] ""  ARS_FD,ATS_FD,BLTN_CAM_FD,CGW_CCU,DCM_FD,FCS_FD,GW_PSU_3RD_FD,GW_PSU_AST_FD,GW_PSU_DRV_FD,GW_PSU_RL_FD,GW_PSU_RR_FD,GW_SAU_DRV_FD,OHCL_FD,PSB_FD,RCM_FD,RCS_FD,RWPC_FD,SCM_FD,SGU_FD,SHVU_3RD_FD,SHVU_CCS_FD,SHVU_FRNT_FD,SHVU_REAR_FD,SHVU_RL_FD,SHVU_RR_FD,WPC_FD
 SG_ CBV_NMCoSRB_WPC2_FD : 11|1@1+ (1,0) [0|0] ""  ARS_FD,ATS_FD,BLTN_CAM_FD,CGW_CCU,DCM_FD,FCS_FD,GW_PSU_3RD_FD,GW_PSU_AST_FD,GW_PSU_DRV_FD,GW_PSU_RL_FD,GW_PSU_RR_FD,GW_SAU_DRV_FD,OHCL_FD,PSB_FD,RCM_FD,RCS_FD,RWPC_FD,SCM_FD,SGU_FD,SHVU_3RD_FD,SHVU_CCS_FD,SHVU_FRNT_FD,SHVU_REAR_FD,SHVU_RL_FD,SHVU_RR_FD,WPC_FD
 SG_ CBV_AWB_WPC2_FD : 12|1@1+ (1,0) [0|0] ""  ARS_FD,ATS_FD,BLTN_CAM_FD,CGW_CCU,DCM_FD,FCS_FD,GW_PSU_3RD_FD,GW_PSU_AST_FD,GW_PSU_DRV_FD,GW_PSU_RL_FD,GW_PSU_RR_FD,GW_SAU_DRV_FD,OHCL_FD,PSB_FD,RCM_FD,RCS_FD,RWPC_FD,SCM_FD,SGU_FD,SHVU_3RD_FD,SHVU_CCS_FD,SHVU_FRNT_FD,SHVU_REAR_FD,SHVU_RL_FD,SHVU_RR_FD,WPC_FD
 SG_ CBV_PNIB_WPC2_FD : 14|1@1+ (1,0) [0|0] ""  ARS_FD,ATS_FD,BLTN_CAM_FD,CGW_CCU,DCM_FD,FCS_FD,GW_PSU_3RD_FD,GW_PSU_AST_FD,GW_PSU_DRV_FD,GW_PSU_RL_FD,GW_PSU_RR_FD,GW_SAU_DRV_FD,OHCL_FD,PSB_FD,RCM_FD,RCS_FD,RWPC_FD,SCM_FD,SGU_FD,SHVU_3RD_FD,SHVU_CCS_FD,SHVU_FRNT_FD,SHVU_REAR_FD,SHVU_RL_FD,SHVU_RR_FD,WPC_FD
 SG_ NRR_WPC2_FD : 16|8@1+ (1,0) [0|0] ""  ARS_FD,ATS_FD,BLTN_CAM_FD,CGW_CCU,DCM_FD,FCS_FD,GW_PSU_3RD_FD,GW_PSU_AST_FD,GW_PSU_DRV_FD,GW_PSU_RL_FD,GW_PSU_RR_FD,GW_SAU_DRV_FD,OHCL_FD,PSB_FD,RCM_FD,RCS_FD,RWPC_FD,SCM_FD,SGU_FD,SHVU_3RD_FD,SHVU_CCS_FD,SHVU_FRNT_FD,SHVU_REAR_FD,SHVU_RL_FD,SHVU_RR_FD,WPC_FD
 SG_ NM_State_WPC2_FD : 24|8@1+ (1,0) [0|0] ""  ARS_FD,ATS_FD,BLTN_CAM_FD,CGW_CCU,DCM_FD,FCS_FD,GW_PSU_3RD_FD,GW_PSU_AST_FD,GW_PSU_DRV_FD,GW_PSU_RL_FD,GW_PSU_RR_FD,GW_SAU_DRV_FD,OHCL_FD,PSB_FD,RCM_FD,RCS_FD,RWPC_FD,SCM_FD,SGU_FD,SHVU_3RD_FD,SHVU_CCS_FD,SHVU_FRNT_FD,SHVU_REAR_FD,SHVU_RL_FD,SHVU_RR_FD,WPC_FD
 SG_ PNI_WPC2_FD : 32|32@1+ (1,0) [0|0] ""  ARS_FD,ATS_FD,BLTN_CAM_FD,CGW_CCU,DCM_FD,FCS_FD,GW_PSU_3RD_FD,GW_PSU_AST_FD,GW_PSU_DRV_FD,GW_PSU_RL_FD,GW_PSU_RR_FD,GW_SAU_DRV_FD,OHCL_FD,PSB_FD,RCM_FD,RCS_FD,RWPC_FD,SCM_FD,SGU_FD,SHVU_3RD_FD,SHVU_CCS_FD,SHVU_FRNT_FD,SHVU_REAR_FD,SHVU_RL_FD,SHVU_RR_FD,WPC_FD
 SG_ PNI_WPC2_FD_1 : 64|64@1+ (1,0) [0|0] ""  ARS_FD,ATS_FD,BLTN_CAM_FD,CGW_CCU,DCM_FD,FCS_FD,GW_PSU_3RD_FD,GW_PSU_AST_FD,GW_PSU_DRV_FD,GW_PSU_RL_FD,GW_PSU_RR_FD,GW_SAU_DRV_FD,OHCL_FD,PSB_FD,RCM_FD,RCS_FD,RWPC_FD,SCM_FD,SGU_FD,SHVU_3RD_FD,SHVU_CCS_FD,SHVU_FRNT_FD,SHVU_REAR_FD,SHVU_RL_FD,SHVU_RR_FD,WPC_FD
 SG_ PNI_WPC2_FD_2 : 128|64@1+ (1,0) [0|0] ""  ARS_FD,ATS_FD,BLTN_CAM_FD,CGW_CCU,DCM_FD,FCS_FD,GW_PSU_3RD_FD,GW_PSU_AST_FD,GW_PSU_DRV_FD,GW_PSU_RL_FD,GW_PSU_RR_FD,GW_SAU_DRV_FD,OHCL_FD,PSB_FD,RCM_FD,RCS_FD,RWPC_FD,SCM_FD,SGU_FD,SHVU_3RD_FD,SHVU_CCS_FD,SHVU_FRNT_FD,SHVU_REAR_FD,SHVU_RL_FD,SHVU_RR_FD,WPC_FD
 SG_ PNI_WPC2_FD_3 : 192|64@1+ (1,0) [0|0] ""  ARS_FD,ATS_FD,BLTN_CAM_FD,CGW_CCU,DCM_FD,FCS_FD,GW_PSU_3RD_FD,GW_PSU_AST_FD,GW_PSU_DRV_FD,GW_PSU_RL_FD,GW_PSU_RR_FD,GW_SAU_DRV_FD,OHCL_FD,PSB_FD,RCM_FD,RCS_FD,RWPC_FD,SCM_FD,SGU_FD,SHVU_3RD_FD,SHVU_CCS_FD,SHVU_FRNT_FD,SHVU_REAR_FD,SHVU_RL_FD,SHVU_RR_FD,WPC_FD

BO_ 2549874823 NM_SCM_FD: 32 SCM_FD
 SG_ SNI_SCM_FD : 0|8@1+ (1,0) [0|0] ""  ARS_FD,ATS_FD,BLTN_CAM_FD,CGW_CCU,DCM_FD,FCS_FD,GW_PSU_3RD_FD,GW_PSU_AST_FD,GW_PSU_DRV_FD,GW_PSU_RL_FD,GW_PSU_RR_FD,GW_SAU_DRV_FD,OHCL_FD,PSB_FD,RCM_FD,RCS_FD,RWPC_FD,SGU_FD,SHVU_3RD_FD,SHVU_CCS_FD,SHVU_FRNT_FD,SHVU_REAR_FD,SHVU_RL_FD,SHVU_RR_FD,WPC2_FD,WPC_FD
 SG_ CBV_RMR_SCM_FD : 8|1@1+ (1,0) [0|0] ""  ARS_FD,ATS_FD,BLTN_CAM_FD,CGW_CCU,DCM_FD,FCS_FD,GW_PSU_3RD_FD,GW_PSU_AST_FD,GW_PSU_DRV_FD,GW_PSU_RL_FD,GW_PSU_RR_FD,GW_SAU_DRV_FD,OHCL_FD,PSB_FD,RCM_FD,RCS_FD,RWPC_FD,SGU_FD,SHVU_3RD_FD,SHVU_CCS_FD,SHVU_FRNT_FD,SHVU_REAR_FD,SHVU_RL_FD,SHVU_RR_FD,WPC2_FD,WPC_FD
 SG_ CBV_NMCoID_SCM_FD : 9|2@1+ (1,0) [0|0] ""  ARS_FD,ATS_FD,BLTN_CAM_FD,CGW_CCU,DCM_FD,FCS_FD,GW_PSU_3RD_FD,GW_PSU_AST_FD,GW_PSU_DRV_FD,GW_PSU_RL_FD,GW_PSU_RR_FD,GW_SAU_DRV_FD,OHCL_FD,PSB_FD,RCM_FD,RCS_FD,RWPC_FD,SGU_FD,SHVU_3RD_FD,SHVU_CCS_FD,SHVU_FRNT_FD,SHVU_REAR_FD,SHVU_RL_FD,SHVU_RR_FD,WPC2_FD,WPC_FD
 SG_ CBV_NMCoSRB_SCM_FD : 11|1@1+ (1,0) [0|0] ""  ARS_FD,ATS_FD,BLTN_CAM_FD,CGW_CCU,DCM_FD,FCS_FD,GW_PSU_3RD_FD,GW_PSU_AST_FD,GW_PSU_DRV_FD,GW_PSU_RL_FD,GW_PSU_RR_FD,GW_SAU_DRV_FD,OHCL_FD,PSB_FD,RCM_FD,RCS_FD,RWPC_FD,SGU_FD,SHVU_3RD_FD,SHVU_CCS_FD,SHVU_FRNT_FD,SHVU_REAR_FD,SHVU_RL_FD,SHVU_RR_FD,WPC2_FD,WPC_FD
 SG_ CBV_AWB_SCM_FD : 12|1@1+ (1,0) [0|0] ""  ARS_FD,ATS_FD,BLTN_CAM_FD,CGW_CCU,DCM_FD,FCS_FD,GW_PSU_3RD_FD,GW_PSU_AST_FD,GW_PSU_DRV_FD,GW_PSU_RL_FD,GW_PSU_RR_FD,GW_SAU_DRV_FD,OHCL_FD,PSB_FD,RCM_FD,RCS_FD,RWPC_FD,SGU_FD,SHVU_3RD_FD,SHVU_CCS_FD,SHVU_FRNT_FD,SHVU_REAR_FD,SHVU_RL_FD,SHVU_RR_FD,WPC2_FD,WPC_FD
 SG_ CBV_PNIB_SCM_FD : 14|1@1+ (1,0) [0|0] ""  ARS_FD,ATS_FD,BLTN_CAM_FD,CGW_CCU,DCM_FD,FCS_FD,GW_PSU_3RD_FD,GW_PSU_AST_FD,GW_PSU_DRV_FD,GW_PSU_RL_FD,GW_PSU_RR_FD,GW_SAU_DRV_FD,OHCL_FD,PSB_FD,RCM_FD,RCS_FD,RWPC_FD,SGU_FD,SHVU_3RD_FD,SHVU_CCS_FD,SHVU_FRNT_FD,SHVU_REAR_FD,SHVU_RL_FD,SHVU_RR_FD,WPC2_FD,WPC_FD
 SG_ NRR_SCM_FD : 16|8@1+ (1,0) [0|0] ""  ARS_FD,ATS_FD,BLTN_CAM_FD,CGW_CCU,DCM_FD,FCS_FD,GW_PSU_3RD_FD,GW_PSU_AST_FD,GW_PSU_DRV_FD,GW_PSU_RL_FD,GW_PSU_RR_FD,GW_SAU_DRV_FD,OHCL_FD,PSB_FD,RCM_FD,RCS_FD,RWPC_FD,SGU_FD,SHVU_3RD_FD,SHVU_CCS_FD,SHVU_FRNT_FD,SHVU_REAR_FD,SHVU_RL_FD,SHVU_RR_FD,WPC2_FD,WPC_FD
 SG_ NM_State_SCM_FD : 24|8@1+ (1,0) [0|0] ""  ARS_FD,ATS_FD,BLTN_CAM_FD,CGW_CCU,DCM_FD,FCS_FD,GW_PSU_3RD_FD,GW_PSU_AST_FD,GW_PSU_DRV_FD,GW_PSU_RL_FD,GW_PSU_RR_FD,GW_SAU_DRV_FD,OHCL_FD,PSB_FD,RCM_FD,RCS_FD,RWPC_FD,SGU_FD,SHVU_3RD_FD,SHVU_CCS_FD,SHVU_FRNT_FD,SHVU_REAR_FD,SHVU_RL_FD,SHVU_RR_FD,WPC2_FD,WPC_FD
 SG_ PNI_SCM_FD : 32|32@1+ (1,0) [0|0] ""  ARS_FD,ATS_FD,BLTN_CAM_FD,CGW_CCU,DCM_FD,FCS_FD,GW_PSU_3RD_FD,GW_PSU_AST_FD,GW_PSU_DRV_FD,GW_PSU_RL_FD,GW_PSU_RR_FD,GW_SAU_DRV_FD,OHCL_FD,PSB_FD,RCM_FD,RCS_FD,RWPC_FD,SGU_FD,SHVU_3RD_FD,SHVU_CCS_FD,SHVU_FRNT_FD,SHVU_REAR_FD,SHVU_RL_FD,SHVU_RR_FD,WPC2_FD,WPC_FD
 SG_ PNI_SCM_FD_1 : 64|64@1+ (1,0) [0|0] ""  ARS_FD,ATS_FD,BLTN_CAM_FD,CGW_CCU,DCM_FD,FCS_FD,GW_PSU_3RD_FD,GW_PSU_AST_FD,GW_PSU_DRV_FD,GW_PSU_RL_FD,GW_PSU_RR_FD,GW_SAU_DRV_FD,OHCL_FD,PSB_FD,RCM_FD,RCS_FD,RWPC_FD,SGU_FD,SHVU_3RD_FD,SHVU_CCS_FD,SHVU_FRNT_FD,SHVU_REAR_FD,SHVU_RL_FD,SHVU_RR_FD,WPC2_FD,WPC_FD
 SG_ PNI_SCM_FD_2 : 128|64@1+ (1,0) [0|0] ""  ARS_FD,ATS_FD,BLTN_CAM_FD,CGW_CCU,DCM_FD,FCS_FD,GW_PSU_3RD_FD,GW_PSU_AST_FD,GW_PSU_DRV_FD,GW_PSU_RL_FD,GW_PSU_RR_FD,GW_SAU_DRV_FD,OHCL_FD,PSB_FD,RCM_FD,RCS_FD,RWPC_FD,SGU_FD,SHVU_3RD_FD,SHVU_CCS_FD,SHVU_FRNT_FD,SHVU_REAR_FD,SHVU_RL_FD,SHVU_RR_FD,WPC2_FD,WPC_FD
 SG_ PNI_SCM_FD_3 : 192|64@1+ (1,0) [0|0] ""  ARS_FD,ATS_FD,BLTN_CAM_FD,CGW_CCU,DCM_FD,FCS_FD,GW_PSU_3RD_FD,GW_PSU_AST_FD,GW_PSU_DRV_FD,GW_PSU_RL_FD,GW_PSU_RR_FD,GW_SAU_DRV_FD,OHCL_FD,PSB_FD,RCM_FD,RCS_FD,RWPC_FD,SGU_FD,SHVU_3RD_FD,SHVU_CCS_FD,SHVU_FRNT_FD,SHVU_REAR_FD,SHVU_RL_FD,SHVU_RR_FD,WPC2_FD,WPC_FD

CM_ BO_ 980 "[PE] Periodic and On Event";
CM_ SG_ 980 BDC_FD_Crc5Val "BDC_FD_CyclicRedundancyCheck5Value";
CM_ SG_ 980 BDC_FD_AlvCnt5Val "BDC_FD_AliveCounter5Value";
CM_ SG_ 980 Lamp_LftTrnLmpCmdSta "Lamp_LeftTurnLampCmdState";
CM_ SG_ 980 Lamp_RtTrnLmpCmdSta "Lamp_RightTurnLampCmdState";
CM_ SG_ 980 Lamp_LftTrnLmpCmd "Lamp_LeftTrunLampCommand";
CM_ SG_ 980 Lamp_RtTrnLmpCmd "Lamp_RightTurnLampCommand";
CM_ SG_ 980 Lamp_TrnLmpMode "Lamp_TurnLampMode";
CM_ SG_ 980 Lamp_HzrdSwIND "Lamp_HazardSwitchIndicator";
CM_ SG_ 980 Lamp_HiPrioHzrdReq "Lamp_HighPriorityHazardRequest ##2G##BCM - BCMmsg19 - C_HazardFromBCMHigh";
CM_ SG_ 980 Lamp_LoPrioHzrdReq "Lamp_LowPriorityHazardStatus ##2G##BCM - BCMmsg19 - C_HazardfromBCMLow";
CM_ SG_ 980 Lamp_ExtrnlTailLmpOnReq "Lamp_ExternalTailLampOnRequest ##2G##BCM - BCMmsg19 - C_ExtTailOn";
CM_ SG_ 980 Lamp_HdLmpLoOnReq "Lamp_HeadLampLowOnRequest ##2G##BCM - BCMmsg19 - C_HLpLowOn";
CM_ SG_ 980 Lamp_HdLmpHiOnReq "Lamp_HeadLampHighOnRequest ##2G##BCM - BCMmsg19 - C_HLpHighOn";
CM_ SG_ 980 Lamp_FrFogLmpOnReq "Lamp_FrontFogLampOnRequest ##2G##BCM - BCMmsg19 - C_FrtFogOn";
CM_ SG_ 980 Lamp_RrFogLmpOnReq "Lamp_RearFogLampOnRequest ##2G##BCM - BCMmsg19 - C_RearFogOn";
CM_ SG_ 980 Lamp_StcBendingLmpLftOnReq "Lamp_StaticBendingLampLeftOnRequest ##2G##BCM - BCMmsg19 - C_StaticBendLhOn";
CM_ SG_ 980 Lamp_StcBendingLmpRtOnReq "Lamp_StaticBendingLampRightOnRequest ##2G##BCM - BCMmsg19 - C_StaticBendRhOn";
CM_ SG_ 980 Lamp_CornerLmpLftOnReq "Lamp_CorneringLampLeftOnRequest ##2G##BCM - BCMmsg19 - C_CorneringLpLhOn";
CM_ SG_ 980 Lamp_CornerLmpRtOnReq "Lamp_CorneringLampRightOnRequest ##2G##BCM - BCMmsg19 - C_CorneringLpRhOn";
CM_ SG_ 980 Lamp_HbaCtrlModTyp "Lamp_HbaControlModeType ##2G##BCM - BCMmsg22 - C_HBAControlMode";
CM_ SG_ 980 Lamp_IFSCtrlModTyp "Lamp_IFSControlModeType ##2G##BCM - BCMmsg22 - C_IFSControlMode";
CM_ SG_ 980 Lamp_HdLmpWlcmCmd "Lamp_HeadLampWelcomeOnCommand ##2G##BCM - BCMmsg19 - C_HLpWelcomeCmd";
CM_ SG_ 980 Lamp_PuddleLmpOnReq "Lamp_PuddleLampOnRequest ##2G##BCM - BCMmsg19 - C_PuddleLpOn";
CM_ SG_ 980 Lamp_IntTailLmpOnReq "Lamp_InternalTailLampOnRequest ##2G##BCM - BCMmsg19 - C_IntTailOn";
CM_ SG_ 980 Lamp_AvTailLmpSta "Lamp_AvTailLampStatus ##2G##BCM - BCMmsg18 - C_AvTail";
CM_ SG_ 980 Lamp_AutoLtSnsrNightSta "Lamp_AutoLightSensorNightStatus ##2G##BCM - BCMmsg24 - C_AutolightValue";
CM_ SG_ 980 Lamp_AutoLtSnsrHorVal "Lamp_AutoLightSensorHorValue ##2G##BCM - BCMmsg24 - C_AutolightSensorHorState";
CM_ BO_ 913 "[PE] Periodic and On Event";
CM_ SG_ 913 WPC_FD_Crc1Val "WPC_FD_CyclicRedundancyCheck1Value";
CM_ SG_ 913 WPC_ResetOpSta "This signal indicates whether the reset operation has been completed or not";
CM_ SG_ 913 WPC_FD_AlvCnt1Val "WPC_FD_AliveCounter1Value";
CM_ SG_ 913 USM_CmdWPCSta "USM_CommandWPCStatus";
CM_ SG_ 913 WPC_PhnLftWrngSta "WPC_PhoneLeftWarningStatus";
CM_ SG_ 913 WPC_SWVerMajor1 "First Word(ASCII) in WPC S/W Ver";
CM_ SG_ 913 WPC_SWVerMinor1 "Second Word(ASCII) in WPC S/W Ver";
CM_ SG_ 913 WPC_SWVerMinor2 "Third Word(ASCII) in WPC S/W Ver";
CM_ BO_ 426 "[P] Periodic";
CM_ SG_ 426 CLU_Crc1Val "CLU_CyclicRedundancyCheck1Value";
CM_ SG_ 426 CLU_FuelSenderRstReq "Reset request signal for ICV fuel-sender";
CM_ SG_ 426 CLU_AlvCnt1Val "CLU_AliveCounter1Value";
CM_ SG_ 426 CLU_DtntOutSta "CLU_DetentOutStatus";
CM_ SG_ 426 CLU_SpdUnitTyp "CLU_SpeedUnitType";
CM_ SG_ 426 CLU_DisSpdDcmlVal "CLU_DisplaySpeedDecimalValue";
CM_ SG_ 426 CLU_SWRCCrsMainSwSta "CLU_SWRCCrsMainSwSta";
CM_ SG_ 426 CLU_SWRCCrsSwSta "CLU_SWRCCrsSwSta";
CM_ SG_ 426 CLU_SWRCLFASwSta "SWRC_LFASwitchStatus";
CM_ SG_ 426 CLU_SWRCSldMainSwSta "SWRC_SpeedLimiterMainSwitchStatus";
CM_ SG_ 426 CLU_RhstaLvlSta "CLU_RheostatLevelStatus";
CM_ SG_ 426 CLU_DisSpdVal "CLU_DisplaySpeedValue";
CM_ SG_ 426 CLU_OKSwSta "OK Switch On/Off State";
CM_ SG_ 426 CLU_DisSpdVal_KPH "CLU_DisplaySpeedValue_KPH";
CM_ SG_ 426 CLU_PwrAutoOffResetReq_HCU "reset power auto off time";
CM_ SG_ 426 CLU_AutoBrightSta "CLU_AutoBrightStatus";
CM_ SG_ 426 CLU_NotMinModeBrightSta "CLU_NotMinimumModeBrightStaus";
CM_ SG_ 426 CLU_FuelSenderResistVal "This is the resistance data come from fuel sender.";
CM_ BO_ 250 "[P] Periodic";
CM_ SG_ 250 HCU_Crc3Val "HCU_CyclicRedundancyCheck3Value";
CM_ SG_ 250 HCU_SpdLimDeviceActSta "HCU_SpeedLimiterDeviceActivationStatus ##2G##HCU - HCU4 - CF_Vcu_SldAct";
CM_ SG_ 250 HCU_SpdLimDeviceOperSta "HCU_SpeedLimiterDeviceOperationStatus ##2G##HCU - HCU4 - CF_Hcu_SldOpr";
CM_ SG_ 250 HCU_SpdLimDeviceVehSpdVal "HCU_SpeedLimiterDeviceVehicleSpeedValue ##2G##HCU - HCU4 - CR_Vcu_SldVs";
CM_ SG_ 250 HCU_SrvModSta "HCU_ServiceModeStatus ##2G##HCU - HCU2 - CF_Hcu_ServiceMod";
CM_ SG_ 250 HCU_StrtInhbt2Sta "HCU_StartInhibit2Status ##2G##HCU - HCU3 - CF_Hcu_StartInh";
CM_ SG_ 250 HCU_StrtInhbtSta "HCU_StartInhibitStatus ##2G##HCU - HCU1 - CF_Hcu_StInhStat";
CM_ SG_ 250 HCU_PdlRgnCmpnRear "Request for hydraulic brake compensation in paddle regeneration braking mode for rear motor( when the coasting tq decrease rapidly )";
CM_ SG_ 250 HCU_VehStrtEnblSta "HCU_VehicleStartEnableStatus ##2G##HCU - HCU1 - CF_Hcu_Veh_ST";
CM_ SG_ 250 HCU_BrkLmpOnReq "HCU_BrakeLampOnRequest###2G####HCU - HCU5 - CF_Hcu_BrkLpReq";
CM_ SG_ 250 HCU_CcDrvAlrtDis "Driver display information of CC can not be engaged";
CM_ SG_ 250 HCU_SldDrvAlrtDis "SLD must be disengaged by system or cannot be engaged";
CM_ SG_ 250 HCU_WhlCrpCrpTqNmVal "HCU_WheelCreepTorqueNmValue ##2G##HCU - HCU2 - CR_Hcu_CrpTq_Nm";
CM_ SG_ 250 LHCU_EngCltchTrnsfrTqPcVal_Copy_ "##2G##HCU - HCU7 - CR_Hcu_EngCltTrnfTq_Pc";
CM_ SG_ 250 HCU_RspaAlvCntVal "RSPA HCU Alive Counter ##2G##HCU - HCU4 - CF_Hcu_RspaAliveCnt";
CM_ SG_ 250 HCU_RspaSta "HCU RSPA Cooperative control staus ##2G##HCU - HCU4 - CF_Hcu_RspaStat";
CM_ SG_ 250 HCU_AlvCnt3Val "HCU_AliveCounter3Value";
CM_ SG_ 250 HCU_RspaCanFailSta "HCU RSPA CAN Fail Status ##2G##HCU - HCU4 - CR_Hcu_RspaCanFailFlag";
CM_ SG_ 250 HCU_RForwardRq "R gear forward drive request";
CM_ SG_ 250 HCU_Mg3SpdCmdVal "MG3 Motor Speed Command";
CM_ SG_ 250 HCU_Mg3TqPcReq "MG3 Motor Torque Command";
CM_ SG_ 250 HCU_Mg3DisChrgTqCmdPcVal_FS "MG3 Motor Discharge Limit Torque Command for Anti-Jerk";
CM_ SG_ 250 HCU_Mg3ChrgTqCmdPcVal_FS "MG3 Motor Charge Limit Torque Command for Anti-Jerk";
CM_ SG_ 250 HCU_11sMaxSpdLimOperSta "HCU_11sMaxSpdLimOperSta";
CM_ SG_ 250 HCU_DrvWhlDmndTqNmVal "HCU_DriverWheelDemandTorqueNmValue ##2G##HCU - HCU2 - CR_Hcu_WhlDemTq_Nm";
CM_ SG_ 250 HCU_STAYModReservationSta "0x0: Default(Off) 0x1 : Off 0x2 : On 0x3 : RESERVED";
CM_ SG_ 250 HCU_STAYModBattMngmntSta "0x0: Default(Off) 0x1 : Off 0x2 : On 0x3 : RESERVED";
CM_ SG_ 250 HCU_Mg3AntJrkInhbtReq "MG3 Motor AntiJerkInhibition";
CM_ SG_ 250 HCU_Mg3CtrlModReq "MG3 Motor Control Mode Command";
CM_ SG_ 250 HCU_Mg3PwmOffInhbtSta "MG3 Motor PWM Off Inhibit";
CM_ SG_ 250 HCU_Mg3PwrEnaSta "MG3 Motor Power Enable";
CM_ SG_ 250 HCU_EstAccelPdlPcVal "HCU_EstimatedAcceleratorPedalPcValue ##2G##HCU - HCU4 - CR_Hcu_EstAccPed_PC";
CM_ SG_ 250 HCU_EstApsSelSta "HCU_EstimatedApsSelectStatus ##2G##HCU - HCU4 - CF_HCU_EstApsSel";
CM_ SG_ 250 HCU_GreenZoneDrvModSta "0x0:Default (USM 미 표출 (메뉴삭제))
0x1:Off (USM 표출 Off 상태 표시) ##2G##HCU - HCU4 - CF_Hcu_GreenZoneDrv_Status";
CM_ SG_ 250 HCU_GreenZoneLmpDis "Indicate Green Zone Area ##2G##HCU - HCU4 - CF_Hcu_GreenZoneLamp";
CM_ SG_ 250 HCU_HcuRdySta "HCU_HybridControlUnitReadyStatus ##2G##HCU - HCU1 - CF_Hcu_Rdy";
CM_ SG_ 250 HCU_HEVRdyDis "HCU_HybridVehicleReadyDisplay ##2G##HCU - HCU1 - CF_Hcu_HevRdyClu";
CM_ SG_ 250 HCU_HevRdySta "HCU_HybridVehicleReadyStatus ##2G##HCU - HCU1 - CF_Hcu_HevRdy";
CM_ SG_ 250 HCU_LimpOffSta "HCU_LimpOffStatus ##2G##HCU - HCU22 - CF_Hcu_LimpOff";
CM_ SG_ 250 HCU_MILOnReq "HCU_MalfunctionIndicatorLampOnRequest ##2G##HCU - HCU1 - CF_Hcu_MILReq";
CM_ SG_ 250 HCU_PhevAutoModOnSta "HCU_PhevAutoModeOnStatus ##2G##HCU - HCU4 - CF_Hcu_AutoCdCs";
CM_ SG_ 250 HCU_SccDrvOvrdReq "HCU_SccDriverOverrideRequest ##2G##HCU - HCU2 - CF_Hcu_Ovrride";
CM_ SG_ 250 HCU_SccEnblSta "HCU_SmartCruiseControlEnableStatus ##2G##HCU - HCU2 - CF_Hcu_SccEna";
CM_ SG_ 250 HCU_SlwDnSta "HCU_SlowDownStatus ##2G##HCU - HCU1 - CF_Hcu_SlwDwnStat";
CM_ SG_ 250 HCU_SmrtEcoGdDis "HCU_SmartEcoGuideDisplay ##2G##HCU - HCU4 - CF_Hcu_SmartEcoDisp";
CM_ SG_ 250 HCU_SmrtEcoLvlDis "HCU_SmartEcoLevelDisplay ##2G##HCU - HCU4 - CR_Hcu_SmartEcoLvl";
CM_ SG_ 250 HCU_SmrtEcoRngDis "HCU_SmartEcoRangeDisplay ##2G##HCU - HCU4 - CR_Hcu_SmartEcoRng";
CM_ BO_ 53 "[P] Periodic";
CM_ SG_ 53 VCU_Crc1Val "VCU_CyclicRedundancyCheck1Value";
CM_ SG_ 53 VCU_ScuKeepWakeReq "VCU_ScuKeepWakeRequest ##2G##VCU - VCU12 - CF_Vcu_SSD";
CM_ SG_ 53 VCU_MotTqCmdRearVal "VCU_MotorTorqueCommandRearValue";
CM_ SG_ 53 VCU_FmcuZeroTqOfsReq "VCU_FmcuZeroTorqueOffsetRequest";
CM_ SG_ 53 VCU_EcmSeqSta "VCU_EcmSequenceStatus ##2G##VCU - VCU1 - CF_Vcu_IGONStatus";
CM_ SG_ 53 VCU_EcmDiagSta "VCU_EcmDiagnosisStatus";
CM_ SG_ 53 VCU_CltActDiagSta "VCU_ClutchActuatorDiagnosisStatus";
CM_ SG_ 53 VCU_CltActDrvCrntVal "VCU_ClutchActuatorDriveCurrentValue";
CM_ SG_ 53 VCU_AlvCnt1Val "VCU_AliveCounter1Value";
CM_ SG_ 53 VCU_CltActPosStrokeVal "VCU_ClutchActuatorPositionStrokeValue";
CM_ SG_ 53 VCU_MainBattTypeSta "VCU_MainBatteryTypeStatus ##2G##VCU - VCU18 - CF_Vcu_MainBattType";
CM_ SG_ 53 VCU_MainBattTypeLrnSta "VCU_MainBatteryTypeLearnStatus ##2G##VCU - VCU18 - CF_Vcu_MainBattTypeLrnSts";
CM_ SG_ 53 VCU_WarmupCycSta "VCU_WarmupCycleStatus ##2G##VCU - VCU1 - CF_Vcu_WarmupCyc";
CM_ SG_ 53 VCU_FatcPermPwrVal "VCU_FatcPermissionPowerValue ##2G##VCU - VCU5 - CR_Vcu_ClimatePerm_W";
CM_ SG_ 53 VCU_GearPosStaDisp "VCU_GearPositionStatusDisp";
CM_ SG_ 53 VCU_PdlStopCtrlSta "Cooperative control state of VCU for stop assist control with IEB";
CM_ SG_ 53 VCU_PdlStopReqTqNmVal "Requested brake torque for cooperative stop assist control";
CM_ SG_ 53 VCU_PMPDActSta "PMPD Function Active State";
CM_ SG_ 53 VCU_PMPDWarnSta "PMPD Function Warning State";
CM_ SG_ 53 VCU_VgsVirSoundBackFireIndex "Virtual sound back fire noise index for VGS mode";
CM_ SG_ 53 VCU_VgsVirEngSpdRpmVal "Virtual engine speed for VGS mode";
CM_ SG_ 53 VCU_RdySta "VCU_ReadyStatus ##2G##VCU - VCU1 - CF_Vcu_Rdy";
CM_ SG_ 53 VCU_VgsVirSoundVolume "Virtual engine sound volume for VGS mode[%]";
CM_ SG_ 53 VCU_VgsVirGearStep "Shift gear when entering VGS mode";
CM_ SG_ 53 VCU_StandbyModSta "Stand by Mode Status";
CM_ SG_ 53 VCU_HVIntLkDischrgReq "VCU_HighVoltageInterlockDischargeRequest";
CM_ SG_ 53 VCU_StartKeyHoldSta "VCU_StartKeyHoldStatus ##2G##VCU - VCU1 - CF_Vcu_Key_ST";
CM_ SG_ 53 VCU_EvDrvRdySta "VCU_EvDriveReadyStatus ##2G##VCU - VCU1 - CF_Vcu_EvRdy";
CM_ SG_ 53 VCU_MotPwrEnReq "VCU_MotorPowerEnableRequest ##2G##VCU - VCU3 - CF_Vcu_MotPwrEna";
CM_ SG_ 53 VCU_GearPosSta "VCU_GearPositionStatus ##2G##VCU - VCU1 - CF_Vcu_GarSelDisp";
CM_ SG_ 53 VCU_LdcInhReq "VCU_LdcInhibitRequest ##2G##VCU - VCU5 - CF_Vcu_LdcInh";
CM_ SG_ 53 VCU_MainRlyOffReq "VCU_MainRelayCutOffRequest ##2G##VCU - VCU1 - CF_Vcu_RelayOffReq";
CM_ SG_ 53 VCU_AccPedDepVal "VCU_AcceleratorPedalDepthValue ##2G##VCU - VCU1 - CR_Vcu_AccPedDep_Pc";
CM_ SG_ 53 VCU_FatcOperPermSta "VCU_FatcOperatingPermissionStatus ##2G##VCU - VCU20 - CF_Vcu_ClimateOperPerm";
CM_ SG_ 53 VCU_DrvCycSta "VCU_DrivingCycleStatus ##2G##VCU - VCU1 - CF_Vcu_Veh_DC";
CM_ SG_ 53 VCU_CltActOpSta "VCU_ClutchActuatorOperatingStatus";
CM_ SG_ 53 VCU_WhlSpdSnsrAlvReq "VCU_WheelSpeedSensorAliveRequest";
CM_ SG_ 53 VCU_DrvModOpSta "VCU's operating drive mode according to CLU and DMIC signals";
CM_ SG_ 53 VCU_HydBrkFcHoldRq "Hydraulic brake force holding request from VCU";
CM_ SG_ 53 VCU_FatcPwrUseVal "VCU_FatcPowerUseValue ##2G##VCU - VCU5 - CR_Vcu_FatcCst";
CM_ SG_ 53 VCU_WhlDemTqVal "VCU_WheelDemandTorqueValue ##2G##VCU - VCU2 - CR_Vcu_WhlDemTq_Nm";
CM_ SG_ 53 VCU_McuAntiJerkInhFrntSta "VCU_McuAntiJerkInhibitionFrontStatus";
CM_ SG_ 53 VCU_McuAntiJerkInhRearSta "VCU_McuAntiJerkInhibitionRearStatus ##2G##VCU - VCU3 - CF_Vcu_MCUAntiJerkInh";
CM_ SG_ 53 VCU_McuPwrLatchHoldReq "VCU_McuPowerLatchHoldRequest ##2G##VCU - VCU20 - CF_Vcu_McuPwrLatchHoldReq";
CM_ SG_ 53 VCU_ScuParkReq "VCU_ScuParkingRequest ##2G##VCU - VCU12 - CF_Vcu_PARKCMD";
CM_ SG_ 53 VCU_MotTqCmdFrntVal "VCU_MotorTorqueCommandFrontValue";
CM_ BO_ 543 "[EC] On Event and On Change";
CM_ SG_ 543 WPC_FD_VCRM_Crc1Val "WPC_FD_VCRM_CyclicRedundancyCheck1Value";
CM_ SG_ 543 WPC_FD_VCRM_AlvCnt1Val "WPC_FD_VCRM_AliveCounter1Value";
CM_ SG_ 543 WPC_PhnUsingTime "Charging time after IGN ON";
CM_ SG_ 543 WPC_PhnChargingCompleteCnt "Number of fully charged event after IGN on";
CM_ SG_ 543 WPC_EPPChargingCnt "EPP TYPE charging count";
CM_ SG_ 543 WPC_MPPChargingCnt "MPP TYPE charging count";
CM_ SG_ 543 WPC_DigitalKeyAuth "starting the car authentication by Digital key";
CM_ SG_ 543 WPC_DigitalKeyDevice "Digital key device type";
CM_ SG_ 543 WPC_PhnChargingErrCnt "Phone Charging Error Count";
CM_ SG_ 543 WPC_ThermalSnsrMaxTemp "Thermal Sensor Max Temperature";
CM_ SG_ 543 WPC_CANBusOffDTC "DTC Monitoring";
CM_ SG_ 543 WPC_LocalCANBusOffDTC "DTC Monitoring";
CM_ SG_ 543 WPC_TempSnsrFltDTC "DTC  Monitoring";
CM_ SG_ 543 WPC_FANFltDTC "DTC Monitoring";
CM_ SG_ 543 WPC_InternalECUErrDTC "DTC Monitoring";
CM_ SG_ 2549874826 SNI_ARS_FD "ASR NM Source Node Identifier";
CM_ SG_ 2549874826 CBV_RMR_ARS_FD "ASR NM Control Bit Vector - Repeat Message Request";
CM_ SG_ 2549874826 CBV_NMCoID_ARS_FD "ASR NM Control Bit Vector - ASR NM Coordinator ID";
CM_ SG_ 2549874826 CBV_NMCoSRB_ARS_FD "ASR NM Control Bit Vector - ASR NM Coordinator Sleep Ready Bit";
CM_ SG_ 2549874826 CBV_AWB_ARS_FD "ASR NM Control Bit Vector - Active Wakeup Bit";
CM_ SG_ 2549874826 CBV_PNIB_ARS_FD "ASR NM Control Bit Vector - PN Info Bit";
CM_ SG_ 2549874826 NRR_ARS_FD "ASR NM Network Request Reason";
CM_ SG_ 2549874826 NM_State_ARS_FD "ASR NM State_Current State_Previous State";
CM_ SG_ 2549874826 PNI_ARS_FD "ASR NM Partial Networking Information";
CM_ SG_ 2549874826 PNI_ARS_FD_1 "ASR NM Partial Networking Information";
CM_ SG_ 2549874826 PNI_ARS_FD_2 "ASR NM Partial Networking Information";
CM_ SG_ 2549874826 PNI_ARS_FD_3 "ASR NM Partial Networking Information";
CM_ SG_ 2549874789 SNI_SHVU_CCS_FD "ASR NM Source Node Identifier";
CM_ SG_ 2549874789 CBV_RMR_SHVU_CCS_FD "ASR NM Control Bit Vector - Repeat Message Request";
CM_ SG_ 2549874789 CBV_NMCoID_SHVU_CCS_FD "ASR NM Control Bit Vector - ASR NM Coordinator ID";
CM_ SG_ 2549874789 CBV_NMCoSRB_SHVU_CCS_FD "ASR NM Control Bit Vector - ASR NM Coordinator Sleep Ready Bit";
CM_ SG_ 2549874789 CBV_AWB_SHVU_CCS_FD "ASR NM Control Bit Vector - Active Wakeup Bit";
CM_ SG_ 2549874789 CBV_PNIB_SHVU_CCS_FD "ASR NM Control Bit Vector - PN Info Bit";
CM_ SG_ 2549874789 NRR_SHVU_CCS_FD "ASR NM Network Request Reason";
CM_ SG_ 2549874789 NM_State_SHVU_CCS_FD "ASR NM State_Current State_Previous State";
CM_ SG_ 2549874789 PNI_SHVU_CCS_FD "ASR NM Partial Networking Information";
CM_ SG_ 2549874789 PNI_SHVU_CCS_FD_1 "ASR NM Partial Networking Information";
CM_ SG_ 2549874789 PNI_SHVU_CCS_FD_2 "ASR NM Partial Networking Information";
CM_ SG_ 2549874789 PNI_SHVU_CCS_FD_3 "ASR NM Partial Networking Information";
CM_ SG_ 2549874846 SNI_WPC_FD "ASR NM Source Node Identifier";
CM_ SG_ 2549874846 CBV_RMR_WPC_FD "ASR NM Control Bit Vector - Repeat Message Request";
CM_ SG_ 2549874846 CBV_NMCoID_WPC_FD "ASR NM Control Bit Vector - ASR NM Coordinator ID";
CM_ SG_ 2549874846 CBV_NMCoSRB_WPC_FD "ASR NM Control Bit Vector - ASR NM Coordinator Sleep Ready Bit";
CM_ SG_ 2549874846 CBV_AWB_WPC_FD "ASR NM Control Bit Vector - Active Wakeup Bit";
CM_ SG_ 2549874846 CBV_PNIB_WPC_FD "ASR NM Control Bit Vector - PN Info Bit";
CM_ SG_ 2549874846 NRR_WPC_FD "ASR NM Network Request Reason";
CM_ SG_ 2549874846 NM_State_WPC_FD "ASR NM State_Current State_Previous State";
CM_ SG_ 2549874846 PNI_WPC_FD "ASR NM Partial Networking Information";
CM_ SG_ 2549874846 PNI_WPC_FD_1 "ASR NM Partial Networking Information";
CM_ SG_ 2549874846 PNI_WPC_FD_2 "ASR NM Partial Networking Information";
CM_ SG_ 2549874846 PNI_WPC_FD_3 "ASR NM Partial Networking Information";
CM_ SG_ 2549874837 SNI_WPC2_FD "ASR NM Source Node Identifier";
CM_ SG_ 2549874837 CBV_RMR_WPC2_FD "ASR NM Control Bit Vector - Repeat Message Request";
CM_ SG_ 2549874837 CBV_NMCoID_WPC2_FD "ASR NM Control Bit Vector - ASR NM Coordinator ID";
CM_ SG_ 2549874837 CBV_NMCoSRB_WPC2_FD "ASR NM Control Bit Vector - ASR NM Coordinator Sleep Ready Bit";
CM_ SG_ 2549874837 CBV_AWB_WPC2_FD "ASR NM Control Bit Vector - Active Wakeup Bit";
CM_ SG_ 2549874837 CBV_PNIB_WPC2_FD "ASR NM Control Bit Vector - PN Info Bit";
CM_ SG_ 2549874837 NRR_WPC2_FD "ASR NM Network Request Reason";
CM_ SG_ 2549874837 NM_State_WPC2_FD "ASR NM State_Current State_Previous State";
CM_ SG_ 2549874837 PNI_WPC2_FD "ASR NM Partial Networking Information";
CM_ SG_ 2549874837 PNI_WPC2_FD_1 "ASR NM Partial Networking Information";
CM_ SG_ 2549874837 PNI_WPC2_FD_2 "ASR NM Partial Networking Information";
CM_ SG_ 2549874837 PNI_WPC2_FD_3 "ASR NM Partial Networking Information";
CM_ SG_ 2549874823 SNI_SCM_FD "ASR NM Source Node Identifier";
CM_ SG_ 2549874823 CBV_RMR_SCM_FD "ASR NM Control Bit Vector - Repeat Message Request";
CM_ SG_ 2549874823 CBV_NMCoID_SCM_FD "ASR NM Control Bit Vector - ASR NM Coordinator ID";
CM_ SG_ 2549874823 CBV_NMCoSRB_SCM_FD "ASR NM Control Bit Vector - ASR NM Coordinator Sleep Ready Bit";
CM_ SG_ 2549874823 CBV_AWB_SCM_FD "ASR NM Control Bit Vector - Active Wakeup Bit";
CM_ SG_ 2549874823 CBV_PNIB_SCM_FD "ASR NM Control Bit Vector - PN Info Bit";
CM_ SG_ 2549874823 NRR_SCM_FD "ASR NM Network Request Reason";
CM_ SG_ 2549874823 NM_State_SCM_FD "ASR NM State_Current State_Previous State";
CM_ SG_ 2549874823 PNI_SCM_FD "ASR NM Partial Networking Information";
CM_ SG_ 2549874823 PNI_SCM_FD_1 "ASR NM Partial Networking Information";
CM_ SG_ 2549874823 PNI_SCM_FD_2 "ASR NM Partial Networking Information";
CM_ SG_ 2549874823 PNI_SCM_FD_3 "ASR NM Partial Networking Information";
BA_DEF_ BO_  "CANFD_BRS" ENUM  "0","1";
BA_DEF_ BO_  "GenMsgEVName" STRING ;
BA_DEF_ BO_  "NmAsrMessage" ENUM  "No","Yes";
BA_DEF_ BO_  "DiagState" ENUM  "No","Yes";
BA_DEF_ BO_  "DiagResponse" ENUM  "No","Yes";
BA_DEF_ BO_  "DiagRequest" ENUM  "No","Yes";
BA_DEF_ BO_  "TpMessage" ENUM  "No","Yes";
BA_DEF_ BO_  "UsrMsgIDSforwardDeviation" INT 0 100;
BA_DEF_ BO_  "UsrMsgIDSbackwardDeviation" INT 50 1000;
BA_DEF_ BO_  "GenMsgCycleTime" INT 0 2000;
BA_DEF_ BO_  "GenMsgStartDelayTime" INT 0 2000;
BA_DEF_ BO_  "GenMsgSendType" ENUM  "Cyclic","NoMsgSendType";
BA_DEF_ BO_  "GenMsgCycleTimeFast" INT 0 500;
BA_DEF_ BO_  "GenMsgDelayTime" INT 0 20;
BA_DEF_ BO_  "GenMsgILSupport" ENUM  "No","Yes";
BA_DEF_ BO_  "GenMsgNrOfRepetition" INT 0 3;
BA_DEF_ BO_  "TpTxIndex" INT 0 65535;
BA_DEF_ BO_  "VFrameFormat" ENUM  "StandardCAN","ExtendedCAN","reserved","reserved","reserved","reserved","reserved","reserved","reserved","reserved","reserved","reserved","reserved","reserved","StandardCAN_FD","ExtendedCAN_FD";
BA_DEF_ SG_  "UserSigValidity" ENUM  "B+","ACC","IG","IG1","IG2","IG3","IG1 or IG2","IG1 or IG3","Undef";
BA_DEF_ SG_  "TimeoutValue" STRING ;
BA_DEF_ SG_  "UsrSigPurpose" ENUM  "Undef","FN","DIAG","DIAG(Req)","DIAG(Res)","DIAG(Func)","DEV","CCP","NM","TP";
BA_DEF_ SG_  "GenSigStartValue" INT 0 1215752192;
BA_DEF_ SG_  "NetworkRequest" ENUM  "Yes","No";
BA_DEF_ SG_  "NetworkRequestHoldingTime" INT 0 65535;
BA_DEF_ SG_  "Description" STRING ;
BA_DEF_ SG_  "Version" STRING ;
BA_DEF_ SG_  "GenSigEnvVarType" ENUM  "Int","Float","Undef";
BA_DEF_ SG_  "GenSigSendType" ENUM  "Cyclic","OnWrite","OnWriteWithRepetition","OnChange","OnChangeWithRepetition","IfActive","IfActiveWithRepetition","NoSigSendType","OnChangeAndIfActive","OnChangeAndIfActiveWithRepetition";
BA_DEF_ SG_  "GwSigLatencyTime" INT 0 65536;
BA_DEF_ SG_  "GwSigMissingSourceType" ENUM  "Undef","OldValue","DefaultValue","InitialValue";
BA_DEF_ SG_  "NWM-WakeupAllowed" ENUM  "<n.a.>";
BA_DEF_ SG_  "RoutingFactor" INT 1 1215752192;
BA_DEF_ SG_  "SystemSignalLongSymbol" STRING ;
BA_DEF_REL_ BU_SG_REL_  "GenSigTimeoutTime" INT 0 7000;
BA_DEF_DEF_  "CANFD_BRS" "1";
BA_DEF_DEF_  "GenMsgEVName" "@Signame";
BA_DEF_DEF_  "NmAsrMessage" "No";
BA_DEF_DEF_  "DiagState" "No";
BA_DEF_DEF_  "DiagResponse" "No";
BA_DEF_DEF_  "DiagRequest" "No";
BA_DEF_DEF_  "TpMessage" "No";
BA_DEF_DEF_  "UsrMsgIDSforwardDeviation" 10;
BA_DEF_DEF_  "UsrMsgIDSbackwardDeviation" 100;
BA_DEF_DEF_  "GenMsgCycleTime" 200;
BA_DEF_DEF_  "GenMsgStartDelayTime" 0;
BA_DEF_DEF_  "GenMsgSendType" "NoMsgSendType";
BA_DEF_DEF_  "GenMsgCycleTimeFast" 40;
BA_DEF_DEF_  "GenMsgDelayTime" 20;
BA_DEF_DEF_  "GenMsgILSupport" "Yes";
BA_DEF_DEF_  "GenMsgNrOfRepetition" 3;
BA_DEF_DEF_  "TpTxIndex" 0;
BA_DEF_DEF_  "VFrameFormat" "StandardCAN";
BA_DEF_DEF_  "UserSigValidity" "IG";
BA_DEF_DEF_  "TimeoutValue" "";
BA_DEF_DEF_  "UsrSigPurpose" "FN";
BA_DEF_DEF_  "GenSigStartValue" 0;
BA_DEF_DEF_  "NetworkRequest" "No";
BA_DEF_DEF_  "NetworkRequestHoldingTime" 0;
BA_DEF_DEF_  "Description" "";
BA_DEF_DEF_  "Version" "";
BA_DEF_DEF_  "GenSigEnvVarType" "Undef";
BA_DEF_DEF_  "GenSigSendType" "NoSigSendType";
BA_DEF_DEF_  "GwSigLatencyTime" 40;
BA_DEF_DEF_  "GwSigMissingSourceType" "Undef";
BA_DEF_DEF_  "NWM-WakeupAllowed" "<n.a.>";
BA_DEF_DEF_  "RoutingFactor" 1;
BA_DEF_DEF_REL_ "GenSigTimeoutTime" 500;
BA_DEF_DEF_  "SystemSignalLongSymbol" "";
BA_ "GenMsgSendType" BO_ 980 0;
BA_ "GenMsgStartDelayTime" BO_ 980 10;
BA_ "VFrameFormat" BO_ 980 14;
BA_ "GenMsgSendType" BO_ 913 0;
BA_ "VFrameFormat" BO_ 913 14;
BA_ "GenMsgSendType" BO_ 426 0;
BA_ "GenMsgCycleTime" BO_ 426 100;
BA_ "GenMsgCycleTimeFast" BO_ 426 0;
BA_ "GenMsgNrOfRepetition" BO_ 426 0;
BA_ "VFrameFormat" BO_ 426 14;
BA_ "GenMsgSendType" BO_ 250 0;
BA_ "GenMsgCycleTime" BO_ 250 50;
BA_ "GenMsgCycleTimeFast" BO_ 250 0;
BA_ "GenMsgNrOfRepetition" BO_ 250 0;
BA_ "VFrameFormat" BO_ 250 14;
BA_ "GenMsgSendType" BO_ 53 0;
BA_ "GenMsgCycleTime" BO_ 53 50;
BA_ "GenMsgCycleTimeFast" BO_ 53 0;
BA_ "GenMsgNrOfRepetition" BO_ 53 0;
BA_ "VFrameFormat" BO_ 53 14;
BA_ "GenMsgCycleTime" BO_ 543 0;
BA_ "VFrameFormat" BO_ 543 14;
BA_ "GenMsgCycleTime" BO_ 2549874826 100;
BA_ "GenMsgCycleTimeFast" BO_ 2549874826 0;
BA_ "GenMsgDelayTime" BO_ 2549874826 10;
BA_ "GenMsgILSupport" BO_ 2549874826 0;
BA_ "GenMsgNrOfRepetition" BO_ 2549874826 0;
BA_ "NmAsrMessage" BO_ 2549874826 1;
BA_ "VFrameFormat" BO_ 2549874826 15;
BA_ "GenMsgCycleTime" BO_ 2549874789 100;
BA_ "GenMsgCycleTimeFast" BO_ 2549874789 0;
BA_ "GenMsgDelayTime" BO_ 2549874789 10;
BA_ "GenMsgILSupport" BO_ 2549874789 0;
BA_ "GenMsgNrOfRepetition" BO_ 2549874789 0;
BA_ "NmAsrMessage" BO_ 2549874789 1;
BA_ "VFrameFormat" BO_ 2549874789 15;
BA_ "GenMsgCycleTime" BO_ 2549874846 100;
BA_ "GenMsgCycleTimeFast" BO_ 2549874846 0;
BA_ "GenMsgDelayTime" BO_ 2549874846 10;
BA_ "GenMsgILSupport" BO_ 2549874846 0;
BA_ "GenMsgNrOfRepetition" BO_ 2549874846 0;
BA_ "NmAsrMessage" BO_ 2549874846 1;
BA_ "VFrameFormat" BO_ 2549874846 15;
BA_ "GenMsgCycleTime" BO_ 2549874837 100;
BA_ "GenMsgCycleTimeFast" BO_ 2549874837 0;
BA_ "GenMsgDelayTime" BO_ 2549874837 10;
BA_ "GenMsgILSupport" BO_ 2549874837 0;
BA_ "GenMsgNrOfRepetition" BO_ 2549874837 0;
BA_ "NmAsrMessage" BO_ 2549874837 1;
BA_ "VFrameFormat" BO_ 2549874837 15;
BA_ "GenMsgCycleTime" BO_ 2549874823 100;
BA_ "GenMsgCycleTimeFast" BO_ 2549874823 0;
BA_ "GenMsgDelayTime" BO_ 2549874823 10;
BA_ "GenMsgILSupport" BO_ 2549874823 0;
BA_ "GenMsgNrOfRepetition" BO_ 2549874823 0;
BA_ "NmAsrMessage" BO_ 2549874823 1;
BA_ "VFrameFormat" BO_ 2549874823 15;
BA_ "Description" SG_ 980 BDC_FD_Crc5Val "The data area for CRC calculation is based on the data length (DLC) of the message DB.

The CRC shall be calculated over the entire data block (excluding the CRC bytes) including the user data, alive counter and Data ID



- CRC Polynomial (0x1021) , Ini";
BA_ "GenSigSendType" SG_ 980 BDC_FD_Crc5Val 4;
BA_ "GenSigStartValue" SG_ 980 BDC_FD_Crc5Val 65535;
BA_ "UserSigValidity" SG_ 980 BDC_FD_Crc5Val 0;
BA_ "Version" SG_ 980 BDC_FD_Crc5Val "22.11.04";
BA_ "Description" SG_ 980 AutoLt_HorRes_STD "This signal is standard horizontal resolution of autolight sensor.



Horizontal brightness(lux)=AutoLt_HorRes_STD*AutoLt_HorVal_STD

※ AutoLt_HorVal_STD : Horizontal value signal

Brightness 0~1,000lux : Resolution is 1lux and value is 0(0h)~1,000(3E8h";
BA_ "GenSigSendType" SG_ 980 AutoLt_HorRes_STD 4;
BA_ "UserSigValidity" SG_ 980 AutoLt_HorRes_STD 0;
BA_ "NetworkRequest" SG_ 980 AutoLt_HorRes_STD 0;
BA_ "NetworkRequestHoldingTime" SG_ 980 AutoLt_HorRes_STD 5000;
BA_ "Version" SG_ 980 AutoLt_HorRes_STD "23.01.01";
BA_ "Description" SG_ 980 AutoLt_VerVal_STD "This signal is standard vertical value of autolight sensor.



Vertical brightness(lux)=AutoLt_VerRes_STD*AutoLt_VerVal_STD

※ AutoLt_VerRes_STD : Vertical resolution signal

Brightness 0~1,000lux : Resolution is 1lux and value is 0(0h)~1,000(3E8h)

Bri";
BA_ "GenSigSendType" SG_ 980 AutoLt_VerVal_STD 4;
BA_ "UserSigValidity" SG_ 980 AutoLt_VerVal_STD 0;
BA_ "NetworkRequest" SG_ 980 AutoLt_VerVal_STD 0;
BA_ "NetworkRequestHoldingTime" SG_ 980 AutoLt_VerVal_STD 5000;
BA_ "Version" SG_ 980 AutoLt_VerVal_STD "23.01.01";
BA_ "Description" SG_ 980 AutoLt_VerRes_STD "This signal is standard vertical resolution of autolight sensor.



Vertical brightness(lux)=AutoLt_VerRes_STD*AutoLt_VerVal_STD

※ AutoLt_VerVal_STD : Vertical value signal

Brightness 0~1,000lux : Resolution is 1lux and value is 0(0h)~1,000(3E8h)

Bri";
BA_ "GenSigSendType" SG_ 980 AutoLt_VerRes_STD 4;
BA_ "UserSigValidity" SG_ 980 AutoLt_VerRes_STD 0;
BA_ "NetworkRequest" SG_ 980 AutoLt_VerRes_STD 0;
BA_ "NetworkRequestHoldingTime" SG_ 980 AutoLt_VerRes_STD 5000;
BA_ "Version" SG_ 980 AutoLt_VerRes_STD "23.01.01";
BA_ "Description" SG_ 980 MoodLamp_SlvColor_X "Color X Mood Lamp to slave";
BA_ "GenSigSendType" SG_ 980 MoodLamp_SlvColor_X 4;
BA_ "GenSigStartValue" SG_ 980 MoodLamp_SlvColor_X 47;
BA_ "UserSigValidity" SG_ 980 MoodLamp_SlvColor_X 0;
BA_ "Version" SG_ 980 MoodLamp_SlvColor_X "23.02.02";
BA_ "Description" SG_ 980 MoodLamp_SlvColor_Y "Color Y Mood lamp to slave";
BA_ "GenSigSendType" SG_ 980 MoodLamp_SlvColor_Y 4;
BA_ "GenSigStartValue" SG_ 980 MoodLamp_SlvColor_Y 51;
BA_ "UserSigValidity" SG_ 980 MoodLamp_SlvColor_Y 0;
BA_ "Version" SG_ 980 MoodLamp_SlvColor_Y "23.02.02";
BA_ "Description" SG_ 980 MoodLamp_SlvBrgtnsVal "Brightness mood lamp to slave";
BA_ "GenSigSendType" SG_ 980 MoodLamp_SlvBrgtnsVal 4;
BA_ "GenSigStartValue" SG_ 980 MoodLamp_SlvBrgtnsVal 250;
BA_ "UserSigValidity" SG_ 980 MoodLamp_SlvBrgtnsVal 0;
BA_ "Version" SG_ 980 MoodLamp_SlvBrgtnsVal "23.02.02";
BA_ "Description" SG_ 980 MoodLamp_SlvFadeInTimetVal "Fade In Time Mood Lamp to slave";
BA_ "GenSigSendType" SG_ 980 MoodLamp_SlvFadeInTimetVal 4;
BA_ "GenSigStartValue" SG_ 980 MoodLamp_SlvFadeInTimetVal 10;
BA_ "UserSigValidity" SG_ 980 MoodLamp_SlvFadeInTimetVal 0;
BA_ "Version" SG_ 980 MoodLamp_SlvFadeInTimetVal "23.02.02";
BA_ "Description" SG_ 980 BDC_FD_AlvCnt5Val "For the first transmission request for a data element the counter shall be initialized with 0 and shall be incremented by 1 for every subsequent send request. 

When the counter reaches the maximum value(0xFF), then it shall restart with 0 for the next s";
BA_ "GenSigSendType" SG_ 980 BDC_FD_AlvCnt5Val 4;
BA_ "UserSigValidity" SG_ 980 BDC_FD_AlvCnt5Val 0;
BA_ "Version" SG_ 980 BDC_FD_AlvCnt5Val "22.11.04";
BA_ "Description" SG_ 980 MoodLamp_SlvFadeOutTimetVal "Fade Out Time Mood Lamp to slave";
BA_ "GenSigSendType" SG_ 980 MoodLamp_SlvFadeOutTimetVal 4;
BA_ "GenSigStartValue" SG_ 980 MoodLamp_SlvFadeOutTimetVal 10;
BA_ "UserSigValidity" SG_ 980 MoodLamp_SlvFadeOutTimetVal 0;
BA_ "Version" SG_ 980 MoodLamp_SlvFadeOutTimetVal "23.02.02";
BA_ "Description" SG_ 980 Lamp_LftTrnLmpCmdSta "Left Turn Signal and Hazard Lamp Command State";
BA_ "GenSigSendType" SG_ 980 Lamp_LftTrnLmpCmdSta 4;
BA_ "UserSigValidity" SG_ 980 Lamp_LftTrnLmpCmdSta 0;
BA_ "NetworkRequest" SG_ 980 Lamp_LftTrnLmpCmdSta 0;
BA_ "NetworkRequestHoldingTime" SG_ 980 Lamp_LftTrnLmpCmdSta 5000;
BA_ "Version" SG_ 980 Lamp_LftTrnLmpCmdSta "23.02.06";
BA_ "Description" SG_ 980 Lamp_RtTrnLmpCmdSta "Right Turn Signal and Hazard Lamp Command State";
BA_ "GenSigSendType" SG_ 980 Lamp_RtTrnLmpCmdSta 4;
BA_ "UserSigValidity" SG_ 980 Lamp_RtTrnLmpCmdSta 0;
BA_ "NetworkRequest" SG_ 980 Lamp_RtTrnLmpCmdSta 0;
BA_ "NetworkRequestHoldingTime" SG_ 980 Lamp_RtTrnLmpCmdSta 5000;
BA_ "Version" SG_ 980 Lamp_RtTrnLmpCmdSta "23.02.06";
BA_ "Description" SG_ 980 Lamp_LftTrnLmpCmd "Left Turn Signal and Hazard Lamp Command State";
BA_ "GenSigSendType" SG_ 980 Lamp_LftTrnLmpCmd 4;
BA_ "UserSigValidity" SG_ 980 Lamp_LftTrnLmpCmd 0;
BA_ "NetworkRequest" SG_ 980 Lamp_LftTrnLmpCmd 0;
BA_ "NetworkRequestHoldingTime" SG_ 980 Lamp_LftTrnLmpCmd 5000;
BA_ "Version" SG_ 980 Lamp_LftTrnLmpCmd "23.02.10";
BA_ "Description" SG_ 980 Lamp_RtTrnLmpCmd "Right Turn Signal and Hazard Lamp Command";
BA_ "GenSigSendType" SG_ 980 Lamp_RtTrnLmpCmd 4;
BA_ "UserSigValidity" SG_ 980 Lamp_RtTrnLmpCmd 0;
BA_ "NetworkRequest" SG_ 980 Lamp_RtTrnLmpCmd 0;
BA_ "NetworkRequestHoldingTime" SG_ 980 Lamp_RtTrnLmpCmd 500;
BA_ "Version" SG_ 980 Lamp_RtTrnLmpCmd "23.02.10";
BA_ "Description" SG_ 980 Lamp_TrnLmpMode "Turn Signal and Hazard Lamp Mode";
BA_ "GenSigSendType" SG_ 980 Lamp_TrnLmpMode 4;
BA_ "UserSigValidity" SG_ 980 Lamp_TrnLmpMode 0;
BA_ "NetworkRequest" SG_ 980 Lamp_TrnLmpMode 0;
BA_ "NetworkRequestHoldingTime" SG_ 980 Lamp_TrnLmpMode 5000;
BA_ "Version" SG_ 980 Lamp_TrnLmpMode "23.04.06";
BA_ "Description" SG_ 980 Lamp_HzrdSwIND "Hazard switch indicator command";
BA_ "GenSigSendType" SG_ 980 Lamp_HzrdSwIND 4;
BA_ "UserSigValidity" SG_ 980 Lamp_HzrdSwIND 0;
BA_ "NetworkRequest" SG_ 980 Lamp_HzrdSwIND 0;
BA_ "NetworkRequestHoldingTime" SG_ 980 Lamp_HzrdSwIND 5000;
BA_ "Version" SG_ 980 Lamp_HzrdSwIND "23.02.10";
BA_ "Description" SG_ 980 Lamp_HdLmpEscortShortCmd "HeadLamp Escort(short) Cmd";
BA_ "GenSigSendType" SG_ 980 Lamp_HdLmpEscortShortCmd 4;
BA_ "UserSigValidity" SG_ 980 Lamp_HdLmpEscortShortCmd 0;
BA_ "NetworkRequest" SG_ 980 Lamp_HdLmpEscortShortCmd 0;
BA_ "NetworkRequestHoldingTime" SG_ 980 Lamp_HdLmpEscortShortCmd 5000;
BA_ "Version" SG_ 980 Lamp_HdLmpEscortShortCmd "23.07.06";
BA_ "Description" SG_ 980 Lamp_LightPopUpMsgType "Only for CPAD type lightmode switch.

Type A : OFF-TAIL-AUTO-LOW

Type B : AUTO-LOW";
BA_ "GenSigSendType" SG_ 980 Lamp_LightPopUpMsgType 4;
BA_ "UserSigValidity" SG_ 980 Lamp_LightPopUpMsgType 0;
BA_ "NetworkRequest" SG_ 980 Lamp_LightPopUpMsgType 0;
BA_ "NetworkRequestHoldingTime" SG_ 980 Lamp_LightPopUpMsgType 5000;
BA_ "Version" SG_ 980 Lamp_LightPopUpMsgType "23.10.00";
BA_ "Description" SG_ 980 Lamp_LightPopUpReq "Only for CPAD Type Lightmode Switch

Current light switch state when the switch is pushed";
BA_ "GenSigSendType" SG_ 980 Lamp_LightPopUpReq 4;
BA_ "UserSigValidity" SG_ 980 Lamp_LightPopUpReq 0;
BA_ "NetworkRequest" SG_ 980 Lamp_LightPopUpReq 0;
BA_ "NetworkRequestHoldingTime" SG_ 980 Lamp_LightPopUpReq 5000;
BA_ "Version" SG_ 980 Lamp_LightPopUpReq "23.10.00";
BA_ "Description" SG_ 980 Lamp_HdLmpLoOffPopUpReq "Head Lamp off pop up alarm request";
BA_ "GenSigSendType" SG_ 980 Lamp_HdLmpLoOffPopUpReq 4;
BA_ "UserSigValidity" SG_ 980 Lamp_HdLmpLoOffPopUpReq 0;
BA_ "NetworkRequest" SG_ 980 Lamp_HdLmpLoOffPopUpReq 0;
BA_ "NetworkRequestHoldingTime" SG_ 980 Lamp_HdLmpLoOffPopUpReq 5000;
BA_ "Version" SG_ 980 Lamp_HdLmpLoOffPopUpReq "24.04.03";
BA_ "Description" SG_ 980 MoodLamp_SpeechRecogPosSta "MoodLamp AIVoice Speech Recognition Position Status";
BA_ "GenSigSendType" SG_ 980 MoodLamp_SpeechRecogPosSta 4;
BA_ "UserSigValidity" SG_ 980 MoodLamp_SpeechRecogPosSta 0;
BA_ "Version" SG_ 980 MoodLamp_SpeechRecogPosSta "24.05.01";
BA_ "Description" SG_ 980 MoodLamp_BttmSlvColor_X "Color X Mood Lamp to slave (Bottom)";
BA_ "GenSigSendType" SG_ 980 MoodLamp_BttmSlvColor_X 4;
BA_ "GenSigStartValue" SG_ 980 MoodLamp_BttmSlvColor_X 47;
BA_ "UserSigValidity" SG_ 980 MoodLamp_BttmSlvColor_X 0;
BA_ "Version" SG_ 980 MoodLamp_BttmSlvColor_X "24.07.06";
BA_ "Description" SG_ 980 MoodLamp_BttmSlvColor_Y "Color Y Mood Lamp to slave (Bottom)";
BA_ "GenSigSendType" SG_ 980 MoodLamp_BttmSlvColor_Y 4;
BA_ "GenSigStartValue" SG_ 980 MoodLamp_BttmSlvColor_Y 51;
BA_ "UserSigValidity" SG_ 980 MoodLamp_BttmSlvColor_Y 0;
BA_ "Version" SG_ 980 MoodLamp_BttmSlvColor_Y "24.07.06";
BA_ "Description" SG_ 980 MoodLamp_BttmSlvBrgtnsVal "Brightness mood lamp to slave (Bottom)";
BA_ "GenSigSendType" SG_ 980 MoodLamp_BttmSlvBrgtnsVal 4;
BA_ "GenSigStartValue" SG_ 980 MoodLamp_BttmSlvBrgtnsVal 250;
BA_ "UserSigValidity" SG_ 980 MoodLamp_BttmSlvBrgtnsVal 0;
BA_ "Version" SG_ 980 MoodLamp_BttmSlvBrgtnsVal "24.07.06";
BA_ "Description" SG_ 980 MoodLamp_BttmSlvFadeInTimetVal "Fade In Time Mood Lamp to slave (Bottom)";
BA_ "GenSigSendType" SG_ 980 MoodLamp_BttmSlvFadeInTimetVal 4;
BA_ "GenSigStartValue" SG_ 980 MoodLamp_BttmSlvFadeInTimetVal 10;
BA_ "UserSigValidity" SG_ 980 MoodLamp_BttmSlvFadeInTimetVal 0;
BA_ "Version" SG_ 980 MoodLamp_BttmSlvFadeInTimetVal "24.07.06";
BA_ "Description" SG_ 980 MoodLamp_BttmSlvFadeOutTimetVal "Fade Out Time Mood Lamp to slave (Bottom)";
BA_ "GenSigSendType" SG_ 980 MoodLamp_BttmSlvFadeOutTimetVal 4;
BA_ "GenSigStartValue" SG_ 980 MoodLamp_BttmSlvFadeOutTimetVal 10;
BA_ "UserSigValidity" SG_ 980 MoodLamp_BttmSlvFadeOutTimetVal 0;
BA_ "Version" SG_ 980 MoodLamp_BttmSlvFadeOutTimetVal "24.07.06";
BA_ "Description" SG_ 980 Lamp_FrontGroundLightOnReq "Signal for turning On/Off front exterior lamp for ground lighting";
BA_ "GenSigSendType" SG_ 980 Lamp_FrontGroundLightOnReq 4;
BA_ "UserSigValidity" SG_ 980 Lamp_FrontGroundLightOnReq 0;
BA_ "NetworkRequest" SG_ 980 Lamp_FrontGroundLightOnReq 0;
BA_ "NetworkRequestHoldingTime" SG_ 980 Lamp_FrontGroundLightOnReq 5000;
BA_ "Version" SG_ 980 Lamp_FrontGroundLightOnReq "24.07.05";
BA_ "Description" SG_ 980 Lamp_SideGroundLightOnReq "Signal for turning On/Off side exterior lamp for ground lighting";
BA_ "GenSigSendType" SG_ 980 Lamp_SideGroundLightOnReq 4;
BA_ "UserSigValidity" SG_ 980 Lamp_SideGroundLightOnReq 0;
BA_ "NetworkRequest" SG_ 980 Lamp_SideGroundLightOnReq 0;
BA_ "NetworkRequestHoldingTime" SG_ 980 Lamp_SideGroundLightOnReq 5000;
BA_ "Version" SG_ 980 Lamp_SideGroundLightOnReq "24.07.05";
BA_ "Description" SG_ 980 Lamp_RearGroundLightOnReq "Signal for turning On/Off rear exterior lamp for ground lighting";
BA_ "GenSigSendType" SG_ 980 Lamp_RearGroundLightOnReq 4;
BA_ "UserSigValidity" SG_ 980 Lamp_RearGroundLightOnReq 0;
BA_ "NetworkRequest" SG_ 980 Lamp_RearGroundLightOnReq 0;
BA_ "NetworkRequestHoldingTime" SG_ 980 Lamp_RearGroundLightOnReq 5000;
BA_ "Version" SG_ 980 Lamp_RearGroundLightOnReq "24.07.05";
BA_ "Description" SG_ 980 Lamp_HiPrioHzrdReq "-Higher priority than SJB hazard

-Diag/Arm/DisArm/Balarm/Panic/MTS

-Initial Value: 2";
BA_ "GenSigSendType" SG_ 980 Lamp_HiPrioHzrdReq 4;
BA_ "GenSigStartValue" SG_ 980 Lamp_HiPrioHzrdReq 2;
BA_ "UserSigValidity" SG_ 980 Lamp_HiPrioHzrdReq 0;
BA_ "NetworkRequest" SG_ 980 Lamp_HiPrioHzrdReq 0;
BA_ "NetworkRequestHoldingTime" SG_ 980 Lamp_HiPrioHzrdReq 5000;
BA_ "Version" SG_ 980 Lamp_HiPrioHzrdReq "17.12.00";
BA_ "Description" SG_ 980 Lamp_FrFogLmpEnable "Fog lamp operational status";
BA_ "GenSigSendType" SG_ 980 Lamp_FrFogLmpEnable 4;
BA_ "UserSigValidity" SG_ 980 Lamp_FrFogLmpEnable 0;
BA_ "NetworkRequest" SG_ 980 Lamp_FrFogLmpEnable 0;
BA_ "NetworkRequestHoldingTime" SG_ 980 Lamp_FrFogLmpEnable 5000;
BA_ "Version" SG_ 980 Lamp_FrFogLmpEnable "24.07.06";
BA_ "Description" SG_ 980 Lamp_RrFogLmpEnable "Fog lamp operational status";
BA_ "GenSigSendType" SG_ 980 Lamp_RrFogLmpEnable 4;
BA_ "UserSigValidity" SG_ 980 Lamp_RrFogLmpEnable 0;
BA_ "NetworkRequest" SG_ 980 Lamp_RrFogLmpEnable 0;
BA_ "NetworkRequestHoldingTime" SG_ 980 Lamp_RrFogLmpEnable 5000;
BA_ "Version" SG_ 980 Lamp_RrFogLmpEnable "24.07.06";
BA_ "Description" SG_ 980 Lamp_LoPrioHzrdReq "-Lower priority than SJB hazard

-TrunkOpenClose/CrashUnlock/RemoteStart

-Initial Value: 2";
BA_ "GenSigSendType" SG_ 980 Lamp_LoPrioHzrdReq 4;
BA_ "GenSigStartValue" SG_ 980 Lamp_LoPrioHzrdReq 2;
BA_ "UserSigValidity" SG_ 980 Lamp_LoPrioHzrdReq 0;
BA_ "NetworkRequest" SG_ 980 Lamp_LoPrioHzrdReq 0;
BA_ "NetworkRequestHoldingTime" SG_ 980 Lamp_LoPrioHzrdReq 5000;
BA_ "Version" SG_ 980 Lamp_LoPrioHzrdReq "17.12.00";
BA_ "Description" SG_ 980 Lamp_ExtrnlTailLmpOnReq "-(Old)C_EXTTailOn";
BA_ "GenSigSendType" SG_ 980 Lamp_ExtrnlTailLmpOnReq 4;
BA_ "UserSigValidity" SG_ 980 Lamp_ExtrnlTailLmpOnReq 0;
BA_ "NetworkRequest" SG_ 980 Lamp_ExtrnlTailLmpOnReq 0;
BA_ "NetworkRequestHoldingTime" SG_ 980 Lamp_ExtrnlTailLmpOnReq 5000;
BA_ "Version" SG_ 980 Lamp_ExtrnlTailLmpOnReq "17.12.00";
BA_ "Description" SG_ 980 Lamp_HdLmpLoOnReq "-(Old)C_HLampLowON";
BA_ "GenSigSendType" SG_ 980 Lamp_HdLmpLoOnReq 4;
BA_ "UserSigValidity" SG_ 980 Lamp_HdLmpLoOnReq 0;
BA_ "NetworkRequest" SG_ 980 Lamp_HdLmpLoOnReq 0;
BA_ "NetworkRequestHoldingTime" SG_ 980 Lamp_HdLmpLoOnReq 5000;
BA_ "Version" SG_ 980 Lamp_HdLmpLoOnReq "17.12.00";
BA_ "Description" SG_ 980 Lamp_HdLmpHiOnReq "-(Old)C_HLampHighON";
BA_ "GenSigSendType" SG_ 980 Lamp_HdLmpHiOnReq 4;
BA_ "UserSigValidity" SG_ 980 Lamp_HdLmpHiOnReq 0;
BA_ "NetworkRequest" SG_ 980 Lamp_HdLmpHiOnReq 0;
BA_ "NetworkRequestHoldingTime" SG_ 980 Lamp_HdLmpHiOnReq 5000;
BA_ "Version" SG_ 980 Lamp_HdLmpHiOnReq "17.12.00";
BA_ "Description" SG_ 980 Lamp_DrlOnReq "Lamp on command for DRL";
BA_ "GenSigSendType" SG_ 980 Lamp_DrlOnReq 4;
BA_ "UserSigValidity" SG_ 980 Lamp_DrlOnReq 0;
BA_ "NetworkRequest" SG_ 980 Lamp_DrlOnReq 0;
BA_ "NetworkRequestHoldingTime" SG_ 980 Lamp_DrlOnReq 5000;
BA_ "Version" SG_ 980 Lamp_DrlOnReq "20.09.00";
BA_ "Description" SG_ 980 Lamp_BckUpLmpCmd "BackUp Lamp On/Off Command";
BA_ "GenSigSendType" SG_ 980 Lamp_BckUpLmpCmd 4;
BA_ "UserSigValidity" SG_ 980 Lamp_BckUpLmpCmd 0;
BA_ "NetworkRequest" SG_ 980 Lamp_BckUpLmpCmd 0;
BA_ "NetworkRequestHoldingTime" SG_ 980 Lamp_BckUpLmpCmd 5000;
BA_ "Version" SG_ 980 Lamp_BckUpLmpCmd "20.08.02";
BA_ "GenSigSendType" SG_ 980 Lamp_FrFogLmpOnReq 4;
BA_ "UserSigValidity" SG_ 980 Lamp_FrFogLmpOnReq 0;
BA_ "NetworkRequest" SG_ 980 Lamp_FrFogLmpOnReq 0;
BA_ "NetworkRequestHoldingTime" SG_ 980 Lamp_FrFogLmpOnReq 5000;
BA_ "Version" SG_ 980 Lamp_FrFogLmpOnReq "17.12.00";
BA_ "GenSigSendType" SG_ 980 Lamp_RrFogLmpOnReq 4;
BA_ "UserSigValidity" SG_ 980 Lamp_RrFogLmpOnReq 0;
BA_ "NetworkRequest" SG_ 980 Lamp_RrFogLmpOnReq 0;
BA_ "NetworkRequestHoldingTime" SG_ 980 Lamp_RrFogLmpOnReq 5000;
BA_ "Version" SG_ 980 Lamp_RrFogLmpOnReq "17.12.00";
BA_ "Description" SG_ 980 Lamp_StcBendingLmpLftOnReq "-(Old)C_StaticBend_LH_On";
BA_ "GenSigSendType" SG_ 980 Lamp_StcBendingLmpLftOnReq 4;
BA_ "UserSigValidity" SG_ 980 Lamp_StcBendingLmpLftOnReq 0;
BA_ "NetworkRequest" SG_ 980 Lamp_StcBendingLmpLftOnReq 0;
BA_ "NetworkRequestHoldingTime" SG_ 980 Lamp_StcBendingLmpLftOnReq 5000;
BA_ "Version" SG_ 980 Lamp_StcBendingLmpLftOnReq "20.08.02";
BA_ "Description" SG_ 980 Lamp_StcBendingLmpRtOnReq "-(Old)C_StaticBend_RH_On";
BA_ "GenSigSendType" SG_ 980 Lamp_StcBendingLmpRtOnReq 4;
BA_ "UserSigValidity" SG_ 980 Lamp_StcBendingLmpRtOnReq 0;
BA_ "NetworkRequest" SG_ 980 Lamp_StcBendingLmpRtOnReq 0;
BA_ "NetworkRequestHoldingTime" SG_ 980 Lamp_StcBendingLmpRtOnReq 5000;
BA_ "Version" SG_ 980 Lamp_StcBendingLmpRtOnReq "20.08.02";
BA_ "Description" SG_ 980 Lamp_CornerLmpLftOnReq "cornering lamp control signal";
BA_ "GenSigSendType" SG_ 980 Lamp_CornerLmpLftOnReq 4;
BA_ "UserSigValidity" SG_ 980 Lamp_CornerLmpLftOnReq 0;
BA_ "NetworkRequest" SG_ 980 Lamp_CornerLmpLftOnReq 0;
BA_ "NetworkRequestHoldingTime" SG_ 980 Lamp_CornerLmpLftOnReq 5000;
BA_ "Version" SG_ 980 Lamp_CornerLmpLftOnReq "20.08.02";
BA_ "Description" SG_ 980 Lamp_CornerLmpRtOnReq "cornering lamp control signal";
BA_ "GenSigSendType" SG_ 980 Lamp_CornerLmpRtOnReq 4;
BA_ "UserSigValidity" SG_ 980 Lamp_CornerLmpRtOnReq 0;
BA_ "NetworkRequest" SG_ 980 Lamp_CornerLmpRtOnReq 0;
BA_ "NetworkRequestHoldingTime" SG_ 980 Lamp_CornerLmpRtOnReq 5000;
BA_ "Version" SG_ 980 Lamp_CornerLmpRtOnReq "20.08.02";
BA_ "Description" SG_ 980 Lamp_HbaCtrlModTyp "This signal headlamp high control by BCM or HBA";
BA_ "GenSigSendType" SG_ 980 Lamp_HbaCtrlModTyp 4;
BA_ "UserSigValidity" SG_ 980 Lamp_HbaCtrlModTyp 0;
BA_ "NetworkRequest" SG_ 980 Lamp_HbaCtrlModTyp 0;
BA_ "NetworkRequestHoldingTime" SG_ 980 Lamp_HbaCtrlModTyp 5000;
BA_ "Version" SG_ 980 Lamp_HbaCtrlModTyp "17.12.00";
BA_ "Description" SG_ 980 Lamp_IFSCtrlModTyp "This signal headlamp high control by BCM or IFS";
BA_ "GenSigSendType" SG_ 980 Lamp_IFSCtrlModTyp 4;
BA_ "UserSigValidity" SG_ 980 Lamp_IFSCtrlModTyp 0;
BA_ "NetworkRequest" SG_ 980 Lamp_IFSCtrlModTyp 0;
BA_ "NetworkRequestHoldingTime" SG_ 980 Lamp_IFSCtrlModTyp 5000;
BA_ "Version" SG_ 980 Lamp_IFSCtrlModTyp "17.12.00";
BA_ "Description" SG_ 980 Lamp_HdLmpWlcmCmd "HeadLamp Welcome Cmd 

- receiver : ICU (CGW)";
BA_ "GenSigSendType" SG_ 980 Lamp_HdLmpWlcmCmd 4;
BA_ "UserSigValidity" SG_ 980 Lamp_HdLmpWlcmCmd 0;
BA_ "NetworkRequest" SG_ 980 Lamp_HdLmpWlcmCmd 0;
BA_ "NetworkRequestHoldingTime" SG_ 980 Lamp_HdLmpWlcmCmd 5000;
BA_ "Version" SG_ 980 Lamp_HdLmpWlcmCmd "23.07.06";
BA_ "Description" SG_ 980 Lamp_PuddleLmpOnReq "Puddle Lamp command";
BA_ "GenSigSendType" SG_ 980 Lamp_PuddleLmpOnReq 4;
BA_ "UserSigValidity" SG_ 980 Lamp_PuddleLmpOnReq 0;
BA_ "NetworkRequest" SG_ 980 Lamp_PuddleLmpOnReq 0;
BA_ "NetworkRequestHoldingTime" SG_ 980 Lamp_PuddleLmpOnReq 5000;
BA_ "Version" SG_ 980 Lamp_PuddleLmpOnReq "17.12.00";
BA_ "Description" SG_ 980 Lamp_ExtLampRSPAMode "RSPA Mode for Box/Cargo Lamp";
BA_ "GenSigSendType" SG_ 980 Lamp_ExtLampRSPAMode 4;
BA_ "UserSigValidity" SG_ 980 Lamp_ExtLampRSPAMode 0;
BA_ "NetworkRequest" SG_ 980 Lamp_ExtLampRSPAMode 0;
BA_ "NetworkRequestHoldingTime" SG_ 980 Lamp_ExtLampRSPAMode 5000;
BA_ "Version" SG_ 980 Lamp_ExtLampRSPAMode "21.09.05";
BA_ "Description" SG_ 980 Lamp_IntTailLmpOnReq "-(Old)C_INTTailOn";
BA_ "GenSigSendType" SG_ 980 Lamp_IntTailLmpOnReq 4;
BA_ "UserSigValidity" SG_ 980 Lamp_IntTailLmpOnReq 0;
BA_ "NetworkRequest" SG_ 980 Lamp_IntTailLmpOnReq 0;
BA_ "NetworkRequestHoldingTime" SG_ 980 Lamp_IntTailLmpOnReq 5000;
BA_ "Version" SG_ 980 Lamp_IntTailLmpOnReq "17.12.00";
BA_ "Description" SG_ 980 Lamp_AvTailLmpSta "-Send with at the same time with C_IntTailOn

-Initiail Value: 1";
BA_ "GenSigSendType" SG_ 980 Lamp_AvTailLmpSta 4;
BA_ "GenSigStartValue" SG_ 980 Lamp_AvTailLmpSta 1;
BA_ "UserSigValidity" SG_ 980 Lamp_AvTailLmpSta 0;
BA_ "NetworkRequest" SG_ 980 Lamp_AvTailLmpSta 0;
BA_ "NetworkRequestHoldingTime" SG_ 980 Lamp_AvTailLmpSta 5000;
BA_ "Version" SG_ 980 Lamp_AvTailLmpSta "21.09.05";
BA_ "Description" SG_ 980 Lamp_AutoLtSnsrNightSta "This signal indicates autolight sensor output";
BA_ "GenSigSendType" SG_ 980 Lamp_AutoLtSnsrNightSta 4;
BA_ "GenSigStartValue" SG_ 980 Lamp_AutoLtSnsrNightSta 1;
BA_ "UserSigValidity" SG_ 980 Lamp_AutoLtSnsrNightSta 0;
BA_ "NetworkRequest" SG_ 980 Lamp_AutoLtSnsrNightSta 0;
BA_ "NetworkRequestHoldingTime" SG_ 980 Lamp_AutoLtSnsrNightSta 5000;
BA_ "Version" SG_ 980 Lamp_AutoLtSnsrNightSta "20.04.06";
BA_ "Description" SG_ 980 Lamp_VendorInfo "Rain sensor Vendor info (LIN to CAN signal)

  - Not applied standard sensor : 0x1 or 0x2

  - Applied standard sensor : 0x3 or 0x4";
BA_ "GenSigSendType" SG_ 980 Lamp_VendorInfo 4;
BA_ "GenSigStartValue" SG_ 980 Lamp_VendorInfo 7;
BA_ "UserSigValidity" SG_ 980 Lamp_VendorInfo 0;
BA_ "NetworkRequest" SG_ 980 Lamp_VendorInfo 0;
BA_ "NetworkRequestHoldingTime" SG_ 980 Lamp_VendorInfo 5000;
BA_ "Version" SG_ 980 Lamp_VendorInfo "22.12.04";
BA_ "Description" SG_ 980 Lamp_AutoLtSnsrHorVal "This signal indicates autolight sensor output (for HUD)

<BCS>

0x0~0x3FE : Light Sensor Value

0x3FF : Invalid

<HELLA>

0x0~0xFE, 100~0x3FE : Light Sensor Value

0xFF, 0x3FF : Invalid";
BA_ "GenSigSendType" SG_ 980 Lamp_AutoLtSnsrHorVal 4;
BA_ "UserSigValidity" SG_ 980 Lamp_AutoLtSnsrHorVal 0;
BA_ "NetworkRequest" SG_ 980 Lamp_AutoLtSnsrHorVal 0;
BA_ "NetworkRequestHoldingTime" SG_ 980 Lamp_AutoLtSnsrHorVal 5000;
BA_ "Version" SG_ 980 Lamp_AutoLtSnsrHorVal "21.12.00";
BA_ "GenSigSendType" SG_ 980 MoodLamp_AIVoiceOptSta 4;
BA_ "UserSigValidity" SG_ 980 MoodLamp_AIVoiceOptSta 0;
BA_ "NetworkRequest" SG_ 980 MoodLamp_AIVoiceOptSta 0;
BA_ "NetworkRequestHoldingTime" SG_ 980 MoodLamp_AIVoiceOptSta 5000;
BA_ "Version" SG_ 980 MoodLamp_AIVoiceOptSta "22.11.02";
BA_ "GenSigSendType" SG_ 980 MoodLamp_DualColorOptSta 4;
BA_ "UserSigValidity" SG_ 980 MoodLamp_DualColorOptSta 0;
BA_ "NetworkRequest" SG_ 980 MoodLamp_DualColorOptSta 0;
BA_ "NetworkRequestHoldingTime" SG_ 980 MoodLamp_DualColorOptSta 5000;
BA_ "Version" SG_ 980 MoodLamp_DualColorOptSta "22.11.02";
BA_ "GenSigSendType" SG_ 980 MoodLamp_MdLmpFadeSta 4;
BA_ "UserSigValidity" SG_ 980 MoodLamp_MdLmpFadeSta 0;
BA_ "NetworkRequest" SG_ 980 MoodLamp_MdLmpFadeSta 0;
BA_ "NetworkRequestHoldingTime" SG_ 980 MoodLamp_MdLmpFadeSta 5000;
BA_ "Version" SG_ 980 MoodLamp_MdLmpFadeSta "22.11.02";
BA_ "GenSigSendType" SG_ 980 MoodLamp_NumRecommendColor 4;
BA_ "UserSigValidity" SG_ 980 MoodLamp_NumRecommendColor 0;
BA_ "NetworkRequest" SG_ 980 MoodLamp_NumRecommendColor 0;
BA_ "NetworkRequestHoldingTime" SG_ 980 MoodLamp_NumRecommendColor 5000;
BA_ "Version" SG_ 980 MoodLamp_NumRecommendColor "22.11.02";
BA_ "Description" SG_ 980 AutoLt_HorVal_STD "This signal is standard horizontal value of autolight sensor



Horizontal brightness(lux)=AutoLt_HorRes_STD*AutoLt_HorVal_STD

※ AutoLt_HorRes_STD : Horizontal resolution signal

Brightness 0~1,000lux : Resolution is 1lux and value is 0(0h)~1,000(3E8h)";
BA_ "GenSigSendType" SG_ 980 AutoLt_HorVal_STD 4;
BA_ "UserSigValidity" SG_ 980 AutoLt_HorVal_STD 0;
BA_ "NetworkRequest" SG_ 980 AutoLt_HorVal_STD 0;
BA_ "NetworkRequestHoldingTime" SG_ 980 AutoLt_HorVal_STD 5000;
BA_ "Version" SG_ 980 AutoLt_HorVal_STD "22.12.04";
BA_ "Description" SG_ 913 WPC_FD_Crc1Val "The data area for CRC calculation is based on the data length (DLC) of the message DB.

The CRC shall be calculated over the entire data block (excluding the CRC bytes) including the user data, alive counter and Data ID



- CRC Polynomial (0x1021) , Ini";
BA_ "GenSigSendType" SG_ 913 WPC_FD_Crc1Val 4;
BA_ "GenSigStartValue" SG_ 913 WPC_FD_Crc1Val 65535;
BA_ "UserSigValidity" SG_ 913 WPC_FD_Crc1Val 3;
BA_ "Version" SG_ 913 WPC_FD_Crc1Val "22.10.20";
BA_ "Description" SG_ 913 WPC_IndSyncVal "WPC IND ANIMATION SYNC SIGANL";
BA_ "GenSigSendType" SG_ 913 WPC_IndSyncVal 4;
BA_ "TimeoutValue" SG_ 913 WPC_IndSyncVal "0x0";
BA_ "UserSigValidity" SG_ 913 WPC_IndSyncVal 3;
BA_ "Version" SG_ 913 WPC_IndSyncVal "22.04.01";
BA_ "Description" SG_ 913 USM_CmdWPCIndSta "WPC Indicator animation type USM";
BA_ "GenSigSendType" SG_ 913 USM_CmdWPCIndSta 4;
BA_ "GenSigStartValue" SG_ 913 USM_CmdWPCIndSta 2;
BA_ "UserSigValidity" SG_ 913 USM_CmdWPCIndSta 0;
BA_ "NetworkRequest" SG_ 913 USM_CmdWPCIndSta 0;
BA_ "NetworkRequestHoldingTime" SG_ 913 USM_CmdWPCIndSta 5000;
BA_ "Version" SG_ 913 USM_CmdWPCIndSta "22.05.02";
BA_ "Description" SG_ 913 WPC_ResetOpSta "This signal indicates whether the reset operation has been completed or not";
BA_ "GenSigSendType" SG_ 913 WPC_ResetOpSta 4;
BA_ "UserSigValidity" SG_ 913 WPC_ResetOpSta 0;
BA_ "Version" SG_ 913 WPC_ResetOpSta "24.05.01";
BA_ "Description" SG_ 913 WPC_FD_AlvCnt1Val "For the first transmission request for a data element the counter shall be initialized with 0 and shall be incremented by 1 for every subsequent send request. 

When the counter reaches the maximum value(0xFF), then it shall restart with 0 for the next s";
BA_ "GenSigSendType" SG_ 913 WPC_FD_AlvCnt1Val 4;
BA_ "UserSigValidity" SG_ 913 WPC_FD_AlvCnt1Val 3;
BA_ "Version" SG_ 913 WPC_FD_AlvCnt1Val "22.10.20";
BA_ "Description" SG_ 913 USM_CmdWPCSta "USM request value of WPC";
BA_ "GenSigSendType" SG_ 913 USM_CmdWPCSta 4;
BA_ "UserSigValidity" SG_ 913 USM_CmdWPCSta 0;
BA_ "NetworkRequest" SG_ 913 USM_CmdWPCSta 0;
BA_ "NetworkRequestHoldingTime" SG_ 913 USM_CmdWPCSta 5000;
BA_ "Version" SG_ 913 USM_CmdWPCSta "17.11.00";
BA_ "Description" SG_ 913 WPC_PhnLftWrngSta "Warning by WPC for User (Phone left in vehicle)";
BA_ "GenSigSendType" SG_ 913 WPC_PhnLftWrngSta 4;
BA_ "UserSigValidity" SG_ 913 WPC_PhnLftWrngSta 0;
BA_ "NetworkRequest" SG_ 913 WPC_PhnLftWrngSta 0;
BA_ "NetworkRequestHoldingTime" SG_ 913 WPC_PhnLftWrngSta 5000;
BA_ "Version" SG_ 913 WPC_PhnLftWrngSta "24.01.00";
BA_ "Description" SG_ 913 WPC_DualWPCOptSta "Apply dual WPC information";
BA_ "GenSigSendType" SG_ 913 WPC_DualWPCOptSta 4;
BA_ "UserSigValidity" SG_ 913 WPC_DualWPCOptSta 0;
BA_ "Version" SG_ 913 WPC_DualWPCOptSta "24.06.00";
BA_ "Description" SG_ 913 WPC_SWVerMajor1 "Indicate the WPC software version as follows:

- The software version is displayed in three digits.

- The Major and Minor digits are separated by '.'

- Signal values are transmitted to ASCII codes.



※ Example

WPC_SWVerMajor1 : 0x41 (HEX) -> ASCII C";
BA_ "GenSigSendType" SG_ 913 WPC_SWVerMajor1 4;
BA_ "UserSigValidity" SG_ 913 WPC_SWVerMajor1 0;
BA_ "Version" SG_ 913 WPC_SWVerMajor1 "20.12.04";
BA_ "Description" SG_ 913 WPC_SWVerMinor1 "Indicate the WPC software version as follows:

- The software version is displayed in three digits.

- The Major and Minor digits are separated by '.'

- Signal values are transmitted to ASCII codes.



※ Example

WPC_SWVerMajor1 : 0x41 (HEX) -> ASCII C";
BA_ "GenSigSendType" SG_ 913 WPC_SWVerMinor1 4;
BA_ "UserSigValidity" SG_ 913 WPC_SWVerMinor1 0;
BA_ "Version" SG_ 913 WPC_SWVerMinor1 "18.10.06";
BA_ "Description" SG_ 913 WPC_SWVerMinor2 "Indicate the WPC software version as follows:

- The software version is displayed in three digits.

- The Major and Minor digits are separated by '.'

- Signal values are transmitted to ASCII codes.



※ Example

WPC_SWVerMajor1 : 0x41 (HEX) -> ASCII C";
BA_ "GenSigSendType" SG_ 913 WPC_SWVerMinor2 4;
BA_ "UserSigValidity" SG_ 913 WPC_SWVerMinor2 0;
BA_ "Version" SG_ 913 WPC_SWVerMinor2 "18.10.06";
BA_ "Description" SG_ 426 CLU_Crc1Val "The data area for CRC calculation is based on the data length (DLC) of the message DB.

The CRC shall be calculated over the entire data block (excluding the CRC bytes) including the user data, alive counter and Data ID



- CRC Polynomial (0x1021) , Ini";
BA_ "GenSigStartValue" SG_ 426 CLU_Crc1Val 65535;
BA_ "UserSigValidity" SG_ 426 CLU_Crc1Val 3;
BA_ "RoutingFactor" SG_ 426 CLU_Crc1Val 0;
BA_ "Version" SG_ 426 CLU_Crc1Val "21.09.03";
BA_ "Description" SG_ 426 CLU_FuelSenderRstReq "This signal is transmitted when initailzing request occur";
BA_ "UserSigValidity" SG_ 426 CLU_FuelSenderRstReq 0;
BA_ "RoutingFactor" SG_ 426 CLU_FuelSenderRstReq 0;
BA_ "Version" SG_ 426 CLU_FuelSenderRstReq "23.05.05";
BA_ "Description" SG_ 426 CLU_AlvCnt1Val "For the first transmission request for a data element the counter shall be initialized with 0 and shall be incremented by 1 for every subsequent send request. 

When the counter reaches the maximum value(0xFF), then it shall restart with 0 for the next s";
BA_ "UserSigValidity" SG_ 426 CLU_AlvCnt1Val 3;
BA_ "RoutingFactor" SG_ 426 CLU_AlvCnt1Val 0;
BA_ "Version" SG_ 426 CLU_AlvCnt1Val "21.09.03";
BA_ "Description" SG_ 426 CLU_DtntOutSta "This signal indicates the status of detent illumination. Cluster sends the detent information for a Unified Illumination system.";
BA_ "UserSigValidity" SG_ 426 CLU_DtntOutSta 0;
BA_ "RoutingFactor" SG_ 426 CLU_DtntOutSta 0;
BA_ "Version" SG_ 426 CLU_DtntOutSta "17.11.00";
BA_ "Description" SG_ 426 CLU_SpdUnitTyp "This signal indicates the unit of the speed displayed in the speedometer.";
BA_ "UserSigValidity" SG_ 426 CLU_SpdUnitTyp 3;
BA_ "RoutingFactor" SG_ 426 CLU_SpdUnitTyp 0;
BA_ "Version" SG_ 426 CLU_SpdUnitTyp "17.11.00";
BA_ "Description" SG_ 426 CLU_DisSpdDcmlVal "The signal 'CF_Clu_VanzDecimal' means the extra value of the signal 'CF_Clu_Vanz' (vehicle speed which is indicated in the speedometer)

Also, This signal should be sent in km/h or MPH according to the 'CF_Clu_SPEED_UNIT' signal.

CF_Clu_SPEED_UNIT = 0 :";
BA_ "UserSigValidity" SG_ 426 CLU_DisSpdDcmlVal 3;
BA_ "RoutingFactor" SG_ 426 CLU_DisSpdDcmlVal 0;
BA_ "Version" SG_ 426 CLU_DisSpdDcmlVal "17.11.00";
BA_ "Description" SG_ 426 CLU_SWRCCrsMainSwSta "Cruise on/off switch";
BA_ "UserSigValidity" SG_ 426 CLU_SWRCCrsMainSwSta 3;
BA_ "RoutingFactor" SG_ 426 CLU_SWRCCrsMainSwSta 0;
BA_ "Version" SG_ 426 CLU_SWRCCrsMainSwSta "18.04.00";
BA_ "Description" SG_ 426 CLU_SWRCCrsSwSta "Depending on whether One-touch logic is applied, the meaning of each signal value is divided into two cases as shown below



Case1) Not applied

0x0:Idle Position

0x1:Resume/Plus

0x2:Set/Minus

0x3:Time gap (Distance, SCC only)

0x4:ACC/SCC cancel



";
BA_ "UserSigValidity" SG_ 426 CLU_SWRCCrsSwSta 3;
BA_ "RoutingFactor" SG_ 426 CLU_SWRCCrsSwSta 0;
BA_ "Version" SG_ 426 CLU_SWRCCrsSwSta "18.07.01";
BA_ "Description" SG_ 426 CLU_SWRCLFASwSta "LFA/HDA on/off switch";
BA_ "UserSigValidity" SG_ 426 CLU_SWRCLFASwSta 3;
BA_ "RoutingFactor" SG_ 426 CLU_SWRCLFASwSta 0;
BA_ "Version" SG_ 426 CLU_SWRCLFASwSta "18.04.00";
BA_ "Description" SG_ 426 CLU_SWRCSldMainSwSta "Speedlimiter on/off switch";
BA_ "UserSigValidity" SG_ 426 CLU_SWRCSldMainSwSta 3;
BA_ "RoutingFactor" SG_ 426 CLU_SWRCSldMainSwSta 0;
BA_ "Version" SG_ 426 CLU_SWRCSldMainSwSta "18.04.00";
BA_ "Description" SG_ 426 CLU_RhstaLvlSta "This signal is used for a rheostat level of CLUSTER from 1 to 21 level (21 level : Detent) for a Unified Illumination system.



※ Start Value : Current value";
BA_ "GenSigStartValue" SG_ 426 CLU_RhstaLvlSta 10;
BA_ "UserSigValidity" SG_ 426 CLU_RhstaLvlSta 0;
BA_ "RoutingFactor" SG_ 426 CLU_RhstaLvlSta 0;
BA_ "Version" SG_ 426 CLU_RhstaLvlSta "17.11.00";
BA_ "Description" SG_ 426 CLU_DisSpdVal "The vehicle speed which is indicated in the speedmeter has to be sent to SCC. This value is used for evalution of SCC command values instead of the vehicle velocity in order to avoid significant difference between the speedmeter indicator and the set spe";
BA_ "UserSigValidity" SG_ 426 CLU_DisSpdVal 3;
BA_ "RoutingFactor" SG_ 426 CLU_DisSpdVal 0;
BA_ "Version" SG_ 426 CLU_DisSpdVal "17.12.03";
BA_ "Description" SG_ 426 CLU_OKSwSta "This signal represents operating status of Ok Switch in Steering Wheel. Default value of this signal is 0 and the value is set to 1 only while a driver is pressing the OK Switch.";
BA_ "UserSigValidity" SG_ 426 CLU_OKSwSta 3;
BA_ "RoutingFactor" SG_ 426 CLU_OKSwSta 0;
BA_ "Version" SG_ 426 CLU_OKSwSta "19.03.06";
BA_ "Description" SG_ 426 CLU_DisSpdVal_KPH "The vehicle speed which is indicated in the speedmeter.

This signal should be sent in km/h only.";
BA_ "UserSigValidity" SG_ 426 CLU_DisSpdVal_KPH 3;
BA_ "RoutingFactor" SG_ 426 CLU_DisSpdVal_KPH 0;
BA_ "Version" SG_ 426 CLU_DisSpdVal_KPH "17.12.09";
BA_ "Description" SG_ 426 CLU_PwrAutoOffResetReq_HCU "This signal is used for a request to reset power auto off time

when OK sw on, this signal 0x1 for 3 period times,and send 0x0 

It is signal for HCU";
BA_ "UserSigValidity" SG_ 426 CLU_PwrAutoOffResetReq_HCU 3;
BA_ "RoutingFactor" SG_ 426 CLU_PwrAutoOffResetReq_HCU 0;
BA_ "Version" SG_ 426 CLU_PwrAutoOffResetReq_HCU "19.10.03";
BA_ "Description" SG_ 426 CLU_CUSTOMSta_NEW "This is a signal for New concept CUSTOM mode in AVN USM

This is a confirm signal for selecting CUSTOM mode in AVN USM

And Other units refer this signal when CUSTOM mode (CLU_DrvngModSwSta=0x6

). Other unit decided the Detailed CUSTOM Mode with this si";
BA_ "UserSigValidity" SG_ 426 CLU_CUSTOMSta_NEW 3;
BA_ "RoutingFactor" SG_ 426 CLU_CUSTOMSta_NEW 0;
BA_ "Version" SG_ 426 CLU_CUSTOMSta_NEW "20.08.07";
BA_ "Description" SG_ 426 CLU_AutoBrightSta "This signal is used for a auto bright level of CLUSTER from 1step to 200step for a Unified Illumination system.



※ Start Value : Current value";
BA_ "UserSigValidity" SG_ 426 CLU_AutoBrightSta 0;
BA_ "RoutingFactor" SG_ 426 CLU_AutoBrightSta 0;
BA_ "Version" SG_ 426 CLU_AutoBrightSta "20.12.05";
BA_ "Description" SG_ 426 CLU_NotMinModeBrightSta "This signal is used for a Cluster brightness level when not in minimum brightness mode.



※ Start Value : Current value";
BA_ "UserSigValidity" SG_ 426 CLU_NotMinModeBrightSta 0;
BA_ "RoutingFactor" SG_ 426 CLU_NotMinModeBrightSta 0;
BA_ "Version" SG_ 426 CLU_NotMinModeBrightSta "22.07.06";
BA_ "Description" SG_ 426 CLU_FuelSenderResistVal "This is the resistance data come from fuel sender.

If fuel sender is open,short condition, Invalid value will be transmitted.

data is valid after cluser waked-up";
BA_ "UserSigValidity" SG_ 426 CLU_FuelSenderResistVal 0;
BA_ "RoutingFactor" SG_ 426 CLU_FuelSenderResistVal 0;
BA_ "Version" SG_ 426 CLU_FuelSenderResistVal "23.06.00";
BA_ "Description" SG_ 250 HCU_Crc3Val "The data area for CRC calculation is based on the data length (DLC) of the message DB.

The CRC shall be calculated over the entire data block (excluding the CRC bytes) including the user data, alive counter and Data ID



- CRC Polynomial (0x1021) , Ini";
BA_ "GenSigStartValue" SG_ 250 HCU_Crc3Val 65535;
BA_ "UserSigValidity" SG_ 250 HCU_Crc3Val 3;
BA_ "RoutingFactor" SG_ 250 HCU_Crc3Val 5;
BA_ "Version" SG_ 250 HCU_Crc3Val "21.09.03";
BA_ "Description" SG_ 250 HCU_SpdLimDeviceActSta "Speed Limiter Device in Activation";
BA_ "UserSigValidity" SG_ 250 HCU_SpdLimDeviceActSta 3;
BA_ "RoutingFactor" SG_ 250 HCU_SpdLimDeviceActSta 5;
BA_ "Version" SG_ 250 HCU_SpdLimDeviceActSta "18.08.02";
BA_ "Description" SG_ 250 HCU_SpdLimDeviceOperSta "Speed Limiter Device in Operation";
BA_ "UserSigValidity" SG_ 250 HCU_SpdLimDeviceOperSta 3;
BA_ "RoutingFactor" SG_ 250 HCU_SpdLimDeviceOperSta 5;
BA_ "Version" SG_ 250 HCU_SpdLimDeviceOperSta "20.05.02";
BA_ "Description" SG_ 250 HCU_SpdLimDeviceVehSpdVal "Speed Limiter Vehicle Speed

This signal should be sent in km/h or MPH according to the “SPEED_UNIT” signal.

SPEED_UNIT = 0 : [km/h]

SPEED_UNIT = 1 : [MPH]";
BA_ "UserSigValidity" SG_ 250 HCU_SpdLimDeviceVehSpdVal 3;
BA_ "RoutingFactor" SG_ 250 HCU_SpdLimDeviceVehSpdVal 5;
BA_ "Version" SG_ 250 HCU_SpdLimDeviceVehSpdVal "21.07.05";
BA_ "Description" SG_ 250 HCU_SrvModSta "Service Test Mode";
BA_ "UserSigValidity" SG_ 250 HCU_SrvModSta 3;
BA_ "RoutingFactor" SG_ 250 HCU_SrvModSta 5;
BA_ "Version" SG_ 250 HCU_SrvModSta "18.08.02";
BA_ "Description" SG_ 250 HCU_StrtInhbt2Sta "Start Inhibit";
BA_ "UserSigValidity" SG_ 250 HCU_StrtInhbt2Sta 3;
BA_ "RoutingFactor" SG_ 250 HCU_StrtInhbt2Sta 5;
BA_ "Version" SG_ 250 HCU_StrtInhbt2Sta "18.08.02";
BA_ "Description" SG_ 250 HCU_StrtInhbtSta "HCU determine Start Inhibit state when HCU received Start Inhibit command from TMU";
BA_ "UserSigValidity" SG_ 250 HCU_StrtInhbtSta 3;
BA_ "RoutingFactor" SG_ 250 HCU_StrtInhbtSta 5;
BA_ "Version" SG_ 250 HCU_StrtInhbtSta "18.08.02";
BA_ "Description" SG_ 250 HCU_PdlRgnCmpnRear "Request for hydraulic brake compensation in paddle regeneration braking mode for rear motor";
BA_ "UserSigValidity" SG_ 250 HCU_PdlRgnCmpnRear 3;
BA_ "RoutingFactor" SG_ 250 HCU_PdlRgnCmpnRear 5;
BA_ "Version" SG_ 250 HCU_PdlRgnCmpnRear "23.03.00";
BA_ "Description" SG_ 250 HCU_VehStrtEnblSta "Start";
BA_ "UserSigValidity" SG_ 250 HCU_VehStrtEnblSta 3;
BA_ "RoutingFactor" SG_ 250 HCU_VehStrtEnblSta 5;
BA_ "Version" SG_ 250 HCU_VehStrtEnblSta "18.08.02";
BA_ "Description" SG_ 250 HCU_BrkLmpOnReq "Brake Lamp On Request";
BA_ "UserSigValidity" SG_ 250 HCU_BrkLmpOnReq 3;
BA_ "RoutingFactor" SG_ 250 HCU_BrkLmpOnReq 5;
BA_ "Version" SG_ 250 HCU_BrkLmpOnReq "19.06.02";
BA_ "Description" SG_ 250 HCU_CcDrvAlrtDis "CC must be disengaged by system or can not be engaged";
BA_ "UserSigValidity" SG_ 250 HCU_CcDrvAlrtDis 3;
BA_ "RoutingFactor" SG_ 250 HCU_CcDrvAlrtDis 5;
BA_ "Version" SG_ 250 HCU_CcDrvAlrtDis "19.12.07";
BA_ "Description" SG_ 250 HCU_SldDrvAlrtDis "SLD must be disengaged by system or cannot be engaged";
BA_ "UserSigValidity" SG_ 250 HCU_SldDrvAlrtDis 3;
BA_ "RoutingFactor" SG_ 250 HCU_SldDrvAlrtDis 5;
BA_ "Version" SG_ 250 HCU_SldDrvAlrtDis "20.01.01";
BA_ "Description" SG_ 250 HCU_WhlCrpCrpTqNmVal "Creep Torque at wheel (If MSB of high byte is 1, (PH) = 1 * (HEX) ? 65536 [Nm]

else (PH) = 1 * (HEX) [Nm])";
BA_ "UserSigValidity" SG_ 250 HCU_WhlCrpCrpTqNmVal 3;
BA_ "RoutingFactor" SG_ 250 HCU_WhlCrpCrpTqNmVal 5;
BA_ "Version" SG_ 250 HCU_WhlCrpCrpTqNmVal "18.08.02";
BA_ "Description" SG_ 250 LHCU_EngCltchTrnsfrTqPcVal_Copy_ "This signal indicates Engine Clutch Transfer Torque (If MSB of high byte is 1, (PH) = 0.1953125 * (HEX) -200 [%] Else (PH) = 0.1953125 * HEX) [%])";
BA_ "UserSigValidity" SG_ 250 LHCU_EngCltchTrnsfrTqPcVal_Copy_ 3;
BA_ "RoutingFactor" SG_ 250 LHCU_EngCltchTrnsfrTqPcVal_Copy_ 5;
BA_ "Version" SG_ 250 LHCU_EngCltchTrnsfrTqPcVal_Copy_ "18.08.12";
BA_ "SystemSignalLongSymbol" SG_ 250 LHCU_EngCltchTrnsfrTqPcVal_Copy_ "LHCU_EngCltchTrnsfrTqPcVal_Copy_1";
BA_ "Description" SG_ 250 HCU_RspaAlvCntVal "RSPA HCU Alive Counter";
BA_ "UserSigValidity" SG_ 250 HCU_RspaAlvCntVal 3;
BA_ "RoutingFactor" SG_ 250 HCU_RspaAlvCntVal 5;
BA_ "Version" SG_ 250 HCU_RspaAlvCntVal "19.01.12";
BA_ "Description" SG_ 250 HCU_RspaSta "HCU RSPA Cooperative control state";
BA_ "UserSigValidity" SG_ 250 HCU_RspaSta 3;
BA_ "RoutingFactor" SG_ 250 HCU_RspaSta 5;
BA_ "Version" SG_ 250 HCU_RspaSta "19.01.12";
BA_ "Description" SG_ 250 HCU_AlvCnt3Val "For the first transmission request for a data element the counter shall be initialized with 0 and shall be incremented by 1 for every subsequent send request. 

When the counter reaches the maximum value(0xFF), then it shall restart with 0 for the next s";
BA_ "UserSigValidity" SG_ 250 HCU_AlvCnt3Val 3;
BA_ "RoutingFactor" SG_ 250 HCU_AlvCnt3Val 5;
BA_ "Version" SG_ 250 HCU_AlvCnt3Val "21.09.03";
BA_ "Description" SG_ 250 HCU_RspaCanFailSta "HCU RSPA CAN Fail Status";
BA_ "UserSigValidity" SG_ 250 HCU_RspaCanFailSta 3;
BA_ "RoutingFactor" SG_ 250 HCU_RspaCanFailSta 5;
BA_ "Version" SG_ 250 HCU_RspaCanFailSta "19.01.12";
BA_ "Description" SG_ 250 HCU_PdlStopCtrlSta "Request Signal for Paddle B Stop Control";
BA_ "UserSigValidity" SG_ 250 HCU_PdlStopCtrlSta 3;
BA_ "RoutingFactor" SG_ 250 HCU_PdlStopCtrlSta 5;
BA_ "Version" SG_ 250 HCU_PdlStopCtrlSta "20.08.02";
BA_ "Description" SG_ 250 HCU_PdlRgnCmpn "Request for hydraulic brake compensation in paddle regeneration braking mode

( when the coasting tq decrease rapidly )";
BA_ "UserSigValidity" SG_ 250 HCU_PdlRgnCmpn 3;
BA_ "RoutingFactor" SG_ 250 HCU_PdlRgnCmpn 5;
BA_ "Version" SG_ 250 HCU_PdlRgnCmpn "21.07.05";
BA_ "Description" SG_ 250 HCU_RForwardRq "R gear forward drive request";
BA_ "UserSigValidity" SG_ 250 HCU_RForwardRq 3;
BA_ "RoutingFactor" SG_ 250 HCU_RForwardRq 5;
BA_ "Version" SG_ 250 HCU_RForwardRq "23.04.07";
BA_ "Description" SG_ 250 HCU_PdlStopReqTqNmVal "Request Brake tq for Paddle B Stop Control";
BA_ "UserSigValidity" SG_ 250 HCU_PdlStopReqTqNmVal 3;
BA_ "RoutingFactor" SG_ 250 HCU_PdlStopReqTqNmVal 5;
BA_ "Version" SG_ 250 HCU_PdlStopReqTqNmVal "20.08.02";
BA_ "Description" SG_ 250 HCU_GearRInhbtSta "Drive inhibit flag in reverse gear.";
BA_ "UserSigValidity" SG_ 250 HCU_GearRInhbtSta 3;
BA_ "RoutingFactor" SG_ 250 HCU_GearRInhbtSta 5;
BA_ "Version" SG_ 250 HCU_GearRInhbtSta "20.11.03";
BA_ "Description" SG_ 250 HCU_GreenzoneDistinctGen "Distict of an GDM's generation (including of function's activating)";
BA_ "UserSigValidity" SG_ 250 HCU_GreenzoneDistinctGen 3;
BA_ "NetworkRequest" SG_ 250 HCU_GreenzoneDistinctGen 0;
BA_ "NetworkRequestHoldingTime" SG_ 250 HCU_GreenzoneDistinctGen 1000;
BA_ "RoutingFactor" SG_ 250 HCU_GreenzoneDistinctGen 5;
BA_ "Version" SG_ 250 HCU_GreenzoneDistinctGen "22.10.20";
BA_ "Description" SG_ 250 HCU_Mg3SpdCmdVal "MG3 Motor Speed Control";
BA_ "UserSigValidity" SG_ 250 HCU_Mg3SpdCmdVal 3;
BA_ "RoutingFactor" SG_ 250 HCU_Mg3SpdCmdVal 5;
BA_ "Version" SG_ 250 HCU_Mg3SpdCmdVal "23.02.09";
BA_ "Description" SG_ 250 HCU_Mg3TqPcReq "MG3 Motor Torque Control command (If MSB of high byte is 1, (PH) = 0.1953125 * (HEX) -200 [%] Else (PH) = 0.1953125 * (HEX) [%])";
BA_ "UserSigValidity" SG_ 250 HCU_Mg3TqPcReq 3;
BA_ "RoutingFactor" SG_ 250 HCU_Mg3TqPcReq 5;
BA_ "Version" SG_ 250 HCU_Mg3TqPcReq "23.02.09";
BA_ "Description" SG_ 250 HCU_Mg3DisChrgTqCmdPcVal_FS "This signal indicates to control MG3 motor discharge limit torque for Anti-Jerk. (If MSB of high byte is 1, (PH) = 0.1953125 * (HEX) ? 200 [%] Else (PH) = 0.1953125 * (HEX) [%])";
BA_ "UserSigValidity" SG_ 250 HCU_Mg3DisChrgTqCmdPcVal_FS 3;
BA_ "RoutingFactor" SG_ 250 HCU_Mg3DisChrgTqCmdPcVal_FS 5;
BA_ "Version" SG_ 250 HCU_Mg3DisChrgTqCmdPcVal_FS "23.04.00";
BA_ "Description" SG_ 250 HCU_Mg3ChrgTqCmdPcVal_FS "This signal indicates to control MG3 motor charge limit torque for Anti-Jerk (If MSB of high byte is 1, (PH) = 0.1953125 * (HEX) ? 200 [%] Else (PH) = 0.1953125 * (HEX) [%])";
BA_ "UserSigValidity" SG_ 250 HCU_Mg3ChrgTqCmdPcVal_FS 3;
BA_ "RoutingFactor" SG_ 250 HCU_Mg3ChrgTqCmdPcVal_FS 5;
BA_ "Version" SG_ 250 HCU_Mg3ChrgTqCmdPcVal_FS "23.04.00";
BA_ "Description" SG_ 250 HCU_11sMaxSpdLimOperSta "110kph Max Speed Limitation Status for 11 passenger vehicle";
BA_ "UserSigValidity" SG_ 250 HCU_11sMaxSpdLimOperSta 3;
BA_ "RoutingFactor" SG_ 250 HCU_11sMaxSpdLimOperSta 5;
BA_ "Version" SG_ 250 HCU_11sMaxSpdLimOperSta "23.09.04";
BA_ "Description" SG_ 250 HCU_DrvWhlDmndTqNmVal "Driver's Demand Torque Restricted by Battery Limit and HHT Temperature (If MSB of high byte is 1, (PH) = 1 * (HEX) ? 65536 [Nm]

else (PH) = 1 * (HEX) [Nm])";
BA_ "UserSigValidity" SG_ 250 HCU_DrvWhlDmndTqNmVal 3;
BA_ "RoutingFactor" SG_ 250 HCU_DrvWhlDmndTqNmVal 5;
BA_ "Version" SG_ 250 HCU_DrvWhlDmndTqNmVal "18.08.02";
BA_ "Description" SG_ 250 HCU_STAYModSta "STAY MODE operation status";
BA_ "UserSigValidity" SG_ 250 HCU_STAYModSta 3;
BA_ "RoutingFactor" SG_ 250 HCU_STAYModSta 5;
BA_ "Version" SG_ 250 HCU_STAYModSta "24.06.00";
BA_ "Description" SG_ 250 HCU_STAYModWarnSta "Determining the Warning Status for STAY MODE Operation";
BA_ "UserSigValidity" SG_ 250 HCU_STAYModWarnSta 3;
BA_ "RoutingFactor" SG_ 250 HCU_STAYModWarnSta 5;
BA_ "Version" SG_ 250 HCU_STAYModWarnSta "24.07.01";
BA_ "Description" SG_ 250 HCU_STAYModReservationSta "This signal is the USM status feedback signal for the STAY MODE reservation request";
BA_ "UserSigValidity" SG_ 250 HCU_STAYModReservationSta 3;
BA_ "RoutingFactor" SG_ 250 HCU_STAYModReservationSta 5;
BA_ "Version" SG_ 250 HCU_STAYModReservationSta "24.07.01";
BA_ "Description" SG_ 250 HCU_STAYModBattMngmntSta "This signal is the cluster alarm signal for pre-charge mode condition";
BA_ "UserSigValidity" SG_ 250 HCU_STAYModBattMngmntSta 3;
BA_ "RoutingFactor" SG_ 250 HCU_STAYModBattMngmntSta 5;
BA_ "Version" SG_ 250 HCU_STAYModBattMngmntSta "24.07.01";
BA_ "Description" SG_ 250 HCU_Mg3AntJrkInhbtReq "MG3 Motor Anti-jerk Inhibition";
BA_ "GenSigStartValue" SG_ 250 HCU_Mg3AntJrkInhbtReq 1;
BA_ "UserSigValidity" SG_ 250 HCU_Mg3AntJrkInhbtReq 3;
BA_ "RoutingFactor" SG_ 250 HCU_Mg3AntJrkInhbtReq 5;
BA_ "Version" SG_ 250 HCU_Mg3AntJrkInhbtReq "23.02.09";
BA_ "Description" SG_ 250 HCU_Mg3CtrlModReq "MG3 Motor Control Mode Command";
BA_ "GenSigStartValue" SG_ 250 HCU_Mg3CtrlModReq 1;
BA_ "UserSigValidity" SG_ 250 HCU_Mg3CtrlModReq 3;
BA_ "RoutingFactor" SG_ 250 HCU_Mg3CtrlModReq 5;
BA_ "Version" SG_ 250 HCU_Mg3CtrlModReq "23.02.09";
BA_ "Description" SG_ 250 HCU_Mg3PwmOffInhbtSta "HCU_Mg3PwmOffInhbtSta indicates precise MG3 motor torque control is necessary.

If this signal is on, MCU should generate torque accordance with HCU torque command.";
BA_ "UserSigValidity" SG_ 250 HCU_Mg3PwmOffInhbtSta 3;
BA_ "RoutingFactor" SG_ 250 HCU_Mg3PwmOffInhbtSta 5;
BA_ "Version" SG_ 250 HCU_Mg3PwmOffInhbtSta "23.02.09";
BA_ "Description" SG_ 250 HCU_Mg3PwrEnaSta "MG3 Motor Power Enable";
BA_ "UserSigValidity" SG_ 250 HCU_Mg3PwrEnaSta 3;
BA_ "RoutingFactor" SG_ 250 HCU_Mg3PwrEnaSta 5;
BA_ "Version" SG_ 250 HCU_Mg3PwrEnaSta "23.02.09";
BA_ "Description" SG_ 250 HCU_EstAccelPdlPcVal "Speed Control Status";
BA_ "UserSigValidity" SG_ 250 HCU_EstAccelPdlPcVal 3;
BA_ "RoutingFactor" SG_ 250 HCU_EstAccelPdlPcVal 5;
BA_ "Version" SG_ 250 HCU_EstAccelPdlPcVal "18.08.02";
BA_ "Description" SG_ 250 HCU_EstApsSelSta "HCU Estimated APS Select when Cruise Mode";
BA_ "UserSigValidity" SG_ 250 HCU_EstApsSelSta 3;
BA_ "RoutingFactor" SG_ 250 HCU_EstApsSelSta 5;
BA_ "Version" SG_ 250 HCU_EstApsSelSta "18.08.02";
BA_ "Description" SG_ 250 HCU_GreenZoneDrvModSta "0x0:Default (USM 미 표출 (메뉴삭제))

0x1:Off (USM 표출 Off 상태 표시)

0x2:On (USM 표출 On 상태 표시

0x3:reserved";
BA_ "UserSigValidity" SG_ 250 HCU_GreenZoneDrvModSta 3;
BA_ "RoutingFactor" SG_ 250 HCU_GreenZoneDrvModSta 5;
BA_ "Version" SG_ 250 HCU_GreenZoneDrvModSta "18.08.02";
BA_ "Description" SG_ 250 HCU_GreenZoneLmpDis "Indicate Green Zone Area";
BA_ "UserSigValidity" SG_ 250 HCU_GreenZoneLmpDis 3;
BA_ "RoutingFactor" SG_ 250 HCU_GreenZoneLmpDis 5;
BA_ "Version" SG_ 250 HCU_GreenZoneLmpDis "18.08.02";
BA_ "Description" SG_ 250 HCU_HcuRdySta "Hybrid Control Unit ready";
BA_ "UserSigValidity" SG_ 250 HCU_HcuRdySta 3;
BA_ "RoutingFactor" SG_ 250 HCU_HcuRdySta 5;
BA_ "Version" SG_ 250 HCU_HcuRdySta "18.08.02";
BA_ "Description" SG_ 250 HCU_HEVRdyDis "This signal indicates whether “READY” lamp on cluster turns on or off.";
BA_ "UserSigValidity" SG_ 250 HCU_HEVRdyDis 3;
BA_ "RoutingFactor" SG_ 250 HCU_HEVRdyDis 5;
BA_ "Version" SG_ 250 HCU_HEVRdyDis "19.09.02";
BA_ "Description" SG_ 250 HCU_HevRdySta "Hybrid Vehicle Drivable ready";
BA_ "UserSigValidity" SG_ 250 HCU_HevRdySta 3;
BA_ "RoutingFactor" SG_ 250 HCU_HevRdySta 5;
BA_ "Version" SG_ 250 HCU_HevRdySta "18.08.02";
BA_ "Description" SG_ 250 HCU_LimpOffSta "Limp off the road";
BA_ "UserSigValidity" SG_ 250 HCU_LimpOffSta 3;
BA_ "RoutingFactor" SG_ 250 HCU_LimpOffSta 5;
BA_ "Version" SG_ 250 HCU_LimpOffSta "18.08.02";
BA_ "Description" SG_ 250 HCU_MILOnReq "HCU sends this signal to turn on the Malfunction Indicator Lamp (MIL).";
BA_ "UserSigValidity" SG_ 250 HCU_MILOnReq 3;
BA_ "RoutingFactor" SG_ 250 HCU_MILOnReq 5;
BA_ "Version" SG_ 250 HCU_MILOnReq "18.08.02";
BA_ "Description" SG_ 250 HCU_PhevAutoModOnSta "PHEV Auto CD CS Mode";
BA_ "UserSigValidity" SG_ 250 HCU_PhevAutoModOnSta 3;
BA_ "RoutingFactor" SG_ 250 HCU_PhevAutoModOnSta 5;
BA_ "Version" SG_ 250 HCU_PhevAutoModOnSta "20.04.02";
BA_ "Description" SG_ 250 HCU_SccDrvOvrdReq "CF_Hcu_Ovrride ※ Start Value : set bit 

Override Drive by driver request during SCC";
BA_ "UserSigValidity" SG_ 250 HCU_SccDrvOvrdReq 3;
BA_ "RoutingFactor" SG_ 250 HCU_SccDrvOvrdReq 5;
BA_ "Version" SG_ 250 HCU_SccDrvOvrdReq "18.08.02";
BA_ "Description" SG_ 250 HCU_SccEnblSta "Smart Cruise Control Enable";
BA_ "UserSigValidity" SG_ 250 HCU_SccEnblSta 3;
BA_ "RoutingFactor" SG_ 250 HCU_SccEnblSta 5;
BA_ "Version" SG_ 250 HCU_SccEnblSta "18.08.02";
BA_ "Description" SG_ 250 HCU_SlwDnSta "HCU determine slowdown state when HCU received slowdown command from TMU";
BA_ "UserSigValidity" SG_ 250 HCU_SlwDnSta 3;
BA_ "RoutingFactor" SG_ 250 HCU_SlwDnSta 5;
BA_ "Version" SG_ 250 HCU_SlwDnSta "18.08.02";
BA_ "Description" SG_ 250 HCU_SmrtEcoGdDis "This signal indicates whether Smart eco guide displays or not. Display equipment(clutster) follows the direction of the value of this signal.";
BA_ "UserSigValidity" SG_ 250 HCU_SmrtEcoGdDis 3;
BA_ "RoutingFactor" SG_ 250 HCU_SmrtEcoGdDis 5;
BA_ "Version" SG_ 250 HCU_SmrtEcoGdDis "18.08.02";
BA_ "Description" SG_ 250 HCU_SmrtEcoLvlDis "This signal is used on the cluster which displays the current driver's demand for Smart eco guide.";
BA_ "UserSigValidity" SG_ 250 HCU_SmrtEcoLvlDis 3;
BA_ "RoutingFactor" SG_ 250 HCU_SmrtEcoLvlDis 5;
BA_ "Version" SG_ 250 HCU_SmrtEcoLvlDis "18.08.02";
BA_ "Description" SG_ 250 HCU_SmrtEcoRngDis "This signal is used on the cluster which guides a driver to drive the car economically.It is variable regarding driving condition such as the road, traffic and so on.";
BA_ "UserSigValidity" SG_ 250 HCU_SmrtEcoRngDis 3;
BA_ "RoutingFactor" SG_ 250 HCU_SmrtEcoRngDis 5;
BA_ "Version" SG_ 250 HCU_SmrtEcoRngDis "18.08.02";
BA_ "Description" SG_ 53 VCU_Crc1Val "The data area for CRC calculation is based on the data length (DLC) of the message DB.

The CRC shall be calculated over the entire data block (excluding the CRC bytes) including the user data, alive counter and Data ID



- CRC Polynomial (0x1021) , Ini";
BA_ "GenSigStartValue" SG_ 53 VCU_Crc1Val 65535;
BA_ "UserSigValidity" SG_ 53 VCU_Crc1Val 7;
BA_ "RoutingFactor" SG_ 53 VCU_Crc1Val 5;
BA_ "Version" SG_ 53 VCU_Crc1Val "21.09.03";
BA_ "Description" SG_ 53 VCU_ScuKeepWakeReq "SCU Keep Wake Request";
BA_ "UserSigValidity" SG_ 53 VCU_ScuKeepWakeReq 7;
BA_ "RoutingFactor" SG_ 53 VCU_ScuKeepWakeReq 5;
BA_ "Version" SG_ 53 VCU_ScuKeepWakeReq "20.04.05";
BA_ "Description" SG_ 53 VCU_MotTqCmdRearVal "Torque Command for Rear Motor";
BA_ "UserSigValidity" SG_ 53 VCU_MotTqCmdRearVal 7;
BA_ "RoutingFactor" SG_ 53 VCU_MotTqCmdRearVal 5;
BA_ "Version" SG_ 53 VCU_MotTqCmdRearVal "20.04.05";
BA_ "Description" SG_ 53 VCU_FmcuZeroTqOfsReq "Fmcu Zero Torque Offset Request";
BA_ "UserSigValidity" SG_ 53 VCU_FmcuZeroTqOfsReq 7;
BA_ "RoutingFactor" SG_ 53 VCU_FmcuZeroTqOfsReq 5;
BA_ "Version" SG_ 53 VCU_FmcuZeroTqOfsReq "20.04.05";
BA_ "Description" SG_ 53 VCU_EcmSeqSta "This signal is VCU System Status Information.";
BA_ "UserSigValidity" SG_ 53 VCU_EcmSeqSta 7;
BA_ "RoutingFactor" SG_ 53 VCU_EcmSeqSta 5;
BA_ "Version" SG_ 53 VCU_EcmSeqSta "20.04.05";
BA_ "UserSigValidity" SG_ 53 VCU_EcmDiagSta 7;
BA_ "RoutingFactor" SG_ 53 VCU_EcmDiagSta 5;
BA_ "Version" SG_ 53 VCU_EcmDiagSta "20.04.05";
BA_ "Description" SG_ 53 VCU_CltActDiagSta "Clutch Actuator Diag Code";
BA_ "UserSigValidity" SG_ 53 VCU_CltActDiagSta 7;
BA_ "RoutingFactor" SG_ 53 VCU_CltActDiagSta 5;
BA_ "Version" SG_ 53 VCU_CltActDiagSta "20.04.05";
BA_ "Description" SG_ 53 VCU_CltActDrvCrntVal "Clutch Actuator Drive Current";
BA_ "UserSigValidity" SG_ 53 VCU_CltActDrvCrntVal 7;
BA_ "RoutingFactor" SG_ 53 VCU_CltActDrvCrntVal 5;
BA_ "Version" SG_ 53 VCU_CltActDrvCrntVal "20.04.05";
BA_ "Description" SG_ 53 VCU_AlvCnt1Val "For the first transmission request for a data element the counter shall be initialized with 0 and shall be incremented by 1 for every subsequent send request. 

When the counter reaches the maximum value(0xFF), then it shall restart with 0 for the next s";
BA_ "UserSigValidity" SG_ 53 VCU_AlvCnt1Val 7;
BA_ "RoutingFactor" SG_ 53 VCU_AlvCnt1Val 5;
BA_ "Version" SG_ 53 VCU_AlvCnt1Val "21.09.03";
BA_ "Description" SG_ 53 VCU_CltActPosStrokeVal "Clutch Actuator Position Stroke";
BA_ "UserSigValidity" SG_ 53 VCU_CltActPosStrokeVal 7;
BA_ "RoutingFactor" SG_ 53 VCU_CltActPosStrokeVal 5;
BA_ "Version" SG_ 53 VCU_CltActPosStrokeVal "20.04.05";
BA_ "Description" SG_ 53 VCU_MainBattTypeSta "Main Battery Type";
BA_ "UserSigValidity" SG_ 53 VCU_MainBattTypeSta 7;
BA_ "RoutingFactor" SG_ 53 VCU_MainBattTypeSta 5;
BA_ "Version" SG_ 53 VCU_MainBattTypeSta "20.08.07";
BA_ "Description" SG_ 53 VCU_MainBattTypeLrnSta "Learn Status of Main Batt. Type";
BA_ "UserSigValidity" SG_ 53 VCU_MainBattTypeLrnSta 7;
BA_ "RoutingFactor" SG_ 53 VCU_MainBattTypeLrnSta 5;
BA_ "Version" SG_ 53 VCU_MainBattTypeLrnSta "20.04.05";
BA_ "Description" SG_ 53 VCU_WarmupCycSta "Warm-up Cycle Status Flag for FRF output to other ECU's";
BA_ "UserSigValidity" SG_ 53 VCU_WarmupCycSta 7;
BA_ "RoutingFactor" SG_ 53 VCU_WarmupCycSta 5;
BA_ "Version" SG_ 53 VCU_WarmupCycSta "20.04.05";
BA_ "Description" SG_ 53 VCU_FatcPermPwrVal "Climate Permission Power";
BA_ "UserSigValidity" SG_ 53 VCU_FatcPermPwrVal 7;
BA_ "RoutingFactor" SG_ 53 VCU_FatcPermPwrVal 5;
BA_ "Version" SG_ 53 VCU_FatcPermPwrVal "20.04.05";
BA_ "Description" SG_ 53 VCU_GearPosStaDisp "Gear Position Status for CLU display";
BA_ "GenSigStartValue" SG_ 53 VCU_GearPosStaDisp 9;
BA_ "UserSigValidity" SG_ 53 VCU_GearPosStaDisp 7;
BA_ "RoutingFactor" SG_ 53 VCU_GearPosStaDisp 5;
BA_ "Version" SG_ 53 VCU_GearPosStaDisp "20.12.04";
BA_ "Description" SG_ 53 VCU_PdlStopCtrlSta "Cooperative control state of VCU for stop assist control with IEB";
BA_ "UserSigValidity" SG_ 53 VCU_PdlStopCtrlSta 7;
BA_ "RoutingFactor" SG_ 53 VCU_PdlStopCtrlSta 5;
BA_ "Version" SG_ 53 VCU_PdlStopCtrlSta "21.08.08";
BA_ "Description" SG_ 53 VCU_PdlStopReqTqNmVal "Requested brake torque for cooperative stop assist control";
BA_ "UserSigValidity" SG_ 53 VCU_PdlStopReqTqNmVal 7;
BA_ "RoutingFactor" SG_ 53 VCU_PdlStopReqTqNmVal 5;
BA_ "Version" SG_ 53 VCU_PdlStopReqTqNmVal "21.08.08";
BA_ "Description" SG_ 53 VCU_PMPDActSta "PMPD Function Active State";
BA_ "UserSigValidity" SG_ 53 VCU_PMPDActSta 7;
BA_ "RoutingFactor" SG_ 53 VCU_PMPDActSta 5;
BA_ "Version" SG_ 53 VCU_PMPDActSta "23.06.01";
BA_ "Description" SG_ 53 VCU_PMPDWarnSta "PMPD Function Warning State";
BA_ "UserSigValidity" SG_ 53 VCU_PMPDWarnSta 7;
BA_ "RoutingFactor" SG_ 53 VCU_PMPDWarnSta 5;
BA_ "Version" SG_ 53 VCU_PMPDWarnSta "24.01.06";
BA_ "Description" SG_ 53 VCU_VgsVirSoundBackFireIndex "Virtual sound back fire noise index for VGS mode";
BA_ "UserSigValidity" SG_ 53 VCU_VgsVirSoundBackFireIndex 7;
BA_ "RoutingFactor" SG_ 53 VCU_VgsVirSoundBackFireIndex 5;
BA_ "Version" SG_ 53 VCU_VgsVirSoundBackFireIndex "21.12.02";
BA_ "Description" SG_ 53 VCU_VgsVirEngSpdRpmVal "Virtual engine speed for VGS mode";
BA_ "UserSigValidity" SG_ 53 VCU_VgsVirEngSpdRpmVal 7;
BA_ "RoutingFactor" SG_ 53 VCU_VgsVirEngSpdRpmVal 5;
BA_ "Version" SG_ 53 VCU_VgsVirEngSpdRpmVal "21.12.02";
BA_ "Description" SG_ 53 VCU_RdySta "VCU Ready";
BA_ "UserSigValidity" SG_ 53 VCU_RdySta 7;
BA_ "RoutingFactor" SG_ 53 VCU_RdySta 5;
BA_ "Version" SG_ 53 VCU_RdySta "20.04.05";
BA_ "Description" SG_ 53 VCU_VgsVirSoundVolume "Virtual engine sound volume for VGS mode[%]";
BA_ "UserSigValidity" SG_ 53 VCU_VgsVirSoundVolume 7;
BA_ "RoutingFactor" SG_ 53 VCU_VgsVirSoundVolume 5;
BA_ "Version" SG_ 53 VCU_VgsVirSoundVolume "21.12.02";
BA_ "Description" SG_ 53 VCU_VgsVirGearStep "Shift gear when entering VGS mode";
BA_ "UserSigValidity" SG_ 53 VCU_VgsVirGearStep 7;
BA_ "RoutingFactor" SG_ 53 VCU_VgsVirGearStep 5;
BA_ "Version" SG_ 53 VCU_VgsVirGearStep "21.12.02";
BA_ "Description" SG_ 53 VCU_StandbyModSta "Stand by Mode Status";
BA_ "UserSigValidity" SG_ 53 VCU_StandbyModSta 7;
BA_ "RoutingFactor" SG_ 53 VCU_StandbyModSta 5;
BA_ "Version" SG_ 53 VCU_StandbyModSta "22.05.04";
BA_ "Description" SG_ 53 VCU_HVIntLkDischrgReq "High Voltage Parts Discharge Request from VCU";
BA_ "UserSigValidity" SG_ 53 VCU_HVIntLkDischrgReq 7;
BA_ "RoutingFactor" SG_ 53 VCU_HVIntLkDischrgReq 5;
BA_ "Version" SG_ 53 VCU_HVIntLkDischrgReq "22.11.02";
BA_ "Description" SG_ 53 VCU_StartKeyHoldSta "Start Key Hold Signal";
BA_ "UserSigValidity" SG_ 53 VCU_StartKeyHoldSta 7;
BA_ "RoutingFactor" SG_ 53 VCU_StartKeyHoldSta 5;
BA_ "Version" SG_ 53 VCU_StartKeyHoldSta "20.04.05";
BA_ "Description" SG_ 53 VCU_EvDrvRdySta "EV Ready";
BA_ "UserSigValidity" SG_ 53 VCU_EvDrvRdySta 7;
BA_ "RoutingFactor" SG_ 53 VCU_EvDrvRdySta 5;
BA_ "Version" SG_ 53 VCU_EvDrvRdySta "20.04.05";
BA_ "Description" SG_ 53 VCU_MotPwrEnReq "Motor Power Enable";
BA_ "UserSigValidity" SG_ 53 VCU_MotPwrEnReq 7;
BA_ "RoutingFactor" SG_ 53 VCU_MotPwrEnReq 5;
BA_ "Version" SG_ 53 VCU_MotPwrEnReq "20.04.05";
BA_ "Description" SG_ 53 VCU_GearPosSta "Gear Position Status";
BA_ "GenSigStartValue" SG_ 53 VCU_GearPosSta 9;
BA_ "UserSigValidity" SG_ 53 VCU_GearPosSta 7;
BA_ "RoutingFactor" SG_ 53 VCU_GearPosSta 5;
BA_ "Version" SG_ 53 VCU_GearPosSta "21.05.01";
BA_ "Description" SG_ 53 VCU_LdcInhReq "LDC Output Inhibit Request";
BA_ "GenSigStartValue" SG_ 53 VCU_LdcInhReq 1;
BA_ "UserSigValidity" SG_ 53 VCU_LdcInhReq 7;
BA_ "RoutingFactor" SG_ 53 VCU_LdcInhReq 5;
BA_ "Version" SG_ 53 VCU_LdcInhReq "20.04.05";
BA_ "Description" SG_ 53 VCU_MainRlyOffReq "Main Relay Cut off Request";
BA_ "UserSigValidity" SG_ 53 VCU_MainRlyOffReq 7;
BA_ "RoutingFactor" SG_ 53 VCU_MainRlyOffReq 5;
BA_ "Version" SG_ 53 VCU_MainRlyOffReq "20.04.05";
BA_ "Description" SG_ 53 VCU_AccPedDepVal "Accelerator Pedal Depth Value";
BA_ "UserSigValidity" SG_ 53 VCU_AccPedDepVal 7;
BA_ "RoutingFactor" SG_ 53 VCU_AccPedDepVal 5;
BA_ "Version" SG_ 53 VCU_AccPedDepVal "20.04.05";
BA_ "Description" SG_ 53 VCU_FatcOperPermSta "Climate Operating Permission";
BA_ "UserSigValidity" SG_ 53 VCU_FatcOperPermSta 7;
BA_ "RoutingFactor" SG_ 53 VCU_FatcOperPermSta 5;
BA_ "Version" SG_ 53 VCU_FatcOperPermSta "20.04.05";
BA_ "Description" SG_ 53 VCU_DrvCycSta "Driving Cycle Status";
BA_ "UserSigValidity" SG_ 53 VCU_DrvCycSta 7;
BA_ "RoutingFactor" SG_ 53 VCU_DrvCycSta 5;
BA_ "Version" SG_ 53 VCU_DrvCycSta "20.04.05";
BA_ "Description" SG_ 53 VCU_CltActOpSta "Clutch Actuator Operating Status";
BA_ "UserSigValidity" SG_ 53 VCU_CltActOpSta 7;
BA_ "RoutingFactor" SG_ 53 VCU_CltActOpSta 5;
BA_ "Version" SG_ 53 VCU_CltActOpSta "20.04.05";
BA_ "Description" SG_ 53 VCU_WhlSpdSnsrAlvReq "Alive Request for Wheel Speed Sensors";
BA_ "UserSigValidity" SG_ 53 VCU_WhlSpdSnsrAlvReq 7;
BA_ "RoutingFactor" SG_ 53 VCU_WhlSpdSnsrAlvReq 5;
BA_ "Version" SG_ 53 VCU_WhlSpdSnsrAlvReq "20.04.05";
BA_ "Description" SG_ 53 VCU_DrvModOpSta "VCU's operating drive mode according to CLU and DMIC signals";
BA_ "UserSigValidity" SG_ 53 VCU_DrvModOpSta 7;
BA_ "RoutingFactor" SG_ 53 VCU_DrvModOpSta 5;
BA_ "Version" SG_ 53 VCU_DrvModOpSta "20.08.07";
BA_ "Description" SG_ 53 VCU_HydBrkFcHoldRq "Hydraulic brake force holding request from VCU";
BA_ "UserSigValidity" SG_ 53 VCU_HydBrkFcHoldRq 7;
BA_ "RoutingFactor" SG_ 53 VCU_HydBrkFcHoldRq 5;
BA_ "Version" SG_ 53 VCU_HydBrkFcHoldRq "22.03.02";
BA_ "Description" SG_ 53 VCU_FatcPwrUseVal "Predicted HVAC Power Consumption";
BA_ "UserSigValidity" SG_ 53 VCU_FatcPwrUseVal 7;
BA_ "RoutingFactor" SG_ 53 VCU_FatcPwrUseVal 5;
BA_ "Version" SG_ 53 VCU_FatcPwrUseVal "20.04.05";
BA_ "Description" SG_ 53 VCU_WhlDemTqVal "Driver's Demand Torque Restricted by Battery Limit and HHT Temperature";
BA_ "UserSigValidity" SG_ 53 VCU_WhlDemTqVal 7;
BA_ "RoutingFactor" SG_ 53 VCU_WhlDemTqVal 5;
BA_ "Version" SG_ 53 VCU_WhlDemTqVal "20.04.05";
BA_ "Description" SG_ 53 VCU_McuAntiJerkInhFrntSta "Anti-jerk Inhibition";
BA_ "GenSigStartValue" SG_ 53 VCU_McuAntiJerkInhFrntSta 1;
BA_ "UserSigValidity" SG_ 53 VCU_McuAntiJerkInhFrntSta 7;
BA_ "RoutingFactor" SG_ 53 VCU_McuAntiJerkInhFrntSta 5;
BA_ "Version" SG_ 53 VCU_McuAntiJerkInhFrntSta "20.04.05";
BA_ "Description" SG_ 53 VCU_McuAntiJerkInhRearSta "Anti-jerk Inhibition";
BA_ "GenSigStartValue" SG_ 53 VCU_McuAntiJerkInhRearSta 1;
BA_ "UserSigValidity" SG_ 53 VCU_McuAntiJerkInhRearSta 7;
BA_ "RoutingFactor" SG_ 53 VCU_McuAntiJerkInhRearSta 5;
BA_ "Version" SG_ 53 VCU_McuAntiJerkInhRearSta "20.04.05";
BA_ "Description" SG_ 53 VCU_McuPwrLatchHoldReq "Mcu Power Latch Hold Request";
BA_ "UserSigValidity" SG_ 53 VCU_McuPwrLatchHoldReq 7;
BA_ "RoutingFactor" SG_ 53 VCU_McuPwrLatchHoldReq 5;
BA_ "Version" SG_ 53 VCU_McuPwrLatchHoldReq "20.04.05";
BA_ "Description" SG_ 53 VCU_ScuParkReq "Parking Command Request";
BA_ "UserSigValidity" SG_ 53 VCU_ScuParkReq 7;
BA_ "RoutingFactor" SG_ 53 VCU_ScuParkReq 5;
BA_ "Version" SG_ 53 VCU_ScuParkReq "20.04.05";
BA_ "Description" SG_ 53 VCU_MotTqCmdFrntVal "Torque Command for Front Motor";
BA_ "UserSigValidity" SG_ 53 VCU_MotTqCmdFrntVal 7;
BA_ "RoutingFactor" SG_ 53 VCU_MotTqCmdFrntVal 5;
BA_ "Version" SG_ 53 VCU_MotTqCmdFrntVal "20.04.05";
BA_ "Description" SG_ 543 WPC_FD_VCRM_Crc1Val "The data area for CRC calculation is based on the data length (DLC) of the message DB.

The CRC shall be calculated over the entire data block (excluding the CRC bytes) including the user data, alive counter and Data ID



- CRC Polynomial (0x1021) , Ini";
BA_ "GenSigSendType" SG_ 543 WPC_FD_VCRM_Crc1Val 4;
BA_ "GenSigStartValue" SG_ 543 WPC_FD_VCRM_Crc1Val 65535;
BA_ "UserSigValidity" SG_ 543 WPC_FD_VCRM_Crc1Val 3;
BA_ "Version" SG_ 543 WPC_FD_VCRM_Crc1Val "23.08.04";
BA_ "Description" SG_ 543 WPC_FD_VCRM_AlvCnt1Val "For the first transmission request for a data element the counter shall be initialized with 0 and shall be incremented by 1 for every subsequent send request. 

When the counter reaches the maximum value(0xFF), then it shall restart with 0 for the next s";
BA_ "GenSigSendType" SG_ 543 WPC_FD_VCRM_AlvCnt1Val 4;
BA_ "UserSigValidity" SG_ 543 WPC_FD_VCRM_AlvCnt1Val 3;
BA_ "Version" SG_ 543 WPC_FD_VCRM_AlvCnt1Val "23.08.04";
BA_ "GenSigSendType" SG_ 543 WPC_PhnUsingTime 4;
BA_ "UserSigValidity" SG_ 543 WPC_PhnUsingTime 0;
BA_ "NetworkRequest" SG_ 543 WPC_PhnUsingTime 0;
BA_ "NetworkRequestHoldingTime" SG_ 543 WPC_PhnUsingTime 5000;
BA_ "Version" SG_ 543 WPC_PhnUsingTime "23.08.06";
BA_ "GenSigSendType" SG_ 543 WPC_PhnChargingCompleteCnt 4;
BA_ "UserSigValidity" SG_ 543 WPC_PhnChargingCompleteCnt 0;
BA_ "NetworkRequest" SG_ 543 WPC_PhnChargingCompleteCnt 0;
BA_ "NetworkRequestHoldingTime" SG_ 543 WPC_PhnChargingCompleteCnt 2000;
BA_ "Version" SG_ 543 WPC_PhnChargingCompleteCnt "23.08.06";
BA_ "GenSigSendType" SG_ 543 WPC_EPPChargingCnt 4;
BA_ "UserSigValidity" SG_ 543 WPC_EPPChargingCnt 0;
BA_ "NetworkRequest" SG_ 543 WPC_EPPChargingCnt 0;
BA_ "NetworkRequestHoldingTime" SG_ 543 WPC_EPPChargingCnt 2000;
BA_ "Version" SG_ 543 WPC_EPPChargingCnt "23.08.06";
BA_ "GenSigSendType" SG_ 543 WPC_MPPChargingCnt 4;
BA_ "UserSigValidity" SG_ 543 WPC_MPPChargingCnt 0;
BA_ "NetworkRequest" SG_ 543 WPC_MPPChargingCnt 0;
BA_ "NetworkRequestHoldingTime" SG_ 543 WPC_MPPChargingCnt 2000;
BA_ "Version" SG_ 543 WPC_MPPChargingCnt "23.08.06";
BA_ "GenSigSendType" SG_ 543 WPC_DigitalKeyAuth 4;
BA_ "UserSigValidity" SG_ 543 WPC_DigitalKeyAuth 0;
BA_ "NetworkRequest" SG_ 543 WPC_DigitalKeyAuth 0;
BA_ "NetworkRequestHoldingTime" SG_ 543 WPC_DigitalKeyAuth 2000;
BA_ "Version" SG_ 543 WPC_DigitalKeyAuth "23.08.06";
BA_ "GenSigSendType" SG_ 543 WPC_DigitalKeyDevice 4;
BA_ "UserSigValidity" SG_ 543 WPC_DigitalKeyDevice 0;
BA_ "NetworkRequest" SG_ 543 WPC_DigitalKeyDevice 0;
BA_ "NetworkRequestHoldingTime" SG_ 543 WPC_DigitalKeyDevice 2000;
BA_ "Version" SG_ 543 WPC_DigitalKeyDevice "23.08.06";
BA_ "GenSigSendType" SG_ 543 WPC_PhnChargingErrCnt 4;
BA_ "UserSigValidity" SG_ 543 WPC_PhnChargingErrCnt 0;
BA_ "NetworkRequest" SG_ 543 WPC_PhnChargingErrCnt 0;
BA_ "NetworkRequestHoldingTime" SG_ 543 WPC_PhnChargingErrCnt 2000;
BA_ "Version" SG_ 543 WPC_PhnChargingErrCnt "23.08.06";
BA_ "GenSigSendType" SG_ 543 WPC_ThermalSnsrMaxTemp 4;
BA_ "UserSigValidity" SG_ 543 WPC_ThermalSnsrMaxTemp 0;
BA_ "NetworkRequest" SG_ 543 WPC_ThermalSnsrMaxTemp 0;
BA_ "NetworkRequestHoldingTime" SG_ 543 WPC_ThermalSnsrMaxTemp 2000;
BA_ "Version" SG_ 543 WPC_ThermalSnsrMaxTemp "23.08.06";
BA_ "GenSigSendType" SG_ 543 WPC_CANBusOffDTC 4;
BA_ "UserSigValidity" SG_ 543 WPC_CANBusOffDTC 0;
BA_ "NetworkRequest" SG_ 543 WPC_CANBusOffDTC 0;
BA_ "NetworkRequestHoldingTime" SG_ 543 WPC_CANBusOffDTC 2000;
BA_ "Version" SG_ 543 WPC_CANBusOffDTC "23.08.06";
BA_ "GenSigSendType" SG_ 543 WPC_LocalCANBusOffDTC 4;
BA_ "UserSigValidity" SG_ 543 WPC_LocalCANBusOffDTC 0;
BA_ "NetworkRequest" SG_ 543 WPC_LocalCANBusOffDTC 0;
BA_ "NetworkRequestHoldingTime" SG_ 543 WPC_LocalCANBusOffDTC 2000;
BA_ "Version" SG_ 543 WPC_LocalCANBusOffDTC "23.08.06";
BA_ "GenSigSendType" SG_ 543 WPC_TempSnsrFltDTC 4;
BA_ "UserSigValidity" SG_ 543 WPC_TempSnsrFltDTC 0;
BA_ "NetworkRequest" SG_ 543 WPC_TempSnsrFltDTC 0;
BA_ "NetworkRequestHoldingTime" SG_ 543 WPC_TempSnsrFltDTC 2000;
BA_ "Version" SG_ 543 WPC_TempSnsrFltDTC "23.08.06";
BA_ "GenSigSendType" SG_ 543 WPC_FANFltDTC 4;
BA_ "UserSigValidity" SG_ 543 WPC_FANFltDTC 0;
BA_ "NetworkRequest" SG_ 543 WPC_FANFltDTC 0;
BA_ "NetworkRequestHoldingTime" SG_ 543 WPC_FANFltDTC 2000;
BA_ "Version" SG_ 543 WPC_FANFltDTC "23.08.06";
BA_ "GenSigSendType" SG_ 543 WPC_InternalECUErrDTC 4;
BA_ "UserSigValidity" SG_ 543 WPC_InternalECUErrDTC 0;
BA_ "NetworkRequest" SG_ 543 WPC_InternalECUErrDTC 0;
BA_ "NetworkRequestHoldingTime" SG_ 543 WPC_InternalECUErrDTC 2000;
BA_ "Version" SG_ 543 WPC_InternalECUErrDTC "23.08.06";
BA_ "UsrSigPurpose" SG_ 2549874826 SNI_ARS_FD 8;
BA_ "UserSigValidity" SG_ 2549874826 SNI_ARS_FD 0;
BA_ "UsrSigPurpose" SG_ 2549874826 CBV_RMR_ARS_FD 8;
BA_ "UserSigValidity" SG_ 2549874826 CBV_RMR_ARS_FD 0;
BA_ "UsrSigPurpose" SG_ 2549874826 CBV_NMCoID_ARS_FD 8;
BA_ "UserSigValidity" SG_ 2549874826 CBV_NMCoID_ARS_FD 0;
BA_ "UsrSigPurpose" SG_ 2549874826 CBV_NMCoSRB_ARS_FD 8;
BA_ "UserSigValidity" SG_ 2549874826 CBV_NMCoSRB_ARS_FD 0;
BA_ "UsrSigPurpose" SG_ 2549874826 CBV_AWB_ARS_FD 8;
BA_ "UserSigValidity" SG_ 2549874826 CBV_AWB_ARS_FD 0;
BA_ "UsrSigPurpose" SG_ 2549874826 CBV_PNIB_ARS_FD 8;
BA_ "UserSigValidity" SG_ 2549874826 CBV_PNIB_ARS_FD 0;
BA_ "UsrSigPurpose" SG_ 2549874826 NRR_ARS_FD 8;
BA_ "UserSigValidity" SG_ 2549874826 NRR_ARS_FD 0;
BA_ "UsrSigPurpose" SG_ 2549874826 NM_State_ARS_FD 8;
BA_ "UserSigValidity" SG_ 2549874826 NM_State_ARS_FD 0;
BA_ "UsrSigPurpose" SG_ 2549874826 PNI_ARS_FD 8;
BA_ "UserSigValidity" SG_ 2549874826 PNI_ARS_FD 0;
BA_ "UsrSigPurpose" SG_ 2549874826 PNI_ARS_FD_1 8;
BA_ "UserSigValidity" SG_ 2549874826 PNI_ARS_FD_1 0;
BA_ "UsrSigPurpose" SG_ 2549874826 PNI_ARS_FD_2 8;
BA_ "UserSigValidity" SG_ 2549874826 PNI_ARS_FD_2 0;
BA_ "UsrSigPurpose" SG_ 2549874826 PNI_ARS_FD_3 8;
BA_ "UserSigValidity" SG_ 2549874826 PNI_ARS_FD_3 0;
BA_ "UsrSigPurpose" SG_ 2549874789 SNI_SHVU_CCS_FD 8;
BA_ "UserSigValidity" SG_ 2549874789 SNI_SHVU_CCS_FD 0;
BA_ "UsrSigPurpose" SG_ 2549874789 CBV_RMR_SHVU_CCS_FD 8;
BA_ "UserSigValidity" SG_ 2549874789 CBV_RMR_SHVU_CCS_FD 0;
BA_ "UsrSigPurpose" SG_ 2549874789 CBV_NMCoID_SHVU_CCS_FD 8;
BA_ "UserSigValidity" SG_ 2549874789 CBV_NMCoID_SHVU_CCS_FD 0;
BA_ "UsrSigPurpose" SG_ 2549874789 CBV_NMCoSRB_SHVU_CCS_FD 8;
BA_ "UserSigValidity" SG_ 2549874789 CBV_NMCoSRB_SHVU_CCS_FD 0;
BA_ "UsrSigPurpose" SG_ 2549874789 CBV_AWB_SHVU_CCS_FD 8;
BA_ "UserSigValidity" SG_ 2549874789 CBV_AWB_SHVU_CCS_FD 0;
BA_ "UsrSigPurpose" SG_ 2549874789 CBV_PNIB_SHVU_CCS_FD 8;
BA_ "UserSigValidity" SG_ 2549874789 CBV_PNIB_SHVU_CCS_FD 0;
BA_ "UsrSigPurpose" SG_ 2549874789 NRR_SHVU_CCS_FD 8;
BA_ "UserSigValidity" SG_ 2549874789 NRR_SHVU_CCS_FD 0;
BA_ "UsrSigPurpose" SG_ 2549874789 NM_State_SHVU_CCS_FD 8;
BA_ "UserSigValidity" SG_ 2549874789 NM_State_SHVU_CCS_FD 0;
BA_ "UsrSigPurpose" SG_ 2549874789 PNI_SHVU_CCS_FD 8;
BA_ "UserSigValidity" SG_ 2549874789 PNI_SHVU_CCS_FD 0;
BA_ "UsrSigPurpose" SG_ 2549874789 PNI_SHVU_CCS_FD_1 8;
BA_ "UserSigValidity" SG_ 2549874789 PNI_SHVU_CCS_FD_1 0;
BA_ "UsrSigPurpose" SG_ 2549874789 PNI_SHVU_CCS_FD_2 8;
BA_ "UserSigValidity" SG_ 2549874789 PNI_SHVU_CCS_FD_2 0;
BA_ "UsrSigPurpose" SG_ 2549874789 PNI_SHVU_CCS_FD_3 8;
BA_ "UserSigValidity" SG_ 2549874789 PNI_SHVU_CCS_FD_3 0;
BA_ "UsrSigPurpose" SG_ 2549874846 SNI_WPC_FD 8;
BA_ "UserSigValidity" SG_ 2549874846 SNI_WPC_FD 0;
BA_ "UsrSigPurpose" SG_ 2549874846 CBV_RMR_WPC_FD 8;
BA_ "UserSigValidity" SG_ 2549874846 CBV_RMR_WPC_FD 0;
BA_ "UsrSigPurpose" SG_ 2549874846 CBV_NMCoID_WPC_FD 8;
BA_ "UserSigValidity" SG_ 2549874846 CBV_NMCoID_WPC_FD 0;
BA_ "UsrSigPurpose" SG_ 2549874846 CBV_NMCoSRB_WPC_FD 8;
BA_ "UserSigValidity" SG_ 2549874846 CBV_NMCoSRB_WPC_FD 0;
BA_ "UsrSigPurpose" SG_ 2549874846 CBV_AWB_WPC_FD 8;
BA_ "UserSigValidity" SG_ 2549874846 CBV_AWB_WPC_FD 0;
BA_ "UsrSigPurpose" SG_ 2549874846 CBV_PNIB_WPC_FD 8;
BA_ "UserSigValidity" SG_ 2549874846 CBV_PNIB_WPC_FD 0;
BA_ "UsrSigPurpose" SG_ 2549874846 NRR_WPC_FD 8;
BA_ "UserSigValidity" SG_ 2549874846 NRR_WPC_FD 0;
BA_ "UsrSigPurpose" SG_ 2549874846 NM_State_WPC_FD 8;
BA_ "UserSigValidity" SG_ 2549874846 NM_State_WPC_FD 0;
BA_ "UsrSigPurpose" SG_ 2549874846 PNI_WPC_FD 8;
BA_ "UserSigValidity" SG_ 2549874846 PNI_WPC_FD 0;
BA_ "UsrSigPurpose" SG_ 2549874846 PNI_WPC_FD_1 8;
BA_ "UserSigValidity" SG_ 2549874846 PNI_WPC_FD_1 0;
BA_ "UsrSigPurpose" SG_ 2549874846 PNI_WPC_FD_2 8;
BA_ "UserSigValidity" SG_ 2549874846 PNI_WPC_FD_2 0;
BA_ "UsrSigPurpose" SG_ 2549874846 PNI_WPC_FD_3 8;
BA_ "UserSigValidity" SG_ 2549874846 PNI_WPC_FD_3 0;
BA_ "UsrSigPurpose" SG_ 2549874837 SNI_WPC2_FD 8;
BA_ "UserSigValidity" SG_ 2549874837 SNI_WPC2_FD 0;
BA_ "UsrSigPurpose" SG_ 2549874837 CBV_RMR_WPC2_FD 8;
BA_ "UserSigValidity" SG_ 2549874837 CBV_RMR_WPC2_FD 0;
BA_ "UsrSigPurpose" SG_ 2549874837 CBV_NMCoID_WPC2_FD 8;
BA_ "UserSigValidity" SG_ 2549874837 CBV_NMCoID_WPC2_FD 0;
BA_ "UsrSigPurpose" SG_ 2549874837 CBV_NMCoSRB_WPC2_FD 8;
BA_ "UserSigValidity" SG_ 2549874837 CBV_NMCoSRB_WPC2_FD 0;
BA_ "UsrSigPurpose" SG_ 2549874837 CBV_AWB_WPC2_FD 8;
BA_ "UserSigValidity" SG_ 2549874837 CBV_AWB_WPC2_FD 0;
BA_ "UsrSigPurpose" SG_ 2549874837 CBV_PNIB_WPC2_FD 8;
BA_ "UserSigValidity" SG_ 2549874837 CBV_PNIB_WPC2_FD 0;
BA_ "UsrSigPurpose" SG_ 2549874837 NRR_WPC2_FD 8;
BA_ "UserSigValidity" SG_ 2549874837 NRR_WPC2_FD 0;
BA_ "UsrSigPurpose" SG_ 2549874837 NM_State_WPC2_FD 8;
BA_ "UserSigValidity" SG_ 2549874837 NM_State_WPC2_FD 0;
BA_ "UsrSigPurpose" SG_ 2549874837 PNI_WPC2_FD 8;
BA_ "UserSigValidity" SG_ 2549874837 PNI_WPC2_FD 0;
BA_ "UsrSigPurpose" SG_ 2549874837 PNI_WPC2_FD_1 8;
BA_ "UserSigValidity" SG_ 2549874837 PNI_WPC2_FD_1 0;
BA_ "UsrSigPurpose" SG_ 2549874837 PNI_WPC2_FD_2 8;
BA_ "UserSigValidity" SG_ 2549874837 PNI_WPC2_FD_2 0;
BA_ "UsrSigPurpose" SG_ 2549874837 PNI_WPC2_FD_3 8;
BA_ "UserSigValidity" SG_ 2549874837 PNI_WPC2_FD_3 0;
BA_ "UsrSigPurpose" SG_ 2549874823 SNI_SCM_FD 8;
BA_ "UserSigValidity" SG_ 2549874823 SNI_SCM_FD 0;
BA_ "UsrSigPurpose" SG_ 2549874823 CBV_RMR_SCM_FD 8;
BA_ "UserSigValidity" SG_ 2549874823 CBV_RMR_SCM_FD 0;
BA_ "UsrSigPurpose" SG_ 2549874823 CBV_NMCoID_SCM_FD 8;
BA_ "UserSigValidity" SG_ 2549874823 CBV_NMCoID_SCM_FD 0;
BA_ "UsrSigPurpose" SG_ 2549874823 CBV_NMCoSRB_SCM_FD 8;
BA_ "UserSigValidity" SG_ 2549874823 CBV_NMCoSRB_SCM_FD 0;
BA_ "UsrSigPurpose" SG_ 2549874823 CBV_AWB_SCM_FD 8;
BA_ "UserSigValidity" SG_ 2549874823 CBV_AWB_SCM_FD 0;
BA_ "UsrSigPurpose" SG_ 2549874823 CBV_PNIB_SCM_FD 8;
BA_ "UserSigValidity" SG_ 2549874823 CBV_PNIB_SCM_FD 0;
BA_ "UsrSigPurpose" SG_ 2549874823 NRR_SCM_FD 8;
BA_ "UserSigValidity" SG_ 2549874823 NRR_SCM_FD 0;
BA_ "UsrSigPurpose" SG_ 2549874823 NM_State_SCM_FD 8;
BA_ "UserSigValidity" SG_ 2549874823 NM_State_SCM_FD 0;
BA_ "UsrSigPurpose" SG_ 2549874823 PNI_SCM_FD 8;
BA_ "UserSigValidity" SG_ 2549874823 PNI_SCM_FD 0;
BA_ "UsrSigPurpose" SG_ 2549874823 PNI_SCM_FD_1 8;
BA_ "UserSigValidity" SG_ 2549874823 PNI_SCM_FD_1 0;
BA_ "UsrSigPurpose" SG_ 2549874823 PNI_SCM_FD_2 8;
BA_ "UserSigValidity" SG_ 2549874823 PNI_SCM_FD_2 0;
BA_ "UsrSigPurpose" SG_ 2549874823 PNI_SCM_FD_3 8;
BA_ "UserSigValidity" SG_ 2549874823 PNI_SCM_FD_3 0;
BA_REL_ "GenSigTimeoutTime" BU_SG_REL_ GW_PSU_DRV_FD SG_ 980 BDC_FD_Crc5Val 1500;
BA_REL_ "GenSigTimeoutTime" BU_SG_REL_ ATS_FD SG_ 980 AutoLt_HorRes_STD 1500;
BA_REL_ "GenSigTimeoutTime" BU_SG_REL_ ATS_FD SG_ 980 AutoLt_VerVal_STD 1500;
BA_REL_ "GenSigTimeoutTime" BU_SG_REL_ ATS_FD SG_ 980 AutoLt_VerRes_STD 1500;
BA_REL_ "GenSigTimeoutTime" BU_SG_REL_ GW_PSU_DRV_FD SG_ 980 BDC_FD_AlvCnt5Val 1500;
BA_REL_ "GenSigTimeoutTime" BU_SG_REL_ BLTN_CAM_FD SG_ 980 Lamp_LftTrnLmpCmd 1500;
BA_REL_ "GenSigTimeoutTime" BU_SG_REL_ BLTN_CAM_FD SG_ 980 Lamp_RtTrnLmpCmd 1500;
BA_REL_ "GenSigTimeoutTime" BU_SG_REL_ BLTN_CAM_FD SG_ 980 Lamp_ExtrnlTailLmpOnReq 1500;
BA_REL_ "GenSigTimeoutTime" BU_SG_REL_ FCS_FD SG_ 980 Lamp_IntTailLmpOnReq 1500;
BA_REL_ "GenSigTimeoutTime" BU_SG_REL_ GW_PSU_3RD_FD SG_ 980 Lamp_IntTailLmpOnReq 1500;
BA_REL_ "GenSigTimeoutTime" BU_SG_REL_ GW_PSU_AST_FD SG_ 980 Lamp_IntTailLmpOnReq 1500;
BA_REL_ "GenSigTimeoutTime" BU_SG_REL_ GW_PSU_DRV_FD SG_ 980 Lamp_IntTailLmpOnReq 1500;
BA_REL_ "GenSigTimeoutTime" BU_SG_REL_ GW_PSU_RL_FD SG_ 980 Lamp_IntTailLmpOnReq 1500;
BA_REL_ "GenSigTimeoutTime" BU_SG_REL_ GW_PSU_RR_FD SG_ 980 Lamp_IntTailLmpOnReq 1500;
BA_REL_ "GenSigTimeoutTime" BU_SG_REL_ RWPC_FD SG_ 980 Lamp_IntTailLmpOnReq 1500;
BA_REL_ "GenSigTimeoutTime" BU_SG_REL_ SHVU_3RD_FD SG_ 980 Lamp_IntTailLmpOnReq 1500;
BA_REL_ "GenSigTimeoutTime" BU_SG_REL_ SHVU_FRNT_FD SG_ 980 Lamp_IntTailLmpOnReq 1500;
BA_REL_ "GenSigTimeoutTime" BU_SG_REL_ SHVU_REAR_FD SG_ 980 Lamp_IntTailLmpOnReq 1500;
BA_REL_ "GenSigTimeoutTime" BU_SG_REL_ SHVU_RL_FD SG_ 980 Lamp_IntTailLmpOnReq 1500;
BA_REL_ "GenSigTimeoutTime" BU_SG_REL_ SHVU_RR_FD SG_ 980 Lamp_IntTailLmpOnReq 1500;
BA_REL_ "GenSigTimeoutTime" BU_SG_REL_ WPC2_FD SG_ 980 Lamp_IntTailLmpOnReq 1500;
BA_REL_ "GenSigTimeoutTime" BU_SG_REL_ WPC_FD SG_ 980 Lamp_IntTailLmpOnReq 1500;
BA_REL_ "GenSigTimeoutTime" BU_SG_REL_ ATS_FD SG_ 980 Lamp_AvTailLmpSta 1500;
BA_REL_ "GenSigTimeoutTime" BU_SG_REL_ GW_PSU_AST_FD SG_ 980 Lamp_AvTailLmpSta 1500;
BA_REL_ "GenSigTimeoutTime" BU_SG_REL_ ATS_FD SG_ 980 Lamp_AutoLtSnsrNightSta 1500;
BA_REL_ "GenSigTimeoutTime" BU_SG_REL_ GW_PSU_AST_FD SG_ 980 Lamp_AutoLtSnsrNightSta 1500;
BA_REL_ "GenSigTimeoutTime" BU_SG_REL_ PSB_FD SG_ 980 Lamp_AutoLtSnsrNightSta 1500;
BA_REL_ "GenSigTimeoutTime" BU_SG_REL_ ATS_FD SG_ 980 Lamp_VendorInfo 1500;
BA_REL_ "GenSigTimeoutTime" BU_SG_REL_ ATS_FD SG_ 980 Lamp_AutoLtSnsrHorVal 1500;
BA_REL_ "GenSigTimeoutTime" BU_SG_REL_ ATS_FD SG_ 980 MoodLamp_DualColorOptSta 1500;
BA_REL_ "GenSigTimeoutTime" BU_SG_REL_ ATS_FD SG_ 980 MoodLamp_NumRecommendColor 1500;
BA_REL_ "GenSigTimeoutTime" BU_SG_REL_ ATS_FD SG_ 980 AutoLt_HorVal_STD 1500;
BA_REL_ "GenSigTimeoutTime" BU_SG_REL_ RWPC_FD SG_ 913 WPC_IndSyncVal 1500;
BA_REL_ "GenSigTimeoutTime" BU_SG_REL_ WPC2_FD SG_ 913 WPC_IndSyncVal 1500;
BA_REL_ "GenSigTimeoutTime" BU_SG_REL_ RWPC_FD SG_ 913 USM_CmdWPCIndSta 1500;
BA_REL_ "GenSigTimeoutTime" BU_SG_REL_ WPC2_FD SG_ 913 USM_CmdWPCIndSta 1500;
BA_REL_ "GenSigTimeoutTime" BU_SG_REL_ CGW_CCU SG_ 913 USM_CmdWPCIndSta 1500;
BA_REL_ "GenSigTimeoutTime" BU_SG_REL_ CGW_CCU SG_ 913 USM_CmdWPCSta 1500;
BA_REL_ "GenSigTimeoutTime" BU_SG_REL_ CGW_CCU SG_ 913 WPC_PhnLftWrngSta 1500;
BA_REL_ "GenSigTimeoutTime" BU_SG_REL_ CGW_CCU SG_ 913 WPC_DualWPCOptSta 5000;
BA_REL_ "GenSigTimeoutTime" BU_SG_REL_ CGW_CCU SG_ 913 WPC_SWVerMajor1 1500;
BA_REL_ "GenSigTimeoutTime" BU_SG_REL_ CGW_CCU SG_ 913 WPC_SWVerMinor1 1500;
BA_REL_ "GenSigTimeoutTime" BU_SG_REL_ CGW_CCU SG_ 913 WPC_SWVerMinor2 1500;
BA_REL_ "GenSigTimeoutTime" BU_SG_REL_ ATS_FD SG_ 426 CLU_Crc1Val 1500;
BA_REL_ "GenSigTimeoutTime" BU_SG_REL_ GW_PSU_DRV_FD SG_ 426 CLU_Crc1Val 1500;
BA_REL_ "GenSigTimeoutTime" BU_SG_REL_ RCM_FD SG_ 426 CLU_Crc1Val 1500;
BA_REL_ "GenSigTimeoutTime" BU_SG_REL_ SHVU_3RD_FD SG_ 426 CLU_Crc1Val 1500;
BA_REL_ "GenSigTimeoutTime" BU_SG_REL_ SHVU_REAR_FD SG_ 426 CLU_Crc1Val 1500;
BA_REL_ "GenSigTimeoutTime" BU_SG_REL_ ATS_FD SG_ 426 CLU_AlvCnt1Val 1500;
BA_REL_ "GenSigTimeoutTime" BU_SG_REL_ GW_PSU_DRV_FD SG_ 426 CLU_AlvCnt1Val 1500;
BA_REL_ "GenSigTimeoutTime" BU_SG_REL_ RCM_FD SG_ 426 CLU_AlvCnt1Val 1500;
BA_REL_ "GenSigTimeoutTime" BU_SG_REL_ SHVU_3RD_FD SG_ 426 CLU_AlvCnt1Val 1500;
BA_REL_ "GenSigTimeoutTime" BU_SG_REL_ SHVU_REAR_FD SG_ 426 CLU_AlvCnt1Val 1500;
BA_REL_ "GenSigTimeoutTime" BU_SG_REL_ ARS_FD SG_ 426 CLU_DtntOutSta 1500;
BA_REL_ "GenSigTimeoutTime" BU_SG_REL_ ATS_FD SG_ 426 CLU_DtntOutSta 1500;
BA_REL_ "GenSigTimeoutTime" BU_SG_REL_ FCS_FD SG_ 426 CLU_DtntOutSta 1500;
BA_REL_ "GenSigTimeoutTime" BU_SG_REL_ GW_PSU_3RD_FD SG_ 426 CLU_DtntOutSta 1500;
BA_REL_ "GenSigTimeoutTime" BU_SG_REL_ GW_PSU_AST_FD SG_ 426 CLU_DtntOutSta 1500;
BA_REL_ "GenSigTimeoutTime" BU_SG_REL_ GW_PSU_DRV_FD SG_ 426 CLU_DtntOutSta 1500;
BA_REL_ "GenSigTimeoutTime" BU_SG_REL_ GW_PSU_RL_FD SG_ 426 CLU_DtntOutSta 1500;
BA_REL_ "GenSigTimeoutTime" BU_SG_REL_ GW_PSU_RR_FD SG_ 426 CLU_DtntOutSta 1500;
BA_REL_ "GenSigTimeoutTime" BU_SG_REL_ GW_SAU_DRV_FD SG_ 426 CLU_DtntOutSta 1500;
BA_REL_ "GenSigTimeoutTime" BU_SG_REL_ OHCL_FD SG_ 426 CLU_DtntOutSta 1500;
BA_REL_ "GenSigTimeoutTime" BU_SG_REL_ RCS_FD SG_ 426 CLU_DtntOutSta 1500;
BA_REL_ "GenSigTimeoutTime" BU_SG_REL_ RWPC_FD SG_ 426 CLU_DtntOutSta 1500;
BA_REL_ "GenSigTimeoutTime" BU_SG_REL_ SHVU_3RD_FD SG_ 426 CLU_DtntOutSta 1500;
BA_REL_ "GenSigTimeoutTime" BU_SG_REL_ SHVU_FRNT_FD SG_ 426 CLU_DtntOutSta 1500;
BA_REL_ "GenSigTimeoutTime" BU_SG_REL_ SHVU_REAR_FD SG_ 426 CLU_DtntOutSta 1500;
BA_REL_ "GenSigTimeoutTime" BU_SG_REL_ SHVU_RL_FD SG_ 426 CLU_DtntOutSta 1500;
BA_REL_ "GenSigTimeoutTime" BU_SG_REL_ SHVU_RR_FD SG_ 426 CLU_DtntOutSta 1500;
BA_REL_ "GenSigTimeoutTime" BU_SG_REL_ WPC2_FD SG_ 426 CLU_DtntOutSta 1500;
BA_REL_ "GenSigTimeoutTime" BU_SG_REL_ WPC_FD SG_ 426 CLU_DtntOutSta 1500;
BA_REL_ "GenSigTimeoutTime" BU_SG_REL_ BLTN_CAM_FD SG_ 426 CLU_SpdUnitTyp 1500;
BA_REL_ "GenSigTimeoutTime" BU_SG_REL_ GW_PSU_DRV_FD SG_ 426 CLU_SpdUnitTyp 1500;
BA_REL_ "GenSigTimeoutTime" BU_SG_REL_ WPC2_FD SG_ 426 CLU_SpdUnitTyp 1500;
BA_REL_ "GenSigTimeoutTime" BU_SG_REL_ ARS_FD SG_ 426 CLU_RhstaLvlSta 1500;
BA_REL_ "GenSigTimeoutTime" BU_SG_REL_ ATS_FD SG_ 426 CLU_RhstaLvlSta 1500;
BA_REL_ "GenSigTimeoutTime" BU_SG_REL_ FCS_FD SG_ 426 CLU_RhstaLvlSta 1500;
BA_REL_ "GenSigTimeoutTime" BU_SG_REL_ GW_PSU_3RD_FD SG_ 426 CLU_RhstaLvlSta 1500;
BA_REL_ "GenSigTimeoutTime" BU_SG_REL_ GW_PSU_AST_FD SG_ 426 CLU_RhstaLvlSta 1500;
BA_REL_ "GenSigTimeoutTime" BU_SG_REL_ GW_PSU_DRV_FD SG_ 426 CLU_RhstaLvlSta 1500;
BA_REL_ "GenSigTimeoutTime" BU_SG_REL_ GW_PSU_RL_FD SG_ 426 CLU_RhstaLvlSta 1500;
BA_REL_ "GenSigTimeoutTime" BU_SG_REL_ GW_PSU_RR_FD SG_ 426 CLU_RhstaLvlSta 1500;
BA_REL_ "GenSigTimeoutTime" BU_SG_REL_ GW_SAU_DRV_FD SG_ 426 CLU_RhstaLvlSta 1500;
BA_REL_ "GenSigTimeoutTime" BU_SG_REL_ OHCL_FD SG_ 426 CLU_RhstaLvlSta 1500;
BA_REL_ "GenSigTimeoutTime" BU_SG_REL_ RCS_FD SG_ 426 CLU_RhstaLvlSta 1500;
BA_REL_ "GenSigTimeoutTime" BU_SG_REL_ RWPC_FD SG_ 426 CLU_RhstaLvlSta 1500;
BA_REL_ "GenSigTimeoutTime" BU_SG_REL_ SHVU_3RD_FD SG_ 426 CLU_RhstaLvlSta 1500;
BA_REL_ "GenSigTimeoutTime" BU_SG_REL_ SHVU_FRNT_FD SG_ 426 CLU_RhstaLvlSta 1500;
BA_REL_ "GenSigTimeoutTime" BU_SG_REL_ SHVU_REAR_FD SG_ 426 CLU_RhstaLvlSta 1500;
BA_REL_ "GenSigTimeoutTime" BU_SG_REL_ SHVU_RL_FD SG_ 426 CLU_RhstaLvlSta 1500;
BA_REL_ "GenSigTimeoutTime" BU_SG_REL_ SHVU_RR_FD SG_ 426 CLU_RhstaLvlSta 1500;
BA_REL_ "GenSigTimeoutTime" BU_SG_REL_ WPC2_FD SG_ 426 CLU_RhstaLvlSta 1500;
BA_REL_ "GenSigTimeoutTime" BU_SG_REL_ WPC_FD SG_ 426 CLU_RhstaLvlSta 1500;
BA_REL_ "GenSigTimeoutTime" BU_SG_REL_ BLTN_CAM_FD SG_ 426 CLU_DisSpdVal 1500;
BA_REL_ "GenSigTimeoutTime" BU_SG_REL_ GW_PSU_AST_FD SG_ 426 CLU_DisSpdVal 1500;
BA_REL_ "GenSigTimeoutTime" BU_SG_REL_ GW_PSU_DRV_FD SG_ 426 CLU_DisSpdVal 1500;
BA_REL_ "GenSigTimeoutTime" BU_SG_REL_ WPC2_FD SG_ 426 CLU_DisSpdVal 1500;
BA_REL_ "GenSigTimeoutTime" BU_SG_REL_ ATS_FD SG_ 426 CLU_DisSpdVal_KPH 1500;
BA_REL_ "GenSigTimeoutTime" BU_SG_REL_ DCM_FD SG_ 426 CLU_DisSpdVal_KPH 1500;
BA_REL_ "GenSigTimeoutTime" BU_SG_REL_ GW_PSU_3RD_FD SG_ 426 CLU_DisSpdVal_KPH 1500;
BA_REL_ "GenSigTimeoutTime" BU_SG_REL_ GW_PSU_AST_FD SG_ 426 CLU_DisSpdVal_KPH 1500;
BA_REL_ "GenSigTimeoutTime" BU_SG_REL_ GW_PSU_DRV_FD SG_ 426 CLU_DisSpdVal_KPH 1500;
BA_REL_ "GenSigTimeoutTime" BU_SG_REL_ GW_PSU_RL_FD SG_ 426 CLU_DisSpdVal_KPH 1500;
BA_REL_ "GenSigTimeoutTime" BU_SG_REL_ GW_PSU_RR_FD SG_ 426 CLU_DisSpdVal_KPH 1500;
BA_REL_ "GenSigTimeoutTime" BU_SG_REL_ GW_SAU_DRV_FD SG_ 426 CLU_DisSpdVal_KPH 1500;
BA_REL_ "GenSigTimeoutTime" BU_SG_REL_ RCM_FD SG_ 426 CLU_DisSpdVal_KPH 1500;
BA_REL_ "GenSigTimeoutTime" BU_SG_REL_ RWPC_FD SG_ 426 CLU_DisSpdVal_KPH 1500;
BA_REL_ "GenSigTimeoutTime" BU_SG_REL_ SHVU_3RD_FD SG_ 426 CLU_DisSpdVal_KPH 1500;
BA_REL_ "GenSigTimeoutTime" BU_SG_REL_ SHVU_FRNT_FD SG_ 426 CLU_DisSpdVal_KPH 1500;
BA_REL_ "GenSigTimeoutTime" BU_SG_REL_ SHVU_REAR_FD SG_ 426 CLU_DisSpdVal_KPH 1500;
BA_REL_ "GenSigTimeoutTime" BU_SG_REL_ SHVU_RL_FD SG_ 426 CLU_DisSpdVal_KPH 1500;
BA_REL_ "GenSigTimeoutTime" BU_SG_REL_ SHVU_RR_FD SG_ 426 CLU_DisSpdVal_KPH 1500;
BA_REL_ "GenSigTimeoutTime" BU_SG_REL_ WPC2_FD SG_ 426 CLU_DisSpdVal_KPH 1500;
BA_REL_ "GenSigTimeoutTime" BU_SG_REL_ WPC_FD SG_ 426 CLU_DisSpdVal_KPH 1500;
BA_REL_ "GenSigTimeoutTime" BU_SG_REL_ ATS_FD SG_ 426 CLU_AutoBrightSta 1500;
BA_REL_ "GenSigTimeoutTime" BU_SG_REL_ BLTN_CAM_FD SG_ 426 CLU_AutoBrightSta 1500;
BA_REL_ "GenSigTimeoutTime" BU_SG_REL_ FCS_FD SG_ 426 CLU_AutoBrightSta 1500;
BA_REL_ "GenSigTimeoutTime" BU_SG_REL_ GW_PSU_3RD_FD SG_ 426 CLU_AutoBrightSta 1500;
BA_REL_ "GenSigTimeoutTime" BU_SG_REL_ GW_PSU_AST_FD SG_ 426 CLU_AutoBrightSta 1500;
BA_REL_ "GenSigTimeoutTime" BU_SG_REL_ GW_PSU_DRV_FD SG_ 426 CLU_AutoBrightSta 1500;
BA_REL_ "GenSigTimeoutTime" BU_SG_REL_ GW_PSU_RL_FD SG_ 426 CLU_AutoBrightSta 1500;
BA_REL_ "GenSigTimeoutTime" BU_SG_REL_ GW_PSU_RR_FD SG_ 426 CLU_AutoBrightSta 1500;
BA_REL_ "GenSigTimeoutTime" BU_SG_REL_ GW_SAU_DRV_FD SG_ 426 CLU_AutoBrightSta 1500;
BA_REL_ "GenSigTimeoutTime" BU_SG_REL_ OHCL_FD SG_ 426 CLU_AutoBrightSta 1500;
BA_REL_ "GenSigTimeoutTime" BU_SG_REL_ RCS_FD SG_ 426 CLU_AutoBrightSta 1500;
BA_REL_ "GenSigTimeoutTime" BU_SG_REL_ RWPC_FD SG_ 426 CLU_AutoBrightSta 1500;
BA_REL_ "GenSigTimeoutTime" BU_SG_REL_ SHVU_3RD_FD SG_ 426 CLU_AutoBrightSta 1500;
BA_REL_ "GenSigTimeoutTime" BU_SG_REL_ SHVU_FRNT_FD SG_ 426 CLU_AutoBrightSta 1500;
BA_REL_ "GenSigTimeoutTime" BU_SG_REL_ SHVU_REAR_FD SG_ 426 CLU_AutoBrightSta 1500;
BA_REL_ "GenSigTimeoutTime" BU_SG_REL_ SHVU_RL_FD SG_ 426 CLU_AutoBrightSta 1500;
BA_REL_ "GenSigTimeoutTime" BU_SG_REL_ SHVU_RR_FD SG_ 426 CLU_AutoBrightSta 1500;
BA_REL_ "GenSigTimeoutTime" BU_SG_REL_ WPC2_FD SG_ 426 CLU_AutoBrightSta 1500;
BA_REL_ "GenSigTimeoutTime" BU_SG_REL_ WPC_FD SG_ 426 CLU_AutoBrightSta 1500;
VAL_ 980 BDC_FD_Crc5Val 0 "0x0x0~0xFFFF:CRCValue" 65535 "0x0x0~0xFFFF:CRCValue" ;
VAL_ 980 AutoLt_HorRes_STD 0 "1lux" 1 "20lux" 2 "Not Used" 3 "Error Indicator" ;
VAL_ 980 AutoLt_VerVal_STD 0 "0x0x0~0x7FE:Value" 2046 "0x0x0~0x7FE:Value" 2047 "Error Indicator" ;
VAL_ 980 AutoLt_VerRes_STD 0 "1lux" 1 "20lux" 2 "Not Used" 3 "Error Indicator" ;
VAL_ 980 MoodLamp_SlvColor_X 0 "0x0x00~0xFA:Color X : 0~250" 250 "0x0x00~0xFA:Color X : 0~250" 251 "Reserved : 251~254" 252 "Reserved : 251~254" 253 "Reserved : 251~254" 254 "Reserved : 251~254" 255 "Invalid : 255" ;
VAL_ 980 MoodLamp_SlvColor_Y 0 "0x0x00~0xFA:Color Y : 0~250" 250 "0x0x00~0xFA:Color Y : 0~250" 251 "Reserved : 251~254" 252 "Reserved : 251~254" 253 "Reserved : 251~254" 254 "Reserved : 251~254" 255 "Invalid : 255" ;
VAL_ 980 MoodLamp_SlvBrgtnsVal 0 "0x0x00~0xFA:Brightness 0~100%" 250 "0x0x00~0xFA:Brightness 0~100%" 251 "RESERVED" 252 "RESERVED" 253 "RESERVED" 254 "RESERVED" 255 "Invalid" ;
VAL_ 980 MoodLamp_SlvFadeInTimetVal 0 "0x0x00~0xFE:Fade in time 0~254" 254 "0x0x00~0xFE:Fade in time 0~254" 255 "Invalid" ;
VAL_ 980 BDC_FD_AlvCnt5Val 0 "0x0x0~0xFF:AlvCntValue" 255 "0x0x0~0xFF:AlvCntValue" ;
VAL_ 980 MoodLamp_SlvFadeOutTimetVal 0 "0x0x00~0xFE:Fade out time 0~254" 254 "0x0x00~0xFE:Fade out time 0~254" 255 "Invalid" ;
VAL_ 980 Lamp_LftTrnLmpCmdSta 0 "Off" 1 "On" 2 "Not Used" 3 "Error Indicator" ;
VAL_ 980 Lamp_RtTrnLmpCmdSta 0 "Off" 1 "On" 2 "Not Used" 3 "Error Indicator" ;
VAL_ 980 Lamp_LftTrnLmpCmd 0 "Inactive" 1 "BlinkingOff" 2 "BlinkingOn" 3 "Error Indicator" ;
VAL_ 980 Lamp_RtTrnLmpCmd 0 "Inactive" 1 "BlinkingOff" 2 "BlinkingOn" 3 "Error Indicator" ;
VAL_ 980 Lamp_TrnLmpMode 0 "Off" 1 "Hazard" 2 "LeftTurnNormal" 3 "RightTurnNormal" 4 "LeftTurnFault" 5 "RightTurnFault" 6 "RESERVED" 7 "Error Indicator" ;
VAL_ 980 Lamp_HzrdSwIND 0 "Inactive" 1 "IndOff" 2 "IndOn" 3 "Error Indicator" ;
VAL_ 980 Lamp_HdLmpEscortShortCmd 0 "Off" 1 "On" 2 "Not Used" 3 "Error Indicator" ;
VAL_ 980 Lamp_LightPopUpMsgType 0 "Default" 1 "A" 2 "B" 3 "Error Indicator" ;
VAL_ 980 Lamp_LightPopUpReq 0 "Light Sw Off" 1 "Tail Sw On" 2 "HeadLamp Low Sw On" 3 "AutoLight Sw On" ;
VAL_ 980 Lamp_HdLmpLoOffPopUpReq 0 "Default" 1 "Off" 2 "On" 3 "Error Indicator" ;
VAL_ 980 MoodLamp_SpeechRecogPosSta 0 "Default" 1 "Front Left" 2 "Front Right" 3 "Rear Left" 4 "Rear Right" 5 "Third Left" 6 "Third Right" 7 "Invalid" ;
VAL_ 980 MoodLamp_BttmSlvColor_X 0 "0x0x00~0xFA:Color X : 0~250" 250 "0x0x00~0xFA:Color X : 0~250" 251 "Reserved : 251~254" 252 "Reserved : 251~254" 253 "Reserved : 251~254" 254 "Reserved : 251~254" 255 "Invalid : 255" ;
VAL_ 980 MoodLamp_BttmSlvColor_Y 0 "0x0x00~0xFA:Color Y : 0~250" 250 "0x0x00~0xFA:Color Y : 0~250" 251 "Reserved : 251~254" 252 "Reserved : 251~254" 253 "Reserved : 251~254" 254 "Reserved : 251~254" 255 "Invalid : 255" ;
VAL_ 980 MoodLamp_BttmSlvBrgtnsVal 0 "0x0x00~0xFA:Brightness 0~100%" 250 "0x0x00~0xFA:Brightness 0~100%" 251 "RESERVED" 252 "RESERVED" 253 "RESERVED" 254 "RESERVED" 255 "Invalid" ;
VAL_ 980 MoodLamp_BttmSlvFadeInTimetVal 0 "0x0x00~0xFE:Fade In time 0~254" 254 "0x0x00~0xFE:Fade In time 0~254" 255 "Invalid" ;
VAL_ 980 MoodLamp_BttmSlvFadeOutTimetVal 0 "0x0x00~0xFE:Fade out time 0~254" 254 "0x0x00~0xFE:Fade out time 0~254" 255 "Invalid" ;
VAL_ 980 Lamp_FrontGroundLightOnReq 0 "Off" 1 "On" 2 "NotUsed" 3 "ErrorIndicator" ;
VAL_ 980 Lamp_SideGroundLightOnReq 0 "Off" 1 "On" 2 "NotUsed" 3 "ErrorIndicator" ;
VAL_ 980 Lamp_RearGroundLightOnReq 0 "Off" 1 "On" 2 "NotUsed" 3 "ErrorIndicator" ;
VAL_ 980 Lamp_HiPrioHzrdReq 0 "Off" 1 "High On" 2 "High Inactive" 3 "Reserved" 4 "Reserved" 5 "Reseved" 6 "Not Used" 7 "Error Indicator" ;
VAL_ 980 Lamp_FrFogLmpEnable 0 "Off" 1 "On" 2 "NotUsed" 3 "ErrorIndicator" ;
VAL_ 980 Lamp_RrFogLmpEnable 0 "Off" 1 "On" 2 "NotUsed" 3 "ErrorIndicator" ;
VAL_ 980 Lamp_LoPrioHzrdReq 0 "Off" 1 "Low On" 2 "Low Inactive" 3 "Reserved" 4 "Reserved" 5 "Reseved" 6 "Not Used" 7 "Error Indicator" ;
VAL_ 980 Lamp_ExtrnlTailLmpOnReq 0 "Off" 1 "On" 2 "Not Used" 3 "Error Indicator" ;
VAL_ 980 Lamp_HdLmpLoOnReq 0 "Off" 1 "On" 2 "Not Used" 3 "Error Indicator" ;
VAL_ 980 Lamp_HdLmpHiOnReq 0 "Off" 1 "On" 2 "Not Used" 3 "Error Indicator" ;
VAL_ 980 Lamp_DrlOnReq 0 "Off" 1 "On" 2 "Not Used" 3 "Error Indicator" ;
VAL_ 980 Lamp_BckUpLmpCmd 0 "Off" 1 "On" 2 "Not Used" 3 "Error Indicator" ;
VAL_ 980 Lamp_FrFogLmpOnReq 0 "Off" 1 "On" 2 "Not Used" 3 "Error Indicator" ;
VAL_ 980 Lamp_RrFogLmpOnReq 0 "Off" 1 "On" 2 "Not Used" 3 "Error Indicator" ;
VAL_ 980 Lamp_StcBendingLmpLftOnReq 0 "Off" 1 "On" 2 "Direct Off" 3 "Error Indicator" ;
VAL_ 980 Lamp_StcBendingLmpRtOnReq 0 "Off" 1 "On" 2 "Direct Off" 3 "Error Indicator" ;
VAL_ 980 Lamp_CornerLmpLftOnReq 0 "Off" 1 "On" 2 "Direct Off" 3 "Error Indicator" ;
VAL_ 980 Lamp_CornerLmpRtOnReq 0 "Off" 1 "On" 2 "Direct Off" 3 "Error Indicator" ;
VAL_ 980 Lamp_HbaCtrlModTyp 0 "H/Lamp High control Mode by BCM" 1 "H/Lamp High control Mode by HBA" 2 "Not Used" 3 "Error Indicator" ;
VAL_ 980 Lamp_IFSCtrlModTyp 0 "H/Lamp High control Mode by BCM" 1 "H/Lamp High control Mode by IFS" 2 "Not Used" 3 "Error Indicator" ;
VAL_ 980 Lamp_HdLmpWlcmCmd 0 "Off" 1 "On" 2 "Not Used" 3 "Error Indicator" ;
VAL_ 980 Lamp_PuddleLmpOnReq 0 "Off" 1 "On" 2 "Not Used" 3 "Error Indicator" ;
VAL_ 980 Lamp_ExtLampRSPAMode 0 "Off" 1 "On" 2 "Not Used" 3 "Error Indicator" ;
VAL_ 980 Lamp_IntTailLmpOnReq 0 "Off" 1 "On" 2 "Not Used" 3 "Error Indicator" ;
VAL_ 980 Lamp_AvTailLmpSta 0 "Off" 1 "On" 2 "Not Used" 3 "Error Indicator" ;
VAL_ 980 Lamp_AutoLtSnsrNightSta 0 "Off" 1 "Night" 2 "Not Used" 3 "Error Indicator" ;
VAL_ 980 Lamp_VendorInfo 0 "Not Used" 1 "TRW(BCS)" 2 "HELLA" 3 "TRW(BCS) STD" 4 "HELLA STD" 5 "Not Used" 6 "Not Used" 7 "Error Indicator" ;
VAL_ 980 Lamp_AutoLtSnsrHorVal 0 "0x0x0~0x3FE:Light Sensor Value" 1022 "0x0x0~0x3FE:Light Sensor Value" 1023 "Invalid" ;
VAL_ 980 MoodLamp_AIVoiceOptSta 0 "Default" 1 "No" 2 "Yes" 3 "Invalid" ;
VAL_ 980 MoodLamp_DualColorOptSta 0 "Default" 1 "Single(USM)" 2 "Dual(USM)" 3 "Invalid" ;
VAL_ 980 MoodLamp_MdLmpFadeSta 0 "Default" 1 "Off" 2 "On" 3 "Invalid" ;
VAL_ 980 MoodLamp_NumRecommendColor 0 "Default" 1 "Number of recommended color (1~14)" 2 "Number of recommended color (1~14)" 3 "Number of recommended color (1~14)" 4 "Number of recommended color (1~14)" 5 "Number of recommended color (1~14)" 6 "Number of recommended color (1~14)" 7 "Number of recommended color (1~14)" 8 "Number of recommended color (1~14)" 9 "Number of recommended color (1~14)" 10 "Number of recommended color (1~14)" 11 "Number of recommended color (1~14)" 12 "Number of recommended color (1~14)" 13 "Number of recommended color (1~14)" 14 "Number of recommended color (1~14)" 15 "Invalid" ;
VAL_ 980 AutoLt_HorVal_STD 0 "0x0x0~0x7FE:Value" 2046 "0x0x0~0x7FE:Value" 2047 "Error Indicator" ;
VAL_ 913 WPC_FD_Crc1Val 0 "0x0x0~0xFFFF:CRCValue" 65535 "0x0x0~0xFFFF:CRCValue" ;
VAL_ 913 WPC_IndSyncVal 0 "default" 1 "off" 2 "1st sync" 3 "2nd sync" 4 "3rd sync" 5 "error off" 6 "error on" 7 "reserved" ;
VAL_ 913 USM_CmdWPCIndSta 0 "Default" 1 "Type 1 (Animation Off)" 2 "Type 2 (Animation On)" 3 "RESERVED" 4 "RESERVED" 5 "RESERVED" 6 "RESERVED" 7 "Invalid" ;
VAL_ 913 WPC_ResetOpSta 0 "Normal" 1 "Reset Complete" 2 "Reset Fail" 3 "RESERVED" ;
VAL_ 913 WPC_FD_AlvCnt1Val 0 "0x0x0~0xFF:AlvCntValue" 255 "0x0x0~0xFF:AlvCntValue" ;
VAL_ 913 USM_CmdWPCSta 0 "Default" 1 "Off(Disable)" 2 "On(Enable)" 3 "Invalid" ;
VAL_ 913 WPC_PhnLftWrngSta 0 "Off" 1 "Cellphone on the pad" 2 "Charging" 3 "Charging complete" 4 "Cellphone reminder" 5 "Error" 6 "NFC Card detected" 7 "Invalid" ;
VAL_ 913 WPC_DualWPCOptSta 0 "Default" 1 "Dual WPC" 2 "RESERVED" 3 "Invalid" ;
VAL_ 913 WPC_SWVerMajor1 0 "0x0x0~0x7F:ASCII Code Value (HEX)" 127 "0x0x0~0x7F:ASCII Code Value (HEX)" ;
VAL_ 913 WPC_SWVerMinor1 0 "0x0x0~0x7F:ASCII Code Value (HEX)" 127 "0x0x0~0x7F:ASCII Code Value (HEX)" ;
VAL_ 913 WPC_SWVerMinor2 0 "0x0x0~0x7F:ASCII Code Value (HEX)" 127 "0x0x0~0x7F:ASCII Code Value (HEX)" ;
VAL_ 426 CLU_Crc1Val 0 "0x0x0~0xFFFF:CRCValue" 65535 "0x0x0~0xFFFF:CRCValue" ;
VAL_ 426 CLU_FuelSenderRstReq 0 "Default" 1 "Initialization" 2 "RESERVED" 3 "Invalid" ;
VAL_ 426 CLU_AlvCnt1Val 0 "0x0x0~0xFF:AlvCntValue" 255 "0x0x0~0xFF:AlvCntValue" ;
VAL_ 426 CLU_DtntOutSta 0 "Detent Off" 1 "Detent On" 2 "Not used" 3 "Error Indicator" ;
VAL_ 426 CLU_SpdUnitTyp 0 "km/h" 1 "MPH" 2 "Not used" 3 "Error Indicator" ;
VAL_ 426 CLU_DisSpdDcmlVal 0 "0" 1 "0.125" 2 "0.250" 3 "0.375" ;
VAL_ 426 CLU_SWRCCrsMainSwSta 0 "Off" 1 "Key On" 2 "Reserved" 3 "Invalid" ;
VAL_ 426 CLU_SWRCCrsSwSta 0 "Idle Position" 1 "Plus" 2 "Minus" 3 "Headway" 4 "Cancel/Pause" 5 "Reserved" 6 "Reserved" 7 "Reserved" ;
VAL_ 426 CLU_SWRCLFASwSta 0 "Off" 1 "Key On" 2 "Reserved" 3 "Invalid" ;
VAL_ 426 CLU_SWRCSldMainSwSta 0 "Off" 1 "Key On" 2 "Reserved" 3 "Invalid" ;
VAL_ 426 CLU_RhstaLvlSta 0 "Reserved" 1 "Step 1" 2 "Step 2" 3 "Step 3" 4 "Step 4" 5 "Step 5" 6 "Step 6" 7 "Step 7" 8 "Step 8" 9 "Step 9" 10 "Step 10" 11 "Step 11" 12 "Step 12" 13 "Step 13" 14 "Step 14" 15 "Step 15" 16 "Step 16" 17 "Step 17" 18 "Step 18" 19 "Step 19" 20 "Step 20 (Reset Value)" 21 "Step 21 (Detent)" ;
VAL_ 426 CLU_DisSpdVal 1023 "Error" ;
VAL_ 426 CLU_OKSwSta 0 "Off" 1 "Key On" 2 "Reserved" 3 "Invalid" ;
VAL_ 426 CLU_DisSpdVal_KPH 511 "Error" ;
VAL_ 426 CLU_PwrAutoOffResetReq_HCU 0 "Default" 1 "Reset Request" 2 "Reserved" 3 "Invalid" ;
VAL_ 426 CLU_CUSTOMSta_NEW 0 "Default" 1 "MY DRIVE MODE(CUSTOM)" 2 "SMART(CUSTOM)" 3 "BABY(CUSTOM)" 4 "RETRO(CUSTOM)" 5 "SNOW(CUSTOM)-Not Terrain" 6 "COMFORT(REAR)(CUSTOM)" 7 "" 8 "" 9 "" 10 "" 11 "" 12 "" 13 "" 14 "Off(CUSTOM)" 15 "Invalid" ;
VAL_ 426 CLU_AutoBrightSta 0 "Reserved (Not Used)" 1 "0x01~0xC8:Bright State (1~200 Step)" 200 "0x01~0xC8:Bright State (1~200 Step)" ;
VAL_ 426 CLU_NotMinModeBrightSta 0 "RESERVED" 1 "0x01~0xC8:CLU Bright State (1~200 Step)" 200 "0x01~0xC8:CLU Bright State (1~200 Step)" 201 "RESERVED" 202 "RESERVED" 203 "RESERVED" 204 "RESERVED" 205 "RESERVED" 206 "RESERVED" 207 "RESERVED" 208 "RESERVED" 209 "RESERVED" 210 "RESERVED" 211 "RESERVED" 212 "RESERVED" 213 "RESERVED" 214 "RESERVED" 215 "RESERVED" 216 "RESERVED" 217 "RESERVED" 218 "RESERVED" 219 "RESERVED" 220 "RESERVED" 221 "RESERVED" 222 "RESERVED" 223 "RESERVED" 224 "RESERVED" 225 "RESERVED" 226 "RESERVED" 227 "RESERVED" 228 "RESERVED" 229 "RESERVED" 230 "RESERVED" 231 "RESERVED" 232 "RESERVED" 233 "RESERVED" 234 "RESERVED" 235 "RESERVED" 236 "RESERVED" 237 "RESERVED" 238 "RESERVED" 239 "RESERVED" 240 "RESERVED" 241 "RESERVED" 242 "RESERVED" 243 "RESERVED" 244 "RESERVED" 245 "RESERVED" 246 "RESERVED" 247 "RESERVED" 248 "RESERVED" 249 "RESERVED" 250 "RESERVED" 251 "RESERVED" 252 "RESERVED" 253 "RESERVED" 254 "RESERVED" 255 "RESERVED" ;
VAL_ 426 CLU_FuelSenderResistVal 0 "Default(no data)" 1 "0x1~0x1FFE:0.1~819.0(Ω)" 8190 "0x1~0x1FFE:0.1~819.0(Ω)" 8191 "Invalid" ;
VAL_ 250 HCU_Crc3Val 0 "0x0x0~0xFFFF:CRCValue" 65535 "0x0x0~0xFFFF:CRCValue" ;
VAL_ 250 HCU_SpdLimDeviceActSta 0 "Speed Limiter Lamp Off (Deactivation)" 1 "Speed Limiter Lamp On (Activation)" 2 "Not used" 3 "Error Indicator" ;
VAL_ 250 HCU_SpdLimDeviceOperSta 0 "Speed Limiter Not Operation" 1 "Speed Limiter Operation" 2 "Speed Limiter Standby" 3 "Error Inicator" ;
VAL_ 250 HCU_SpdLimDeviceVehSpdVal 0 "0x0x00~0xFF:real values" 255 "0x0x00~0xFF:real values" ;
VAL_ 250 HCU_SrvModSta 0 "Normal made" 1 "2WD Test mode" 2 "Not used" 3 "Error Indicator" ;
VAL_ 250 HCU_StrtInhbt2Sta 0 "None" 1 "Start Inhibit" 2 "Not used" 3 "Error Indicator" ;
VAL_ 250 HCU_StrtInhbtSta 0 "None" 1 "Start Inhibit state" 2 "Not used" 3 "Error Indicator" ;
VAL_ 250 HCU_PdlRgnCmpnRear 0 "Not Request" 1 "Compensation Request" 2 "RESERVED" 3 "RESERVED" ;
VAL_ 250 HCU_VehStrtEnblSta 0 "Start disable" 1 "Start Enable" 2 "Not used" 3 "Error Indicator" ;
VAL_ 250 HCU_BrkLmpOnReq 0 "None" 1 "Lamp On Request" 2 "Not Used" 3 "Error Indicator" ;
VAL_ 250 HCU_CcDrvAlrtDis 0 "default" 1 "CC Disengaged" 2 "No CC Engage Condition" 3 "reserved" ;
VAL_ 250 HCU_SldDrvAlrtDis 0 "default" 1 "SLDdisengeged" 2 "NoSLDEngageCondition" 3 "Reserve" ;
VAL_ 250 HCU_RspaAlvCntVal 0 "counter" 1 "counter" 2 "counter" 3 "counter" ;
VAL_ 250 HCU_RspaSta 0 "Invalid" 1 "Init" 2 "New Start" 3 "Ready OK" 4 "" 5 "Assist OK" 6 "Assist Fail" 7 "Abort" 8 "Ready Fail" ;
VAL_ 250 HCU_AlvCnt3Val 0 "0x0x0~0xFF:AlvCntValue" 255 "0x0x0~0xFF:AlvCntValue" ;
VAL_ 250 HCU_RspaCanFailSta 0 "HCU received RSPA CAN message successfully" 1 "HCU failed to receive RSPA CAN message succesfully" 2 "Reserved" 3 "Reserved" ;
VAL_ 250 HCU_PdlStopCtrlSta 0 "Not Request" 1 "Request" 2 "Not Used" 3 "Not Used" ;
VAL_ 250 HCU_PdlRgnCmpn 0 "Not Request" 1 "Compensation Request" 2 "RESERVED" 3 "RESERVED" ;
VAL_ 250 HCU_RForwardRq 0 "Not Request" 1 "R forward drive" 2 "RESERVED" 3 "RESERVED" ;
VAL_ 250 HCU_GearRInhbtSta 0 "Not Request" 1 "Request for Drive Inhibit Gear R" 2 "Reserve" 3 "Reserve" ;
VAL_ 250 HCU_GreenzoneDistinctGen 0 "Inactivate of an greenzone function" 1 "GEN1" 2 "GEN2" 3 "GEN3" 4 "GEN4" 5 "GEN5" 6 "RESERVED" 7 "RESERVED" 8 "RESERVED" 9 "RESERVED" 10 "RESERVED" 11 "RESERVED" 12 "RESERVED" 13 "RESERVED" 14 "RESERVED" 15 "INVALID" ;
VAL_ 250 HCU_11sMaxSpdLimOperSta 0 "Max Speed Limit Inactive" 1 "Max Speed Limit Active" 2 "RESERVED" 3 "RESERVED" ;
VAL_ 250 HCU_STAYModSta 0 "Default (OFF)" 1 "STAY MODE ON" 2 "STAY MODE Abnormal HOLD" 3 "STAY MODE Normal HOLD" 4 "STAY MODE FINISHED" 5 "RESERVED" 6 "RESERVED" 7 "Invalid" ;
VAL_ 250 HCU_STAYModWarnSta 0 "System Normal" 1 "LOW SOC / Low Fuel" 2 "ENG On Request" 3 "Gear Condition dissatisfaction" 4 "System Abnormal" 5 "RESERVED" 6 "RESERVED" 7 "RESERVED" ;
VAL_ 250 HCU_STAYModReservationSta 0 "Default(Off)" 1 "Off" 2 "On" 3 "RESERVED" ;
VAL_ 250 HCU_STAYModBattMngmntSta 0 "Default(Off)" 1 "Off" 2 "On" 3 "RESERVED" ;
VAL_ 250 HCU_EstApsSelSta 0 "EMS real APS use" 1 "HCU Estimated APS use" 2 "Not used" 3 "Error Indicator" ;
VAL_ 250 HCU_GreenZoneDrvModSta 0 "Default" 1 "Off" 2 "On" 3 "reserved" ;
VAL_ 250 HCU_GreenZoneLmpDis 0 "GDM Lamp Off" 1 "GDM Lamp On" ;
VAL_ 250 HCU_HcuRdySta 0 "HCU not Ready" 1 "HCU Control Board Ready" 2 "Not used" 3 "Error Indicator" ;
VAL_ 250 HCU_HEVRdyDis 0 "READY LAMP OFF" 1 "READY LAMP ON" 2 "Not used" 3 "READY LAMP BLINKING" ;
VAL_ 250 HCU_HevRdySta 0 "HEV not ready" 1 "HEV Drivable" 2 "Not used" 3 "Error Indicator" ;
VAL_ 250 HCU_LimpOffSta 0 "None" 1 "Limp off the road" 2 "Not used" 3 "Error Indicator" ;
VAL_ 250 HCU_MILOnReq 0 "Not request" 1 "MIL On Request" 2 "Not used" 3 "Error Indicator" ;
VAL_ 250 HCU_PhevAutoModOnSta 0 "AUTO Mode Off" 1 "AUTO Mode On" ;
VAL_ 250 HCU_SccDrvOvrdReq 0 "Override clear" 1 "Override set" 2 "Not used" 3 "Error Indicator" ;
VAL_ 250 HCU_SccEnblSta 0 "SCC Impossible" 1 "SCC Possible" 2 "Not used" 3 "Error Indicator" ;
VAL_ 250 HCU_SlwDnSta 0 "None" 1 "Slowdown state" 2 "Not used" 3 "Error Indicator" ;
VAL_ 250 HCU_SmrtEcoGdDis 0 "Off" 1 "On" 2 "Not used" 3 "Error Indicator" ;
VAL_ 250 HCU_SmrtEcoLvlDis 0 "Not Display" 1 "1~100%" 2 "1~100%" 3 "1~100%" 4 "1~100%" 5 "1~100%" 6 "1~100%" 7 "1~100%" 8 "1~100%" 9 "1~100%" 10 "1~100%" 11 "1~100%" 12 "1~100%" 13 "1~100%" 14 "1~100%" 15 "1~100%" 16 "1~100%" 17 "1~100%" 18 "1~100%" 19 "1~100%" 20 "1~100%" 21 "1~100%" 22 "1~100%" 23 "1~100%" 24 "1~100%" 25 "1~100%" 26 "1~100%" 27 "1~100%" 28 "1~100%" 29 "1~100%" 30 "1~100%" 31 "1~100%" 32 "1~100%" 33 "1~100%" 34 "1~100%" 35 "1~100%" 36 "1~100%" 37 "1~100%" 38 "1~100%" 39 "1~100%" 40 "1~100%" 41 "1~100%" 42 "1~100%" 43 "1~100%" 44 "1~100%" 45 "1~100%" 46 "1~100%" 47 "1~100%" 48 "1~100%" 49 "1~100%" 50 "1~100%" 51 "1~100%" 52 "1~100%" 53 "1~100%" 54 "1~100%" 55 "1~100%" 56 "1~100%" 57 "1~100%" 58 "1~100%" 59 "1~100%" 60 "1~100%" 61 "1~100%" 62 "1~100%" 63 "1~100%" 64 "1~100%" 65 "1~100%" 66 "1~100%" 67 "1~100%" 68 "1~100%" 69 "1~100%" 70 "1~100%" 71 "1~100%" 72 "1~100%" 73 "1~100%" 74 "1~100%" 75 "1~100%" 76 "1~100%" 77 "1~100%" 78 "1~100%" 79 "1~100%" 80 "1~100%" 81 "1~100%" 82 "1~100%" 83 "1~100%" 84 "1~100%" 85 "1~100%" 86 "1~100%" 87 "1~100%" 88 "1~100%" 89 "1~100%" 90 "1~100%" 91 "1~100%" 92 "1~100%" 93 "1~100%" 94 "1~100%" 95 "1~100%" 96 "1~100%" 97 "1~100%" 98 "1~100%" 99 "1~100%" 100 "1~100%" 101 "Reserved" 102 "Reserved" 103 "Reserved" 104 "Reserved" 105 "Reserved" 106 "Reserved" 107 "Reserved" 108 "Reserved" 109 "Reserved" 110 "Reserved" 111 "Reserved" 112 "Reserved" 113 "Reserved" 114 "Reserved" 115 "Reserved" 116 "Reserved" 117 "Reserved" 118 "Reserved" 119 "Reserved" 120 "Reserved" 121 "Reserved" 122 "Reserved" 123 "Reserved" 124 "Reserved" 125 "Reserved" 126 "Reserved" 127 "Reserved" ;
VAL_ 250 HCU_SmrtEcoRngDis 0 "Not Display" 1 "1~100%" 2 "1~100%" 3 "1~100%" 4 "1~100%" 5 "1~100%" 6 "1~100%" 7 "1~100%" 8 "1~100%" 9 "1~100%" 10 "1~100%" 11 "1~100%" 12 "1~100%" 13 "1~100%" 14 "1~100%" 15 "1~100%" 16 "1~100%" 17 "1~100%" 18 "1~100%" 19 "1~100%" 20 "1~100%" 21 "1~100%" 22 "1~100%" 23 "1~100%" 24 "1~100%" 25 "1~100%" 26 "1~100%" 27 "1~100%" 28 "1~100%" 29 "1~100%" 30 "1~100%" 31 "1~100%" 32 "1~100%" 33 "1~100%" 34 "1~100%" 35 "1~100%" 36 "1~100%" 37 "1~100%" 38 "1~100%" 39 "1~100%" 40 "1~100%" 41 "1~100%" 42 "1~100%" 43 "1~100%" 44 "1~100%" 45 "1~100%" 46 "1~100%" 47 "1~100%" 48 "1~100%" 49 "1~100%" 50 "1~100%" 51 "1~100%" 52 "1~100%" 53 "1~100%" 54 "1~100%" 55 "1~100%" 56 "1~100%" 57 "1~100%" 58 "1~100%" 59 "1~100%" 60 "1~100%" 61 "1~100%" 62 "1~100%" 63 "1~100%" 64 "1~100%" 65 "1~100%" 66 "1~100%" 67 "1~100%" 68 "1~100%" 69 "1~100%" 70 "1~100%" 71 "1~100%" 72 "1~100%" 73 "1~100%" 74 "1~100%" 75 "1~100%" 76 "1~100%" 77 "1~100%" 78 "1~100%" 79 "1~100%" 80 "1~100%" 81 "1~100%" 82 "1~100%" 83 "1~100%" 84 "1~100%" 85 "1~100%" 86 "1~100%" 87 "1~100%" 88 "1~100%" 89 "1~100%" 90 "1~100%" 91 "1~100%" 92 "1~100%" 93 "1~100%" 94 "1~100%" 95 "1~100%" 96 "1~100%" 97 "1~100%" 98 "1~100%" 99 "1~100%" 100 "1~100%" 101 "Reserved" 102 "Reserved" 103 "Reserved" 104 "Reserved" 105 "Reserved" 106 "Reserved" 107 "Reserved" 108 "Reserved" 109 "Reserved" 110 "Reserved" 111 "Reserved" 112 "Reserved" 113 "Reserved" 114 "Reserved" 115 "Reserved" 116 "Reserved" 117 "Reserved" 118 "Reserved" 119 "Reserved" 120 "Reserved" 121 "Reserved" 122 "Reserved" 123 "Reserved" 124 "Reserved" 125 "Reserved" 126 "Reserved" 127 "Reserved" ;
VAL_ 53 VCU_Crc1Val 0 "0x0x0~0xFFFF:CRCValue" 65535 "0x0x0~0xFFFF:CRCValue" ;
VAL_ 53 VCU_ScuKeepWakeReq 0 "None" 1 "Keep Wake Request" 2 "Not used" 3 "Error Indicator" ;
VAL_ 53 VCU_FmcuZeroTqOfsReq 0 "No Request" 1 "Request" 2 "Not used" 3 "Error Indicator" ;
VAL_ 53 VCU_EcmSeqSta 0 "IG Off" 1 "IG On_PowerLatch" 2 "IG On Init" 3 "IG On_Rdy" 4 "IG On_Drivalble" 5 "IG On_PD" 6 "IGON_NonDrivable" ;
VAL_ 53 VCU_AlvCnt1Val 0 "0x0x0~0xFF:AlvCntValue" 255 "0x0x0~0xFF:AlvCntValue" ;
VAL_ 53 VCU_MainBattTypeSta 0 "Short Range Type" 1 "Standard Range Type" 2 "Long Range Type" 3 "Not Used" ;
VAL_ 53 VCU_MainBattTypeLrnSta 0 "Unlearnt" 1 "Learnt" 2 "Not used" 3 "Error Indicator" ;
VAL_ 53 VCU_WarmupCycSta 0 "None" 1 "Warm-up Cycle Completed" 2 "Not used" 3 "Error Indicator" ;
VAL_ 53 VCU_GearPosStaDisp 0 "P" 1 "B" 2 "Not Used" 3 "Not Used" 4 "Not Used" 5 "D" 6 "N" 7 "R" 8 "Not Used" 9 "Not Display at Cluster" 10 "Reserved" 11 "Reserved" 12 "Manual Shift Mode on Retromode" 13 "Reserved" 14 "Intermediate Position" 15 "Fault" ;
VAL_ 53 VCU_PdlStopCtrlSta 0 "No Request" 1 "Target brake torque control request" 2 "AVH request" 3 "AVH working" ;
VAL_ 53 VCU_PdlStopReqTqNmVal 0 "0x0x0~0xFFFF:Request brake torque for stop assist control" 65535 "0x0x0~0xFFFF:Request brake torque for stop assist control" ;
VAL_ 53 VCU_PMPDActSta 0 "Off" 1 "PMPD ON - Torque Limitation" 2 "PMPD ON - Brake Act" 3 "PMPD Inactive" ;
VAL_ 53 VCU_PMPDWarnSta 0 "미송출" 1 "일시 기능 OFF (재진입 금지)" 2 "기능 OFF by User" 3 "기능 OFF by failure" ;
VAL_ 53 VCU_VgsVirSoundBackFireIndex 0 "No Action Status" 1 "Tip-Out Back Fire Lv1 ~ Lv8" 2 "Tip-Out Back Fire Lv1 ~ Lv8" 3 "Tip-Out Back Fire Lv1 ~ Lv8" 4 "Tip-Out Back Fire Lv1 ~ Lv8" 5 "Tip-Out Back Fire Lv1 ~ Lv8" 6 "Tip-Out Back Fire Lv1 ~ Lv8" 7 "Tip-Out Back Fire Lv1 ~ Lv8" 8 "Tip-Out Back Fire Lv1 ~ Lv8" 17 "Bubbling Sound Lv1 ~ Lv8" 18 "Bubbling Sound Lv1 ~ Lv8" 19 "Bubbling Sound Lv1 ~ Lv8" 20 "Bubbling Sound Lv1 ~ Lv8" 21 "Bubbling Sound Lv1 ~ Lv8" 22 "Bubbling Sound Lv1 ~ Lv8" 23 "Bubbling Sound Lv1 ~ Lv8" 24 "Bubbling Sound Lv1 ~ Lv8" 9 "Upshift BANG Sound Lv1 ~ Lv8" 10 "Upshift BANG Sound Lv1 ~ Lv8" 11 "Upshift BANG Sound Lv1 ~ Lv8" 12 "Upshift BANG Sound Lv1 ~ Lv8" 13 "Upshift BANG Sound Lv1 ~ Lv8" 14 "Upshift BANG Sound Lv1 ~ Lv8" 15 "Upshift BANG Sound Lv1 ~ Lv8" 16 "Upshift BANG Sound Lv1 ~ Lv8" ;
VAL_ 53 VCU_VgsVirEngSpdRpmVal 0 "0x0x0~0x7FFE:RPM" 32766 "0x0x0~0x7FFE:RPM" 32767 "Error Indicator" ;
VAL_ 53 VCU_RdySta 0 "None" 1 "VCU Control Board Ready" 2 "Not used" 3 "Error Indicator" ;
VAL_ 53 VCU_VgsVirSoundVolume 0 "0x0x0~0xFE:0~100%" 254 "0x0x0~0xFE:0~100%" 0 "0x0~0xFF:Invalid Error" 255 "0x0~0xFF:Invalid Error" ;
VAL_ 53 VCU_VgsVirGearStep 0 "Not Used" 1 "1gear" 2 "2gear" 3 "3gear" 4 "4gear" 5 "5gear" 6 "6gear" 7 "7gear" 8 "8gear" 9 "Reserved" 10 "Reserved" 11 "Reserved" 12 "Reserved" 13 "Reserved" 14 "Reserved" 15 "Reserved" ;
VAL_ 53 VCU_StandbyModSta 0 "Standby Mode Off" 1 "Standby Mode without HV Request" 2 "Standby Mode with HV Request" 3 "RESERVED" ;
VAL_ 53 VCU_HVIntLkDischrgReq 0 "Not Request(Default)" 1 "Request" 2 "RESERVED" 3 "Error Indicator" ;
VAL_ 53 VCU_StartKeyHoldSta 0 "None" 1 "Start" 2 "Not used" 3 "Error Indicator" ;
VAL_ 53 VCU_EvDrvRdySta 0 "None" 1 "EV Drivable" 2 "Not used" 3 "Error Indicator" ;
VAL_ 53 VCU_MotPwrEnReq 0 "None" 1 "Allow Motor System to Control" 2 "Not used" 3 "Error Indicator" ;
VAL_ 53 VCU_GearPosSta 0 "P" 1 "B" 2 "Not Used" 3 "Not Used" 4 "Not Used" 5 "D" 6 "N" 7 "R" 8 "Not Used" 9 "Not Display at Cluster" 10 "Reserved" 11 "Reserved" 12 "Reserved" 13 "Reserved" 14 "Intermediate Position" 15 "Fault" ;
VAL_ 53 VCU_LdcInhReq 0 "None" 1 "LDC Off Request" 2 "Not used" 3 "Error Indicator" ;
VAL_ 53 VCU_MainRlyOffReq 0 "None" 1 "Relay Cut Off" 2 "Not used" 3 "Error Indicator" ;
VAL_ 53 VCU_AccPedDepVal 255 "Error Indicator" ;
VAL_ 53 VCU_FatcOperPermSta 0 "Not Permiited" 1 "Permitted" 2 "Not used" 3 "Error Indicator" ;
VAL_ 53 VCU_DrvCycSta 0 "No Driving Cycle Active" 1 "Driving Cycle Active" 2 "Not used" 3 "Error Indicator" ;
VAL_ 53 VCU_CltActOpSta 0 "Neutral" 1 "Actuating" 2 "In Gear" 3 "Referencing" 4 "Fault" ;
VAL_ 53 VCU_WhlSpdSnsrAlvReq 0 "No Request" 1 "Alive Request" 2 "Not used" 3 "Error Indicator" ;
VAL_ 53 VCU_DrvModOpSta 0 "Eco" 1 "Normal" 2 "Sport" 3 "Reserved" 4 "Reserved" 5 "Snow" 6 "Sand" 7 "Mud" 8 "Reserved" 9 "Reserved" 10 "Reserved" 11 "Reserved" 12 "Reserved" 13 "Reserved" 14 "Reserved" 15 "Reserved" ;
VAL_ 53 VCU_HydBrkFcHoldRq 0 "None" 1 "Hold Request" 2 "Reserved" 3 "Error" ;
VAL_ 53 VCU_McuAntiJerkInhFrntSta 0 "Anti-jerk Not Inhibit" 1 "Anti-jerk Inhibit" 2 "Not used" 3 "Error Indicator" ;
VAL_ 53 VCU_McuAntiJerkInhRearSta 0 "Anti-jerk Not Inhibit" 1 "Anti-jerk Inhibit" 2 "Not used" 3 "Error Indicator" ;
VAL_ 53 VCU_McuPwrLatchHoldReq 0 "No Request" 1 "Power Latch Hold Request" 2 "Not used" 3 "Error Indicator" ;
VAL_ 53 VCU_ScuParkReq 0 "Wait Command" 1 "Not used" 2 "Parking Command" 3 "Not Parking Command" ;
VAL_ 543 WPC_FD_VCRM_Crc1Val 0 "0x0x0~0xFFFF:CRCValue" 65535 "0x0x0~0xFFFF:CRCValue" ;
VAL_ 543 WPC_FD_VCRM_AlvCnt1Val 0 "0x0x0~0xFF:AlvCntValue" 255 "0x0x0~0xFF:AlvCntValue" ;
VAL_ 543 WPC_PhnUsingTime 0 "0x0x0~0xFE:Charging time after IGN ON" 254 "0x0x0~0xFE:Charging time after IGN ON" 254 "Error" 255 "Error" ;
VAL_ 543 WPC_PhnChargingCompleteCnt 0 "Number of fully charged event after IGN on" 1 "Number of fully charged event after IGN on" 2 "Number of fully charged event after IGN on" 3 "Number of fully charged event after IGN on" 4 "Number of fully charged event after IGN on" 5 "Number of fully charged event after IGN on" 6 "Number of fully charged event after IGN on" 7 "Number of fully charged event after IGN on" 8 "Number of fully charged event after IGN on" 9 "Number of fully charged event after IGN on" 10 "Number of fully charged event after IGN on" 11 "Number of fully charged event after IGN on" 12 "Number of fully charged event after IGN on" 13 "Number of fully charged event after IGN on" 14 "Number of fully charged event after IGN on" 15 "Number of fully charged event after IGN on" ;
VAL_ 543 WPC_EPPChargingCnt 0 "EPP charging count after IGN on" 1 "EPP charging count after IGN on" 2 "EPP charging count after IGN on" 3 "EPP charging count after IGN on" 4 "EPP charging count after IGN on" 5 "EPP charging count after IGN on" 6 "EPP charging count after IGN on" 7 "EPP charging count after IGN on" 8 "EPP charging count after IGN on" 9 "EPP charging count after IGN on" 10 "EPP charging count after IGN on" 11 "EPP charging count after IGN on" 12 "EPP charging count after IGN on" 13 "EPP charging count after IGN on" 14 "EPP charging count after IGN on" 15 "If EPP Charging count is more than 15 times, output will be 0xF" ;
VAL_ 543 WPC_MPPChargingCnt 0 "MPP charging count after IGN on" 1 "MPP charging count after IGN on" 2 "MPP charging count after IGN on" 3 "MPP charging count after IGN on" 4 "MPP charging count after IGN on" 5 "MPP charging count after IGN on" 6 "MPP charging count after IGN on" 7 "MPP charging count after IGN on" 8 "MPP charging count after IGN on" 9 "MPP charging count after IGN on" 10 "MPP charging count after IGN on" 11 "MPP charging count after IGN on" 12 "MPP charging count after IGN on" 13 "MPP charging count after IGN on" 14 "MPP charging count after IGN on" 15 "If MPP charging count is more than 15 times, output will be 0xF" ;
VAL_ 543 WPC_DigitalKeyAuth 0 "Default" 1 "Auth by Digital Key" ;
VAL_ 543 WPC_DigitalKeyDevice 0 "Default" 1 "Androide Device" 2 "Androide Devcie(Watch)" 3 "Apple Device" 4 "Apple Device(Watch)" 5 "Card key" 6 "RESERVED" ;
VAL_ 543 WPC_PhnChargingErrCnt 0 "FOD Error Count" 1 "FOD Error Count" 2 "FOD Error Count" 3 "FOD Error Count" 4 "FOD Error Count" 5 "FOD Error Count" 6 "FOD Error Count" 7 "FOD Error Count" 8 "FOD Error Count" 9 "FOD Error Count" 10 "FOD Error Count" 11 "FOD Error Count" 12 "FOD Error Count" 13 "FOD Error Count" 14 "FOD Error Count" 15 "FOD Error Count" 16 "FOD Error Count" 17 "FOD Error Count" 18 "FOD Error Count" 19 "FOD Error Count" 20 "FOD Error Count" 21 "FOD Error Count" 22 "FOD Error Count" 23 "FOD Error Count" 24 "FOD Error Count" 25 "FOD Error Count" 26 "FOD Error Count" 27 "FOD Error Count" 28 "FOD Error Count" 29 "FOD Error Count" 30 "FOD Error Count" 31 "FOD Error Count" 32 "FOD Error Count" 33 "FOD Error Count" 34 "FOD Error Count" 35 "FOD Error Count" 36 "FOD Error Count" 37 "FOD Error Count" 38 "FOD Error Count" 39 "FOD Error Count" 40 "FOD Error Count" 41 "FOD Error Count" 42 "FOD Error Count" 43 "FOD Error Count" 44 "FOD Error Count" 45 "FOD Error Count" 46 "FOD Error Count" 47 "FOD Error Count" 48 "FOD Error Count" 49 "FOD Error Count" 50 "FOD Error Count" 51 "FOD Error Count" 52 "FOD Error Count" 53 "FOD Error Count" 54 "FOD Error Count" 55 "FOD Error Count" 56 "FOD Error Count" 57 "FOD Error Count" 58 "FOD Error Count" 59 "FOD Error Count" 60 "FOD Error Count" 61 "FOD Error Count" 62 "FOD Error Count" 63 "FOD Error Count Over 63 times" ;
VAL_ 543 WPC_ThermalSnsrMaxTemp 0 "0x0x0~0xFE:Max Temperature" 254 "0x0x0~0xFE:Max Temperature" 255 "Error" ;
VAL_ 543 WPC_CANBusOffDTC 0 "Default" 1 "DTC Set" ;
VAL_ 543 WPC_LocalCANBusOffDTC 0 "Default" 1 "DTC Set" ;
VAL_ 543 WPC_TempSnsrFltDTC 0 "Default" 1 "DTC Set" ;
VAL_ 543 WPC_FANFltDTC 0 "Default" 1 "DTC Set" ;
VAL_ 543 WPC_InternalECUErrDTC 0 "Default" 1 "DTC Set" ;
VAL_ 2549874826 SNI_ARS_FD 0 "0x0x0~0xFF:NM Source Node ID" 255 "0x0x0~0xFF:NM Source Node ID" ;
VAL_ 2549874826 CBV_RMR_ARS_FD 0 "Repeat Message State not requested" 1 "Repeat Message State requested" ;
VAL_ 2549874826 CBV_NMCoID_ARS_FD 0 "NM Coordinator ID" 1 "NM Coordinator ID" 2 "NM Coordinator ID" 3 "NM Coordinator ID" ;
VAL_ 2549874826 CBV_NMCoSRB_ARS_FD 0 "Start of synchronized shutdown is not requested by main coordinator" 1 "Start of synchronized shutdown is requested by main coordinator" ;
VAL_ 2549874826 CBV_AWB_ARS_FD 0 "Node has not woken up the network (passive wakeup)" 1 "Node has woken up the network (active wakeup)" ;
VAL_ 2549874826 CBV_PNIB_ARS_FD 0 "NM PDU contains no partial network cluster information in the user data area" 1 "NM PDU contains partial network cluster information in the user data area" ;
VAL_ 2549874826 NRR_ARS_FD 0 "Default" 1 "0x1~0xFF:RESERVED" 255 "0x1~0xFF:RESERVED" ;
VAL_ 2549874826 NM_State_ARS_FD 0 "Default" 1 "NM_RMS_BSM" 2 "NM_RMS_PBSM" 3 "RESERVED" 4 "NM_NS_RMS" 5 "RESERVED" 6 "RESERVED" 7 "RESERVED" 8 "NM_NS_RSS" 9 "RESERVED" 10 "RESERVED" 11 "RESERVED" 12 "RESERVED" 13 "RESERVED" 14 "RESERVED" 15 "RESERVED" 16 "NM_RMS_RSS" 17 "RESERVED" 18 "RESERVED" 19 "RESERVED" 20 "RESERVED" 21 "RESERVED" 22 "RESERVED" 23 "RESERVED" 24 "RESERVED" 25 "RESERVED" 26 "RESERVED" 27 "RESERVED" 28 "RESERVED" 29 "RESERVED" 30 "RESERVED" 31 "RESERVED" 32 "NM_RMS_NS" 33 "0x21~0xFF:RESERVED" 255 "0x21~0xFF:RESERVED" ;
VAL_ 2549874826 PNI_ARS_FD 0 "0x0x0~0xFFFFFFFF:NM PNC Bit" 2147483647 "0x0x0~0xFFFFFFFF:NM PNC Bit" ;
VAL_ 2549874826 PNI_ARS_FD_1 0 "0x0~0xFFFFFFFFFFFFFFFF:NM PNC Bit" ;
VAL_ 2549874826 PNI_ARS_FD_2 0 "0x0~0xFFFFFFFFFFFFFFFF:NM PNC Bit" ;
VAL_ 2549874826 PNI_ARS_FD_3 0 "0x0~0xFFFFFFFFFFFFFFFF:NM PNC Bit" ;
VAL_ 2549874789 SNI_SHVU_CCS_FD 0 "0x0x0~0xFF:NM Source Node ID" 255 "0x0x0~0xFF:NM Source Node ID" ;
VAL_ 2549874789 CBV_RMR_SHVU_CCS_FD 0 "Repeat Message State not requested" 1 "Repeat Message State requested" ;
VAL_ 2549874789 CBV_NMCoID_SHVU_CCS_FD 0 "NM Coordinator ID" 1 "NM Coordinator ID" 2 "NM Coordinator ID" 3 "NM Coordinator ID" ;
VAL_ 2549874789 CBV_NMCoSRB_SHVU_CCS_FD 0 "Start of synchronized shutdown is not requested by main coordinator" 1 "Start of synchronized shutdown is requested by main coordinator" ;
VAL_ 2549874789 CBV_AWB_SHVU_CCS_FD 0 "Node has not woken up the network (passive wakeup)" 1 "Node has woken up the network (active wakeup)" ;
VAL_ 2549874789 CBV_PNIB_SHVU_CCS_FD 0 "NM PDU contains no partial network cluster information in the user data area" 1 "NM PDU contains partial network cluster information in the user data area" ;
VAL_ 2549874789 NRR_SHVU_CCS_FD 0 "Default" 1 "0x1~0xFF:RESERVED" 255 "0x1~0xFF:RESERVED" ;
VAL_ 2549874789 NM_State_SHVU_CCS_FD 0 "Default" 1 "NM_RMS_BSM" 2 "NM_RMS_PBSM" 3 "RESERVED" 4 "NM_NS_RMS" 5 "RESERVED" 6 "RESERVED" 7 "RESERVED" 8 "NM_NS_RSS" 9 "RESERVED" 10 "RESERVED" 11 "RESERVED" 12 "RESERVED" 13 "RESERVED" 14 "RESERVED" 15 "RESERVED" 16 "NM_RMS_RSS" 17 "RESERVED" 18 "RESERVED" 19 "RESERVED" 20 "RESERVED" 21 "RESERVED" 22 "RESERVED" 23 "RESERVED" 24 "RESERVED" 25 "RESERVED" 26 "RESERVED" 27 "RESERVED" 28 "RESERVED" 29 "RESERVED" 30 "RESERVED" 31 "RESERVED" 32 "NM_RMS_NS" 33 "0x21~0xFF:RESERVED" 255 "0x21~0xFF:RESERVED" ;
VAL_ 2549874789 PNI_SHVU_CCS_FD 0 "0x0x0~0xFFFFFFFF:NM PNC Bit" 2147483647 "0x0x0~0xFFFFFFFF:NM PNC Bit" ;
VAL_ 2549874789 PNI_SHVU_CCS_FD_1 0 "0x0~0xFFFFFFFFFFFFFFFF:NM PNC Bit" ;
VAL_ 2549874789 PNI_SHVU_CCS_FD_2 0 "0x0~0xFFFFFFFFFFFFFFFF:NM PNC Bit" ;
VAL_ 2549874789 PNI_SHVU_CCS_FD_3 0 "0x0~0xFFFFFFFFFFFFFFFF:NM PNC Bit" ;
VAL_ 2549874846 SNI_WPC_FD 0 "0x0x0~0xFF:NM Source Node ID" 255 "0x0x0~0xFF:NM Source Node ID" ;
VAL_ 2549874846 CBV_RMR_WPC_FD 0 "Repeat Message State not requested" 1 "Repeat Message State requested" ;
VAL_ 2549874846 CBV_NMCoID_WPC_FD 0 "NM Coordinator ID" 1 "NM Coordinator ID" 2 "NM Coordinator ID" 3 "NM Coordinator ID" ;
VAL_ 2549874846 CBV_NMCoSRB_WPC_FD 0 "Start of synchronized shutdown is not requested by main coordinator" 1 "Start of synchronized shutdown is requested by main coordinator" ;
VAL_ 2549874846 CBV_AWB_WPC_FD 0 "Node has not woken up the network (passive wakeup)" 1 "Node has woken up the network (active wakeup)" ;
VAL_ 2549874846 CBV_PNIB_WPC_FD 0 "NM PDU contains no partial network cluster information in the user data area" 1 "NM PDU contains partial network cluster information in the user data area" ;
VAL_ 2549874846 NRR_WPC_FD 0 "Default" 1 "0x1~0xFF:RESERVED" 255 "0x1~0xFF:RESERVED" ;
VAL_ 2549874846 NM_State_WPC_FD 0 "Default" 1 "NM_RMS_BSM" 2 "NM_RMS_PBSM" 3 "RESERVED" 4 "NM_NS_RMS" 5 "RESERVED" 6 "RESERVED" 7 "RESERVED" 8 "NM_NS_RSS" 9 "RESERVED" 10 "RESERVED" 11 "RESERVED" 12 "RESERVED" 13 "RESERVED" 14 "RESERVED" 15 "RESERVED" 16 "NM_RMS_RSS" 17 "RESERVED" 18 "RESERVED" 19 "RESERVED" 20 "RESERVED" 21 "RESERVED" 22 "RESERVED" 23 "RESERVED" 24 "RESERVED" 25 "RESERVED" 26 "RESERVED" 27 "RESERVED" 28 "RESERVED" 29 "RESERVED" 30 "RESERVED" 31 "RESERVED" 32 "NM_RMS_NS" 33 "0x21~0xFF:RESERVED" 255 "0x21~0xFF:RESERVED" ;
VAL_ 2549874846 PNI_WPC_FD 0 "0x0x0~0xFFFFFFFF:NM PNC Bit" 2147483647 "0x0x0~0xFFFFFFFF:NM PNC Bit" ;
VAL_ 2549874846 PNI_WPC_FD_1 0 "0x0~0xFFFFFFFFFFFFFFFF:NM PNC Bit" ;
VAL_ 2549874846 PNI_WPC_FD_2 0 "0x0~0xFFFFFFFFFFFFFFFF:NM PNC Bit" ;
VAL_ 2549874846 PNI_WPC_FD_3 0 "0x0~0xFFFFFFFFFFFFFFFF:NM PNC Bit" ;
VAL_ 2549874837 SNI_WPC2_FD 0 "0x0x0~0xFF:NM Source Node ID" 255 "0x0x0~0xFF:NM Source Node ID" ;
VAL_ 2549874837 CBV_RMR_WPC2_FD 0 "Repeat Message State not requested" 1 "Repeat Message State requested" ;
VAL_ 2549874837 CBV_NMCoID_WPC2_FD 0 "NM Coordinator ID" 1 "NM Coordinator ID" 2 "NM Coordinator ID" 3 "NM Coordinator ID" ;
VAL_ 2549874837 CBV_NMCoSRB_WPC2_FD 0 "Start of synchronized shutdown is not requested by main coordinator" 1 "Start of synchronized shutdown is requested by main coordinator" ;
VAL_ 2549874837 CBV_AWB_WPC2_FD 0 "Node has not woken up the network (passive wakeup)" 1 "Node has woken up the network (active wakeup)" ;
VAL_ 2549874837 CBV_PNIB_WPC2_FD 0 "NM PDU contains no partial network cluster information in the user data area" 1 "NM PDU contains partial network cluster information in the user data area" ;
VAL_ 2549874837 NRR_WPC2_FD 0 "Default" 1 "0x1~0xFF:RESERVED" 255 "0x1~0xFF:RESERVED" ;
VAL_ 2549874837 NM_State_WPC2_FD 0 "Default" 1 "NM_RMS_BSM" 2 "NM_RMS_PBSM" 3 "RESERVED" 4 "NM_NS_RMS" 5 "RESERVED" 6 "RESERVED" 7 "RESERVED" 8 "NM_NS_RSS" 9 "RESERVED" 10 "RESERVED" 11 "RESERVED" 12 "RESERVED" 13 "RESERVED" 14 "RESERVED" 15 "RESERVED" 16 "NM_RMS_RSS" 17 "RESERVED" 18 "RESERVED" 19 "RESERVED" 20 "RESERVED" 21 "RESERVED" 22 "RESERVED" 23 "RESERVED" 24 "RESERVED" 25 "RESERVED" 26 "RESERVED" 27 "RESERVED" 28 "RESERVED" 29 "RESERVED" 30 "RESERVED" 31 "RESERVED" 32 "NM_RMS_NS" 33 "0x21~0xFF:RESERVED" 255 "0x21~0xFF:RESERVED" ;
VAL_ 2549874837 PNI_WPC2_FD 0 "0x0x0~0xFFFFFFFF:NM PNC Bit" 2147483647 "0x0x0~0xFFFFFFFF:NM PNC Bit" ;
VAL_ 2549874837 PNI_WPC2_FD_1 0 "0x0~0xFFFFFFFFFFFFFFFF:NM PNC Bit" ;
VAL_ 2549874837 PNI_WPC2_FD_2 0 "0x0~0xFFFFFFFFFFFFFFFF:NM PNC Bit" ;
VAL_ 2549874837 PNI_WPC2_FD_3 0 "0x0~0xFFFFFFFFFFFFFFFF:NM PNC Bit" ;
VAL_ 2549874823 SNI_SCM_FD 0 "0x0x0~0xFF:NM Source Node ID" 255 "0x0x0~0xFF:NM Source Node ID" ;
VAL_ 2549874823 CBV_RMR_SCM_FD 0 "Repeat Message State not requested" 1 "Repeat Message State requested" ;
VAL_ 2549874823 CBV_NMCoID_SCM_FD 0 "NM Coordinator ID" 1 "NM Coordinator ID" 2 "NM Coordinator ID" 3 "NM Coordinator ID" ;
VAL_ 2549874823 CBV_NMCoSRB_SCM_FD 0 "Start of synchronized shutdown is not requested by main coordinator" 1 "Start of synchronized shutdown is requested by main coordinator" ;
VAL_ 2549874823 CBV_AWB_SCM_FD 0 "Node has not woken up the network (passive wakeup)" 1 "Node has woken up the network (active wakeup)" ;
VAL_ 2549874823 CBV_PNIB_SCM_FD 0 "NM PDU contains no partial network cluster information in the user data area" 1 "NM PDU contains partial network cluster information in the user data area" ;
VAL_ 2549874823 NRR_SCM_FD 0 "Default" 1 "0x1~0xFF:RESERVED" 255 "0x1~0xFF:RESERVED" ;
VAL_ 2549874823 NM_State_SCM_FD 0 "Default" 1 "NM_RMS_BSM" 2 "NM_RMS_PBSM" 3 "RESERVED" 4 "NM_NS_RMS" 5 "RESERVED" 6 "RESERVED" 7 "RESERVED" 8 "NM_NS_RSS" 9 "RESERVED" 10 "RESERVED" 11 "RESERVED" 12 "RESERVED" 13 "RESERVED" 14 "RESERVED" 15 "RESERVED" 16 "NM_RMS_RSS" 17 "RESERVED" 18 "RESERVED" 19 "RESERVED" 20 "RESERVED" 21 "RESERVED" 22 "RESERVED" 23 "RESERVED" 24 "RESERVED" 25 "RESERVED" 26 "RESERVED" 27 "RESERVED" 28 "RESERVED" 29 "RESERVED" 30 "RESERVED" 31 "RESERVED" 32 "NM_RMS_NS" 33 "0x21~0xFF:RESERVED" 255 "0x21~0xFF:RESERVED" ;
VAL_ 2549874823 PNI_SCM_FD 0 "0x0x0~0xFFFFFFFF:NM PNC Bit" 2147483647 "0x0x0~0xFFFFFFFF:NM PNC Bit" ;
VAL_ 2549874823 PNI_SCM_FD_1 0 "0x0~0xFFFFFFFFFFFFFFFF:NM PNC Bit" ;
VAL_ 2549874823 PNI_SCM_FD_2 0 "0x0~0xFFFFFFFFFFFFFFFF:NM PNC Bit" ;
VAL_ 2549874823 PNI_SCM_FD_3 0 "0x0~0xFFFFFFFFFFFFFFFF:NM PNC Bit" ;
