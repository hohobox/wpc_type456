VERSION ""

NS_ :

BS_:

BU_: L_DHRR_FD L_UWB_BLE_MST_FD L_UWB_RR_FD L_UWB_BLE_SLV_FD L_UWB_FR_FD L_ROA_FR_FD L_ROA_FD L_DHRL_FD L_UWB_TRNK_FD L_UWB_FRNK_FD L_EDT_FD L_UWB_FL_FD GW_BDC_FD L_UWB_RL_FD L_SAL_FD L_WPC_FD L_TPMS_FD L_DHL_FD L_DHR_FD

BO_ 980 BDC_FD_05_200ms: 32 GW_BDC_FD
 SG_ BDC_FD_Crc5Val : 0|16@1+ (1,0) [0|0] "" Vector__XXX
 SG_ AutoLt_HorRes_STD : 107|2@1+ (1,0) [0|0] "" Vector__XXX
 SG_ AutoLt_VerVal_STD : 109|11@1+ (1,0) [0|0] "" Vector__XXX
 SG_ AutoLt_VerRes_STD : 120|2@1+ (1,0) [0|0] "" Vector__XXX
 SG_ MoodLamp_SlvColor_X : 128|8@1+ (1,0) [0|0] "" Vector__XXX
 SG_ MoodLamp_SlvColor_Y : 136|8@1+ (1,0) [0|0] "" Vector__XXX
 SG_ MoodLamp_SlvBrgtnsVal : 144|8@1+ (1,0) [0|0] "" Vector__XXX
 SG_ MoodLamp_SlvFadeInTimetVal : 152|8@1+ (1,0) [0|0] "" Vector__XXX
 SG_ BDC_FD_AlvCnt5Val : 16|8@1+ (1,0) [0|0] "" Vector__XXX
 SG_ MoodLamp_SlvFadeOutTimetVal : 160|8@1+ (1,0) [0|0] "" Vector__XXX
 SG_ Lamp_LftTrnLmpCmdSta : 168|2@1+ (1,0) [0|0] "" Vector__XXX
 SG_ Lamp_RtTrnLmpCmdSta : 170|2@1+ (1,0) [0|0] "" Vector__XXX
 SG_ Lamp_LftTrnLmpCmd : 172|2@1+ (1,0) [0|0] "" Vector__XXX
 SG_ Lamp_RtTrnLmpCmd : 174|2@1+ (1,0) [0|0] "" Vector__XXX
 SG_ Lamp_TrnLmpMode : 176|3@1+ (1,0) [0|0] "" Vector__XXX
 SG_ Lamp_HzrdSwIND : 182|2@1+ (1,0) [0|0] "" Vector__XXX
 SG_ Lamp_HdLmpEscortShortCmd_Copy_0 : 184|2@1+ (1,0) [0|0] "" Vector__XXX
 SG_ Lamp_LightPopUpMsgType : 186|2@1+ (1,0) [0|0] "" Vector__XXX
 SG_ Lamp_LightPopUpReq : 188|2@1+ (1,0) [0|0] "" Vector__XXX
 SG_ Lamp_HdLmpLoOffPopUpReq_Copy_0 : 190|2@1+ (1,0) [0|0] "" Vector__XXX
 SG_ MoodLamp_SpeechRecogPosSta : 192|3@1+ (1,0) [0|0] "" Vector__XXX
 SG_ MoodLamp_BttmSlvColor_X : 195|8@1+ (1,0) [0|0] "" Vector__XXX
 SG_ MoodLamp_BttmSlvColor_Y : 203|8@1+ (1,0) [0|0] "" Vector__XXX
 SG_ MoodLamp_BttmSlvBrgtnsVal : 211|8@1+ (1,0) [0|0] "" Vector__XXX
 SG_ MoodLamp_BttmSlvFadeInTimetVal : 219|8@1+ (1,0) [0|0] "" Vector__XXX
 SG_ MoodLamp_BttmSlvFadeOutTimetVal : 227|8@1+ (1,0) [0|0] "" Vector__XXX
 SG_ Lamp_FrontGroundLightOnReq : 235|2@1+ (1,0) [0|0] "" Vector__XXX
 SG_ Lamp_SideGroundLightOnReq : 237|2@1+ (1,0) [0|0] "" Vector__XXX
 SG_ Lamp_RearGroundLightOnReq : 239|2@1+ (1,0) [0|0] "" Vector__XXX
 SG_ Lamp_HiPrioHzrdReq_Copy_0 : 24|3@1+ (1,0) [0|0] "" Vector__XXX
 SG_ Lamp_FrFogLmpEnable : 241|2@1+ (1,0) [0|0] "" Vector__XXX
 SG_ Lamp_RrFogLmpEnable : 243|2@1+ (1,0) [0|0] "" Vector__XXX
 SG_ Lamp_LoPrioHzrdReq_Copy_0 : 27|3@1+ (1,0) [0|0] "" Vector__XXX
 SG_ Lamp_ExtrnlTailLmpOnReq_Copy_0 : 30|2@1+ (1,0) [0|0] "" Vector__XXX
 SG_ Lamp_HdLmpLoOnReq_Copy_0 : 32|2@1+ (1,0) [0|0] "" Vector__XXX
 SG_ Lamp_HdLmpHiOnReq_Copy_0 : 34|2@1+ (1,0) [0|0] "" Vector__XXX
 SG_ Lamp_DrlOnReq_Copy_0 : 36|2@1+ (1,0) [0|0] "" Vector__XXX
 SG_ Lamp_BckUpLmpCmd_Copy_0 : 38|2@1+ (1,0) [0|0] "" Vector__XXX
 SG_ Lamp_FrFogLmpOnReq_Copy_0 : 40|2@1+ (1,0) [0|0] "" Vector__XXX
 SG_ Lamp_RrFogLmpOnReq_Copy_0 : 42|2@1+ (1,0) [0|0] "" Vector__XXX
 SG_ Lamp_StcBendingLmpLftOnReq_Copy_ : 44|2@1+ (1,0) [0|0] "" Vector__XXX
 SG_ Lamp_StcBendingLmpRtOnReq_Copy_0 : 46|2@1+ (1,0) [0|0] "" Vector__XXX
 SG_ Lamp_CornerLmpLftOnReq_Copy_0 : 48|2@1+ (1,0) [0|0] "" Vector__XXX
 SG_ Lamp_CornerLmpRtOnReq_Copy_0 : 50|2@1+ (1,0) [0|0] "" Vector__XXX
 SG_ Lamp_HbaCtrlModTyp_Copy_0 : 52|2@1+ (1,0) [0|0] "" Vector__XXX
 SG_ Lamp_IFSCtrlModTyp_Copy_0 : 54|2@1+ (1,0) [0|0] "" Vector__XXX
 SG_ Lamp_HdLmpWlcmCmd_Copy_0 : 56|2@1+ (1,0) [0|0] "" Vector__XXX
 SG_ Lamp_PuddleLmpOnReq_Copy_0 : 58|2@1+ (1,0) [0|0] ""  L_DHL_FD,L_DHRL_FD,L_DHRR_FD,L_DHR_FD
 SG_ Lamp_ExtLampRSPAMode_Copy_0 : 60|2@1+ (1,0) [0|0] "" Vector__XXX
 SG_ Lamp_IntTailLmpOnReq_Copy_0 : 62|2@1+ (1,0) [0|0] "" Vector__XXX
 SG_ Lamp_AvTailLmpSta_Copy_0 : 64|2@1+ (1,0) [0|0] "" Vector__XXX
 SG_ Lamp_AutoLtSnsrNightSta_Copy_0 : 66|2@1+ (1,0) [0|0] "" Vector__XXX
 SG_ Lamp_VendorInfo_Copy_0 : 68|3@1+ (1,0) [0|0] "" Vector__XXX
 SG_ Lamp_AutoLtSnsrHorVal_Copy_0 : 72|10@1+ (1,0) [0|0] "" Vector__XXX
 SG_ MoodLamp_AIVoiceOptSta : 82|2@1+ (1,0) [0|0] "" Vector__XXX
 SG_ MoodLamp_DualColorOptSta : 84|2@1+ (1,0) [0|0] "" Vector__XXX
 SG_ MoodLamp_MdLmpFadeSta : 86|2@1+ (1,0) [0|0] "" Vector__XXX
 SG_ MoodLamp_NumRecommendColor : 88|4@1+ (1,0) [0|0] "" Vector__XXX
 SG_ AutoLt_HorVal_STD : 96|11@1+ (1,0) [0|0] "" Vector__XXX

BO_ 2683310247 L_ROA_FD_Dev_07: 8 L_ROA_FD
 SG_ ROA_Dev_07 : 0|64@1+ (1,0) [0|0] "" Vector__XXX

BO_ 2683310246 L_ROA_FD_Dev_06: 8 L_ROA_FD
 SG_ ROA_Dev_06 : 0|64@1+ (1,0) [0|0] "" Vector__XXX

BO_ 2683310245 L_ROA_FD_Dev_05: 8 L_ROA_FD
 SG_ ROA_Dev_05 : 0|64@1+ (1,0) [0|0] "" Vector__XXX

BO_ 2683310244 L_ROA_FD_Dev_04: 8 L_ROA_FD
 SG_ ROA_Dev_04 : 0|64@1+ (1,0) [0|0] "" Vector__XXX

BO_ 2683310243 L_ROA_FD_Dev_03: 8 L_ROA_FD
 SG_ ROA_Dev_03 : 0|64@1+ (1,0) [0|0] "" Vector__XXX

BO_ 2683310242 L_ROA_FD_Dev_02: 8 L_ROA_FD
 SG_ ROA_Dev_02 : 0|64@1+ (1,0) [0|0] "" Vector__XXX

BO_ 2683310241 L_ROA_FD_Dev_01: 8 L_ROA_FD
 SG_ ROA_Dev_01 : 0|64@1+ (1,0) [0|0] "" Vector__XXX

BO_ 2281701600 L_UWB_FRNK_FD_10_200ms: 24 L_UWB_FRNK_FD
 SG_ L_UWB_FRNK_FD_Crc10Val : 0|16@1+ (1,0) [0|0] "0" Vector__XXX
 SG_ UWB_FRNK_SW_MCU_Ver_Major : 104|8@1+ (1,0) [0|0] ""  L_UWB_BLE_MST_FD
 SG_ UWB_FRNK_SW_MCU_Ver_Minor : 112|8@1+ (1,0) [0|0] ""  L_UWB_BLE_MST_FD
 SG_ UWB_FRNK_SW_IC_Ver_Major : 120|8@1+ (1,0) [0|0] ""  L_UWB_BLE_MST_FD
 SG_ UWB_FRNK_SW_IC_Ver_Minor : 128|8@1+ (1,0) [0|0] ""  L_UWB_BLE_MST_FD
 SG_ UWB_FRNK_DTC : 136|8@1+ (1,0) [0|0] ""  L_UWB_BLE_MST_FD
 SG_ L_UWB_FRNK_FD_AlvCnt10Val : 16|8@1+ (1,0) [0|0] "0" Vector__XXX
 SG_ UWB_FRNK_Status1 : 24|4@1+ (1,0) [0|7] ""  GW_BDC_FD,L_UWB_BLE_MST_FD
 SG_ UWB_FRNK_Status2 : 28|4@1+ (1,0) [0|0] ""  GW_BDC_FD,L_UWB_BLE_MST_FD
 SG_ UWB_FRNK_Status3 : 32|4@1+ (1,0) [0|0] ""  GW_BDC_FD,L_UWB_BLE_MST_FD
 SG_ UWB_FRNK_Status4 : 36|4@1+ (1,0) [0|0] ""  GW_BDC_FD,L_UWB_BLE_MST_FD
 SG_ UWB_FRNK_Status5 : 40|4@1+ (1,0) [0|0] ""  GW_BDC_FD,L_UWB_BLE_MST_FD
 SG_ UWB_FRNK_Status6 : 44|4@1+ (1,0) [0|0] ""  GW_BDC_FD,L_UWB_BLE_MST_FD
 SG_ UWB_FRNK_Status7 : 48|4@1+ (1,0) [0|0] ""  GW_BDC_FD,L_UWB_BLE_MST_FD
 SG_ UWB_FRNK_Status8 : 52|4@1+ (1,0) [0|0] ""  GW_BDC_FD,L_UWB_BLE_MST_FD
 SG_ UWB_FRNK_Status9 : 56|4@1+ (1,0) [0|0] ""  GW_BDC_FD,L_UWB_BLE_MST_FD
 SG_ UWB_FRNK_Status10 : 60|4@1+ (1,0) [0|0] ""  GW_BDC_FD,L_UWB_BLE_MST_FD
 SG_ UWB_FRNK_Status11 : 64|4@1+ (1,0) [0|0] ""  GW_BDC_FD,L_UWB_BLE_MST_FD
 SG_ UWB_FRNK_Status12 : 68|4@1+ (1,0) [0|0] ""  GW_BDC_FD,L_UWB_BLE_MST_FD
 SG_ UWB_FRNK_Status13 : 72|4@1+ (1,0) [0|0] ""  GW_BDC_FD,L_UWB_BLE_MST_FD
 SG_ UWB_FRNK_Status14 : 76|4@1+ (1,0) [0|0] ""  GW_BDC_FD,L_UWB_BLE_MST_FD
 SG_ UWB_FRNK_Status15 : 80|4@1+ (1,0) [0|0] ""  GW_BDC_FD,L_UWB_BLE_MST_FD
 SG_ UWB_FRNK_Status16 : 84|4@1+ (1,0) [0|0] ""  GW_BDC_FD,L_UWB_BLE_MST_FD
 SG_ UWB_FRNK_HW_Ver_Major : 88|8@1+ (1,0) [0|0] ""  L_UWB_BLE_MST_FD
 SG_ UWB_FRNK_HW_Ver_Minor : 96|8@1+ (1,0) [0|0] ""  L_UWB_BLE_MST_FD

BO_ 2683310240 L_ROA_FD_Dev_00: 8 L_ROA_FD
 SG_ ROA_Dev_00 : 0|64@1+ (1,0) [0|0] "" Vector__XXX

BO_ 2683310250 L_ROA_FD_Dev_10: 8 L_ROA_FD
 SG_ ROA_Dev_10 : 0|64@1+ (1,0) [0|0] "" Vector__XXX

BO_ 2683310249 L_ROA_FD_Dev_09: 8 L_ROA_FD
 SG_ ROA_Dev_09 : 0|64@1+ (1,0) [0|0] "" Vector__XXX

BO_ 2683310248 L_ROA_FD_Dev_08: 8 L_ROA_FD
 SG_ ROA_Dev_08 : 0|64@1+ (1,0) [0|0] "" Vector__XXX

BO_ 2549874733 NM_L_DHRR_FD: 32 L_DHRR_FD
 SG_ SNI_L_DHRR_FD : 0|8@1+ (1,0) [0|0] ""  GW_BDC_FD,L_DHL_FD,L_DHRL_FD,L_DHR_FD,L_SAL_FD,L_TPMS_FD,L_UWB_BLE_MST_FD,L_UWB_BLE_SLV_FD,L_UWB_FL_FD,L_UWB_FRNK_FD,L_UWB_FR_FD,L_UWB_RL_FD,L_UWB_RR_FD,L_UWB_TRNK_FD,L_WPC_FD
 SG_ CBV_RMR_L_DHRR_FD : 8|1@1+ (1,0) [0|0] ""  GW_BDC_FD,L_DHL_FD,L_DHRL_FD,L_DHR_FD,L_SAL_FD,L_TPMS_FD,L_UWB_BLE_MST_FD,L_UWB_BLE_SLV_FD,L_UWB_FL_FD,L_UWB_FRNK_FD,L_UWB_FR_FD,L_UWB_RL_FD,L_UWB_RR_FD,L_UWB_TRNK_FD,L_WPC_FD
 SG_ CBV_NMCoID_L_DHRR_FD : 9|2@1+ (1,0) [0|0] ""  GW_BDC_FD,L_DHL_FD,L_DHRL_FD,L_DHR_FD,L_SAL_FD,L_TPMS_FD,L_UWB_BLE_MST_FD,L_UWB_BLE_SLV_FD,L_UWB_FL_FD,L_UWB_FRNK_FD,L_UWB_FR_FD,L_UWB_RL_FD,L_UWB_RR_FD,L_UWB_TRNK_FD,L_WPC_FD
 SG_ CBV_NMCoSRB_L_DHRR_FD : 11|1@1+ (1,0) [0|0] ""  GW_BDC_FD,L_DHL_FD,L_DHRL_FD,L_DHR_FD,L_SAL_FD,L_TPMS_FD,L_UWB_BLE_MST_FD,L_UWB_BLE_SLV_FD,L_UWB_FL_FD,L_UWB_FRNK_FD,L_UWB_FR_FD,L_UWB_RL_FD,L_UWB_RR_FD,L_UWB_TRNK_FD,L_WPC_FD
 SG_ CBV_AWB_L_DHRR_FD : 12|1@1+ (1,0) [0|0] ""  GW_BDC_FD,L_DHL_FD,L_DHRL_FD,L_DHR_FD,L_SAL_FD,L_TPMS_FD,L_UWB_BLE_MST_FD,L_UWB_BLE_SLV_FD,L_UWB_FL_FD,L_UWB_FRNK_FD,L_UWB_FR_FD,L_UWB_RL_FD,L_UWB_RR_FD,L_UWB_TRNK_FD,L_WPC_FD
 SG_ CBV_PNIB_L_DHRR_FD : 14|1@1+ (1,0) [0|0] ""  GW_BDC_FD,L_DHL_FD,L_DHRL_FD,L_DHR_FD,L_SAL_FD,L_TPMS_FD,L_UWB_BLE_MST_FD,L_UWB_BLE_SLV_FD,L_UWB_FL_FD,L_UWB_FRNK_FD,L_UWB_FR_FD,L_UWB_RL_FD,L_UWB_RR_FD,L_UWB_TRNK_FD,L_WPC_FD
 SG_ NRR_L_DHRR_FD : 16|8@1+ (1,0) [0|0] ""  GW_BDC_FD,L_DHL_FD,L_DHRL_FD,L_DHR_FD,L_SAL_FD,L_TPMS_FD,L_UWB_BLE_MST_FD,L_UWB_BLE_SLV_FD,L_UWB_FL_FD,L_UWB_FRNK_FD,L_UWB_FR_FD,L_UWB_RL_FD,L_UWB_RR_FD,L_UWB_TRNK_FD,L_WPC_FD
 SG_ NM_State_L_DHRR_FD : 24|8@1+ (1,0) [0|0] ""  GW_BDC_FD,L_DHL_FD,L_DHRL_FD,L_DHR_FD,L_SAL_FD,L_TPMS_FD,L_UWB_BLE_MST_FD,L_UWB_BLE_SLV_FD,L_UWB_FL_FD,L_UWB_FRNK_FD,L_UWB_FR_FD,L_UWB_RL_FD,L_UWB_RR_FD,L_UWB_TRNK_FD,L_WPC_FD
 SG_ PNI_L_DHRR_FD : 32|32@1+ (1,0) [0|0] ""  GW_BDC_FD,L_DHL_FD,L_DHRL_FD,L_DHR_FD,L_SAL_FD,L_TPMS_FD,L_UWB_BLE_MST_FD,L_UWB_BLE_SLV_FD,L_UWB_FL_FD,L_UWB_FRNK_FD,L_UWB_FR_FD,L_UWB_RL_FD,L_UWB_RR_FD,L_UWB_TRNK_FD,L_WPC_FD
 SG_ PNI_L_DHRR_FD_1 : 64|64@1+ (1,0) [0|0] ""  GW_BDC_FD,L_DHL_FD,L_DHRL_FD,L_DHR_FD,L_SAL_FD,L_TPMS_FD,L_UWB_BLE_MST_FD,L_UWB_BLE_SLV_FD,L_UWB_FL_FD,L_UWB_FRNK_FD,L_UWB_FR_FD,L_UWB_RL_FD,L_UWB_RR_FD,L_UWB_TRNK_FD,L_WPC_FD
 SG_ PNI_L_DHRR_FD_2 : 128|64@1+ (1,0) [0|0] ""  GW_BDC_FD,L_DHL_FD,L_DHRL_FD,L_DHR_FD,L_SAL_FD,L_TPMS_FD,L_UWB_BLE_MST_FD,L_UWB_BLE_SLV_FD,L_UWB_FL_FD,L_UWB_FRNK_FD,L_UWB_FR_FD,L_UWB_RL_FD,L_UWB_RR_FD,L_UWB_TRNK_FD,L_WPC_FD
 SG_ PNI_L_DHRR_FD_3 : 192|64@1+ (1,0) [0|0] ""  GW_BDC_FD,L_DHL_FD,L_DHRL_FD,L_DHR_FD,L_SAL_FD,L_TPMS_FD,L_UWB_BLE_MST_FD,L_UWB_BLE_SLV_FD,L_UWB_FL_FD,L_UWB_FRNK_FD,L_UWB_FR_FD,L_UWB_RL_FD,L_UWB_RR_FD,L_UWB_TRNK_FD,L_WPC_FD

BO_ 2549874720 NM_L_UWB_BLE_MST_FD: 32 L_UWB_BLE_MST_FD
 SG_ SNI_L_UWB_BLE_MST_FD : 0|8@1+ (1,0) [0|0] ""  GW_BDC_FD,L_DHL_FD,L_DHRL_FD,L_DHRR_FD,L_DHR_FD,L_SAL_FD,L_TPMS_FD,L_UWB_BLE_SLV_FD,L_UWB_FL_FD,L_UWB_FRNK_FD,L_UWB_FR_FD,L_UWB_RL_FD,L_UWB_RR_FD,L_UWB_TRNK_FD,L_WPC_FD
 SG_ CBV_RMR_L_UWB_BLE_MST_FD : 8|1@1+ (1,0) [0|0] ""  GW_BDC_FD,L_DHL_FD,L_DHRL_FD,L_DHRR_FD,L_DHR_FD,L_SAL_FD,L_TPMS_FD,L_UWB_BLE_SLV_FD,L_UWB_FL_FD,L_UWB_FRNK_FD,L_UWB_FR_FD,L_UWB_RL_FD,L_UWB_RR_FD,L_UWB_TRNK_FD,L_WPC_FD
 SG_ CBV_NMCoID_L_UWB_BLE_MST_FD : 9|2@1+ (1,0) [0|0] ""  GW_BDC_FD,L_DHL_FD,L_DHRL_FD,L_DHRR_FD,L_DHR_FD,L_SAL_FD,L_TPMS_FD,L_UWB_BLE_SLV_FD,L_UWB_FL_FD,L_UWB_FRNK_FD,L_UWB_FR_FD,L_UWB_RL_FD,L_UWB_RR_FD,L_UWB_TRNK_FD,L_WPC_FD
 SG_ CBV_NMCoSRB_L_UWB_BLE_MST_FD : 11|1@1+ (1,0) [0|0] ""  GW_BDC_FD,L_DHL_FD,L_DHRL_FD,L_DHRR_FD,L_DHR_FD,L_SAL_FD,L_TPMS_FD,L_UWB_BLE_SLV_FD,L_UWB_FL_FD,L_UWB_FRNK_FD,L_UWB_FR_FD,L_UWB_RL_FD,L_UWB_RR_FD,L_UWB_TRNK_FD,L_WPC_FD
 SG_ CBV_AWB_L_UWB_BLE_MST_FD : 12|1@1+ (1,0) [0|0] ""  GW_BDC_FD,L_DHL_FD,L_DHRL_FD,L_DHRR_FD,L_DHR_FD,L_SAL_FD,L_TPMS_FD,L_UWB_BLE_SLV_FD,L_UWB_FL_FD,L_UWB_FRNK_FD,L_UWB_FR_FD,L_UWB_RL_FD,L_UWB_RR_FD,L_UWB_TRNK_FD,L_WPC_FD
 SG_ CBV_PNIB_L_UWB_BLE_MST_FD : 14|1@1+ (1,0) [0|0] ""  GW_BDC_FD,L_DHL_FD,L_DHRL_FD,L_DHRR_FD,L_DHR_FD,L_SAL_FD,L_TPMS_FD,L_UWB_BLE_SLV_FD,L_UWB_FL_FD,L_UWB_FRNK_FD,L_UWB_FR_FD,L_UWB_RL_FD,L_UWB_RR_FD,L_UWB_TRNK_FD,L_WPC_FD
 SG_ NRR_L_UWB_BLE_MST_FD : 16|8@1+ (1,0) [0|0] ""  GW_BDC_FD,L_DHL_FD,L_DHRL_FD,L_DHRR_FD,L_DHR_FD,L_SAL_FD,L_TPMS_FD,L_UWB_BLE_SLV_FD,L_UWB_FL_FD,L_UWB_FRNK_FD,L_UWB_FR_FD,L_UWB_RL_FD,L_UWB_RR_FD,L_UWB_TRNK_FD,L_WPC_FD
 SG_ NM_State_L_UWB_BLE_MST_FD : 24|8@1+ (1,0) [0|0] ""  GW_BDC_FD,L_DHL_FD,L_DHRL_FD,L_DHRR_FD,L_DHR_FD,L_SAL_FD,L_TPMS_FD,L_UWB_BLE_SLV_FD,L_UWB_FL_FD,L_UWB_FRNK_FD,L_UWB_FR_FD,L_UWB_RL_FD,L_UWB_RR_FD,L_UWB_TRNK_FD,L_WPC_FD
 SG_ PNI_L_UWB_BLE_MST_FD : 32|32@1+ (1,0) [0|0] ""  GW_BDC_FD,L_DHL_FD,L_DHRL_FD,L_DHRR_FD,L_DHR_FD,L_SAL_FD,L_TPMS_FD,L_UWB_BLE_SLV_FD,L_UWB_FL_FD,L_UWB_FRNK_FD,L_UWB_FR_FD,L_UWB_RL_FD,L_UWB_RR_FD,L_UWB_TRNK_FD,L_WPC_FD
 SG_ PNI_L_UWB_BLE_MST_FD_1 : 64|64@1+ (1,0) [0|0] ""  GW_BDC_FD,L_DHL_FD,L_DHRL_FD,L_DHRR_FD,L_DHR_FD,L_SAL_FD,L_TPMS_FD,L_UWB_BLE_SLV_FD,L_UWB_FL_FD,L_UWB_FRNK_FD,L_UWB_FR_FD,L_UWB_RL_FD,L_UWB_RR_FD,L_UWB_TRNK_FD,L_WPC_FD
 SG_ PNI_L_UWB_BLE_MST_FD_2 : 128|64@1+ (1,0) [0|0] ""  GW_BDC_FD,L_DHL_FD,L_DHRL_FD,L_DHRR_FD,L_DHR_FD,L_SAL_FD,L_TPMS_FD,L_UWB_BLE_SLV_FD,L_UWB_FL_FD,L_UWB_FRNK_FD,L_UWB_FR_FD,L_UWB_RL_FD,L_UWB_RR_FD,L_UWB_TRNK_FD,L_WPC_FD
 SG_ PNI_L_UWB_BLE_MST_FD_3 : 192|64@1+ (1,0) [0|0] ""  GW_BDC_FD,L_DHL_FD,L_DHRL_FD,L_DHRR_FD,L_DHR_FD,L_SAL_FD,L_TPMS_FD,L_UWB_BLE_SLV_FD,L_UWB_FL_FD,L_UWB_FRNK_FD,L_UWB_FR_FD,L_UWB_RL_FD,L_UWB_RR_FD,L_UWB_TRNK_FD,L_WPC_FD

BO_ 2549874726 NM_L_UWB_RR_FD: 32 L_UWB_RR_FD
 SG_ SNI_L_UWB_RR_FD : 0|8@1+ (1,0) [0|0] ""  GW_BDC_FD,L_DHL_FD,L_DHRL_FD,L_DHRR_FD,L_DHR_FD,L_SAL_FD,L_TPMS_FD,L_UWB_BLE_MST_FD,L_UWB_BLE_SLV_FD,L_UWB_FL_FD,L_UWB_FRNK_FD,L_UWB_FR_FD,L_UWB_RL_FD,L_UWB_TRNK_FD,L_WPC_FD
 SG_ CBV_RMR_L_UWB_RR_FD : 8|1@1+ (1,0) [0|0] ""  GW_BDC_FD,L_DHL_FD,L_DHRL_FD,L_DHRR_FD,L_DHR_FD,L_SAL_FD,L_TPMS_FD,L_UWB_BLE_MST_FD,L_UWB_BLE_SLV_FD,L_UWB_FL_FD,L_UWB_FRNK_FD,L_UWB_FR_FD,L_UWB_RL_FD,L_UWB_TRNK_FD,L_WPC_FD
 SG_ CBV_NMCoID_L_UWB_RR_FD : 9|2@1+ (1,0) [0|0] ""  GW_BDC_FD,L_DHL_FD,L_DHRL_FD,L_DHRR_FD,L_DHR_FD,L_SAL_FD,L_TPMS_FD,L_UWB_BLE_MST_FD,L_UWB_BLE_SLV_FD,L_UWB_FL_FD,L_UWB_FRNK_FD,L_UWB_FR_FD,L_UWB_RL_FD,L_UWB_TRNK_FD,L_WPC_FD
 SG_ CBV_NMCoSRB_L_UWB_RR_FD : 11|1@1+ (1,0) [0|0] ""  GW_BDC_FD,L_DHL_FD,L_DHRL_FD,L_DHRR_FD,L_DHR_FD,L_SAL_FD,L_TPMS_FD,L_UWB_BLE_MST_FD,L_UWB_BLE_SLV_FD,L_UWB_FL_FD,L_UWB_FRNK_FD,L_UWB_FR_FD,L_UWB_RL_FD,L_UWB_TRNK_FD,L_WPC_FD
 SG_ CBV_AWB_L_UWB_RR_FD : 12|1@1+ (1,0) [0|0] ""  GW_BDC_FD,L_DHL_FD,L_DHRL_FD,L_DHRR_FD,L_DHR_FD,L_SAL_FD,L_TPMS_FD,L_UWB_BLE_MST_FD,L_UWB_BLE_SLV_FD,L_UWB_FL_FD,L_UWB_FRNK_FD,L_UWB_FR_FD,L_UWB_RL_FD,L_UWB_TRNK_FD,L_WPC_FD
 SG_ CBV_PNIB_L_UWB_RR_FD : 14|1@1+ (1,0) [0|0] ""  GW_BDC_FD,L_DHL_FD,L_DHRL_FD,L_DHRR_FD,L_DHR_FD,L_SAL_FD,L_TPMS_FD,L_UWB_BLE_MST_FD,L_UWB_BLE_SLV_FD,L_UWB_FL_FD,L_UWB_FRNK_FD,L_UWB_FR_FD,L_UWB_RL_FD,L_UWB_TRNK_FD,L_WPC_FD
 SG_ NRR_L_UWB_RR_FD : 16|8@1+ (1,0) [0|0] ""  GW_BDC_FD,L_DHL_FD,L_DHRL_FD,L_DHRR_FD,L_DHR_FD,L_SAL_FD,L_TPMS_FD,L_UWB_BLE_MST_FD,L_UWB_BLE_SLV_FD,L_UWB_FL_FD,L_UWB_FRNK_FD,L_UWB_FR_FD,L_UWB_RL_FD,L_UWB_TRNK_FD,L_WPC_FD
 SG_ NM_State_L_UWB_RR_FD : 24|8@1+ (1,0) [0|0] ""  GW_BDC_FD,L_DHL_FD,L_DHRL_FD,L_DHRR_FD,L_DHR_FD,L_SAL_FD,L_TPMS_FD,L_UWB_BLE_MST_FD,L_UWB_BLE_SLV_FD,L_UWB_FL_FD,L_UWB_FRNK_FD,L_UWB_FR_FD,L_UWB_RL_FD,L_UWB_TRNK_FD,L_WPC_FD
 SG_ PNI_L_UWB_RR_FD : 32|32@1+ (1,0) [0|0] ""  GW_BDC_FD,L_DHL_FD,L_DHRL_FD,L_DHRR_FD,L_DHR_FD,L_SAL_FD,L_TPMS_FD,L_UWB_BLE_MST_FD,L_UWB_BLE_SLV_FD,L_UWB_FL_FD,L_UWB_FRNK_FD,L_UWB_FR_FD,L_UWB_RL_FD,L_UWB_TRNK_FD,L_WPC_FD
 SG_ PNI_L_UWB_RR_FD_1 : 64|64@1+ (1,0) [0|0] ""  GW_BDC_FD,L_DHL_FD,L_DHRL_FD,L_DHRR_FD,L_DHR_FD,L_SAL_FD,L_TPMS_FD,L_UWB_BLE_MST_FD,L_UWB_BLE_SLV_FD,L_UWB_FL_FD,L_UWB_FRNK_FD,L_UWB_FR_FD,L_UWB_RL_FD,L_UWB_TRNK_FD,L_WPC_FD
 SG_ PNI_L_UWB_RR_FD_2 : 128|64@1+ (1,0) [0|0] ""  GW_BDC_FD,L_DHL_FD,L_DHRL_FD,L_DHRR_FD,L_DHR_FD,L_SAL_FD,L_TPMS_FD,L_UWB_BLE_MST_FD,L_UWB_BLE_SLV_FD,L_UWB_FL_FD,L_UWB_FRNK_FD,L_UWB_FR_FD,L_UWB_RL_FD,L_UWB_TRNK_FD,L_WPC_FD
 SG_ PNI_L_UWB_RR_FD_3 : 192|64@1+ (1,0) [0|0] ""  GW_BDC_FD,L_DHL_FD,L_DHRL_FD,L_DHRR_FD,L_DHR_FD,L_SAL_FD,L_TPMS_FD,L_UWB_BLE_MST_FD,L_UWB_BLE_SLV_FD,L_UWB_FL_FD,L_UWB_FRNK_FD,L_UWB_FR_FD,L_UWB_RL_FD,L_UWB_TRNK_FD,L_WPC_FD

BO_ 2549874721 NM_L_UWB_BLE_SLV_FD: 32 L_UWB_BLE_SLV_FD
 SG_ SNI_L_UWB_BLE_SLV_FD : 0|8@1+ (1,0) [0|0] ""  GW_BDC_FD,L_DHL_FD,L_DHRL_FD,L_DHRR_FD,L_DHR_FD,L_SAL_FD,L_TPMS_FD,L_UWB_BLE_MST_FD,L_UWB_FL_FD,L_UWB_FRNK_FD,L_UWB_FR_FD,L_UWB_RL_FD,L_UWB_RR_FD,L_UWB_TRNK_FD,L_WPC_FD
 SG_ CBV_RMR_L_UWB_BLE_SLV_FD : 8|1@1+ (1,0) [0|0] ""  GW_BDC_FD,L_DHL_FD,L_DHRL_FD,L_DHRR_FD,L_DHR_FD,L_SAL_FD,L_TPMS_FD,L_UWB_BLE_MST_FD,L_UWB_FL_FD,L_UWB_FRNK_FD,L_UWB_FR_FD,L_UWB_RL_FD,L_UWB_RR_FD,L_UWB_TRNK_FD,L_WPC_FD
 SG_ CBV_NMCoID_L_UWB_BLE_SLV_FD : 9|2@1+ (1,0) [0|0] ""  GW_BDC_FD,L_DHL_FD,L_DHRL_FD,L_DHRR_FD,L_DHR_FD,L_SAL_FD,L_TPMS_FD,L_UWB_BLE_MST_FD,L_UWB_FL_FD,L_UWB_FRNK_FD,L_UWB_FR_FD,L_UWB_RL_FD,L_UWB_RR_FD,L_UWB_TRNK_FD,L_WPC_FD
 SG_ CBV_NMCoSRB_L_UWB_BLE_SLV_FD : 11|1@1+ (1,0) [0|0] ""  GW_BDC_FD,L_DHL_FD,L_DHRL_FD,L_DHRR_FD,L_DHR_FD,L_SAL_FD,L_TPMS_FD,L_UWB_BLE_MST_FD,L_UWB_FL_FD,L_UWB_FRNK_FD,L_UWB_FR_FD,L_UWB_RL_FD,L_UWB_RR_FD,L_UWB_TRNK_FD,L_WPC_FD
 SG_ CBV_AWB_L_UWB_BLE_SLV_FD : 12|1@1+ (1,0) [0|0] ""  GW_BDC_FD,L_DHL_FD,L_DHRL_FD,L_DHRR_FD,L_DHR_FD,L_SAL_FD,L_TPMS_FD,L_UWB_BLE_MST_FD,L_UWB_FL_FD,L_UWB_FRNK_FD,L_UWB_FR_FD,L_UWB_RL_FD,L_UWB_RR_FD,L_UWB_TRNK_FD,L_WPC_FD
 SG_ CBV_PNIB_L_UWB_BLE_SLV_FD : 14|1@1+ (1,0) [0|0] ""  GW_BDC_FD,L_DHL_FD,L_DHRL_FD,L_DHRR_FD,L_DHR_FD,L_SAL_FD,L_TPMS_FD,L_UWB_BLE_MST_FD,L_UWB_FL_FD,L_UWB_FRNK_FD,L_UWB_FR_FD,L_UWB_RL_FD,L_UWB_RR_FD,L_UWB_TRNK_FD,L_WPC_FD
 SG_ NRR_L_UWB_BLE_SLV_FD : 16|8@1+ (1,0) [0|0] ""  GW_BDC_FD,L_DHL_FD,L_DHRL_FD,L_DHRR_FD,L_DHR_FD,L_SAL_FD,L_TPMS_FD,L_UWB_BLE_MST_FD,L_UWB_FL_FD,L_UWB_FRNK_FD,L_UWB_FR_FD,L_UWB_RL_FD,L_UWB_RR_FD,L_UWB_TRNK_FD,L_WPC_FD
 SG_ NM_State_L_UWB_BLE_SLV_FD : 24|8@1+ (1,0) [0|0] ""  GW_BDC_FD,L_DHL_FD,L_DHRL_FD,L_DHRR_FD,L_DHR_FD,L_SAL_FD,L_TPMS_FD,L_UWB_BLE_MST_FD,L_UWB_FL_FD,L_UWB_FRNK_FD,L_UWB_FR_FD,L_UWB_RL_FD,L_UWB_RR_FD,L_UWB_TRNK_FD,L_WPC_FD
 SG_ PNI_L_UWB_BLE_SLV_FD : 32|32@1+ (1,0) [0|0] ""  GW_BDC_FD,L_DHL_FD,L_DHRL_FD,L_DHRR_FD,L_DHR_FD,L_SAL_FD,L_TPMS_FD,L_UWB_BLE_MST_FD,L_UWB_FL_FD,L_UWB_FRNK_FD,L_UWB_FR_FD,L_UWB_RL_FD,L_UWB_RR_FD,L_UWB_TRNK_FD,L_WPC_FD
 SG_ PNI_L_UWB_BLE_SLV_FD_1 : 64|64@1+ (1,0) [0|0] ""  GW_BDC_FD,L_DHL_FD,L_DHRL_FD,L_DHRR_FD,L_DHR_FD,L_SAL_FD,L_TPMS_FD,L_UWB_BLE_MST_FD,L_UWB_FL_FD,L_UWB_FRNK_FD,L_UWB_FR_FD,L_UWB_RL_FD,L_UWB_RR_FD,L_UWB_TRNK_FD,L_WPC_FD
 SG_ PNI_L_UWB_BLE_SLV_FD_2 : 128|64@1+ (1,0) [0|0] ""  GW_BDC_FD,L_DHL_FD,L_DHRL_FD,L_DHRR_FD,L_DHR_FD,L_SAL_FD,L_TPMS_FD,L_UWB_BLE_MST_FD,L_UWB_FL_FD,L_UWB_FRNK_FD,L_UWB_FR_FD,L_UWB_RL_FD,L_UWB_RR_FD,L_UWB_TRNK_FD,L_WPC_FD
 SG_ PNI_L_UWB_BLE_SLV_FD_3 : 192|64@1+ (1,0) [0|0] ""  GW_BDC_FD,L_DHL_FD,L_DHRL_FD,L_DHRR_FD,L_DHR_FD,L_SAL_FD,L_TPMS_FD,L_UWB_BLE_MST_FD,L_UWB_FL_FD,L_UWB_FRNK_FD,L_UWB_FR_FD,L_UWB_RL_FD,L_UWB_RR_FD,L_UWB_TRNK_FD,L_WPC_FD

BO_ 2549874723 NM_L_UWB_FR_FD: 32 L_UWB_FR_FD
 SG_ SNI_L_UWB_FR_FD : 0|8@1+ (1,0) [0|0] ""  GW_BDC_FD,L_DHL_FD,L_DHRL_FD,L_DHRR_FD,L_DHR_FD,L_SAL_FD,L_TPMS_FD,L_UWB_BLE_MST_FD,L_UWB_BLE_SLV_FD,L_UWB_FL_FD,L_UWB_FRNK_FD,L_UWB_RL_FD,L_UWB_RR_FD,L_UWB_TRNK_FD,L_WPC_FD
 SG_ CBV_RMR_L_UWB_FR_FD : 8|1@1+ (1,0) [0|0] ""  GW_BDC_FD,L_DHL_FD,L_DHRL_FD,L_DHRR_FD,L_DHR_FD,L_SAL_FD,L_TPMS_FD,L_UWB_BLE_MST_FD,L_UWB_BLE_SLV_FD,L_UWB_FL_FD,L_UWB_FRNK_FD,L_UWB_RL_FD,L_UWB_RR_FD,L_UWB_TRNK_FD,L_WPC_FD
 SG_ CBV_NMCoID_L_UWB_FR_FD : 9|2@1+ (1,0) [0|0] ""  GW_BDC_FD,L_DHL_FD,L_DHRL_FD,L_DHRR_FD,L_DHR_FD,L_SAL_FD,L_TPMS_FD,L_UWB_BLE_MST_FD,L_UWB_BLE_SLV_FD,L_UWB_FL_FD,L_UWB_FRNK_FD,L_UWB_RL_FD,L_UWB_RR_FD,L_UWB_TRNK_FD,L_WPC_FD
 SG_ CBV_NMCoSRB_L_UWB_FR_FD : 11|1@1+ (1,0) [0|0] ""  GW_BDC_FD,L_DHL_FD,L_DHRL_FD,L_DHRR_FD,L_DHR_FD,L_SAL_FD,L_TPMS_FD,L_UWB_BLE_MST_FD,L_UWB_BLE_SLV_FD,L_UWB_FL_FD,L_UWB_FRNK_FD,L_UWB_RL_FD,L_UWB_RR_FD,L_UWB_TRNK_FD,L_WPC_FD
 SG_ CBV_AWB_L_UWB_FR_FD : 12|1@1+ (1,0) [0|0] ""  GW_BDC_FD,L_DHL_FD,L_DHRL_FD,L_DHRR_FD,L_DHR_FD,L_SAL_FD,L_TPMS_FD,L_UWB_BLE_MST_FD,L_UWB_BLE_SLV_FD,L_UWB_FL_FD,L_UWB_FRNK_FD,L_UWB_RL_FD,L_UWB_RR_FD,L_UWB_TRNK_FD,L_WPC_FD
 SG_ CBV_PNIB_L_UWB_FR_FD : 14|1@1+ (1,0) [0|0] ""  GW_BDC_FD,L_DHL_FD,L_DHRL_FD,L_DHRR_FD,L_DHR_FD,L_SAL_FD,L_TPMS_FD,L_UWB_BLE_MST_FD,L_UWB_BLE_SLV_FD,L_UWB_FL_FD,L_UWB_FRNK_FD,L_UWB_RL_FD,L_UWB_RR_FD,L_UWB_TRNK_FD,L_WPC_FD
 SG_ NRR_L_UWB_FR_FD : 16|8@1+ (1,0) [0|0] ""  GW_BDC_FD,L_DHL_FD,L_DHRL_FD,L_DHRR_FD,L_DHR_FD,L_SAL_FD,L_TPMS_FD,L_UWB_BLE_MST_FD,L_UWB_BLE_SLV_FD,L_UWB_FL_FD,L_UWB_FRNK_FD,L_UWB_RL_FD,L_UWB_RR_FD,L_UWB_TRNK_FD,L_WPC_FD
 SG_ NM_State_L_UWB_FR_FD : 24|8@1+ (1,0) [0|0] ""  GW_BDC_FD,L_DHL_FD,L_DHRL_FD,L_DHRR_FD,L_DHR_FD,L_SAL_FD,L_TPMS_FD,L_UWB_BLE_MST_FD,L_UWB_BLE_SLV_FD,L_UWB_FL_FD,L_UWB_FRNK_FD,L_UWB_RL_FD,L_UWB_RR_FD,L_UWB_TRNK_FD,L_WPC_FD
 SG_ PNI_L_UWB_FR_FD : 32|32@1+ (1,0) [0|0] ""  GW_BDC_FD,L_DHL_FD,L_DHRL_FD,L_DHRR_FD,L_DHR_FD,L_SAL_FD,L_TPMS_FD,L_UWB_BLE_MST_FD,L_UWB_BLE_SLV_FD,L_UWB_FL_FD,L_UWB_FRNK_FD,L_UWB_RL_FD,L_UWB_RR_FD,L_UWB_TRNK_FD,L_WPC_FD
 SG_ PNI_L_UWB_FR_FD_1 : 64|64@1+ (1,0) [0|0] ""  GW_BDC_FD,L_DHL_FD,L_DHRL_FD,L_DHRR_FD,L_DHR_FD,L_SAL_FD,L_TPMS_FD,L_UWB_BLE_MST_FD,L_UWB_BLE_SLV_FD,L_UWB_FL_FD,L_UWB_FRNK_FD,L_UWB_RL_FD,L_UWB_RR_FD,L_UWB_TRNK_FD,L_WPC_FD
 SG_ PNI_L_UWB_FR_FD_2 : 128|64@1+ (1,0) [0|0] ""  GW_BDC_FD,L_DHL_FD,L_DHRL_FD,L_DHRR_FD,L_DHR_FD,L_SAL_FD,L_TPMS_FD,L_UWB_BLE_MST_FD,L_UWB_BLE_SLV_FD,L_UWB_FL_FD,L_UWB_FRNK_FD,L_UWB_RL_FD,L_UWB_RR_FD,L_UWB_TRNK_FD,L_WPC_FD
 SG_ PNI_L_UWB_FR_FD_3 : 192|64@1+ (1,0) [0|0] ""  GW_BDC_FD,L_DHL_FD,L_DHRL_FD,L_DHRR_FD,L_DHR_FD,L_SAL_FD,L_TPMS_FD,L_UWB_BLE_MST_FD,L_UWB_BLE_SLV_FD,L_UWB_FL_FD,L_UWB_FRNK_FD,L_UWB_RL_FD,L_UWB_RR_FD,L_UWB_TRNK_FD,L_WPC_FD

BO_ 2549874732 NM_L_DHRL_FD: 32 L_DHRL_FD
 SG_ SNI_L_DHRL_FD : 0|8@1+ (1,0) [0|0] ""  GW_BDC_FD,L_DHL_FD,L_DHRR_FD,L_DHR_FD,L_SAL_FD,L_TPMS_FD,L_UWB_BLE_MST_FD,L_UWB_BLE_SLV_FD,L_UWB_FL_FD,L_UWB_FRNK_FD,L_UWB_FR_FD,L_UWB_RL_FD,L_UWB_RR_FD,L_UWB_TRNK_FD,L_WPC_FD
 SG_ CBV_RMR_L_DHRL_FD : 8|1@1+ (1,0) [0|0] ""  GW_BDC_FD,L_DHL_FD,L_DHRR_FD,L_DHR_FD,L_SAL_FD,L_TPMS_FD,L_UWB_BLE_MST_FD,L_UWB_BLE_SLV_FD,L_UWB_FL_FD,L_UWB_FRNK_FD,L_UWB_FR_FD,L_UWB_RL_FD,L_UWB_RR_FD,L_UWB_TRNK_FD,L_WPC_FD
 SG_ CBV_NMCoID_L_DHRL_FD : 9|2@1+ (1,0) [0|0] ""  GW_BDC_FD,L_DHL_FD,L_DHRR_FD,L_DHR_FD,L_SAL_FD,L_TPMS_FD,L_UWB_BLE_MST_FD,L_UWB_BLE_SLV_FD,L_UWB_FL_FD,L_UWB_FRNK_FD,L_UWB_FR_FD,L_UWB_RL_FD,L_UWB_RR_FD,L_UWB_TRNK_FD,L_WPC_FD
 SG_ CBV_NMCoSRB_L_DHRL_FD : 11|1@1+ (1,0) [0|0] ""  GW_BDC_FD,L_DHL_FD,L_DHRR_FD,L_DHR_FD,L_SAL_FD,L_TPMS_FD,L_UWB_BLE_MST_FD,L_UWB_BLE_SLV_FD,L_UWB_FL_FD,L_UWB_FRNK_FD,L_UWB_FR_FD,L_UWB_RL_FD,L_UWB_RR_FD,L_UWB_TRNK_FD,L_WPC_FD
 SG_ CBV_AWB_L_DHRL_FD : 12|1@1+ (1,0) [0|0] ""  GW_BDC_FD,L_DHL_FD,L_DHRR_FD,L_DHR_FD,L_SAL_FD,L_TPMS_FD,L_UWB_BLE_MST_FD,L_UWB_BLE_SLV_FD,L_UWB_FL_FD,L_UWB_FRNK_FD,L_UWB_FR_FD,L_UWB_RL_FD,L_UWB_RR_FD,L_UWB_TRNK_FD,L_WPC_FD
 SG_ CBV_PNIB_L_DHRL_FD : 14|1@1+ (1,0) [0|0] ""  GW_BDC_FD,L_DHL_FD,L_DHRR_FD,L_DHR_FD,L_SAL_FD,L_TPMS_FD,L_UWB_BLE_MST_FD,L_UWB_BLE_SLV_FD,L_UWB_FL_FD,L_UWB_FRNK_FD,L_UWB_FR_FD,L_UWB_RL_FD,L_UWB_RR_FD,L_UWB_TRNK_FD,L_WPC_FD
 SG_ NRR_L_DHRL_FD : 16|8@1+ (1,0) [0|0] ""  GW_BDC_FD,L_DHL_FD,L_DHRR_FD,L_DHR_FD,L_SAL_FD,L_TPMS_FD,L_UWB_BLE_MST_FD,L_UWB_BLE_SLV_FD,L_UWB_FL_FD,L_UWB_FRNK_FD,L_UWB_FR_FD,L_UWB_RL_FD,L_UWB_RR_FD,L_UWB_TRNK_FD,L_WPC_FD
 SG_ NM_State_L_DHRL_FD : 24|8@1+ (1,0) [0|0] ""  GW_BDC_FD,L_DHL_FD,L_DHRR_FD,L_DHR_FD,L_SAL_FD,L_TPMS_FD,L_UWB_BLE_MST_FD,L_UWB_BLE_SLV_FD,L_UWB_FL_FD,L_UWB_FRNK_FD,L_UWB_FR_FD,L_UWB_RL_FD,L_UWB_RR_FD,L_UWB_TRNK_FD,L_WPC_FD
 SG_ PNI_L_DHRL_FD : 32|32@1+ (1,0) [0|0] ""  GW_BDC_FD,L_DHL_FD,L_DHRR_FD,L_DHR_FD,L_SAL_FD,L_TPMS_FD,L_UWB_BLE_MST_FD,L_UWB_BLE_SLV_FD,L_UWB_FL_FD,L_UWB_FRNK_FD,L_UWB_FR_FD,L_UWB_RL_FD,L_UWB_RR_FD,L_UWB_TRNK_FD,L_WPC_FD
 SG_ PNI_L_DHRL_FD_1 : 64|64@1+ (1,0) [0|0] ""  GW_BDC_FD,L_DHL_FD,L_DHRR_FD,L_DHR_FD,L_SAL_FD,L_TPMS_FD,L_UWB_BLE_MST_FD,L_UWB_BLE_SLV_FD,L_UWB_FL_FD,L_UWB_FRNK_FD,L_UWB_FR_FD,L_UWB_RL_FD,L_UWB_RR_FD,L_UWB_TRNK_FD,L_WPC_FD
 SG_ PNI_L_DHRL_FD_2 : 128|64@1+ (1,0) [0|0] ""  GW_BDC_FD,L_DHL_FD,L_DHRR_FD,L_DHR_FD,L_SAL_FD,L_TPMS_FD,L_UWB_BLE_MST_FD,L_UWB_BLE_SLV_FD,L_UWB_FL_FD,L_UWB_FRNK_FD,L_UWB_FR_FD,L_UWB_RL_FD,L_UWB_RR_FD,L_UWB_TRNK_FD,L_WPC_FD
 SG_ PNI_L_DHRL_FD_3 : 192|64@1+ (1,0) [0|0] ""  GW_BDC_FD,L_DHL_FD,L_DHRR_FD,L_DHR_FD,L_SAL_FD,L_TPMS_FD,L_UWB_BLE_MST_FD,L_UWB_BLE_SLV_FD,L_UWB_FL_FD,L_UWB_FRNK_FD,L_UWB_FR_FD,L_UWB_RL_FD,L_UWB_RR_FD,L_UWB_TRNK_FD,L_WPC_FD

BO_ 2549874727 NM_L_UWB_TRNK_FD: 32 L_UWB_TRNK_FD
 SG_ SNI_L_UWB_TRNK_FD : 0|8@1+ (1,0) [0|0] ""  GW_BDC_FD,L_DHL_FD,L_DHRL_FD,L_DHRR_FD,L_DHR_FD,L_SAL_FD,L_TPMS_FD,L_UWB_BLE_MST_FD,L_UWB_BLE_SLV_FD,L_UWB_FL_FD,L_UWB_FRNK_FD,L_UWB_FR_FD,L_UWB_RL_FD,L_UWB_RR_FD,L_WPC_FD
 SG_ CBV_RMR_L_UWB_TRNK_FD : 8|1@1+ (1,0) [0|0] ""  GW_BDC_FD,L_DHL_FD,L_DHRL_FD,L_DHRR_FD,L_DHR_FD,L_SAL_FD,L_TPMS_FD,L_UWB_BLE_MST_FD,L_UWB_BLE_SLV_FD,L_UWB_FL_FD,L_UWB_FRNK_FD,L_UWB_FR_FD,L_UWB_RL_FD,L_UWB_RR_FD,L_WPC_FD
 SG_ CBV_NMCoID_L_UWB_TRNK_FD : 9|2@1+ (1,0) [0|0] ""  GW_BDC_FD,L_DHL_FD,L_DHRL_FD,L_DHRR_FD,L_DHR_FD,L_SAL_FD,L_TPMS_FD,L_UWB_BLE_MST_FD,L_UWB_BLE_SLV_FD,L_UWB_FL_FD,L_UWB_FRNK_FD,L_UWB_FR_FD,L_UWB_RL_FD,L_UWB_RR_FD,L_WPC_FD
 SG_ CBV_NMCoSRB_L_UWB_TRNK_FD : 11|1@1+ (1,0) [0|0] ""  GW_BDC_FD,L_DHL_FD,L_DHRL_FD,L_DHRR_FD,L_DHR_FD,L_SAL_FD,L_TPMS_FD,L_UWB_BLE_MST_FD,L_UWB_BLE_SLV_FD,L_UWB_FL_FD,L_UWB_FRNK_FD,L_UWB_FR_FD,L_UWB_RL_FD,L_UWB_RR_FD,L_WPC_FD
 SG_ CBV_AWB_L_UWB_TRNK_FD : 12|1@1+ (1,0) [0|0] ""  GW_BDC_FD,L_DHL_FD,L_DHRL_FD,L_DHRR_FD,L_DHR_FD,L_SAL_FD,L_TPMS_FD,L_UWB_BLE_MST_FD,L_UWB_BLE_SLV_FD,L_UWB_FL_FD,L_UWB_FRNK_FD,L_UWB_FR_FD,L_UWB_RL_FD,L_UWB_RR_FD,L_WPC_FD
 SG_ CBV_PNIB_L_UWB_TRNK_FD : 14|1@1+ (1,0) [0|0] ""  GW_BDC_FD,L_DHL_FD,L_DHRL_FD,L_DHRR_FD,L_DHR_FD,L_SAL_FD,L_TPMS_FD,L_UWB_BLE_MST_FD,L_UWB_BLE_SLV_FD,L_UWB_FL_FD,L_UWB_FRNK_FD,L_UWB_FR_FD,L_UWB_RL_FD,L_UWB_RR_FD,L_WPC_FD
 SG_ NRR_L_UWB_TRNK_FD : 16|8@1+ (1,0) [0|0] ""  GW_BDC_FD,L_DHL_FD,L_DHRL_FD,L_DHRR_FD,L_DHR_FD,L_SAL_FD,L_TPMS_FD,L_UWB_BLE_MST_FD,L_UWB_BLE_SLV_FD,L_UWB_FL_FD,L_UWB_FRNK_FD,L_UWB_FR_FD,L_UWB_RL_FD,L_UWB_RR_FD,L_WPC_FD
 SG_ NM_State_L_UWB_TRNK_FD : 24|8@1+ (1,0) [0|0] ""  GW_BDC_FD,L_DHL_FD,L_DHRL_FD,L_DHRR_FD,L_DHR_FD,L_SAL_FD,L_TPMS_FD,L_UWB_BLE_MST_FD,L_UWB_BLE_SLV_FD,L_UWB_FL_FD,L_UWB_FRNK_FD,L_UWB_FR_FD,L_UWB_RL_FD,L_UWB_RR_FD,L_WPC_FD
 SG_ PNI_L_UWB_TRNK_FD : 32|32@1+ (1,0) [0|0] ""  GW_BDC_FD,L_DHL_FD,L_DHRL_FD,L_DHRR_FD,L_DHR_FD,L_SAL_FD,L_TPMS_FD,L_UWB_BLE_MST_FD,L_UWB_BLE_SLV_FD,L_UWB_FL_FD,L_UWB_FRNK_FD,L_UWB_FR_FD,L_UWB_RL_FD,L_UWB_RR_FD,L_WPC_FD
 SG_ PNI_L_UWB_TRNK_FD_1 : 64|64@1+ (1,0) [0|0] ""  GW_BDC_FD,L_DHL_FD,L_DHRL_FD,L_DHRR_FD,L_DHR_FD,L_SAL_FD,L_TPMS_FD,L_UWB_BLE_MST_FD,L_UWB_BLE_SLV_FD,L_UWB_FL_FD,L_UWB_FRNK_FD,L_UWB_FR_FD,L_UWB_RL_FD,L_UWB_RR_FD,L_WPC_FD
 SG_ PNI_L_UWB_TRNK_FD_2 : 128|64@1+ (1,0) [0|0] ""  GW_BDC_FD,L_DHL_FD,L_DHRL_FD,L_DHRR_FD,L_DHR_FD,L_SAL_FD,L_TPMS_FD,L_UWB_BLE_MST_FD,L_UWB_BLE_SLV_FD,L_UWB_FL_FD,L_UWB_FRNK_FD,L_UWB_FR_FD,L_UWB_RL_FD,L_UWB_RR_FD,L_WPC_FD
 SG_ PNI_L_UWB_TRNK_FD_3 : 192|64@1+ (1,0) [0|0] ""  GW_BDC_FD,L_DHL_FD,L_DHRL_FD,L_DHRR_FD,L_DHR_FD,L_SAL_FD,L_TPMS_FD,L_UWB_BLE_MST_FD,L_UWB_BLE_SLV_FD,L_UWB_FL_FD,L_UWB_FRNK_FD,L_UWB_FR_FD,L_UWB_RL_FD,L_UWB_RR_FD,L_WPC_FD

BO_ 2549874724 NM_L_UWB_FRNK_FD: 32 L_UWB_FRNK_FD
 SG_ SNI_L_UWB_FRNK_FD : 0|8@1+ (1,0) [0|0] ""  GW_BDC_FD,L_DHL_FD,L_DHRL_FD,L_DHRR_FD,L_DHR_FD,L_SAL_FD,L_TPMS_FD,L_UWB_BLE_MST_FD,L_UWB_BLE_SLV_FD,L_UWB_FL_FD,L_UWB_FR_FD,L_UWB_RL_FD,L_UWB_RR_FD,L_UWB_TRNK_FD,L_WPC_FD
 SG_ CBV_RMR_L_UWB_FRNK_FD : 8|1@1+ (1,0) [0|0] ""  GW_BDC_FD,L_DHL_FD,L_DHRL_FD,L_DHRR_FD,L_DHR_FD,L_SAL_FD,L_TPMS_FD,L_UWB_BLE_MST_FD,L_UWB_BLE_SLV_FD,L_UWB_FL_FD,L_UWB_FR_FD,L_UWB_RL_FD,L_UWB_RR_FD,L_UWB_TRNK_FD,L_WPC_FD
 SG_ CBV_NMCoID_L_UWB_FRNK_FD : 9|2@1+ (1,0) [0|0] ""  GW_BDC_FD,L_DHL_FD,L_DHRL_FD,L_DHRR_FD,L_DHR_FD,L_SAL_FD,L_TPMS_FD,L_UWB_BLE_MST_FD,L_UWB_BLE_SLV_FD,L_UWB_FL_FD,L_UWB_FR_FD,L_UWB_RL_FD,L_UWB_RR_FD,L_UWB_TRNK_FD,L_WPC_FD
 SG_ CBV_NMCoSRB_L_UWB_FRNK_FD : 11|1@1+ (1,0) [0|0] ""  GW_BDC_FD,L_DHL_FD,L_DHRL_FD,L_DHRR_FD,L_DHR_FD,L_SAL_FD,L_TPMS_FD,L_UWB_BLE_MST_FD,L_UWB_BLE_SLV_FD,L_UWB_FL_FD,L_UWB_FR_FD,L_UWB_RL_FD,L_UWB_RR_FD,L_UWB_TRNK_FD,L_WPC_FD
 SG_ CBV_AWB_L_UWB_FRNK_FD : 12|1@1+ (1,0) [0|0] ""  GW_BDC_FD,L_DHL_FD,L_DHRL_FD,L_DHRR_FD,L_DHR_FD,L_SAL_FD,L_TPMS_FD,L_UWB_BLE_MST_FD,L_UWB_BLE_SLV_FD,L_UWB_FL_FD,L_UWB_FR_FD,L_UWB_RL_FD,L_UWB_RR_FD,L_UWB_TRNK_FD,L_WPC_FD
 SG_ CBV_PNIB_L_UWB_FRNK_FD : 14|1@1+ (1,0) [0|0] ""  GW_BDC_FD,L_DHL_FD,L_DHRL_FD,L_DHRR_FD,L_DHR_FD,L_SAL_FD,L_TPMS_FD,L_UWB_BLE_MST_FD,L_UWB_BLE_SLV_FD,L_UWB_FL_FD,L_UWB_FR_FD,L_UWB_RL_FD,L_UWB_RR_FD,L_UWB_TRNK_FD,L_WPC_FD
 SG_ NRR_L_UWB_FRNK_FD : 16|8@1+ (1,0) [0|0] ""  GW_BDC_FD,L_DHL_FD,L_DHRL_FD,L_DHRR_FD,L_DHR_FD,L_SAL_FD,L_TPMS_FD,L_UWB_BLE_MST_FD,L_UWB_BLE_SLV_FD,L_UWB_FL_FD,L_UWB_FR_FD,L_UWB_RL_FD,L_UWB_RR_FD,L_UWB_TRNK_FD,L_WPC_FD
 SG_ NM_State_L_UWB_FRNK_FD : 24|8@1+ (1,0) [0|0] ""  GW_BDC_FD,L_DHL_FD,L_DHRL_FD,L_DHRR_FD,L_DHR_FD,L_SAL_FD,L_TPMS_FD,L_UWB_BLE_MST_FD,L_UWB_BLE_SLV_FD,L_UWB_FL_FD,L_UWB_FR_FD,L_UWB_RL_FD,L_UWB_RR_FD,L_UWB_TRNK_FD,L_WPC_FD
 SG_ PNI_L_UWB_FRNK_FD : 32|32@1+ (1,0) [0|0] ""  GW_BDC_FD,L_DHL_FD,L_DHRL_FD,L_DHRR_FD,L_DHR_FD,L_SAL_FD,L_TPMS_FD,L_UWB_BLE_MST_FD,L_UWB_BLE_SLV_FD,L_UWB_FL_FD,L_UWB_FR_FD,L_UWB_RL_FD,L_UWB_RR_FD,L_UWB_TRNK_FD,L_WPC_FD
 SG_ PNI_L_UWB_FRNK_FD_1 : 64|64@1+ (1,0) [0|0] ""  GW_BDC_FD,L_DHL_FD,L_DHRL_FD,L_DHRR_FD,L_DHR_FD,L_SAL_FD,L_TPMS_FD,L_UWB_BLE_MST_FD,L_UWB_BLE_SLV_FD,L_UWB_FL_FD,L_UWB_FR_FD,L_UWB_RL_FD,L_UWB_RR_FD,L_UWB_TRNK_FD,L_WPC_FD
 SG_ PNI_L_UWB_FRNK_FD_2 : 128|64@1+ (1,0) [0|0] ""  GW_BDC_FD,L_DHL_FD,L_DHRL_FD,L_DHRR_FD,L_DHR_FD,L_SAL_FD,L_TPMS_FD,L_UWB_BLE_MST_FD,L_UWB_BLE_SLV_FD,L_UWB_FL_FD,L_UWB_FR_FD,L_UWB_RL_FD,L_UWB_RR_FD,L_UWB_TRNK_FD,L_WPC_FD
 SG_ PNI_L_UWB_FRNK_FD_3 : 192|64@1+ (1,0) [0|0] ""  GW_BDC_FD,L_DHL_FD,L_DHRL_FD,L_DHRR_FD,L_DHR_FD,L_SAL_FD,L_TPMS_FD,L_UWB_BLE_MST_FD,L_UWB_BLE_SLV_FD,L_UWB_FL_FD,L_UWB_FR_FD,L_UWB_RL_FD,L_UWB_RR_FD,L_UWB_TRNK_FD,L_WPC_FD

BO_ 2549874722 NM_L_UWB_FL_FD: 32 L_UWB_FL_FD
 SG_ SNI_L_UWB_FL_FD : 0|8@1+ (1,0) [0|0] ""  GW_BDC_FD,L_DHL_FD,L_DHRL_FD,L_DHRR_FD,L_DHR_FD,L_SAL_FD,L_TPMS_FD,L_UWB_BLE_MST_FD,L_UWB_BLE_SLV_FD,L_UWB_FRNK_FD,L_UWB_FR_FD,L_UWB_RL_FD,L_UWB_RR_FD,L_UWB_TRNK_FD,L_WPC_FD
 SG_ CBV_RMR_L_UWB_FL_FD : 8|1@1+ (1,0) [0|0] ""  GW_BDC_FD,L_DHL_FD,L_DHRL_FD,L_DHRR_FD,L_DHR_FD,L_SAL_FD,L_TPMS_FD,L_UWB_BLE_MST_FD,L_UWB_BLE_SLV_FD,L_UWB_FRNK_FD,L_UWB_FR_FD,L_UWB_RL_FD,L_UWB_RR_FD,L_UWB_TRNK_FD,L_WPC_FD
 SG_ CBV_NMCoID_L_UWB_FL_FD : 9|2@1+ (1,0) [0|0] ""  GW_BDC_FD,L_DHL_FD,L_DHRL_FD,L_DHRR_FD,L_DHR_FD,L_SAL_FD,L_TPMS_FD,L_UWB_BLE_MST_FD,L_UWB_BLE_SLV_FD,L_UWB_FRNK_FD,L_UWB_FR_FD,L_UWB_RL_FD,L_UWB_RR_FD,L_UWB_TRNK_FD,L_WPC_FD
 SG_ CBV_NMCoSRB_L_UWB_FL_FD : 11|1@1+ (1,0) [0|0] ""  GW_BDC_FD,L_DHL_FD,L_DHRL_FD,L_DHRR_FD,L_DHR_FD,L_SAL_FD,L_TPMS_FD,L_UWB_BLE_MST_FD,L_UWB_BLE_SLV_FD,L_UWB_FRNK_FD,L_UWB_FR_FD,L_UWB_RL_FD,L_UWB_RR_FD,L_UWB_TRNK_FD,L_WPC_FD
 SG_ CBV_AWB_L_UWB_FL_FD : 12|1@1+ (1,0) [0|0] ""  GW_BDC_FD,L_DHL_FD,L_DHRL_FD,L_DHRR_FD,L_DHR_FD,L_SAL_FD,L_TPMS_FD,L_UWB_BLE_MST_FD,L_UWB_BLE_SLV_FD,L_UWB_FRNK_FD,L_UWB_FR_FD,L_UWB_RL_FD,L_UWB_RR_FD,L_UWB_TRNK_FD,L_WPC_FD
 SG_ CBV_PNIB_L_UWB_FL_FD : 14|1@1+ (1,0) [0|0] ""  GW_BDC_FD,L_DHL_FD,L_DHRL_FD,L_DHRR_FD,L_DHR_FD,L_SAL_FD,L_TPMS_FD,L_UWB_BLE_MST_FD,L_UWB_BLE_SLV_FD,L_UWB_FRNK_FD,L_UWB_FR_FD,L_UWB_RL_FD,L_UWB_RR_FD,L_UWB_TRNK_FD,L_WPC_FD
 SG_ NRR_L_UWB_FL_FD : 16|8@1+ (1,0) [0|0] ""  GW_BDC_FD,L_DHL_FD,L_DHRL_FD,L_DHRR_FD,L_DHR_FD,L_SAL_FD,L_TPMS_FD,L_UWB_BLE_MST_FD,L_UWB_BLE_SLV_FD,L_UWB_FRNK_FD,L_UWB_FR_FD,L_UWB_RL_FD,L_UWB_RR_FD,L_UWB_TRNK_FD,L_WPC_FD
 SG_ NM_State_L_UWB_FL_FD : 24|8@1+ (1,0) [0|0] ""  GW_BDC_FD,L_DHL_FD,L_DHRL_FD,L_DHRR_FD,L_DHR_FD,L_SAL_FD,L_TPMS_FD,L_UWB_BLE_MST_FD,L_UWB_BLE_SLV_FD,L_UWB_FRNK_FD,L_UWB_FR_FD,L_UWB_RL_FD,L_UWB_RR_FD,L_UWB_TRNK_FD,L_WPC_FD
 SG_ PNI_L_UWB_FL_FD : 32|32@1+ (1,0) [0|0] ""  GW_BDC_FD,L_DHL_FD,L_DHRL_FD,L_DHRR_FD,L_DHR_FD,L_SAL_FD,L_TPMS_FD,L_UWB_BLE_MST_FD,L_UWB_BLE_SLV_FD,L_UWB_FRNK_FD,L_UWB_FR_FD,L_UWB_RL_FD,L_UWB_RR_FD,L_UWB_TRNK_FD,L_WPC_FD
 SG_ PNI_L_UWB_FL_FD_1 : 64|64@1+ (1,0) [0|0] ""  GW_BDC_FD,L_DHL_FD,L_DHRL_FD,L_DHRR_FD,L_DHR_FD,L_SAL_FD,L_TPMS_FD,L_UWB_BLE_MST_FD,L_UWB_BLE_SLV_FD,L_UWB_FRNK_FD,L_UWB_FR_FD,L_UWB_RL_FD,L_UWB_RR_FD,L_UWB_TRNK_FD,L_WPC_FD
 SG_ PNI_L_UWB_FL_FD_2 : 128|64@1+ (1,0) [0|0] ""  GW_BDC_FD,L_DHL_FD,L_DHRL_FD,L_DHRR_FD,L_DHR_FD,L_SAL_FD,L_TPMS_FD,L_UWB_BLE_MST_FD,L_UWB_BLE_SLV_FD,L_UWB_FRNK_FD,L_UWB_FR_FD,L_UWB_RL_FD,L_UWB_RR_FD,L_UWB_TRNK_FD,L_WPC_FD
 SG_ PNI_L_UWB_FL_FD_3 : 192|64@1+ (1,0) [0|0] ""  GW_BDC_FD,L_DHL_FD,L_DHRL_FD,L_DHRR_FD,L_DHR_FD,L_SAL_FD,L_TPMS_FD,L_UWB_BLE_MST_FD,L_UWB_BLE_SLV_FD,L_UWB_FRNK_FD,L_UWB_FR_FD,L_UWB_RL_FD,L_UWB_RR_FD,L_UWB_TRNK_FD,L_WPC_FD

BO_ 2549874816 NM_GW_BDC_FD: 32 GW_BDC_FD
 SG_ SNI_GW_BDC_FD : 0|8@1+ (1,0) [0|0] ""  L_DHL_FD,L_DHRL_FD,L_DHRR_FD,L_DHR_FD,L_SAL_FD,L_TPMS_FD,L_UWB_BLE_MST_FD,L_UWB_BLE_SLV_FD,L_UWB_FL_FD,L_UWB_FRNK_FD,L_UWB_FR_FD,L_UWB_RL_FD,L_UWB_RR_FD,L_UWB_TRNK_FD,L_WPC_FD
 SG_ CBV_RMR_GW_BDC_FD : 8|1@1+ (1,0) [0|0] ""  L_DHL_FD,L_DHRL_FD,L_DHRR_FD,L_DHR_FD,L_SAL_FD,L_TPMS_FD,L_UWB_BLE_MST_FD,L_UWB_BLE_SLV_FD,L_UWB_FL_FD,L_UWB_FRNK_FD,L_UWB_FR_FD,L_UWB_RL_FD,L_UWB_RR_FD,L_UWB_TRNK_FD,L_WPC_FD
 SG_ CBV_NMCoID_GW_BDC_FD : 9|2@1+ (1,0) [0|0] ""  L_DHL_FD,L_DHRL_FD,L_DHRR_FD,L_DHR_FD,L_SAL_FD,L_TPMS_FD,L_UWB_BLE_MST_FD,L_UWB_BLE_SLV_FD,L_UWB_FL_FD,L_UWB_FRNK_FD,L_UWB_FR_FD,L_UWB_RL_FD,L_UWB_RR_FD,L_UWB_TRNK_FD,L_WPC_FD
 SG_ CBV_NMCoSRB_GW_BDC_FD : 11|1@1+ (1,0) [0|0] ""  L_DHL_FD,L_DHRL_FD,L_DHRR_FD,L_DHR_FD,L_SAL_FD,L_TPMS_FD,L_UWB_BLE_MST_FD,L_UWB_BLE_SLV_FD,L_UWB_FL_FD,L_UWB_FRNK_FD,L_UWB_FR_FD,L_UWB_RL_FD,L_UWB_RR_FD,L_UWB_TRNK_FD,L_WPC_FD
 SG_ CBV_AWB_GW_BDC_FD : 12|1@1+ (1,0) [0|0] ""  L_DHL_FD,L_DHRL_FD,L_DHRR_FD,L_DHR_FD,L_SAL_FD,L_TPMS_FD,L_UWB_BLE_MST_FD,L_UWB_BLE_SLV_FD,L_UWB_FL_FD,L_UWB_FRNK_FD,L_UWB_FR_FD,L_UWB_RL_FD,L_UWB_RR_FD,L_UWB_TRNK_FD,L_WPC_FD
 SG_ CBV_PNIB_GW_BDC_FD : 14|1@1+ (1,0) [0|0] ""  L_DHL_FD,L_DHRL_FD,L_DHRR_FD,L_DHR_FD,L_SAL_FD,L_TPMS_FD,L_UWB_BLE_MST_FD,L_UWB_BLE_SLV_FD,L_UWB_FL_FD,L_UWB_FRNK_FD,L_UWB_FR_FD,L_UWB_RL_FD,L_UWB_RR_FD,L_UWB_TRNK_FD,L_WPC_FD
 SG_ NRR_GW_BDC_FD : 16|8@1+ (1,0) [0|0] ""  L_DHL_FD,L_DHRL_FD,L_DHRR_FD,L_DHR_FD,L_SAL_FD,L_TPMS_FD,L_UWB_BLE_MST_FD,L_UWB_BLE_SLV_FD,L_UWB_FL_FD,L_UWB_FRNK_FD,L_UWB_FR_FD,L_UWB_RL_FD,L_UWB_RR_FD,L_UWB_TRNK_FD,L_WPC_FD
 SG_ NM_State_GW_BDC_FD : 24|8@1+ (1,0) [0|0] ""  L_DHL_FD,L_DHRL_FD,L_DHRR_FD,L_DHR_FD,L_SAL_FD,L_TPMS_FD,L_UWB_BLE_MST_FD,L_UWB_BLE_SLV_FD,L_UWB_FL_FD,L_UWB_FRNK_FD,L_UWB_FR_FD,L_UWB_RL_FD,L_UWB_RR_FD,L_UWB_TRNK_FD,L_WPC_FD
 SG_ PNI_GW_BDC_FD : 32|32@1+ (1,0) [0|0] ""  L_DHL_FD,L_DHRL_FD,L_DHRR_FD,L_DHR_FD,L_SAL_FD,L_TPMS_FD,L_UWB_BLE_MST_FD,L_UWB_BLE_SLV_FD,L_UWB_FL_FD,L_UWB_FRNK_FD,L_UWB_FR_FD,L_UWB_RL_FD,L_UWB_RR_FD,L_UWB_TRNK_FD,L_WPC_FD
 SG_ PNI_GW_BDC_FD_1 : 64|64@1+ (1,0) [0|0] ""  L_DHL_FD,L_DHRL_FD,L_DHRR_FD,L_DHR_FD,L_SAL_FD,L_TPMS_FD,L_UWB_BLE_MST_FD,L_UWB_BLE_SLV_FD,L_UWB_FL_FD,L_UWB_FRNK_FD,L_UWB_FR_FD,L_UWB_RL_FD,L_UWB_RR_FD,L_UWB_TRNK_FD,L_WPC_FD
 SG_ PNI_GW_BDC_FD_2 : 128|64@1+ (1,0) [0|0] ""  L_DHL_FD,L_DHRL_FD,L_DHRR_FD,L_DHR_FD,L_SAL_FD,L_TPMS_FD,L_UWB_BLE_MST_FD,L_UWB_BLE_SLV_FD,L_UWB_FL_FD,L_UWB_FRNK_FD,L_UWB_FR_FD,L_UWB_RL_FD,L_UWB_RR_FD,L_UWB_TRNK_FD,L_WPC_FD
 SG_ PNI_GW_BDC_FD_3 : 192|64@1+ (1,0) [0|0] ""  L_DHL_FD,L_DHRL_FD,L_DHRR_FD,L_DHR_FD,L_SAL_FD,L_TPMS_FD,L_UWB_BLE_MST_FD,L_UWB_BLE_SLV_FD,L_UWB_FL_FD,L_UWB_FRNK_FD,L_UWB_FR_FD,L_UWB_RL_FD,L_UWB_RR_FD,L_UWB_TRNK_FD,L_WPC_FD

BO_ 2549874725 NM_L_UWB_RL_FD: 32 L_UWB_RL_FD
 SG_ SNI_L_UWB_RL_FD : 0|8@1+ (1,0) [0|0] ""  GW_BDC_FD,L_DHL_FD,L_DHRL_FD,L_DHRR_FD,L_DHR_FD,L_SAL_FD,L_TPMS_FD,L_UWB_BLE_MST_FD,L_UWB_BLE_SLV_FD,L_UWB_FL_FD,L_UWB_FRNK_FD,L_UWB_FR_FD,L_UWB_RR_FD,L_UWB_TRNK_FD,L_WPC_FD
 SG_ CBV_RMR_L_UWB_RL_FD : 8|1@1+ (1,0) [0|0] ""  GW_BDC_FD,L_DHL_FD,L_DHRL_FD,L_DHRR_FD,L_DHR_FD,L_SAL_FD,L_TPMS_FD,L_UWB_BLE_MST_FD,L_UWB_BLE_SLV_FD,L_UWB_FL_FD,L_UWB_FRNK_FD,L_UWB_FR_FD,L_UWB_RR_FD,L_UWB_TRNK_FD,L_WPC_FD
 SG_ CBV_NMCoID_L_UWB_RL_FD : 9|2@1+ (1,0) [0|0] ""  GW_BDC_FD,L_DHL_FD,L_DHRL_FD,L_DHRR_FD,L_DHR_FD,L_SAL_FD,L_TPMS_FD,L_UWB_BLE_MST_FD,L_UWB_BLE_SLV_FD,L_UWB_FL_FD,L_UWB_FRNK_FD,L_UWB_FR_FD,L_UWB_RR_FD,L_UWB_TRNK_FD,L_WPC_FD
 SG_ CBV_NMCoSRB_L_UWB_RL_FD : 11|1@1+ (1,0) [0|0] ""  GW_BDC_FD,L_DHL_FD,L_DHRL_FD,L_DHRR_FD,L_DHR_FD,L_SAL_FD,L_TPMS_FD,L_UWB_BLE_MST_FD,L_UWB_BLE_SLV_FD,L_UWB_FL_FD,L_UWB_FRNK_FD,L_UWB_FR_FD,L_UWB_RR_FD,L_UWB_TRNK_FD,L_WPC_FD
 SG_ CBV_AWB_L_UWB_RL_FD : 12|1@1+ (1,0) [0|0] ""  GW_BDC_FD,L_DHL_FD,L_DHRL_FD,L_DHRR_FD,L_DHR_FD,L_SAL_FD,L_TPMS_FD,L_UWB_BLE_MST_FD,L_UWB_BLE_SLV_FD,L_UWB_FL_FD,L_UWB_FRNK_FD,L_UWB_FR_FD,L_UWB_RR_FD,L_UWB_TRNK_FD,L_WPC_FD
 SG_ CBV_PNIB_L_UWB_RL_FD : 14|1@1+ (1,0) [0|0] ""  GW_BDC_FD,L_DHL_FD,L_DHRL_FD,L_DHRR_FD,L_DHR_FD,L_SAL_FD,L_TPMS_FD,L_UWB_BLE_MST_FD,L_UWB_BLE_SLV_FD,L_UWB_FL_FD,L_UWB_FRNK_FD,L_UWB_FR_FD,L_UWB_RR_FD,L_UWB_TRNK_FD,L_WPC_FD
 SG_ NRR_L_UWB_RL_FD : 16|8@1+ (1,0) [0|0] ""  GW_BDC_FD,L_DHL_FD,L_DHRL_FD,L_DHRR_FD,L_DHR_FD,L_SAL_FD,L_TPMS_FD,L_UWB_BLE_MST_FD,L_UWB_BLE_SLV_FD,L_UWB_FL_FD,L_UWB_FRNK_FD,L_UWB_FR_FD,L_UWB_RR_FD,L_UWB_TRNK_FD,L_WPC_FD
 SG_ NM_State_L_UWB_RL_FD : 24|8@1+ (1,0) [0|0] ""  GW_BDC_FD,L_DHL_FD,L_DHRL_FD,L_DHRR_FD,L_DHR_FD,L_SAL_FD,L_TPMS_FD,L_UWB_BLE_MST_FD,L_UWB_BLE_SLV_FD,L_UWB_FL_FD,L_UWB_FRNK_FD,L_UWB_FR_FD,L_UWB_RR_FD,L_UWB_TRNK_FD,L_WPC_FD
 SG_ PNI_L_UWB_RL_FD : 32|32@1+ (1,0) [0|0] ""  GW_BDC_FD,L_DHL_FD,L_DHRL_FD,L_DHRR_FD,L_DHR_FD,L_SAL_FD,L_TPMS_FD,L_UWB_BLE_MST_FD,L_UWB_BLE_SLV_FD,L_UWB_FL_FD,L_UWB_FRNK_FD,L_UWB_FR_FD,L_UWB_RR_FD,L_UWB_TRNK_FD,L_WPC_FD
 SG_ PNI_L_UWB_RL_FD_1 : 64|64@1+ (1,0) [0|0] ""  GW_BDC_FD,L_DHL_FD,L_DHRL_FD,L_DHRR_FD,L_DHR_FD,L_SAL_FD,L_TPMS_FD,L_UWB_BLE_MST_FD,L_UWB_BLE_SLV_FD,L_UWB_FL_FD,L_UWB_FRNK_FD,L_UWB_FR_FD,L_UWB_RR_FD,L_UWB_TRNK_FD,L_WPC_FD
 SG_ PNI_L_UWB_RL_FD_2 : 128|64@1+ (1,0) [0|0] ""  GW_BDC_FD,L_DHL_FD,L_DHRL_FD,L_DHRR_FD,L_DHR_FD,L_SAL_FD,L_TPMS_FD,L_UWB_BLE_MST_FD,L_UWB_BLE_SLV_FD,L_UWB_FL_FD,L_UWB_FRNK_FD,L_UWB_FR_FD,L_UWB_RR_FD,L_UWB_TRNK_FD,L_WPC_FD
 SG_ PNI_L_UWB_RL_FD_3 : 192|64@1+ (1,0) [0|0] ""  GW_BDC_FD,L_DHL_FD,L_DHRL_FD,L_DHRR_FD,L_DHR_FD,L_SAL_FD,L_TPMS_FD,L_UWB_BLE_MST_FD,L_UWB_BLE_SLV_FD,L_UWB_FL_FD,L_UWB_FRNK_FD,L_UWB_FR_FD,L_UWB_RR_FD,L_UWB_TRNK_FD,L_WPC_FD

BO_ 2549874857 NM_L_SAL_FD: 32 L_SAL_FD
 SG_ SNI_L_SAL_FD : 0|8@1+ (1,0) [0|0] ""  GW_BDC_FD,L_DHL_FD,L_DHRL_FD,L_DHRR_FD,L_DHR_FD,L_TPMS_FD,L_UWB_BLE_MST_FD,L_UWB_BLE_SLV_FD,L_UWB_FL_FD,L_UWB_FRNK_FD,L_UWB_FR_FD,L_UWB_RL_FD,L_UWB_RR_FD,L_UWB_TRNK_FD,L_WPC_FD
 SG_ CBV_RMR_L_SAL_FD : 8|1@1+ (1,0) [0|0] ""  GW_BDC_FD,L_DHL_FD,L_DHRL_FD,L_DHRR_FD,L_DHR_FD,L_TPMS_FD,L_UWB_BLE_MST_FD,L_UWB_BLE_SLV_FD,L_UWB_FL_FD,L_UWB_FRNK_FD,L_UWB_FR_FD,L_UWB_RL_FD,L_UWB_RR_FD,L_UWB_TRNK_FD,L_WPC_FD
 SG_ CBV_NMCoID_L_SAL_FD : 9|2@1+ (1,0) [0|0] ""  GW_BDC_FD,L_DHL_FD,L_DHRL_FD,L_DHRR_FD,L_DHR_FD,L_TPMS_FD,L_UWB_BLE_MST_FD,L_UWB_BLE_SLV_FD,L_UWB_FL_FD,L_UWB_FRNK_FD,L_UWB_FR_FD,L_UWB_RL_FD,L_UWB_RR_FD,L_UWB_TRNK_FD,L_WPC_FD
 SG_ CBV_NMCoSRB_L_SAL_FD : 11|1@1+ (1,0) [0|0] ""  GW_BDC_FD,L_DHL_FD,L_DHRL_FD,L_DHRR_FD,L_DHR_FD,L_TPMS_FD,L_UWB_BLE_MST_FD,L_UWB_BLE_SLV_FD,L_UWB_FL_FD,L_UWB_FRNK_FD,L_UWB_FR_FD,L_UWB_RL_FD,L_UWB_RR_FD,L_UWB_TRNK_FD,L_WPC_FD
 SG_ CBV_AWB_L_SAL_FD : 12|1@1+ (1,0) [0|0] ""  GW_BDC_FD,L_DHL_FD,L_DHRL_FD,L_DHRR_FD,L_DHR_FD,L_TPMS_FD,L_UWB_BLE_MST_FD,L_UWB_BLE_SLV_FD,L_UWB_FL_FD,L_UWB_FRNK_FD,L_UWB_FR_FD,L_UWB_RL_FD,L_UWB_RR_FD,L_UWB_TRNK_FD,L_WPC_FD
 SG_ CBV_PNIB_L_SAL_FD : 14|1@1+ (1,0) [0|0] ""  GW_BDC_FD,L_DHL_FD,L_DHRL_FD,L_DHRR_FD,L_DHR_FD,L_TPMS_FD,L_UWB_BLE_MST_FD,L_UWB_BLE_SLV_FD,L_UWB_FL_FD,L_UWB_FRNK_FD,L_UWB_FR_FD,L_UWB_RL_FD,L_UWB_RR_FD,L_UWB_TRNK_FD,L_WPC_FD
 SG_ NRR_L_SAL_FD : 16|8@1+ (1,0) [0|0] ""  GW_BDC_FD,L_DHL_FD,L_DHRL_FD,L_DHRR_FD,L_DHR_FD,L_TPMS_FD,L_UWB_BLE_MST_FD,L_UWB_BLE_SLV_FD,L_UWB_FL_FD,L_UWB_FRNK_FD,L_UWB_FR_FD,L_UWB_RL_FD,L_UWB_RR_FD,L_UWB_TRNK_FD,L_WPC_FD
 SG_ NM_State_L_SAL_FD : 24|8@1+ (1,0) [0|0] ""  GW_BDC_FD,L_DHL_FD,L_DHRL_FD,L_DHRR_FD,L_DHR_FD,L_TPMS_FD,L_UWB_BLE_MST_FD,L_UWB_BLE_SLV_FD,L_UWB_FL_FD,L_UWB_FRNK_FD,L_UWB_FR_FD,L_UWB_RL_FD,L_UWB_RR_FD,L_UWB_TRNK_FD,L_WPC_FD
 SG_ PNI_L_SAL_FD : 32|32@1+ (1,0) [0|0] ""  GW_BDC_FD,L_DHL_FD,L_DHRL_FD,L_DHRR_FD,L_DHR_FD,L_TPMS_FD,L_UWB_BLE_MST_FD,L_UWB_BLE_SLV_FD,L_UWB_FL_FD,L_UWB_FRNK_FD,L_UWB_FR_FD,L_UWB_RL_FD,L_UWB_RR_FD,L_UWB_TRNK_FD,L_WPC_FD
 SG_ PNI_L_SAL_FD_1 : 64|64@1+ (1,0) [0|0] ""  GW_BDC_FD,L_DHL_FD,L_DHRL_FD,L_DHRR_FD,L_DHR_FD,L_TPMS_FD,L_UWB_BLE_MST_FD,L_UWB_BLE_SLV_FD,L_UWB_FL_FD,L_UWB_FRNK_FD,L_UWB_FR_FD,L_UWB_RL_FD,L_UWB_RR_FD,L_UWB_TRNK_FD,L_WPC_FD
 SG_ PNI_L_SAL_FD_2 : 128|64@1+ (1,0) [0|0] ""  GW_BDC_FD,L_DHL_FD,L_DHRL_FD,L_DHRR_FD,L_DHR_FD,L_TPMS_FD,L_UWB_BLE_MST_FD,L_UWB_BLE_SLV_FD,L_UWB_FL_FD,L_UWB_FRNK_FD,L_UWB_FR_FD,L_UWB_RL_FD,L_UWB_RR_FD,L_UWB_TRNK_FD,L_WPC_FD
 SG_ PNI_L_SAL_FD_3 : 192|64@1+ (1,0) [0|0] ""  GW_BDC_FD,L_DHL_FD,L_DHRL_FD,L_DHRR_FD,L_DHR_FD,L_TPMS_FD,L_UWB_BLE_MST_FD,L_UWB_BLE_SLV_FD,L_UWB_FL_FD,L_UWB_FRNK_FD,L_UWB_FR_FD,L_UWB_RL_FD,L_UWB_RR_FD,L_UWB_TRNK_FD,L_WPC_FD

BO_ 2549874718 NM_L_WPC_FD: 32 L_WPC_FD
 SG_ SNI_L_WPC_FD : 0|8@1+ (1,0) [0|0] ""  GW_BDC_FD,L_DHL_FD,L_DHRL_FD,L_DHRR_FD,L_DHR_FD,L_SAL_FD,L_TPMS_FD,L_UWB_BLE_MST_FD,L_UWB_BLE_SLV_FD,L_UWB_FL_FD,L_UWB_FRNK_FD,L_UWB_FR_FD,L_UWB_RL_FD,L_UWB_RR_FD,L_UWB_TRNK_FD
 SG_ CBV_RMR_L_WPC_FD : 8|1@1+ (1,0) [0|0] ""  GW_BDC_FD,L_DHL_FD,L_DHRL_FD,L_DHRR_FD,L_DHR_FD,L_SAL_FD,L_TPMS_FD,L_UWB_BLE_MST_FD,L_UWB_BLE_SLV_FD,L_UWB_FL_FD,L_UWB_FRNK_FD,L_UWB_FR_FD,L_UWB_RL_FD,L_UWB_RR_FD,L_UWB_TRNK_FD
 SG_ CBV_NMCoID_L_WPC_FD : 9|2@1+ (1,0) [0|0] ""  GW_BDC_FD,L_DHL_FD,L_DHRL_FD,L_DHRR_FD,L_DHR_FD,L_SAL_FD,L_TPMS_FD,L_UWB_BLE_MST_FD,L_UWB_BLE_SLV_FD,L_UWB_FL_FD,L_UWB_FRNK_FD,L_UWB_FR_FD,L_UWB_RL_FD,L_UWB_RR_FD,L_UWB_TRNK_FD
 SG_ CBV_NMCoSRB_L_WPC_FD : 11|1@1+ (1,0) [0|0] ""  GW_BDC_FD,L_DHL_FD,L_DHRL_FD,L_DHRR_FD,L_DHR_FD,L_SAL_FD,L_TPMS_FD,L_UWB_BLE_MST_FD,L_UWB_BLE_SLV_FD,L_UWB_FL_FD,L_UWB_FRNK_FD,L_UWB_FR_FD,L_UWB_RL_FD,L_UWB_RR_FD,L_UWB_TRNK_FD
 SG_ CBV_AWB_L_WPC_FD : 12|1@1+ (1,0) [0|0] ""  GW_BDC_FD,L_DHL_FD,L_DHRL_FD,L_DHRR_FD,L_DHR_FD,L_SAL_FD,L_TPMS_FD,L_UWB_BLE_MST_FD,L_UWB_BLE_SLV_FD,L_UWB_FL_FD,L_UWB_FRNK_FD,L_UWB_FR_FD,L_UWB_RL_FD,L_UWB_RR_FD,L_UWB_TRNK_FD
 SG_ CBV_PNIB_L_WPC_FD : 14|1@1+ (1,0) [0|0] ""  GW_BDC_FD,L_DHL_FD,L_DHRL_FD,L_DHRR_FD,L_DHR_FD,L_SAL_FD,L_TPMS_FD,L_UWB_BLE_MST_FD,L_UWB_BLE_SLV_FD,L_UWB_FL_FD,L_UWB_FRNK_FD,L_UWB_FR_FD,L_UWB_RL_FD,L_UWB_RR_FD,L_UWB_TRNK_FD
 SG_ NRR_L_WPC_FD : 16|8@1+ (1,0) [0|0] ""  GW_BDC_FD,L_DHL_FD,L_DHRL_FD,L_DHRR_FD,L_DHR_FD,L_SAL_FD,L_TPMS_FD,L_UWB_BLE_MST_FD,L_UWB_BLE_SLV_FD,L_UWB_FL_FD,L_UWB_FRNK_FD,L_UWB_FR_FD,L_UWB_RL_FD,L_UWB_RR_FD,L_UWB_TRNK_FD
 SG_ NM_State_L_WPC_FD : 24|8@1+ (1,0) [0|0] ""  GW_BDC_FD,L_DHL_FD,L_DHRL_FD,L_DHRR_FD,L_DHR_FD,L_SAL_FD,L_TPMS_FD,L_UWB_BLE_MST_FD,L_UWB_BLE_SLV_FD,L_UWB_FL_FD,L_UWB_FRNK_FD,L_UWB_FR_FD,L_UWB_RL_FD,L_UWB_RR_FD,L_UWB_TRNK_FD
 SG_ PNI_L_WPC_FD : 32|32@1+ (1,0) [0|0] ""  GW_BDC_FD,L_DHL_FD,L_DHRL_FD,L_DHRR_FD,L_DHR_FD,L_SAL_FD,L_TPMS_FD,L_UWB_BLE_MST_FD,L_UWB_BLE_SLV_FD,L_UWB_FL_FD,L_UWB_FRNK_FD,L_UWB_FR_FD,L_UWB_RL_FD,L_UWB_RR_FD,L_UWB_TRNK_FD
 SG_ PNI_L_WPC_FD_1 : 64|64@1+ (1,0) [0|0] ""  GW_BDC_FD,L_DHL_FD,L_DHRL_FD,L_DHRR_FD,L_DHR_FD,L_SAL_FD,L_TPMS_FD,L_UWB_BLE_MST_FD,L_UWB_BLE_SLV_FD,L_UWB_FL_FD,L_UWB_FRNK_FD,L_UWB_FR_FD,L_UWB_RL_FD,L_UWB_RR_FD,L_UWB_TRNK_FD
 SG_ PNI_L_WPC_FD_2 : 128|64@1+ (1,0) [0|0] ""  GW_BDC_FD,L_DHL_FD,L_DHRL_FD,L_DHRR_FD,L_DHR_FD,L_SAL_FD,L_TPMS_FD,L_UWB_BLE_MST_FD,L_UWB_BLE_SLV_FD,L_UWB_FL_FD,L_UWB_FRNK_FD,L_UWB_FR_FD,L_UWB_RL_FD,L_UWB_RR_FD,L_UWB_TRNK_FD
 SG_ PNI_L_WPC_FD_3 : 192|64@1+ (1,0) [0|0] ""  GW_BDC_FD,L_DHL_FD,L_DHRL_FD,L_DHRR_FD,L_DHR_FD,L_SAL_FD,L_TPMS_FD,L_UWB_BLE_MST_FD,L_UWB_BLE_SLV_FD,L_UWB_FL_FD,L_UWB_FRNK_FD,L_UWB_FR_FD,L_UWB_RL_FD,L_UWB_RR_FD,L_UWB_TRNK_FD

BO_ 2549874728 NM_L_TPMS_FD: 32 L_TPMS_FD
 SG_ SNI_L_TPMS_FD : 0|8@1+ (1,0) [0|0] ""  GW_BDC_FD,L_DHL_FD,L_DHRL_FD,L_DHRR_FD,L_DHR_FD,L_SAL_FD,L_UWB_BLE_MST_FD,L_UWB_BLE_SLV_FD,L_UWB_FL_FD,L_UWB_FRNK_FD,L_UWB_FR_FD,L_UWB_RL_FD,L_UWB_RR_FD,L_UWB_TRNK_FD,L_WPC_FD
 SG_ CBV_RMR_L_TPMS_FD : 8|1@1+ (1,0) [0|0] ""  GW_BDC_FD,L_DHL_FD,L_DHRL_FD,L_DHRR_FD,L_DHR_FD,L_SAL_FD,L_UWB_BLE_MST_FD,L_UWB_BLE_SLV_FD,L_UWB_FL_FD,L_UWB_FRNK_FD,L_UWB_FR_FD,L_UWB_RL_FD,L_UWB_RR_FD,L_UWB_TRNK_FD,L_WPC_FD
 SG_ CBV_NMCoID_L_TPMS_FD : 9|2@1+ (1,0) [0|0] ""  GW_BDC_FD,L_DHL_FD,L_DHRL_FD,L_DHRR_FD,L_DHR_FD,L_SAL_FD,L_UWB_BLE_MST_FD,L_UWB_BLE_SLV_FD,L_UWB_FL_FD,L_UWB_FRNK_FD,L_UWB_FR_FD,L_UWB_RL_FD,L_UWB_RR_FD,L_UWB_TRNK_FD,L_WPC_FD
 SG_ CBV_NMCoSRB_L_TPMS_FD : 11|1@1+ (1,0) [0|0] ""  GW_BDC_FD,L_DHL_FD,L_DHRL_FD,L_DHRR_FD,L_DHR_FD,L_SAL_FD,L_UWB_BLE_MST_FD,L_UWB_BLE_SLV_FD,L_UWB_FL_FD,L_UWB_FRNK_FD,L_UWB_FR_FD,L_UWB_RL_FD,L_UWB_RR_FD,L_UWB_TRNK_FD,L_WPC_FD
 SG_ CBV_AWB_L_TPMS_FD : 12|1@1+ (1,0) [0|0] ""  GW_BDC_FD,L_DHL_FD,L_DHRL_FD,L_DHRR_FD,L_DHR_FD,L_SAL_FD,L_UWB_BLE_MST_FD,L_UWB_BLE_SLV_FD,L_UWB_FL_FD,L_UWB_FRNK_FD,L_UWB_FR_FD,L_UWB_RL_FD,L_UWB_RR_FD,L_UWB_TRNK_FD,L_WPC_FD
 SG_ CBV_PNIB_L_TPMS_FD : 14|1@1+ (1,0) [0|0] ""  GW_BDC_FD,L_DHL_FD,L_DHRL_FD,L_DHRR_FD,L_DHR_FD,L_SAL_FD,L_UWB_BLE_MST_FD,L_UWB_BLE_SLV_FD,L_UWB_FL_FD,L_UWB_FRNK_FD,L_UWB_FR_FD,L_UWB_RL_FD,L_UWB_RR_FD,L_UWB_TRNK_FD,L_WPC_FD
 SG_ NRR_L_TPMS_FD : 16|8@1+ (1,0) [0|0] ""  GW_BDC_FD,L_DHL_FD,L_DHRL_FD,L_DHRR_FD,L_DHR_FD,L_SAL_FD,L_UWB_BLE_MST_FD,L_UWB_BLE_SLV_FD,L_UWB_FL_FD,L_UWB_FRNK_FD,L_UWB_FR_FD,L_UWB_RL_FD,L_UWB_RR_FD,L_UWB_TRNK_FD,L_WPC_FD
 SG_ NM_State_L_TPMS_FD : 24|8@1+ (1,0) [0|0] ""  GW_BDC_FD,L_DHL_FD,L_DHRL_FD,L_DHRR_FD,L_DHR_FD,L_SAL_FD,L_UWB_BLE_MST_FD,L_UWB_BLE_SLV_FD,L_UWB_FL_FD,L_UWB_FRNK_FD,L_UWB_FR_FD,L_UWB_RL_FD,L_UWB_RR_FD,L_UWB_TRNK_FD,L_WPC_FD
 SG_ PNI_L_TPMS_FD : 32|32@1+ (1,0) [0|0] ""  GW_BDC_FD,L_DHL_FD,L_DHRL_FD,L_DHRR_FD,L_DHR_FD,L_SAL_FD,L_UWB_BLE_MST_FD,L_UWB_BLE_SLV_FD,L_UWB_FL_FD,L_UWB_FRNK_FD,L_UWB_FR_FD,L_UWB_RL_FD,L_UWB_RR_FD,L_UWB_TRNK_FD,L_WPC_FD
 SG_ PNI_L_TPMS_FD_1 : 64|64@1+ (1,0) [0|0] ""  GW_BDC_FD,L_DHL_FD,L_DHRL_FD,L_DHRR_FD,L_DHR_FD,L_SAL_FD,L_UWB_BLE_MST_FD,L_UWB_BLE_SLV_FD,L_UWB_FL_FD,L_UWB_FRNK_FD,L_UWB_FR_FD,L_UWB_RL_FD,L_UWB_RR_FD,L_UWB_TRNK_FD,L_WPC_FD
 SG_ PNI_L_TPMS_FD_2 : 128|64@1+ (1,0) [0|0] ""  GW_BDC_FD,L_DHL_FD,L_DHRL_FD,L_DHRR_FD,L_DHR_FD,L_SAL_FD,L_UWB_BLE_MST_FD,L_UWB_BLE_SLV_FD,L_UWB_FL_FD,L_UWB_FRNK_FD,L_UWB_FR_FD,L_UWB_RL_FD,L_UWB_RR_FD,L_UWB_TRNK_FD,L_WPC_FD
 SG_ PNI_L_TPMS_FD_3 : 192|64@1+ (1,0) [0|0] ""  GW_BDC_FD,L_DHL_FD,L_DHRL_FD,L_DHRR_FD,L_DHR_FD,L_SAL_FD,L_UWB_BLE_MST_FD,L_UWB_BLE_SLV_FD,L_UWB_FL_FD,L_UWB_FRNK_FD,L_UWB_FR_FD,L_UWB_RL_FD,L_UWB_RR_FD,L_UWB_TRNK_FD,L_WPC_FD

BO_ 2549874730 NM_L_DHL_FD: 32 L_DHL_FD
 SG_ SNI_L_DHL_FD : 0|8@1+ (1,0) [0|0] ""  GW_BDC_FD,L_DHRL_FD,L_DHRR_FD,L_DHR_FD,L_SAL_FD,L_TPMS_FD,L_UWB_BLE_MST_FD,L_UWB_BLE_SLV_FD,L_UWB_FL_FD,L_UWB_FRNK_FD,L_UWB_FR_FD,L_UWB_RL_FD,L_UWB_RR_FD,L_UWB_TRNK_FD,L_WPC_FD
 SG_ CBV_RMR_L_DHL_FD : 8|1@1+ (1,0) [0|0] ""  GW_BDC_FD,L_DHRL_FD,L_DHRR_FD,L_DHR_FD,L_SAL_FD,L_TPMS_FD,L_UWB_BLE_MST_FD,L_UWB_BLE_SLV_FD,L_UWB_FL_FD,L_UWB_FRNK_FD,L_UWB_FR_FD,L_UWB_RL_FD,L_UWB_RR_FD,L_UWB_TRNK_FD,L_WPC_FD
 SG_ CBV_NMCoID_L_DHL_FD : 9|2@1+ (1,0) [0|0] ""  GW_BDC_FD,L_DHRL_FD,L_DHRR_FD,L_DHR_FD,L_SAL_FD,L_TPMS_FD,L_UWB_BLE_MST_FD,L_UWB_BLE_SLV_FD,L_UWB_FL_FD,L_UWB_FRNK_FD,L_UWB_FR_FD,L_UWB_RL_FD,L_UWB_RR_FD,L_UWB_TRNK_FD,L_WPC_FD
 SG_ CBV_NMCoSRB_L_DHL_FD : 11|1@1+ (1,0) [0|0] ""  GW_BDC_FD,L_DHRL_FD,L_DHRR_FD,L_DHR_FD,L_SAL_FD,L_TPMS_FD,L_UWB_BLE_MST_FD,L_UWB_BLE_SLV_FD,L_UWB_FL_FD,L_UWB_FRNK_FD,L_UWB_FR_FD,L_UWB_RL_FD,L_UWB_RR_FD,L_UWB_TRNK_FD,L_WPC_FD
 SG_ CBV_AWB_L_DHL_FD : 12|1@1+ (1,0) [0|0] ""  GW_BDC_FD,L_DHRL_FD,L_DHRR_FD,L_DHR_FD,L_SAL_FD,L_TPMS_FD,L_UWB_BLE_MST_FD,L_UWB_BLE_SLV_FD,L_UWB_FL_FD,L_UWB_FRNK_FD,L_UWB_FR_FD,L_UWB_RL_FD,L_UWB_RR_FD,L_UWB_TRNK_FD,L_WPC_FD
 SG_ CBV_PNIB_L_DHL_FD : 14|1@1+ (1,0) [0|0] ""  GW_BDC_FD,L_DHRL_FD,L_DHRR_FD,L_DHR_FD,L_SAL_FD,L_TPMS_FD,L_UWB_BLE_MST_FD,L_UWB_BLE_SLV_FD,L_UWB_FL_FD,L_UWB_FRNK_FD,L_UWB_FR_FD,L_UWB_RL_FD,L_UWB_RR_FD,L_UWB_TRNK_FD,L_WPC_FD
 SG_ NRR_L_DHL_FD : 16|8@1+ (1,0) [0|0] ""  GW_BDC_FD,L_DHRL_FD,L_DHRR_FD,L_DHR_FD,L_SAL_FD,L_TPMS_FD,L_UWB_BLE_MST_FD,L_UWB_BLE_SLV_FD,L_UWB_FL_FD,L_UWB_FRNK_FD,L_UWB_FR_FD,L_UWB_RL_FD,L_UWB_RR_FD,L_UWB_TRNK_FD,L_WPC_FD
 SG_ NM_State_L_DHL_FD : 24|8@1+ (1,0) [0|0] ""  GW_BDC_FD,L_DHRL_FD,L_DHRR_FD,L_DHR_FD,L_SAL_FD,L_TPMS_FD,L_UWB_BLE_MST_FD,L_UWB_BLE_SLV_FD,L_UWB_FL_FD,L_UWB_FRNK_FD,L_UWB_FR_FD,L_UWB_RL_FD,L_UWB_RR_FD,L_UWB_TRNK_FD,L_WPC_FD
 SG_ PNI_L_DHL_FD : 32|32@1+ (1,0) [0|0] ""  GW_BDC_FD,L_DHRL_FD,L_DHRR_FD,L_DHR_FD,L_SAL_FD,L_TPMS_FD,L_UWB_BLE_MST_FD,L_UWB_BLE_SLV_FD,L_UWB_FL_FD,L_UWB_FRNK_FD,L_UWB_FR_FD,L_UWB_RL_FD,L_UWB_RR_FD,L_UWB_TRNK_FD,L_WPC_FD
 SG_ PNI_L_DHL_FD_1 : 64|64@1+ (1,0) [0|0] ""  GW_BDC_FD,L_DHRL_FD,L_DHRR_FD,L_DHR_FD,L_SAL_FD,L_TPMS_FD,L_UWB_BLE_MST_FD,L_UWB_BLE_SLV_FD,L_UWB_FL_FD,L_UWB_FRNK_FD,L_UWB_FR_FD,L_UWB_RL_FD,L_UWB_RR_FD,L_UWB_TRNK_FD,L_WPC_FD
 SG_ PNI_L_DHL_FD_2 : 128|64@1+ (1,0) [0|0] ""  GW_BDC_FD,L_DHRL_FD,L_DHRR_FD,L_DHR_FD,L_SAL_FD,L_TPMS_FD,L_UWB_BLE_MST_FD,L_UWB_BLE_SLV_FD,L_UWB_FL_FD,L_UWB_FRNK_FD,L_UWB_FR_FD,L_UWB_RL_FD,L_UWB_RR_FD,L_UWB_TRNK_FD,L_WPC_FD
 SG_ PNI_L_DHL_FD_3 : 192|64@1+ (1,0) [0|0] ""  GW_BDC_FD,L_DHRL_FD,L_DHRR_FD,L_DHR_FD,L_SAL_FD,L_TPMS_FD,L_UWB_BLE_MST_FD,L_UWB_BLE_SLV_FD,L_UWB_FL_FD,L_UWB_FRNK_FD,L_UWB_FR_FD,L_UWB_RL_FD,L_UWB_RR_FD,L_UWB_TRNK_FD,L_WPC_FD

BO_ 2549874731 NM_L_DHR_FD: 32 L_DHR_FD
 SG_ SNI_L_DHR_FD : 0|8@1+ (1,0) [0|0] ""  GW_BDC_FD,L_DHL_FD,L_DHRL_FD,L_DHRR_FD,L_SAL_FD,L_TPMS_FD,L_UWB_BLE_MST_FD,L_UWB_BLE_SLV_FD,L_UWB_FL_FD,L_UWB_FRNK_FD,L_UWB_FR_FD,L_UWB_RL_FD,L_UWB_RR_FD,L_UWB_TRNK_FD,L_WPC_FD
 SG_ CBV_RMR_L_DHR_FD : 8|1@1+ (1,0) [0|0] ""  GW_BDC_FD,L_DHL_FD,L_DHRL_FD,L_DHRR_FD,L_SAL_FD,L_TPMS_FD,L_UWB_BLE_MST_FD,L_UWB_BLE_SLV_FD,L_UWB_FL_FD,L_UWB_FRNK_FD,L_UWB_FR_FD,L_UWB_RL_FD,L_UWB_RR_FD,L_UWB_TRNK_FD,L_WPC_FD
 SG_ CBV_NMCoID_L_DHR_FD : 9|2@1+ (1,0) [0|0] ""  GW_BDC_FD,L_DHL_FD,L_DHRL_FD,L_DHRR_FD,L_SAL_FD,L_TPMS_FD,L_UWB_BLE_MST_FD,L_UWB_BLE_SLV_FD,L_UWB_FL_FD,L_UWB_FRNK_FD,L_UWB_FR_FD,L_UWB_RL_FD,L_UWB_RR_FD,L_UWB_TRNK_FD,L_WPC_FD
 SG_ CBV_NMCoSRB_L_DHR_FD : 11|1@1+ (1,0) [0|0] ""  GW_BDC_FD,L_DHL_FD,L_DHRL_FD,L_DHRR_FD,L_SAL_FD,L_TPMS_FD,L_UWB_BLE_MST_FD,L_UWB_BLE_SLV_FD,L_UWB_FL_FD,L_UWB_FRNK_FD,L_UWB_FR_FD,L_UWB_RL_FD,L_UWB_RR_FD,L_UWB_TRNK_FD,L_WPC_FD
 SG_ CBV_AWB_L_DHR_FD : 12|1@1+ (1,0) [0|0] ""  GW_BDC_FD,L_DHL_FD,L_DHRL_FD,L_DHRR_FD,L_SAL_FD,L_TPMS_FD,L_UWB_BLE_MST_FD,L_UWB_BLE_SLV_FD,L_UWB_FL_FD,L_UWB_FRNK_FD,L_UWB_FR_FD,L_UWB_RL_FD,L_UWB_RR_FD,L_UWB_TRNK_FD,L_WPC_FD
 SG_ CBV_PNIB_L_DHR_FD : 14|1@1+ (1,0) [0|0] ""  GW_BDC_FD,L_DHL_FD,L_DHRL_FD,L_DHRR_FD,L_SAL_FD,L_TPMS_FD,L_UWB_BLE_MST_FD,L_UWB_BLE_SLV_FD,L_UWB_FL_FD,L_UWB_FRNK_FD,L_UWB_FR_FD,L_UWB_RL_FD,L_UWB_RR_FD,L_UWB_TRNK_FD,L_WPC_FD
 SG_ NRR_L_DHR_FD : 16|8@1+ (1,0) [0|0] ""  GW_BDC_FD,L_DHL_FD,L_DHRL_FD,L_DHRR_FD,L_SAL_FD,L_TPMS_FD,L_UWB_BLE_MST_FD,L_UWB_BLE_SLV_FD,L_UWB_FL_FD,L_UWB_FRNK_FD,L_UWB_FR_FD,L_UWB_RL_FD,L_UWB_RR_FD,L_UWB_TRNK_FD,L_WPC_FD
 SG_ NM_State_L_DHR_FD : 24|8@1+ (1,0) [0|0] ""  GW_BDC_FD,L_DHL_FD,L_DHRL_FD,L_DHRR_FD,L_SAL_FD,L_TPMS_FD,L_UWB_BLE_MST_FD,L_UWB_BLE_SLV_FD,L_UWB_FL_FD,L_UWB_FRNK_FD,L_UWB_FR_FD,L_UWB_RL_FD,L_UWB_RR_FD,L_UWB_TRNK_FD,L_WPC_FD
 SG_ PNI_L_DHR_FD : 32|32@1+ (1,0) [0|0] ""  GW_BDC_FD,L_DHL_FD,L_DHRL_FD,L_DHRR_FD,L_SAL_FD,L_TPMS_FD,L_UWB_BLE_MST_FD,L_UWB_BLE_SLV_FD,L_UWB_FL_FD,L_UWB_FRNK_FD,L_UWB_FR_FD,L_UWB_RL_FD,L_UWB_RR_FD,L_UWB_TRNK_FD,L_WPC_FD
 SG_ PNI_L_DHR_FD_1 : 64|64@1+ (1,0) [0|0] ""  GW_BDC_FD,L_DHL_FD,L_DHRL_FD,L_DHRR_FD,L_SAL_FD,L_TPMS_FD,L_UWB_BLE_MST_FD,L_UWB_BLE_SLV_FD,L_UWB_FL_FD,L_UWB_FRNK_FD,L_UWB_FR_FD,L_UWB_RL_FD,L_UWB_RR_FD,L_UWB_TRNK_FD,L_WPC_FD
 SG_ PNI_L_DHR_FD_2 : 128|64@1+ (1,0) [0|0] ""  GW_BDC_FD,L_DHL_FD,L_DHRL_FD,L_DHRR_FD,L_SAL_FD,L_TPMS_FD,L_UWB_BLE_MST_FD,L_UWB_BLE_SLV_FD,L_UWB_FL_FD,L_UWB_FRNK_FD,L_UWB_FR_FD,L_UWB_RL_FD,L_UWB_RR_FD,L_UWB_TRNK_FD,L_WPC_FD
 SG_ PNI_L_DHR_FD_3 : 192|64@1+ (1,0) [0|0] ""  GW_BDC_FD,L_DHL_FD,L_DHRL_FD,L_DHRR_FD,L_SAL_FD,L_TPMS_FD,L_UWB_BLE_MST_FD,L_UWB_BLE_SLV_FD,L_UWB_FL_FD,L_UWB_FRNK_FD,L_UWB_FR_FD,L_UWB_RL_FD,L_UWB_RR_FD,L_UWB_TRNK_FD,L_WPC_FD

CM_ BO_ 980 "[PE] Periodic and On Event";
CM_ SG_ 980 BDC_FD_Crc5Val "BDC_FD_CyclicRedundancyCheck5Value";
CM_ SG_ 980 BDC_FD_AlvCnt5Val "BDC_FD_AliveCounter5Value";
CM_ SG_ 980 Lamp_LftTrnLmpCmdSta "Lamp_LeftTurnLampCmdState";
CM_ SG_ 980 Lamp_RtTrnLmpCmdSta "Lamp_RightTurnLampCmdState";
CM_ SG_ 980 Lamp_LftTrnLmpCmd "Lamp_LeftTrunLampCommand";
CM_ SG_ 980 Lamp_RtTrnLmpCmd "Lamp_RightTurnLampCommand";
CM_ SG_ 980 Lamp_TrnLmpMode "Lamp_TurnLampMode";
CM_ SG_ 980 Lamp_HzrdSwIND "Lamp_HazardSwitchIndicator";
CM_ SG_ 980 Lamp_HiPrioHzrdReq_Copy_0 "Lamp_HighPriorityHazardRequest ##2G##BCM - BCMmsg19 - C_HazardFromBCMHigh";
CM_ SG_ 980 Lamp_LoPrioHzrdReq_Copy_0 "Lamp_LowPriorityHazardStatus ##2G##BCM - BCMmsg19 - C_HazardfromBCMLow";
CM_ SG_ 980 Lamp_ExtrnlTailLmpOnReq_Copy_0 "Lamp_ExternalTailLampOnRequest ##2G##BCM - BCMmsg19 - C_ExtTailOn";
CM_ SG_ 980 Lamp_HdLmpLoOnReq_Copy_0 "Lamp_HeadLampLowOnRequest ##2G##BCM - BCMmsg19 - C_HLpLowOn";
CM_ SG_ 980 Lamp_HdLmpHiOnReq_Copy_0 "Lamp_HeadLampHighOnRequest ##2G##BCM - BCMmsg19 - C_HLpHighOn";
CM_ SG_ 980 Lamp_FrFogLmpOnReq_Copy_0 "Lamp_FrontFogLampOnRequest ##2G##BCM - BCMmsg19 - C_FrtFogOn";
CM_ SG_ 980 Lamp_RrFogLmpOnReq_Copy_0 "Lamp_RearFogLampOnRequest ##2G##BCM - BCMmsg19 - C_RearFogOn";
CM_ SG_ 980 Lamp_StcBendingLmpLftOnReq_Copy_ "Lamp_StaticBendingLampLeftOnRequest ##2G##BCM - BCMmsg19 - C_StaticBendLhOn";
CM_ SG_ 980 Lamp_StcBendingLmpRtOnReq_Copy_0 "Lamp_StaticBendingLampRightOnRequest ##2G##BCM - BCMmsg19 - C_StaticBendRhOn";
CM_ SG_ 980 Lamp_CornerLmpLftOnReq_Copy_0 "Lamp_CorneringLampLeftOnRequest ##2G##BCM - BCMmsg19 - C_CorneringLpLhOn";
CM_ SG_ 980 Lamp_CornerLmpRtOnReq_Copy_0 "Lamp_CorneringLampRightOnRequest ##2G##BCM - BCMmsg19 - C_CorneringLpRhOn";
CM_ SG_ 980 Lamp_HbaCtrlModTyp_Copy_0 "Lamp_HbaControlModeType ##2G##BCM - BCMmsg22 - C_HBAControlMode";
CM_ SG_ 980 Lamp_IFSCtrlModTyp_Copy_0 "Lamp_IFSControlModeType ##2G##BCM - BCMmsg22 - C_IFSControlMode";
CM_ SG_ 980 Lamp_HdLmpWlcmCmd_Copy_0 "Lamp_HeadLampWelcomeOnCommand ##2G##BCM - BCMmsg19 - C_HLpWelcomeCmd";
CM_ SG_ 980 Lamp_PuddleLmpOnReq_Copy_0 "Lamp_PuddleLampOnRequest ##2G##BCM - BCMmsg19 - C_PuddleLpOn";
CM_ SG_ 980 Lamp_IntTailLmpOnReq_Copy_0 "Lamp_InternalTailLampOnRequest ##2G##BCM - BCMmsg19 - C_IntTailOn";
CM_ SG_ 980 Lamp_AvTailLmpSta_Copy_0 "Lamp_AvTailLampStatus ##2G##BCM - BCMmsg18 - C_AvTail";
CM_ SG_ 980 Lamp_AutoLtSnsrNightSta_Copy_0 "Lamp_AutoLightSensorNightStatus ##2G##BCM - BCMmsg24 - C_AutolightValue";
CM_ SG_ 980 Lamp_AutoLtSnsrHorVal_Copy_0 "Lamp_AutoLightSensorHorValue ##2G##BCM - BCMmsg24 - C_AutolightSensorHorState";
CM_ BO_ 2683310247 "[EW] On Event and On Write";
CM_ SG_ 2683310247 ROA_Dev_07 "Development Mode Data";
CM_ BO_ 2683310246 "[EW] On Event and On Write";
CM_ SG_ 2683310246 ROA_Dev_06 "Development Mode Data";
CM_ BO_ 2683310245 "[EW] On Event and On Write";
CM_ SG_ 2683310245 ROA_Dev_05 "Development Mode Data";
CM_ BO_ 2683310244 "[EW] On Event and On Write";
CM_ SG_ 2683310244 ROA_Dev_04 "Development Mode Data";
CM_ BO_ 2683310243 "[EW] On Event and On Write";
CM_ SG_ 2683310243 ROA_Dev_03 "Development Mode Data";
CM_ BO_ 2683310242 "[EW] On Event and On Write";
CM_ SG_ 2683310242 ROA_Dev_02 "Development Mode Data";
CM_ BO_ 2683310241 "[EW] On Event and On Write";
CM_ SG_ 2683310241 ROA_Dev_01 "Development Mode Data";
CM_ BO_ 2281701600 "[PE] Periodic and On Event";
CM_ SG_ 2281701600 L_UWB_FRNK_FD_Crc10Val "L_UWB_FRNK_FD_CyclicRedundancyCheck10Value";
CM_ SG_ 2281701600 UWB_FRNK_SW_MCU_Ver_Major "UWB FRNK SW MCU Version Major";
CM_ SG_ 2281701600 UWB_FRNK_SW_MCU_Ver_Minor "UWB FRNK SW MCU Version Minor";
CM_ SG_ 2281701600 UWB_FRNK_SW_IC_Ver_Major "UWB FRNK SW IC Version Major";
CM_ SG_ 2281701600 UWB_FRNK_SW_IC_Ver_Minor "UWB FRNK SW IC Version Minor";
CM_ SG_ 2281701600 UWB_FRNK_DTC "UWB FRNK DTC Data";
CM_ SG_ 2281701600 L_UWB_FRNK_FD_AlvCnt10Val "L_UWB_FRNK_FD_AliveCounter10Value";
CM_ SG_ 2281701600 UWB_FRNK_Status1 "UWB_FRNK Processing Status 1";
CM_ SG_ 2281701600 UWB_FRNK_Status2 "UWB_FRNK Processing Status 2";
CM_ SG_ 2281701600 UWB_FRNK_Status3 "UWB_FRNK Processing Status 3";
CM_ SG_ 2281701600 UWB_FRNK_Status4 "UWB_FRNK Processing Status 4";
CM_ SG_ 2281701600 UWB_FRNK_Status5 "UWB_FRNK Processing Status 5";
CM_ SG_ 2281701600 UWB_FRNK_Status6 "UWB_FRNK Processing Status 6";
CM_ SG_ 2281701600 UWB_FRNK_Status7 "UWB_FRNK Processing Status 7";
CM_ SG_ 2281701600 UWB_FRNK_Status8 "UWB_FRNK Processing Status 8";
CM_ SG_ 2281701600 UWB_FRNK_Status9 "UWB_FRNK Processing Status 9";
CM_ SG_ 2281701600 UWB_FRNK_Status10 "UWB_FRNK Processing Status 10";
CM_ SG_ 2281701600 UWB_FRNK_Status11 "UWB_FRNK Processing Status 11";
CM_ SG_ 2281701600 UWB_FRNK_Status12 "UWB_FRNK Processing Status 12";
CM_ SG_ 2281701600 UWB_FRNK_Status13 "UWB_FRNK Processing Status 13";
CM_ SG_ 2281701600 UWB_FRNK_Status14 "UWB_FRNK Processing Status 14";
CM_ SG_ 2281701600 UWB_FRNK_Status15 "UWB_FRNK Processing Status 15";
CM_ SG_ 2281701600 UWB_FRNK_Status16 "UWB_FRNK Processing Status 16";
CM_ SG_ 2281701600 UWB_FRNK_HW_Ver_Major "UWB FRNK HW Version Major";
CM_ SG_ 2281701600 UWB_FRNK_HW_Ver_Minor "UWB FRNK HW Version Minor";
CM_ BO_ 2683310240 "[EW] On Event and On Write";
CM_ SG_ 2683310240 ROA_Dev_00 "Development Mode Data";
CM_ BO_ 2683310250 "[EW] On Event and On Write";
CM_ SG_ 2683310250 ROA_Dev_10 "Development Mode Data";
CM_ BO_ 2683310249 "[EW] On Event and On Write";
CM_ SG_ 2683310249 ROA_Dev_09 "Development Mode Data";
CM_ BO_ 2683310248 "[EW] On Event and On Write";
CM_ SG_ 2683310248 ROA_Dev_08 "Development Mode Data";
CM_ SG_ 2549874733 SNI_L_DHRR_FD "ASR NM Source Node Identifier";
CM_ SG_ 2549874733 CBV_RMR_L_DHRR_FD "ASR NM Control Bit Vector - Repeat Message Request";
CM_ SG_ 2549874733 CBV_NMCoID_L_DHRR_FD "ASR NM Control Bit Vector - ASR NM Coordinator ID";
CM_ SG_ 2549874733 CBV_NMCoSRB_L_DHRR_FD "ASR NM Control Bit Vector - ASR NM Coordinator Sleep Ready Bit";
CM_ SG_ 2549874733 CBV_AWB_L_DHRR_FD "ASR NM Control Bit Vector - Active Wakeup Bit";
CM_ SG_ 2549874733 CBV_PNIB_L_DHRR_FD "ASR NM Control Bit Vector - PN Info Bit";
CM_ SG_ 2549874733 NRR_L_DHRR_FD "ASR NM Network Request Reason";
CM_ SG_ 2549874733 NM_State_L_DHRR_FD "ASR NM State_Current State_Previous State";
CM_ SG_ 2549874733 PNI_L_DHRR_FD "ASR NM Partial Networking Information";
CM_ SG_ 2549874733 PNI_L_DHRR_FD_1 "ASR NM Partial Networking Information";
CM_ SG_ 2549874733 PNI_L_DHRR_FD_2 "ASR NM Partial Networking Information";
CM_ SG_ 2549874733 PNI_L_DHRR_FD_3 "ASR NM Partial Networking Information";
CM_ SG_ 2549874720 SNI_L_UWB_BLE_MST_FD "ASR NM Source Node Identifier";
CM_ SG_ 2549874720 CBV_RMR_L_UWB_BLE_MST_FD "ASR NM Control Bit Vector - Repeat Message Request";
CM_ SG_ 2549874720 CBV_NMCoID_L_UWB_BLE_MST_FD "ASR NM Control Bit Vector - ASR NM Coordinator ID";
CM_ SG_ 2549874720 CBV_NMCoSRB_L_UWB_BLE_MST_FD "ASR NM Control Bit Vector - ASR NM Coordinator Sleep Ready Bit";
CM_ SG_ 2549874720 CBV_AWB_L_UWB_BLE_MST_FD "ASR NM Control Bit Vector - Active Wakeup Bit";
CM_ SG_ 2549874720 CBV_PNIB_L_UWB_BLE_MST_FD "ASR NM Control Bit Vector - PN Info Bit";
CM_ SG_ 2549874720 NRR_L_UWB_BLE_MST_FD "ASR NM Network Request Reason";
CM_ SG_ 2549874720 NM_State_L_UWB_BLE_MST_FD "ASR NM State_Current State_Previous State";
CM_ SG_ 2549874720 PNI_L_UWB_BLE_MST_FD "ASR NM Partial Networking Information";
CM_ SG_ 2549874720 PNI_L_UWB_BLE_MST_FD_1 "ASR NM Partial Networking Information";
CM_ SG_ 2549874720 PNI_L_UWB_BLE_MST_FD_2 "ASR NM Partial Networking Information";
CM_ SG_ 2549874720 PNI_L_UWB_BLE_MST_FD_3 "ASR NM Partial Networking Information";
CM_ SG_ 2549874726 SNI_L_UWB_RR_FD "ASR NM Source Node Identifier";
CM_ SG_ 2549874726 CBV_RMR_L_UWB_RR_FD "ASR NM Control Bit Vector - Repeat Message Request";
CM_ SG_ 2549874726 CBV_NMCoID_L_UWB_RR_FD "ASR NM Control Bit Vector - ASR NM Coordinator ID";
CM_ SG_ 2549874726 CBV_NMCoSRB_L_UWB_RR_FD "ASR NM Control Bit Vector - ASR NM Coordinator Sleep Ready Bit";
CM_ SG_ 2549874726 CBV_AWB_L_UWB_RR_FD "ASR NM Control Bit Vector - Active Wakeup Bit";
CM_ SG_ 2549874726 CBV_PNIB_L_UWB_RR_FD "ASR NM Control Bit Vector - PN Info Bit";
CM_ SG_ 2549874726 NRR_L_UWB_RR_FD "ASR NM Network Request Reason";
CM_ SG_ 2549874726 NM_State_L_UWB_RR_FD "ASR NM State_Current State_Previous State";
CM_ SG_ 2549874726 PNI_L_UWB_RR_FD "ASR NM Partial Networking Information";
CM_ SG_ 2549874726 PNI_L_UWB_RR_FD_1 "ASR NM Partial Networking Information";
CM_ SG_ 2549874726 PNI_L_UWB_RR_FD_2 "ASR NM Partial Networking Information";
CM_ SG_ 2549874726 PNI_L_UWB_RR_FD_3 "ASR NM Partial Networking Information";
CM_ SG_ 2549874721 SNI_L_UWB_BLE_SLV_FD "ASR NM Source Node Identifier";
CM_ SG_ 2549874721 CBV_RMR_L_UWB_BLE_SLV_FD "ASR NM Control Bit Vector - Repeat Message Request";
CM_ SG_ 2549874721 CBV_NMCoID_L_UWB_BLE_SLV_FD "ASR NM Control Bit Vector - ASR NM Coordinator ID";
CM_ SG_ 2549874721 CBV_NMCoSRB_L_UWB_BLE_SLV_FD "ASR NM Control Bit Vector - ASR NM Coordinator Sleep Ready Bit";
CM_ SG_ 2549874721 CBV_AWB_L_UWB_BLE_SLV_FD "ASR NM Control Bit Vector - Active Wakeup Bit";
CM_ SG_ 2549874721 CBV_PNIB_L_UWB_BLE_SLV_FD "ASR NM Control Bit Vector - PN Info Bit";
CM_ SG_ 2549874721 NRR_L_UWB_BLE_SLV_FD "ASR NM Network Request Reason";
CM_ SG_ 2549874721 NM_State_L_UWB_BLE_SLV_FD "ASR NM State_Current State_Previous State";
CM_ SG_ 2549874721 PNI_L_UWB_BLE_SLV_FD "ASR NM Partial Networking Information";
CM_ SG_ 2549874721 PNI_L_UWB_BLE_SLV_FD_1 "ASR NM Partial Networking Information";
CM_ SG_ 2549874721 PNI_L_UWB_BLE_SLV_FD_2 "ASR NM Partial Networking Information";
CM_ SG_ 2549874721 PNI_L_UWB_BLE_SLV_FD_3 "ASR NM Partial Networking Information";
CM_ SG_ 2549874723 SNI_L_UWB_FR_FD "ASR NM Source Node Identifier";
CM_ SG_ 2549874723 CBV_RMR_L_UWB_FR_FD "ASR NM Control Bit Vector - Repeat Message Request";
CM_ SG_ 2549874723 CBV_NMCoID_L_UWB_FR_FD "ASR NM Control Bit Vector - ASR NM Coordinator ID";
CM_ SG_ 2549874723 CBV_NMCoSRB_L_UWB_FR_FD "ASR NM Control Bit Vector - ASR NM Coordinator Sleep Ready Bit";
CM_ SG_ 2549874723 CBV_AWB_L_UWB_FR_FD "ASR NM Control Bit Vector - Active Wakeup Bit";
CM_ SG_ 2549874723 CBV_PNIB_L_UWB_FR_FD "ASR NM Control Bit Vector - PN Info Bit";
CM_ SG_ 2549874723 NRR_L_UWB_FR_FD "ASR NM Network Request Reason";
CM_ SG_ 2549874723 NM_State_L_UWB_FR_FD "ASR NM State_Current State_Previous State";
CM_ SG_ 2549874723 PNI_L_UWB_FR_FD "ASR NM Partial Networking Information";
CM_ SG_ 2549874723 PNI_L_UWB_FR_FD_1 "ASR NM Partial Networking Information";
CM_ SG_ 2549874723 PNI_L_UWB_FR_FD_2 "ASR NM Partial Networking Information";
CM_ SG_ 2549874723 PNI_L_UWB_FR_FD_3 "ASR NM Partial Networking Information";
CM_ SG_ 2549874732 SNI_L_DHRL_FD "ASR NM Source Node Identifier";
CM_ SG_ 2549874732 CBV_RMR_L_DHRL_FD "ASR NM Control Bit Vector - Repeat Message Request";
CM_ SG_ 2549874732 CBV_NMCoID_L_DHRL_FD "ASR NM Control Bit Vector - ASR NM Coordinator ID";
CM_ SG_ 2549874732 CBV_NMCoSRB_L_DHRL_FD "ASR NM Control Bit Vector - ASR NM Coordinator Sleep Ready Bit";
CM_ SG_ 2549874732 CBV_AWB_L_DHRL_FD "ASR NM Control Bit Vector - Active Wakeup Bit";
CM_ SG_ 2549874732 CBV_PNIB_L_DHRL_FD "ASR NM Control Bit Vector - PN Info Bit";
CM_ SG_ 2549874732 NRR_L_DHRL_FD "ASR NM Network Request Reason";
CM_ SG_ 2549874732 NM_State_L_DHRL_FD "ASR NM State_Current State_Previous State";
CM_ SG_ 2549874732 PNI_L_DHRL_FD "ASR NM Partial Networking Information";
CM_ SG_ 2549874732 PNI_L_DHRL_FD_1 "ASR NM Partial Networking Information";
CM_ SG_ 2549874732 PNI_L_DHRL_FD_2 "ASR NM Partial Networking Information";
CM_ SG_ 2549874732 PNI_L_DHRL_FD_3 "ASR NM Partial Networking Information";
CM_ SG_ 2549874727 SNI_L_UWB_TRNK_FD "ASR NM Source Node Identifier";
CM_ SG_ 2549874727 CBV_RMR_L_UWB_TRNK_FD "ASR NM Control Bit Vector - Repeat Message Request";
CM_ SG_ 2549874727 CBV_NMCoID_L_UWB_TRNK_FD "ASR NM Control Bit Vector - ASR NM Coordinator ID";
CM_ SG_ 2549874727 CBV_NMCoSRB_L_UWB_TRNK_FD "ASR NM Control Bit Vector - ASR NM Coordinator Sleep Ready Bit";
CM_ SG_ 2549874727 CBV_AWB_L_UWB_TRNK_FD "ASR NM Control Bit Vector - Active Wakeup Bit";
CM_ SG_ 2549874727 CBV_PNIB_L_UWB_TRNK_FD "ASR NM Control Bit Vector - PN Info Bit";
CM_ SG_ 2549874727 NRR_L_UWB_TRNK_FD "ASR NM Network Request Reason";
CM_ SG_ 2549874727 NM_State_L_UWB_TRNK_FD "ASR NM State_Current State_Previous State";
CM_ SG_ 2549874727 PNI_L_UWB_TRNK_FD "ASR NM Partial Networking Information";
CM_ SG_ 2549874727 PNI_L_UWB_TRNK_FD_1 "ASR NM Partial Networking Information";
CM_ SG_ 2549874727 PNI_L_UWB_TRNK_FD_2 "ASR NM Partial Networking Information";
CM_ SG_ 2549874727 PNI_L_UWB_TRNK_FD_3 "ASR NM Partial Networking Information";
CM_ SG_ 2549874724 SNI_L_UWB_FRNK_FD "ASR NM Source Node Identifier";
CM_ SG_ 2549874724 CBV_RMR_L_UWB_FRNK_FD "ASR NM Control Bit Vector - Repeat Message Request";
CM_ SG_ 2549874724 CBV_NMCoID_L_UWB_FRNK_FD "ASR NM Control Bit Vector - ASR NM Coordinator ID";
CM_ SG_ 2549874724 CBV_NMCoSRB_L_UWB_FRNK_FD "ASR NM Control Bit Vector - ASR NM Coordinator Sleep Ready Bit";
CM_ SG_ 2549874724 CBV_AWB_L_UWB_FRNK_FD "ASR NM Control Bit Vector - Active Wakeup Bit";
CM_ SG_ 2549874724 CBV_PNIB_L_UWB_FRNK_FD "ASR NM Control Bit Vector - PN Info Bit";
CM_ SG_ 2549874724 NRR_L_UWB_FRNK_FD "ASR NM Network Request Reason";
CM_ SG_ 2549874724 NM_State_L_UWB_FRNK_FD "ASR NM State_Current State_Previous State";
CM_ SG_ 2549874724 PNI_L_UWB_FRNK_FD "ASR NM Partial Networking Information";
CM_ SG_ 2549874724 PNI_L_UWB_FRNK_FD_1 "ASR NM Partial Networking Information";
CM_ SG_ 2549874724 PNI_L_UWB_FRNK_FD_2 "ASR NM Partial Networking Information";
CM_ SG_ 2549874724 PNI_L_UWB_FRNK_FD_3 "ASR NM Partial Networking Information";
CM_ SG_ 2549874722 SNI_L_UWB_FL_FD "ASR NM Source Node Identifier";
CM_ SG_ 2549874722 CBV_RMR_L_UWB_FL_FD "ASR NM Control Bit Vector - Repeat Message Request";
CM_ SG_ 2549874722 CBV_NMCoID_L_UWB_FL_FD "ASR NM Control Bit Vector - ASR NM Coordinator ID";
CM_ SG_ 2549874722 CBV_NMCoSRB_L_UWB_FL_FD "ASR NM Control Bit Vector - ASR NM Coordinator Sleep Ready Bit";
CM_ SG_ 2549874722 CBV_AWB_L_UWB_FL_FD "ASR NM Control Bit Vector - Active Wakeup Bit";
CM_ SG_ 2549874722 CBV_PNIB_L_UWB_FL_FD "ASR NM Control Bit Vector - PN Info Bit";
CM_ SG_ 2549874722 NRR_L_UWB_FL_FD "ASR NM Network Request Reason";
CM_ SG_ 2549874722 NM_State_L_UWB_FL_FD "ASR NM State_Current State_Previous State";
CM_ SG_ 2549874722 PNI_L_UWB_FL_FD "ASR NM Partial Networking Information";
CM_ SG_ 2549874722 PNI_L_UWB_FL_FD_1 "ASR NM Partial Networking Information";
CM_ SG_ 2549874722 PNI_L_UWB_FL_FD_2 "ASR NM Partial Networking Information";
CM_ SG_ 2549874722 PNI_L_UWB_FL_FD_3 "ASR NM Partial Networking Information";
CM_ SG_ 2549874816 SNI_GW_BDC_FD "ASR NM Source Node Identifier";
CM_ SG_ 2549874816 CBV_RMR_GW_BDC_FD "ASR NM Control Bit Vector - Repeat Message Request";
CM_ SG_ 2549874816 CBV_NMCoID_GW_BDC_FD "ASR NM Control Bit Vector - ASR NM Coordinator ID";
CM_ SG_ 2549874816 CBV_NMCoSRB_GW_BDC_FD "ASR NM Control Bit Vector - ASR NM Coordinator Sleep Ready Bit";
CM_ SG_ 2549874816 CBV_AWB_GW_BDC_FD "ASR NM Control Bit Vector - Active Wakeup Bit";
CM_ SG_ 2549874816 CBV_PNIB_GW_BDC_FD "ASR NM Control Bit Vector - PN Info Bit";
CM_ SG_ 2549874816 NRR_GW_BDC_FD "ASR NM Network Request Reason";
CM_ SG_ 2549874816 NM_State_GW_BDC_FD "ASR NM State_Current State_Previous State";
CM_ SG_ 2549874816 PNI_GW_BDC_FD "ASR NM Partial Networking Information";
CM_ SG_ 2549874816 PNI_GW_BDC_FD_1 "ASR NM Partial Networking Information";
CM_ SG_ 2549874816 PNI_GW_BDC_FD_2 "ASR NM Partial Networking Information";
CM_ SG_ 2549874816 PNI_GW_BDC_FD_3 "ASR NM Partial Networking Information";
CM_ SG_ 2549874725 SNI_L_UWB_RL_FD "ASR NM Source Node Identifier";
CM_ SG_ 2549874725 CBV_RMR_L_UWB_RL_FD "ASR NM Control Bit Vector - Repeat Message Request";
CM_ SG_ 2549874725 CBV_NMCoID_L_UWB_RL_FD "ASR NM Control Bit Vector - ASR NM Coordinator ID";
CM_ SG_ 2549874725 CBV_NMCoSRB_L_UWB_RL_FD "ASR NM Control Bit Vector - ASR NM Coordinator Sleep Ready Bit";
CM_ SG_ 2549874725 CBV_AWB_L_UWB_RL_FD "ASR NM Control Bit Vector - Active Wakeup Bit";
CM_ SG_ 2549874725 CBV_PNIB_L_UWB_RL_FD "ASR NM Control Bit Vector - PN Info Bit";
CM_ SG_ 2549874725 NRR_L_UWB_RL_FD "ASR NM Network Request Reason";
CM_ SG_ 2549874725 NM_State_L_UWB_RL_FD "ASR NM State_Current State_Previous State";
CM_ SG_ 2549874725 PNI_L_UWB_RL_FD "ASR NM Partial Networking Information";
CM_ SG_ 2549874725 PNI_L_UWB_RL_FD_1 "ASR NM Partial Networking Information";
CM_ SG_ 2549874725 PNI_L_UWB_RL_FD_2 "ASR NM Partial Networking Information";
CM_ SG_ 2549874725 PNI_L_UWB_RL_FD_3 "ASR NM Partial Networking Information";
CM_ SG_ 2549874857 SNI_L_SAL_FD "ASR NM Source Node Identifier";
CM_ SG_ 2549874857 CBV_RMR_L_SAL_FD "ASR NM Control Bit Vector - Repeat Message Request";
CM_ SG_ 2549874857 CBV_NMCoID_L_SAL_FD "ASR NM Control Bit Vector - ASR NM Coordinator ID";
CM_ SG_ 2549874857 CBV_NMCoSRB_L_SAL_FD "ASR NM Control Bit Vector - ASR NM Coordinator Sleep Ready Bit";
CM_ SG_ 2549874857 CBV_AWB_L_SAL_FD "ASR NM Control Bit Vector - Active Wakeup Bit";
CM_ SG_ 2549874857 CBV_PNIB_L_SAL_FD "ASR NM Control Bit Vector - PN Info Bit";
CM_ SG_ 2549874857 NRR_L_SAL_FD "ASR NM Network Request Reason";
CM_ SG_ 2549874857 NM_State_L_SAL_FD "ASR NM State_Current State_Previous State";
CM_ SG_ 2549874857 PNI_L_SAL_FD "ASR NM Partial Networking Information";
CM_ SG_ 2549874857 PNI_L_SAL_FD_1 "ASR NM Partial Networking Information";
CM_ SG_ 2549874857 PNI_L_SAL_FD_2 "ASR NM Partial Networking Information";
CM_ SG_ 2549874857 PNI_L_SAL_FD_3 "ASR NM Partial Networking Information";
CM_ SG_ 2549874718 SNI_L_WPC_FD "ASR NM Source Node Identifier";
CM_ SG_ 2549874718 CBV_RMR_L_WPC_FD "ASR NM Control Bit Vector - Repeat Message Request";
CM_ SG_ 2549874718 CBV_NMCoID_L_WPC_FD "ASR NM Control Bit Vector - ASR NM Coordinator ID";
CM_ SG_ 2549874718 CBV_NMCoSRB_L_WPC_FD "ASR NM Control Bit Vector - ASR NM Coordinator Sleep Ready Bit";
CM_ SG_ 2549874718 CBV_AWB_L_WPC_FD "ASR NM Control Bit Vector - Active Wakeup Bit";
CM_ SG_ 2549874718 CBV_PNIB_L_WPC_FD "ASR NM Control Bit Vector - PN Info Bit";
CM_ SG_ 2549874718 NRR_L_WPC_FD "ASR NM Network Request Reason";
CM_ SG_ 2549874718 NM_State_L_WPC_FD "ASR NM State_Current State_Previous State";
CM_ SG_ 2549874718 PNI_L_WPC_FD "ASR NM Partial Networking Information";
CM_ SG_ 2549874718 PNI_L_WPC_FD_1 "ASR NM Partial Networking Information";
CM_ SG_ 2549874718 PNI_L_WPC_FD_2 "ASR NM Partial Networking Information";
CM_ SG_ 2549874718 PNI_L_WPC_FD_3 "ASR NM Partial Networking Information";
CM_ SG_ 2549874728 SNI_L_TPMS_FD "ASR NM Source Node Identifier";
CM_ SG_ 2549874728 CBV_RMR_L_TPMS_FD "ASR NM Control Bit Vector - Repeat Message Request";
CM_ SG_ 2549874728 CBV_NMCoID_L_TPMS_FD "ASR NM Control Bit Vector - ASR NM Coordinator ID";
CM_ SG_ 2549874728 CBV_NMCoSRB_L_TPMS_FD "ASR NM Control Bit Vector - ASR NM Coordinator Sleep Ready Bit";
CM_ SG_ 2549874728 CBV_AWB_L_TPMS_FD "ASR NM Control Bit Vector - Active Wakeup Bit";
CM_ SG_ 2549874728 CBV_PNIB_L_TPMS_FD "ASR NM Control Bit Vector - PN Info Bit";
CM_ SG_ 2549874728 NRR_L_TPMS_FD "ASR NM Network Request Reason";
CM_ SG_ 2549874728 NM_State_L_TPMS_FD "ASR NM State_Current State_Previous State";
CM_ SG_ 2549874728 PNI_L_TPMS_FD "ASR NM Partial Networking Information";
CM_ SG_ 2549874728 PNI_L_TPMS_FD_1 "ASR NM Partial Networking Information";
CM_ SG_ 2549874728 PNI_L_TPMS_FD_2 "ASR NM Partial Networking Information";
CM_ SG_ 2549874728 PNI_L_TPMS_FD_3 "ASR NM Partial Networking Information";
CM_ SG_ 2549874730 SNI_L_DHL_FD "ASR NM Source Node Identifier";
CM_ SG_ 2549874730 CBV_RMR_L_DHL_FD "ASR NM Control Bit Vector - Repeat Message Request";
CM_ SG_ 2549874730 CBV_NMCoID_L_DHL_FD "ASR NM Control Bit Vector - ASR NM Coordinator ID";
CM_ SG_ 2549874730 CBV_NMCoSRB_L_DHL_FD "ASR NM Control Bit Vector - ASR NM Coordinator Sleep Ready Bit";
CM_ SG_ 2549874730 CBV_AWB_L_DHL_FD "ASR NM Control Bit Vector - Active Wakeup Bit";
CM_ SG_ 2549874730 CBV_PNIB_L_DHL_FD "ASR NM Control Bit Vector - PN Info Bit";
CM_ SG_ 2549874730 NRR_L_DHL_FD "ASR NM Network Request Reason";
CM_ SG_ 2549874730 NM_State_L_DHL_FD "ASR NM State_Current State_Previous State";
CM_ SG_ 2549874730 PNI_L_DHL_FD "ASR NM Partial Networking Information";
CM_ SG_ 2549874730 PNI_L_DHL_FD_1 "ASR NM Partial Networking Information";
CM_ SG_ 2549874730 PNI_L_DHL_FD_2 "ASR NM Partial Networking Information";
CM_ SG_ 2549874730 PNI_L_DHL_FD_3 "ASR NM Partial Networking Information";
CM_ SG_ 2549874731 SNI_L_DHR_FD "ASR NM Source Node Identifier";
CM_ SG_ 2549874731 CBV_RMR_L_DHR_FD "ASR NM Control Bit Vector - Repeat Message Request";
CM_ SG_ 2549874731 CBV_NMCoID_L_DHR_FD "ASR NM Control Bit Vector - ASR NM Coordinator ID";
CM_ SG_ 2549874731 CBV_NMCoSRB_L_DHR_FD "ASR NM Control Bit Vector - ASR NM Coordinator Sleep Ready Bit";
CM_ SG_ 2549874731 CBV_AWB_L_DHR_FD "ASR NM Control Bit Vector - Active Wakeup Bit";
CM_ SG_ 2549874731 CBV_PNIB_L_DHR_FD "ASR NM Control Bit Vector - PN Info Bit";
CM_ SG_ 2549874731 NRR_L_DHR_FD "ASR NM Network Request Reason";
CM_ SG_ 2549874731 NM_State_L_DHR_FD "ASR NM State_Current State_Previous State";
CM_ SG_ 2549874731 PNI_L_DHR_FD "ASR NM Partial Networking Information";
CM_ SG_ 2549874731 PNI_L_DHR_FD_1 "ASR NM Partial Networking Information";
CM_ SG_ 2549874731 PNI_L_DHR_FD_2 "ASR NM Partial Networking Information";
CM_ SG_ 2549874731 PNI_L_DHR_FD_3 "ASR NM Partial Networking Information";
BA_DEF_ BO_  "CANFD_BRS" ENUM  "0","1";
BA_DEF_ BO_  "GenMsgEVName" STRING ;
BA_DEF_ BO_  "NmAsrMessage" ENUM  "No","Yes";
BA_DEF_ BO_  "DiagState" ENUM  "No","Yes";
BA_DEF_ BO_  "DiagResponse" ENUM  "No","Yes";
BA_DEF_ BO_  "DiagRequest" ENUM  "No","Yes";
BA_DEF_ BO_  "TpMessage" ENUM  "No","Yes";
BA_DEF_ BO_  "UsrMsgIDSforwardDeviation" INT 0 100;
BA_DEF_ BO_  "UsrMsgIDSbackwardDeviation" INT 50 1000;
BA_DEF_ BO_  "GenMsgCycleTime" INT 0 2000;
BA_DEF_ BO_  "GenMsgStartDelayTime" INT 0 2000;
BA_DEF_ BO_  "GenMsgSendType" ENUM  "Cyclic","NoMsgSendType";
BA_DEF_ BO_  "GenMsgCycleTimeFast" INT 0 500;
BA_DEF_ BO_  "GenMsgDelayTime" INT 0 20;
BA_DEF_ BO_  "GenMsgILSupport" ENUM  "No","Yes";
BA_DEF_ BO_  "GenMsgNrOfRepetition" INT 0 3;
BA_DEF_ BO_  "TpTxIndex" INT 0 65535;
BA_DEF_ BO_  "VFrameFormat" ENUM  "StandardCAN","ExtendedCAN","reserved","reserved","reserved","reserved","reserved","reserved","reserved","reserved","reserved","reserved","reserved","reserved","StandardCAN_FD","ExtendedCAN_FD";
BA_DEF_ SG_  "UserSigValidity" ENUM  "B+","ACC","IG","IG1","IG2","IG3","IG1 or IG2","IG1 or IG3","Undef";
BA_DEF_ SG_  "TimeoutValue" STRING ;
BA_DEF_ SG_  "UsrSigPurpose" ENUM  "Undef","FN","DIAG","DIAG(Req)","DIAG(Res)","DIAG(Func)","DEV","CCP","NM","TP";
BA_DEF_ SG_  "GenSigStartValue" INT 0 1215752192;
BA_DEF_ SG_  "NetworkRequest" ENUM  "Yes","No";
BA_DEF_ SG_  "NetworkRequestHoldingTime" INT 0 65535;
BA_DEF_ SG_  "Description" STRING ;
BA_DEF_ SG_  "Version" STRING ;
BA_DEF_ SG_  "GenSigEnvVarType" ENUM  "Int","Float","Undef";
BA_DEF_ SG_  "GenSigSendType" ENUM  "Cyclic","OnWrite","OnWriteWithRepetition","OnChange","OnChangeWithRepetition","IfActive","IfActiveWithRepetition","NoSigSendType","OnChangeAndIfActive","OnChangeAndIfActiveWithRepetition";
BA_DEF_ SG_  "GwSigLatencyTime" INT 0 65536;
BA_DEF_ SG_  "GwSigMissingSourceType" ENUM  "Undef","OldValue","DefaultValue","InitialValue";
BA_DEF_ SG_  "NWM-WakeupAllowed" ENUM  "<n.a.>";
BA_DEF_ SG_  "RoutingFactor" INT 1 1215752192;
BA_DEF_ SG_  "SystemSignalLongSymbol" STRING ;
BA_DEF_REL_ BU_SG_REL_  "GenSigTimeoutTime" INT 0 7000;
BA_DEF_DEF_  "CANFD_BRS" "1";
BA_DEF_DEF_  "GenMsgEVName" "@Signame";
BA_DEF_DEF_  "NmAsrMessage" "No";
BA_DEF_DEF_  "DiagState" "No";
BA_DEF_DEF_  "DiagResponse" "No";
BA_DEF_DEF_  "DiagRequest" "No";
BA_DEF_DEF_  "TpMessage" "No";
BA_DEF_DEF_  "UsrMsgIDSforwardDeviation" 10;
BA_DEF_DEF_  "UsrMsgIDSbackwardDeviation" 100;
BA_DEF_DEF_  "GenMsgCycleTime" 200;
BA_DEF_DEF_  "GenMsgStartDelayTime" 0;
BA_DEF_DEF_  "GenMsgSendType" "NoMsgSendType";
BA_DEF_DEF_  "GenMsgCycleTimeFast" 40;
BA_DEF_DEF_  "GenMsgDelayTime" 20;
BA_DEF_DEF_  "GenMsgILSupport" "Yes";
BA_DEF_DEF_  "GenMsgNrOfRepetition" 3;
BA_DEF_DEF_  "TpTxIndex" 0;
BA_DEF_DEF_  "VFrameFormat" "StandardCAN";
BA_DEF_DEF_  "UserSigValidity" "IG";
BA_DEF_DEF_  "TimeoutValue" "";
BA_DEF_DEF_  "UsrSigPurpose" "FN";
BA_DEF_DEF_  "GenSigStartValue" 0;
BA_DEF_DEF_  "NetworkRequest" "No";
BA_DEF_DEF_  "NetworkRequestHoldingTime" 0;
BA_DEF_DEF_  "Description" "";
BA_DEF_DEF_  "Version" "";
BA_DEF_DEF_  "GenSigEnvVarType" "Undef";
BA_DEF_DEF_  "GenSigSendType" "NoSigSendType";
BA_DEF_DEF_  "GwSigLatencyTime" 40;
BA_DEF_DEF_  "GwSigMissingSourceType" "Undef";
BA_DEF_DEF_  "NWM-WakeupAllowed" "<n.a.>";
BA_DEF_DEF_  "RoutingFactor" 1;
BA_DEF_DEF_REL_ "GenSigTimeoutTime" 500;
BA_DEF_DEF_  "SystemSignalLongSymbol" "";
BA_ "GenMsgStartDelayTime" BO_ 980 10;
BA_ "GenMsgSendType" BO_ 980 0;
BA_ "VFrameFormat" BO_ 980 14;
BA_ "GenMsgDelayTime" BO_ 2683310247 10;
BA_ "GenMsgCycleTime" BO_ 2683310247 0;
BA_ "VFrameFormat" BO_ 2683310247 15;
BA_ "GenMsgDelayTime" BO_ 2683310246 10;
BA_ "GenMsgCycleTime" BO_ 2683310246 0;
BA_ "VFrameFormat" BO_ 2683310246 15;
BA_ "GenMsgDelayTime" BO_ 2683310245 10;
BA_ "GenMsgCycleTime" BO_ 2683310245 0;
BA_ "VFrameFormat" BO_ 2683310245 15;
BA_ "GenMsgDelayTime" BO_ 2683310244 10;
BA_ "GenMsgCycleTime" BO_ 2683310244 0;
BA_ "VFrameFormat" BO_ 2683310244 15;
BA_ "GenMsgDelayTime" BO_ 2683310243 10;
BA_ "GenMsgCycleTime" BO_ 2683310243 0;
BA_ "VFrameFormat" BO_ 2683310243 15;
BA_ "GenMsgDelayTime" BO_ 2683310242 10;
BA_ "GenMsgCycleTime" BO_ 2683310242 0;
BA_ "VFrameFormat" BO_ 2683310242 15;
BA_ "GenMsgDelayTime" BO_ 2683310241 10;
BA_ "GenMsgCycleTime" BO_ 2683310241 0;
BA_ "VFrameFormat" BO_ 2683310241 15;
BA_ "GenMsgSendType" BO_ 2281701600 0;
BA_ "VFrameFormat" BO_ 2281701600 15;
BA_ "GenMsgDelayTime" BO_ 2683310240 10;
BA_ "GenMsgCycleTime" BO_ 2683310240 0;
BA_ "VFrameFormat" BO_ 2683310240 15;
BA_ "GenMsgDelayTime" BO_ 2683310250 10;
BA_ "GenMsgCycleTime" BO_ 2683310250 0;
BA_ "VFrameFormat" BO_ 2683310250 15;
BA_ "GenMsgDelayTime" BO_ 2683310249 10;
BA_ "GenMsgCycleTime" BO_ 2683310249 0;
BA_ "VFrameFormat" BO_ 2683310249 15;
BA_ "GenMsgDelayTime" BO_ 2683310248 10;
BA_ "GenMsgCycleTime" BO_ 2683310248 0;
BA_ "VFrameFormat" BO_ 2683310248 15;
BA_ "NmAsrMessage" BO_ 2549874733 1;
BA_ "GenMsgNrOfRepetition" BO_ 2549874733 0;
BA_ "GenMsgILSupport" BO_ 2549874733 0;
BA_ "GenMsgDelayTime" BO_ 2549874733 10;
BA_ "GenMsgCycleTimeFast" BO_ 2549874733 0;
BA_ "GenMsgCycleTime" BO_ 2549874733 100;
BA_ "VFrameFormat" BO_ 2549874733 15;
BA_ "NmAsrMessage" BO_ 2549874720 1;
BA_ "GenMsgNrOfRepetition" BO_ 2549874720 0;
BA_ "GenMsgILSupport" BO_ 2549874720 0;
BA_ "GenMsgDelayTime" BO_ 2549874720 10;
BA_ "GenMsgCycleTimeFast" BO_ 2549874720 0;
BA_ "GenMsgCycleTime" BO_ 2549874720 100;
BA_ "VFrameFormat" BO_ 2549874720 15;
BA_ "NmAsrMessage" BO_ 2549874726 1;
BA_ "GenMsgNrOfRepetition" BO_ 2549874726 0;
BA_ "GenMsgILSupport" BO_ 2549874726 0;
BA_ "GenMsgDelayTime" BO_ 2549874726 10;
BA_ "GenMsgCycleTimeFast" BO_ 2549874726 0;
BA_ "GenMsgCycleTime" BO_ 2549874726 100;
BA_ "VFrameFormat" BO_ 2549874726 15;
BA_ "NmAsrMessage" BO_ 2549874721 1;
BA_ "GenMsgNrOfRepetition" BO_ 2549874721 0;
BA_ "GenMsgILSupport" BO_ 2549874721 0;
BA_ "GenMsgDelayTime" BO_ 2549874721 10;
BA_ "GenMsgCycleTimeFast" BO_ 2549874721 0;
BA_ "GenMsgCycleTime" BO_ 2549874721 100;
BA_ "VFrameFormat" BO_ 2549874721 15;
BA_ "NmAsrMessage" BO_ 2549874723 1;
BA_ "GenMsgNrOfRepetition" BO_ 2549874723 0;
BA_ "GenMsgILSupport" BO_ 2549874723 0;
BA_ "GenMsgDelayTime" BO_ 2549874723 10;
BA_ "GenMsgCycleTimeFast" BO_ 2549874723 0;
BA_ "GenMsgCycleTime" BO_ 2549874723 100;
BA_ "VFrameFormat" BO_ 2549874723 15;
BA_ "NmAsrMessage" BO_ 2549874732 1;
BA_ "GenMsgNrOfRepetition" BO_ 2549874732 0;
BA_ "GenMsgILSupport" BO_ 2549874732 0;
BA_ "GenMsgDelayTime" BO_ 2549874732 10;
BA_ "GenMsgCycleTimeFast" BO_ 2549874732 0;
BA_ "GenMsgCycleTime" BO_ 2549874732 100;
BA_ "VFrameFormat" BO_ 2549874732 15;
BA_ "NmAsrMessage" BO_ 2549874727 1;
BA_ "GenMsgNrOfRepetition" BO_ 2549874727 0;
BA_ "GenMsgILSupport" BO_ 2549874727 0;
BA_ "GenMsgDelayTime" BO_ 2549874727 10;
BA_ "GenMsgCycleTimeFast" BO_ 2549874727 0;
BA_ "GenMsgCycleTime" BO_ 2549874727 100;
BA_ "VFrameFormat" BO_ 2549874727 15;
BA_ "NmAsrMessage" BO_ 2549874724 1;
BA_ "GenMsgNrOfRepetition" BO_ 2549874724 0;
BA_ "GenMsgILSupport" BO_ 2549874724 0;
BA_ "GenMsgDelayTime" BO_ 2549874724 10;
BA_ "GenMsgCycleTimeFast" BO_ 2549874724 0;
BA_ "GenMsgCycleTime" BO_ 2549874724 100;
BA_ "VFrameFormat" BO_ 2549874724 15;
BA_ "NmAsrMessage" BO_ 2549874722 1;
BA_ "GenMsgNrOfRepetition" BO_ 2549874722 0;
BA_ "GenMsgILSupport" BO_ 2549874722 0;
BA_ "GenMsgDelayTime" BO_ 2549874722 10;
BA_ "GenMsgCycleTimeFast" BO_ 2549874722 0;
BA_ "GenMsgCycleTime" BO_ 2549874722 100;
BA_ "VFrameFormat" BO_ 2549874722 15;
BA_ "NmAsrMessage" BO_ 2549874816 1;
BA_ "GenMsgNrOfRepetition" BO_ 2549874816 0;
BA_ "GenMsgILSupport" BO_ 2549874816 0;
BA_ "GenMsgDelayTime" BO_ 2549874816 10;
BA_ "GenMsgCycleTimeFast" BO_ 2549874816 0;
BA_ "GenMsgCycleTime" BO_ 2549874816 100;
BA_ "VFrameFormat" BO_ 2549874816 15;
BA_ "NmAsrMessage" BO_ 2549874725 1;
BA_ "GenMsgNrOfRepetition" BO_ 2549874725 0;
BA_ "GenMsgILSupport" BO_ 2549874725 0;
BA_ "GenMsgDelayTime" BO_ 2549874725 10;
BA_ "GenMsgCycleTimeFast" BO_ 2549874725 0;
BA_ "GenMsgCycleTime" BO_ 2549874725 100;
BA_ "VFrameFormat" BO_ 2549874725 15;
BA_ "NmAsrMessage" BO_ 2549874857 1;
BA_ "GenMsgNrOfRepetition" BO_ 2549874857 0;
BA_ "GenMsgILSupport" BO_ 2549874857 0;
BA_ "GenMsgDelayTime" BO_ 2549874857 10;
BA_ "GenMsgCycleTimeFast" BO_ 2549874857 0;
BA_ "GenMsgCycleTime" BO_ 2549874857 100;
BA_ "VFrameFormat" BO_ 2549874857 15;
BA_ "NmAsrMessage" BO_ 2549874718 1;
BA_ "GenMsgNrOfRepetition" BO_ 2549874718 0;
BA_ "GenMsgILSupport" BO_ 2549874718 0;
BA_ "GenMsgDelayTime" BO_ 2549874718 10;
BA_ "GenMsgCycleTimeFast" BO_ 2549874718 0;
BA_ "GenMsgCycleTime" BO_ 2549874718 100;
BA_ "VFrameFormat" BO_ 2549874718 15;
BA_ "NmAsrMessage" BO_ 2549874728 1;
BA_ "GenMsgNrOfRepetition" BO_ 2549874728 0;
BA_ "GenMsgILSupport" BO_ 2549874728 0;
BA_ "GenMsgDelayTime" BO_ 2549874728 10;
BA_ "GenMsgCycleTimeFast" BO_ 2549874728 0;
BA_ "GenMsgCycleTime" BO_ 2549874728 100;
BA_ "VFrameFormat" BO_ 2549874728 15;
BA_ "NmAsrMessage" BO_ 2549874730 1;
BA_ "GenMsgNrOfRepetition" BO_ 2549874730 0;
BA_ "GenMsgILSupport" BO_ 2549874730 0;
BA_ "GenMsgDelayTime" BO_ 2549874730 10;
BA_ "GenMsgCycleTimeFast" BO_ 2549874730 0;
BA_ "GenMsgCycleTime" BO_ 2549874730 100;
BA_ "VFrameFormat" BO_ 2549874730 15;
BA_ "NmAsrMessage" BO_ 2549874731 1;
BA_ "GenMsgNrOfRepetition" BO_ 2549874731 0;
BA_ "GenMsgILSupport" BO_ 2549874731 0;
BA_ "GenMsgDelayTime" BO_ 2549874731 10;
BA_ "GenMsgCycleTimeFast" BO_ 2549874731 0;
BA_ "GenMsgCycleTime" BO_ 2549874731 100;
BA_ "VFrameFormat" BO_ 2549874731 15;
BA_ "Version" SG_ 980 BDC_FD_Crc5Val "22.11.04";
BA_ "UserSigValidity" SG_ 980 BDC_FD_Crc5Val 0;
BA_ "GenSigStartValue" SG_ 980 BDC_FD_Crc5Val 65535;
BA_ "GenSigSendType" SG_ 980 BDC_FD_Crc5Val 4;
BA_ "Description" SG_ 980 BDC_FD_Crc5Val "The data area for CRC calculation is based on the data length (DLC) of the message DB.

The CRC shall be calculated over the entire data block (excluding the CRC bytes) including the user data, alive counter and Data ID



- CRC Polynomial (0x1021) , Ini";
BA_ "Version" SG_ 980 AutoLt_HorRes_STD "23.01.01";
BA_ "NetworkRequestHoldingTime" SG_ 980 AutoLt_HorRes_STD 5000;
BA_ "NetworkRequest" SG_ 980 AutoLt_HorRes_STD 0;
BA_ "UserSigValidity" SG_ 980 AutoLt_HorRes_STD 0;
BA_ "GenSigSendType" SG_ 980 AutoLt_HorRes_STD 4;
BA_ "Description" SG_ 980 AutoLt_HorRes_STD "This signal is standard horizontal resolution of autolight sensor.



Horizontal brightness(lux)=AutoLt_HorRes_STD*AutoLt_HorVal_STD

б╪ AutoLt_HorVal_STD : Horizontal value signal

Brightness 0~1,000lux : Resolution is 1lux and value is 0(0h)~1,000(3E8h";
BA_ "Version" SG_ 980 AutoLt_VerVal_STD "23.01.01";
BA_ "NetworkRequestHoldingTime" SG_ 980 AutoLt_VerVal_STD 5000;
BA_ "NetworkRequest" SG_ 980 AutoLt_VerVal_STD 0;
BA_ "UserSigValidity" SG_ 980 AutoLt_VerVal_STD 0;
BA_ "GenSigSendType" SG_ 980 AutoLt_VerVal_STD 4;
BA_ "Description" SG_ 980 AutoLt_VerVal_STD "This signal is standard vertical value of autolight sensor.



Vertical brightness(lux)=AutoLt_VerRes_STD*AutoLt_VerVal_STD

б╪ AutoLt_VerRes_STD : Vertical resolution signal

Brightness 0~1,000lux : Resolution is 1lux and value is 0(0h)~1,000(3E8h)

Bri";
BA_ "Version" SG_ 980 AutoLt_VerRes_STD "23.01.01";
BA_ "NetworkRequestHoldingTime" SG_ 980 AutoLt_VerRes_STD 5000;
BA_ "NetworkRequest" SG_ 980 AutoLt_VerRes_STD 0;
BA_ "UserSigValidity" SG_ 980 AutoLt_VerRes_STD 0;
BA_ "GenSigSendType" SG_ 980 AutoLt_VerRes_STD 4;
BA_ "Description" SG_ 980 AutoLt_VerRes_STD "This signal is standard vertical resolution of autolight sensor.



Vertical brightness(lux)=AutoLt_VerRes_STD*AutoLt_VerVal_STD

б╪ AutoLt_VerVal_STD : Vertical value signal

Brightness 0~1,000lux : Resolution is 1lux and value is 0(0h)~1,000(3E8h)

Bri";
BA_ "Version" SG_ 980 MoodLamp_SlvColor_X "23.02.02";
BA_ "UserSigValidity" SG_ 980 MoodLamp_SlvColor_X 0;
BA_ "GenSigStartValue" SG_ 980 MoodLamp_SlvColor_X 47;
BA_ "GenSigSendType" SG_ 980 MoodLamp_SlvColor_X 4;
BA_ "Description" SG_ 980 MoodLamp_SlvColor_X "Color X Mood Lamp to slave";
BA_ "Version" SG_ 980 MoodLamp_SlvColor_Y "23.02.02";
BA_ "UserSigValidity" SG_ 980 MoodLamp_SlvColor_Y 0;
BA_ "GenSigStartValue" SG_ 980 MoodLamp_SlvColor_Y 51;
BA_ "GenSigSendType" SG_ 980 MoodLamp_SlvColor_Y 4;
BA_ "Description" SG_ 980 MoodLamp_SlvColor_Y "Color Y Mood lamp to slave";
BA_ "Version" SG_ 980 MoodLamp_SlvBrgtnsVal "23.02.02";
BA_ "UserSigValidity" SG_ 980 MoodLamp_SlvBrgtnsVal 0;
BA_ "GenSigStartValue" SG_ 980 MoodLamp_SlvBrgtnsVal 250;
BA_ "GenSigSendType" SG_ 980 MoodLamp_SlvBrgtnsVal 4;
BA_ "Description" SG_ 980 MoodLamp_SlvBrgtnsVal "Brightness mood lamp to slave";
BA_ "Version" SG_ 980 MoodLamp_SlvFadeInTimetVal "23.02.02";
BA_ "UserSigValidity" SG_ 980 MoodLamp_SlvFadeInTimetVal 0;
BA_ "GenSigStartValue" SG_ 980 MoodLamp_SlvFadeInTimetVal 10;
BA_ "GenSigSendType" SG_ 980 MoodLamp_SlvFadeInTimetVal 4;
BA_ "Description" SG_ 980 MoodLamp_SlvFadeInTimetVal "Fade In Time Mood Lamp to slave";
BA_ "Version" SG_ 980 BDC_FD_AlvCnt5Val "22.11.04";
BA_ "UserSigValidity" SG_ 980 BDC_FD_AlvCnt5Val 0;
BA_ "GenSigSendType" SG_ 980 BDC_FD_AlvCnt5Val 4;
BA_ "Description" SG_ 980 BDC_FD_AlvCnt5Val "For the first transmission request for a data element the counter shall be initialized with 0 and shall be incremented by 1 for every subsequent send request. 

When the counter reaches the maximum value(0xFF), then it shall restart with 0 for the next s";
BA_ "Version" SG_ 980 MoodLamp_SlvFadeOutTimetVal "23.02.02";
BA_ "UserSigValidity" SG_ 980 MoodLamp_SlvFadeOutTimetVal 0;
BA_ "GenSigStartValue" SG_ 980 MoodLamp_SlvFadeOutTimetVal 10;
BA_ "GenSigSendType" SG_ 980 MoodLamp_SlvFadeOutTimetVal 4;
BA_ "Description" SG_ 980 MoodLamp_SlvFadeOutTimetVal "Fade Out Time Mood Lamp to slave";
BA_ "Version" SG_ 980 Lamp_LftTrnLmpCmdSta "23.02.06";
BA_ "NetworkRequestHoldingTime" SG_ 980 Lamp_LftTrnLmpCmdSta 5000;
BA_ "NetworkRequest" SG_ 980 Lamp_LftTrnLmpCmdSta 0;
BA_ "UserSigValidity" SG_ 980 Lamp_LftTrnLmpCmdSta 0;
BA_ "GenSigSendType" SG_ 980 Lamp_LftTrnLmpCmdSta 4;
BA_ "Description" SG_ 980 Lamp_LftTrnLmpCmdSta "Left Turn Signal and Hazard Lamp Command State";
BA_ "Version" SG_ 980 Lamp_RtTrnLmpCmdSta "23.02.06";
BA_ "NetworkRequestHoldingTime" SG_ 980 Lamp_RtTrnLmpCmdSta 5000;
BA_ "NetworkRequest" SG_ 980 Lamp_RtTrnLmpCmdSta 0;
BA_ "UserSigValidity" SG_ 980 Lamp_RtTrnLmpCmdSta 0;
BA_ "GenSigSendType" SG_ 980 Lamp_RtTrnLmpCmdSta 4;
BA_ "Description" SG_ 980 Lamp_RtTrnLmpCmdSta "Right Turn Signal and Hazard Lamp Command State";
BA_ "Version" SG_ 980 Lamp_LftTrnLmpCmd "23.02.10";
BA_ "NetworkRequestHoldingTime" SG_ 980 Lamp_LftTrnLmpCmd 5000;
BA_ "NetworkRequest" SG_ 980 Lamp_LftTrnLmpCmd 0;
BA_ "UserSigValidity" SG_ 980 Lamp_LftTrnLmpCmd 0;
BA_ "GenSigSendType" SG_ 980 Lamp_LftTrnLmpCmd 4;
BA_ "Description" SG_ 980 Lamp_LftTrnLmpCmd "Left Turn Signal and Hazard Lamp Command State";
BA_ "Version" SG_ 980 Lamp_RtTrnLmpCmd "23.02.10";
BA_ "NetworkRequestHoldingTime" SG_ 980 Lamp_RtTrnLmpCmd 500;
BA_ "NetworkRequest" SG_ 980 Lamp_RtTrnLmpCmd 0;
BA_ "UserSigValidity" SG_ 980 Lamp_RtTrnLmpCmd 0;
BA_ "GenSigSendType" SG_ 980 Lamp_RtTrnLmpCmd 4;
BA_ "Description" SG_ 980 Lamp_RtTrnLmpCmd "Right Turn Signal and Hazard Lamp Command";
BA_ "Version" SG_ 980 Lamp_TrnLmpMode "23.04.06";
BA_ "NetworkRequestHoldingTime" SG_ 980 Lamp_TrnLmpMode 5000;
BA_ "NetworkRequest" SG_ 980 Lamp_TrnLmpMode 0;
BA_ "UserSigValidity" SG_ 980 Lamp_TrnLmpMode 0;
BA_ "GenSigSendType" SG_ 980 Lamp_TrnLmpMode 4;
BA_ "Description" SG_ 980 Lamp_TrnLmpMode "Turn Signal and Hazard Lamp Mode";
BA_ "Version" SG_ 980 Lamp_HzrdSwIND "23.02.10";
BA_ "NetworkRequestHoldingTime" SG_ 980 Lamp_HzrdSwIND 5000;
BA_ "NetworkRequest" SG_ 980 Lamp_HzrdSwIND 0;
BA_ "UserSigValidity" SG_ 980 Lamp_HzrdSwIND 0;
BA_ "GenSigSendType" SG_ 980 Lamp_HzrdSwIND 4;
BA_ "Description" SG_ 980 Lamp_HzrdSwIND "Hazard switch indicator command";
BA_ "Version" SG_ 980 Lamp_HdLmpEscortShortCmd_Copy_0 "23.07.06";
BA_ "NetworkRequestHoldingTime" SG_ 980 Lamp_HdLmpEscortShortCmd_Copy_0 5000;
BA_ "NetworkRequest" SG_ 980 Lamp_HdLmpEscortShortCmd_Copy_0 0;
BA_ "UserSigValidity" SG_ 980 Lamp_HdLmpEscortShortCmd_Copy_0 0;
BA_ "GenSigSendType" SG_ 980 Lamp_HdLmpEscortShortCmd_Copy_0 4;
BA_ "Description" SG_ 980 Lamp_HdLmpEscortShortCmd_Copy_0 "HeadLamp Escort(short) Cmd";
BA_ "Version" SG_ 980 Lamp_LightPopUpMsgType "23.10.00";
BA_ "NetworkRequestHoldingTime" SG_ 980 Lamp_LightPopUpMsgType 5000;
BA_ "NetworkRequest" SG_ 980 Lamp_LightPopUpMsgType 0;
BA_ "UserSigValidity" SG_ 980 Lamp_LightPopUpMsgType 0;
BA_ "GenSigSendType" SG_ 980 Lamp_LightPopUpMsgType 4;
BA_ "Description" SG_ 980 Lamp_LightPopUpMsgType "Only for CPAD type lightmode switch.

Type A : OFF-TAIL-AUTO-LOW

Type B : AUTO-LOW";
BA_ "Version" SG_ 980 Lamp_LightPopUpReq "23.10.00";
BA_ "NetworkRequestHoldingTime" SG_ 980 Lamp_LightPopUpReq 5000;
BA_ "NetworkRequest" SG_ 980 Lamp_LightPopUpReq 0;
BA_ "UserSigValidity" SG_ 980 Lamp_LightPopUpReq 0;
BA_ "GenSigSendType" SG_ 980 Lamp_LightPopUpReq 4;
BA_ "Description" SG_ 980 Lamp_LightPopUpReq "Only for CPAD Type Lightmode Switch

Current light switch state when the switch is pushed";
BA_ "Version" SG_ 980 Lamp_HdLmpLoOffPopUpReq_Copy_0 "24.04.03";
BA_ "NetworkRequestHoldingTime" SG_ 980 Lamp_HdLmpLoOffPopUpReq_Copy_0 5000;
BA_ "NetworkRequest" SG_ 980 Lamp_HdLmpLoOffPopUpReq_Copy_0 0;
BA_ "UserSigValidity" SG_ 980 Lamp_HdLmpLoOffPopUpReq_Copy_0 0;
BA_ "GenSigSendType" SG_ 980 Lamp_HdLmpLoOffPopUpReq_Copy_0 4;
BA_ "Description" SG_ 980 Lamp_HdLmpLoOffPopUpReq_Copy_0 "Head Lamp off pop up alarm request";
BA_ "Version" SG_ 980 MoodLamp_SpeechRecogPosSta "24.05.01";
BA_ "UserSigValidity" SG_ 980 MoodLamp_SpeechRecogPosSta 0;
BA_ "GenSigSendType" SG_ 980 MoodLamp_SpeechRecogPosSta 4;
BA_ "Description" SG_ 980 MoodLamp_SpeechRecogPosSta "MoodLamp AIVoice Speech Recognition Position Status";
BA_ "Version" SG_ 980 MoodLamp_BttmSlvColor_X "24.07.06";
BA_ "UserSigValidity" SG_ 980 MoodLamp_BttmSlvColor_X 0;
BA_ "GenSigStartValue" SG_ 980 MoodLamp_BttmSlvColor_X 47;
BA_ "GenSigSendType" SG_ 980 MoodLamp_BttmSlvColor_X 4;
BA_ "Description" SG_ 980 MoodLamp_BttmSlvColor_X "Color X Mood Lamp to slave (Bottom)";
BA_ "Version" SG_ 980 MoodLamp_BttmSlvColor_Y "24.07.06";
BA_ "UserSigValidity" SG_ 980 MoodLamp_BttmSlvColor_Y 0;
BA_ "GenSigStartValue" SG_ 980 MoodLamp_BttmSlvColor_Y 51;
BA_ "GenSigSendType" SG_ 980 MoodLamp_BttmSlvColor_Y 4;
BA_ "Description" SG_ 980 MoodLamp_BttmSlvColor_Y "Color Y Mood Lamp to slave (Bottom)";
BA_ "Version" SG_ 980 MoodLamp_BttmSlvBrgtnsVal "24.07.06";
BA_ "UserSigValidity" SG_ 980 MoodLamp_BttmSlvBrgtnsVal 0;
BA_ "GenSigStartValue" SG_ 980 MoodLamp_BttmSlvBrgtnsVal 250;
BA_ "GenSigSendType" SG_ 980 MoodLamp_BttmSlvBrgtnsVal 4;
BA_ "Description" SG_ 980 MoodLamp_BttmSlvBrgtnsVal "Brightness mood lamp to slave (Bottom)";
BA_ "Version" SG_ 980 MoodLamp_BttmSlvFadeInTimetVal "24.07.06";
BA_ "UserSigValidity" SG_ 980 MoodLamp_BttmSlvFadeInTimetVal 0;
BA_ "GenSigStartValue" SG_ 980 MoodLamp_BttmSlvFadeInTimetVal 10;
BA_ "GenSigSendType" SG_ 980 MoodLamp_BttmSlvFadeInTimetVal 4;
BA_ "Description" SG_ 980 MoodLamp_BttmSlvFadeInTimetVal "Fade In Time Mood Lamp to slave (Bottom)";
BA_ "Version" SG_ 980 MoodLamp_BttmSlvFadeOutTimetVal "24.07.06";
BA_ "UserSigValidity" SG_ 980 MoodLamp_BttmSlvFadeOutTimetVal 0;
BA_ "GenSigStartValue" SG_ 980 MoodLamp_BttmSlvFadeOutTimetVal 10;
BA_ "GenSigSendType" SG_ 980 MoodLamp_BttmSlvFadeOutTimetVal 4;
BA_ "Description" SG_ 980 MoodLamp_BttmSlvFadeOutTimetVal "Fade Out Time Mood Lamp to slave (Bottom)";
BA_ "Version" SG_ 980 Lamp_FrontGroundLightOnReq "24.07.05";
BA_ "NetworkRequestHoldingTime" SG_ 980 Lamp_FrontGroundLightOnReq 5000;
BA_ "NetworkRequest" SG_ 980 Lamp_FrontGroundLightOnReq 0;
BA_ "UserSigValidity" SG_ 980 Lamp_FrontGroundLightOnReq 0;
BA_ "GenSigSendType" SG_ 980 Lamp_FrontGroundLightOnReq 4;
BA_ "Description" SG_ 980 Lamp_FrontGroundLightOnReq "Signal for turning On/Off front exterior lamp for ground lighting";
BA_ "Version" SG_ 980 Lamp_SideGroundLightOnReq "24.07.05";
BA_ "NetworkRequestHoldingTime" SG_ 980 Lamp_SideGroundLightOnReq 5000;
BA_ "NetworkRequest" SG_ 980 Lamp_SideGroundLightOnReq 0;
BA_ "UserSigValidity" SG_ 980 Lamp_SideGroundLightOnReq 0;
BA_ "GenSigSendType" SG_ 980 Lamp_SideGroundLightOnReq 4;
BA_ "Description" SG_ 980 Lamp_SideGroundLightOnReq "Signal for turning On/Off side exterior lamp for ground lighting";
BA_ "Version" SG_ 980 Lamp_RearGroundLightOnReq "24.07.05";
BA_ "NetworkRequestHoldingTime" SG_ 980 Lamp_RearGroundLightOnReq 5000;
BA_ "NetworkRequest" SG_ 980 Lamp_RearGroundLightOnReq 0;
BA_ "UserSigValidity" SG_ 980 Lamp_RearGroundLightOnReq 0;
BA_ "GenSigSendType" SG_ 980 Lamp_RearGroundLightOnReq 4;
BA_ "Description" SG_ 980 Lamp_RearGroundLightOnReq "Signal for turning On/Off rear exterior lamp for ground lighting";
BA_ "Version" SG_ 980 Lamp_HiPrioHzrdReq_Copy_0 "17.12.00";
BA_ "NetworkRequestHoldingTime" SG_ 980 Lamp_HiPrioHzrdReq_Copy_0 5000;
BA_ "NetworkRequest" SG_ 980 Lamp_HiPrioHzrdReq_Copy_0 0;
BA_ "UserSigValidity" SG_ 980 Lamp_HiPrioHzrdReq_Copy_0 0;
BA_ "GenSigStartValue" SG_ 980 Lamp_HiPrioHzrdReq_Copy_0 2;
BA_ "GenSigSendType" SG_ 980 Lamp_HiPrioHzrdReq_Copy_0 4;
BA_ "Description" SG_ 980 Lamp_HiPrioHzrdReq_Copy_0 "-Higher priority than SJB hazard

-Diag/Arm/DisArm/Balarm/Panic/MTS

-Initial Value: 2";
BA_ "Version" SG_ 980 Lamp_FrFogLmpEnable "24.07.06";
BA_ "NetworkRequestHoldingTime" SG_ 980 Lamp_FrFogLmpEnable 5000;
BA_ "NetworkRequest" SG_ 980 Lamp_FrFogLmpEnable 0;
BA_ "UserSigValidity" SG_ 980 Lamp_FrFogLmpEnable 0;
BA_ "GenSigSendType" SG_ 980 Lamp_FrFogLmpEnable 4;
BA_ "Description" SG_ 980 Lamp_FrFogLmpEnable "Fog lamp operational status";
BA_ "Version" SG_ 980 Lamp_RrFogLmpEnable "24.07.06";
BA_ "NetworkRequestHoldingTime" SG_ 980 Lamp_RrFogLmpEnable 5000;
BA_ "NetworkRequest" SG_ 980 Lamp_RrFogLmpEnable 0;
BA_ "UserSigValidity" SG_ 980 Lamp_RrFogLmpEnable 0;
BA_ "GenSigSendType" SG_ 980 Lamp_RrFogLmpEnable 4;
BA_ "Description" SG_ 980 Lamp_RrFogLmpEnable "Fog lamp operational status";
BA_ "Version" SG_ 980 Lamp_LoPrioHzrdReq_Copy_0 "17.12.00";
BA_ "NetworkRequestHoldingTime" SG_ 980 Lamp_LoPrioHzrdReq_Copy_0 5000;
BA_ "NetworkRequest" SG_ 980 Lamp_LoPrioHzrdReq_Copy_0 0;
BA_ "UserSigValidity" SG_ 980 Lamp_LoPrioHzrdReq_Copy_0 0;
BA_ "GenSigStartValue" SG_ 980 Lamp_LoPrioHzrdReq_Copy_0 2;
BA_ "GenSigSendType" SG_ 980 Lamp_LoPrioHzrdReq_Copy_0 4;
BA_ "Description" SG_ 980 Lamp_LoPrioHzrdReq_Copy_0 "-Lower priority than SJB hazard

-TrunkOpenClose/CrashUnlock/RemoteStart

-Initial Value: 2";
BA_ "Version" SG_ 980 Lamp_ExtrnlTailLmpOnReq_Copy_0 "17.12.00";
BA_ "NetworkRequestHoldingTime" SG_ 980 Lamp_ExtrnlTailLmpOnReq_Copy_0 5000;
BA_ "NetworkRequest" SG_ 980 Lamp_ExtrnlTailLmpOnReq_Copy_0 0;
BA_ "UserSigValidity" SG_ 980 Lamp_ExtrnlTailLmpOnReq_Copy_0 0;
BA_ "GenSigSendType" SG_ 980 Lamp_ExtrnlTailLmpOnReq_Copy_0 4;
BA_ "Description" SG_ 980 Lamp_ExtrnlTailLmpOnReq_Copy_0 "-(Old)C_EXTTailOn";
BA_ "Version" SG_ 980 Lamp_HdLmpLoOnReq_Copy_0 "17.12.00";
BA_ "NetworkRequestHoldingTime" SG_ 980 Lamp_HdLmpLoOnReq_Copy_0 5000;
BA_ "NetworkRequest" SG_ 980 Lamp_HdLmpLoOnReq_Copy_0 0;
BA_ "UserSigValidity" SG_ 980 Lamp_HdLmpLoOnReq_Copy_0 0;
BA_ "GenSigSendType" SG_ 980 Lamp_HdLmpLoOnReq_Copy_0 4;
BA_ "Description" SG_ 980 Lamp_HdLmpLoOnReq_Copy_0 "-(Old)C_HLampLowON";
BA_ "Version" SG_ 980 Lamp_HdLmpHiOnReq_Copy_0 "17.12.00";
BA_ "NetworkRequestHoldingTime" SG_ 980 Lamp_HdLmpHiOnReq_Copy_0 5000;
BA_ "NetworkRequest" SG_ 980 Lamp_HdLmpHiOnReq_Copy_0 0;
BA_ "UserSigValidity" SG_ 980 Lamp_HdLmpHiOnReq_Copy_0 0;
BA_ "GenSigSendType" SG_ 980 Lamp_HdLmpHiOnReq_Copy_0 4;
BA_ "Description" SG_ 980 Lamp_HdLmpHiOnReq_Copy_0 "-(Old)C_HLampHighON";
BA_ "Version" SG_ 980 Lamp_DrlOnReq_Copy_0 "20.09.00";
BA_ "NetworkRequestHoldingTime" SG_ 980 Lamp_DrlOnReq_Copy_0 5000;
BA_ "NetworkRequest" SG_ 980 Lamp_DrlOnReq_Copy_0 0;
BA_ "UserSigValidity" SG_ 980 Lamp_DrlOnReq_Copy_0 0;
BA_ "GenSigSendType" SG_ 980 Lamp_DrlOnReq_Copy_0 4;
BA_ "Description" SG_ 980 Lamp_DrlOnReq_Copy_0 "Lamp on command for DRL";
BA_ "Version" SG_ 980 Lamp_BckUpLmpCmd_Copy_0 "20.08.02";
BA_ "NetworkRequestHoldingTime" SG_ 980 Lamp_BckUpLmpCmd_Copy_0 5000;
BA_ "NetworkRequest" SG_ 980 Lamp_BckUpLmpCmd_Copy_0 0;
BA_ "UserSigValidity" SG_ 980 Lamp_BckUpLmpCmd_Copy_0 0;
BA_ "GenSigSendType" SG_ 980 Lamp_BckUpLmpCmd_Copy_0 4;
BA_ "Description" SG_ 980 Lamp_BckUpLmpCmd_Copy_0 "BackUp Lamp On/Off Command";
BA_ "Version" SG_ 980 Lamp_FrFogLmpOnReq_Copy_0 "17.12.00";
BA_ "NetworkRequestHoldingTime" SG_ 980 Lamp_FrFogLmpOnReq_Copy_0 5000;
BA_ "NetworkRequest" SG_ 980 Lamp_FrFogLmpOnReq_Copy_0 0;
BA_ "UserSigValidity" SG_ 980 Lamp_FrFogLmpOnReq_Copy_0 0;
BA_ "GenSigSendType" SG_ 980 Lamp_FrFogLmpOnReq_Copy_0 4;
BA_ "Version" SG_ 980 Lamp_RrFogLmpOnReq_Copy_0 "17.12.00";
BA_ "NetworkRequestHoldingTime" SG_ 980 Lamp_RrFogLmpOnReq_Copy_0 5000;
BA_ "NetworkRequest" SG_ 980 Lamp_RrFogLmpOnReq_Copy_0 0;
BA_ "UserSigValidity" SG_ 980 Lamp_RrFogLmpOnReq_Copy_0 0;
BA_ "GenSigSendType" SG_ 980 Lamp_RrFogLmpOnReq_Copy_0 4;
BA_ "Version" SG_ 980 Lamp_StcBendingLmpLftOnReq_Copy_ "20.08.02";
BA_ "NetworkRequestHoldingTime" SG_ 980 Lamp_StcBendingLmpLftOnReq_Copy_ 5000;
BA_ "NetworkRequest" SG_ 980 Lamp_StcBendingLmpLftOnReq_Copy_ 0;
BA_ "UserSigValidity" SG_ 980 Lamp_StcBendingLmpLftOnReq_Copy_ 0;
BA_ "GenSigSendType" SG_ 980 Lamp_StcBendingLmpLftOnReq_Copy_ 4;
BA_ "Description" SG_ 980 Lamp_StcBendingLmpLftOnReq_Copy_ "-(Old)C_StaticBend_LH_On";
BA_ "SystemSignalLongSymbol" SG_ 980 Lamp_StcBendingLmpLftOnReq_Copy_ "Lamp_StcBendingLmpLftOnReq_Copy_0";
BA_ "Version" SG_ 980 Lamp_StcBendingLmpRtOnReq_Copy_0 "20.08.02";
BA_ "NetworkRequestHoldingTime" SG_ 980 Lamp_StcBendingLmpRtOnReq_Copy_0 5000;
BA_ "NetworkRequest" SG_ 980 Lamp_StcBendingLmpRtOnReq_Copy_0 0;
BA_ "UserSigValidity" SG_ 980 Lamp_StcBendingLmpRtOnReq_Copy_0 0;
BA_ "GenSigSendType" SG_ 980 Lamp_StcBendingLmpRtOnReq_Copy_0 4;
BA_ "Description" SG_ 980 Lamp_StcBendingLmpRtOnReq_Copy_0 "-(Old)C_StaticBend_RH_On";
BA_ "Version" SG_ 980 Lamp_CornerLmpLftOnReq_Copy_0 "20.08.02";
BA_ "NetworkRequestHoldingTime" SG_ 980 Lamp_CornerLmpLftOnReq_Copy_0 5000;
BA_ "NetworkRequest" SG_ 980 Lamp_CornerLmpLftOnReq_Copy_0 0;
BA_ "UserSigValidity" SG_ 980 Lamp_CornerLmpLftOnReq_Copy_0 0;
BA_ "GenSigSendType" SG_ 980 Lamp_CornerLmpLftOnReq_Copy_0 4;
BA_ "Description" SG_ 980 Lamp_CornerLmpLftOnReq_Copy_0 "cornering lamp control signal";
BA_ "Version" SG_ 980 Lamp_CornerLmpRtOnReq_Copy_0 "20.08.02";
BA_ "NetworkRequestHoldingTime" SG_ 980 Lamp_CornerLmpRtOnReq_Copy_0 5000;
BA_ "NetworkRequest" SG_ 980 Lamp_CornerLmpRtOnReq_Copy_0 0;
BA_ "UserSigValidity" SG_ 980 Lamp_CornerLmpRtOnReq_Copy_0 0;
BA_ "GenSigSendType" SG_ 980 Lamp_CornerLmpRtOnReq_Copy_0 4;
BA_ "Description" SG_ 980 Lamp_CornerLmpRtOnReq_Copy_0 "cornering lamp control signal";
BA_ "Version" SG_ 980 Lamp_HbaCtrlModTyp_Copy_0 "17.12.00";
BA_ "NetworkRequestHoldingTime" SG_ 980 Lamp_HbaCtrlModTyp_Copy_0 5000;
BA_ "NetworkRequest" SG_ 980 Lamp_HbaCtrlModTyp_Copy_0 0;
BA_ "UserSigValidity" SG_ 980 Lamp_HbaCtrlModTyp_Copy_0 0;
BA_ "GenSigSendType" SG_ 980 Lamp_HbaCtrlModTyp_Copy_0 4;
BA_ "Description" SG_ 980 Lamp_HbaCtrlModTyp_Copy_0 "This signal headlamp high control by BCM or HBA";
BA_ "Version" SG_ 980 Lamp_IFSCtrlModTyp_Copy_0 "17.12.00";
BA_ "NetworkRequestHoldingTime" SG_ 980 Lamp_IFSCtrlModTyp_Copy_0 5000;
BA_ "NetworkRequest" SG_ 980 Lamp_IFSCtrlModTyp_Copy_0 0;
BA_ "UserSigValidity" SG_ 980 Lamp_IFSCtrlModTyp_Copy_0 0;
BA_ "GenSigSendType" SG_ 980 Lamp_IFSCtrlModTyp_Copy_0 4;
BA_ "Description" SG_ 980 Lamp_IFSCtrlModTyp_Copy_0 "This signal headlamp high control by BCM or IFS";
BA_ "Version" SG_ 980 Lamp_HdLmpWlcmCmd_Copy_0 "23.07.06";
BA_ "NetworkRequestHoldingTime" SG_ 980 Lamp_HdLmpWlcmCmd_Copy_0 5000;
BA_ "NetworkRequest" SG_ 980 Lamp_HdLmpWlcmCmd_Copy_0 0;
BA_ "UserSigValidity" SG_ 980 Lamp_HdLmpWlcmCmd_Copy_0 0;
BA_ "GenSigSendType" SG_ 980 Lamp_HdLmpWlcmCmd_Copy_0 4;
BA_ "Description" SG_ 980 Lamp_HdLmpWlcmCmd_Copy_0 "HeadLamp Welcome Cmd 

- receiver : ICU (CGW)";
BA_ "Version" SG_ 980 Lamp_PuddleLmpOnReq_Copy_0 "17.12.00";
BA_ "NetworkRequestHoldingTime" SG_ 980 Lamp_PuddleLmpOnReq_Copy_0 5000;
BA_ "NetworkRequest" SG_ 980 Lamp_PuddleLmpOnReq_Copy_0 0;
BA_ "UserSigValidity" SG_ 980 Lamp_PuddleLmpOnReq_Copy_0 0;
BA_ "GenSigSendType" SG_ 980 Lamp_PuddleLmpOnReq_Copy_0 4;
BA_ "Description" SG_ 980 Lamp_PuddleLmpOnReq_Copy_0 "Puddle Lamp command";
BA_ "Version" SG_ 980 Lamp_ExtLampRSPAMode_Copy_0 "21.09.05";
BA_ "NetworkRequestHoldingTime" SG_ 980 Lamp_ExtLampRSPAMode_Copy_0 5000;
BA_ "NetworkRequest" SG_ 980 Lamp_ExtLampRSPAMode_Copy_0 0;
BA_ "UserSigValidity" SG_ 980 Lamp_ExtLampRSPAMode_Copy_0 0;
BA_ "GenSigSendType" SG_ 980 Lamp_ExtLampRSPAMode_Copy_0 4;
BA_ "Description" SG_ 980 Lamp_ExtLampRSPAMode_Copy_0 "RSPA Mode for Box/Cargo Lamp";
BA_ "Version" SG_ 980 Lamp_IntTailLmpOnReq_Copy_0 "17.12.00";
BA_ "NetworkRequestHoldingTime" SG_ 980 Lamp_IntTailLmpOnReq_Copy_0 5000;
BA_ "NetworkRequest" SG_ 980 Lamp_IntTailLmpOnReq_Copy_0 0;
BA_ "UserSigValidity" SG_ 980 Lamp_IntTailLmpOnReq_Copy_0 0;
BA_ "GenSigSendType" SG_ 980 Lamp_IntTailLmpOnReq_Copy_0 4;
BA_ "Description" SG_ 980 Lamp_IntTailLmpOnReq_Copy_0 "-(Old)C_INTTailOn";
BA_ "Version" SG_ 980 Lamp_AvTailLmpSta_Copy_0 "21.09.05";
BA_ "NetworkRequestHoldingTime" SG_ 980 Lamp_AvTailLmpSta_Copy_0 5000;
BA_ "NetworkRequest" SG_ 980 Lamp_AvTailLmpSta_Copy_0 0;
BA_ "UserSigValidity" SG_ 980 Lamp_AvTailLmpSta_Copy_0 0;
BA_ "GenSigStartValue" SG_ 980 Lamp_AvTailLmpSta_Copy_0 1;
BA_ "GenSigSendType" SG_ 980 Lamp_AvTailLmpSta_Copy_0 4;
BA_ "Description" SG_ 980 Lamp_AvTailLmpSta_Copy_0 "-Send with at the same time with C_IntTailOn

-Initiail Value: 1";
BA_ "Version" SG_ 980 Lamp_AutoLtSnsrNightSta_Copy_0 "20.04.06";
BA_ "NetworkRequestHoldingTime" SG_ 980 Lamp_AutoLtSnsrNightSta_Copy_0 5000;
BA_ "NetworkRequest" SG_ 980 Lamp_AutoLtSnsrNightSta_Copy_0 0;
BA_ "UserSigValidity" SG_ 980 Lamp_AutoLtSnsrNightSta_Copy_0 0;
BA_ "GenSigStartValue" SG_ 980 Lamp_AutoLtSnsrNightSta_Copy_0 1;
BA_ "GenSigSendType" SG_ 980 Lamp_AutoLtSnsrNightSta_Copy_0 4;
BA_ "Description" SG_ 980 Lamp_AutoLtSnsrNightSta_Copy_0 "This signal indicates autolight sensor output";
BA_ "Version" SG_ 980 Lamp_VendorInfo_Copy_0 "22.12.04";
BA_ "NetworkRequestHoldingTime" SG_ 980 Lamp_VendorInfo_Copy_0 5000;
BA_ "NetworkRequest" SG_ 980 Lamp_VendorInfo_Copy_0 0;
BA_ "UserSigValidity" SG_ 980 Lamp_VendorInfo_Copy_0 0;
BA_ "GenSigStartValue" SG_ 980 Lamp_VendorInfo_Copy_0 7;
BA_ "GenSigSendType" SG_ 980 Lamp_VendorInfo_Copy_0 4;
BA_ "Description" SG_ 980 Lamp_VendorInfo_Copy_0 "Rain sensor Vendor info (LIN to CAN signal)

  - Not applied standard sensor : 0x1 or 0x2

  - Applied standard sensor : 0x3 or 0x4";
BA_ "Version" SG_ 980 Lamp_AutoLtSnsrHorVal_Copy_0 "21.12.00";
BA_ "NetworkRequestHoldingTime" SG_ 980 Lamp_AutoLtSnsrHorVal_Copy_0 5000;
BA_ "NetworkRequest" SG_ 980 Lamp_AutoLtSnsrHorVal_Copy_0 0;
BA_ "UserSigValidity" SG_ 980 Lamp_AutoLtSnsrHorVal_Copy_0 0;
BA_ "GenSigSendType" SG_ 980 Lamp_AutoLtSnsrHorVal_Copy_0 4;
BA_ "Description" SG_ 980 Lamp_AutoLtSnsrHorVal_Copy_0 "This signal indicates autolight sensor output (for HUD)

<BCS>

0x0~0x3FE : Light Sensor Value

0x3FF : Invalid

<HELLA>

0x0~0xFE, 100~0x3FE : Light Sensor Value

0xFF, 0x3FF : Invalid";
BA_ "Version" SG_ 980 MoodLamp_AIVoiceOptSta "22.11.02";
BA_ "NetworkRequestHoldingTime" SG_ 980 MoodLamp_AIVoiceOptSta 5000;
BA_ "NetworkRequest" SG_ 980 MoodLamp_AIVoiceOptSta 0;
BA_ "UserSigValidity" SG_ 980 MoodLamp_AIVoiceOptSta 0;
BA_ "GenSigSendType" SG_ 980 MoodLamp_AIVoiceOptSta 4;
BA_ "Version" SG_ 980 MoodLamp_DualColorOptSta "22.11.02";
BA_ "NetworkRequestHoldingTime" SG_ 980 MoodLamp_DualColorOptSta 5000;
BA_ "NetworkRequest" SG_ 980 MoodLamp_DualColorOptSta 0;
BA_ "UserSigValidity" SG_ 980 MoodLamp_DualColorOptSta 0;
BA_ "GenSigSendType" SG_ 980 MoodLamp_DualColorOptSta 4;
BA_ "Version" SG_ 980 MoodLamp_MdLmpFadeSta "22.11.02";
BA_ "NetworkRequestHoldingTime" SG_ 980 MoodLamp_MdLmpFadeSta 5000;
BA_ "NetworkRequest" SG_ 980 MoodLamp_MdLmpFadeSta 0;
BA_ "UserSigValidity" SG_ 980 MoodLamp_MdLmpFadeSta 0;
BA_ "GenSigSendType" SG_ 980 MoodLamp_MdLmpFadeSta 4;
BA_ "Version" SG_ 980 MoodLamp_NumRecommendColor "22.11.02";
BA_ "NetworkRequestHoldingTime" SG_ 980 MoodLamp_NumRecommendColor 5000;
BA_ "NetworkRequest" SG_ 980 MoodLamp_NumRecommendColor 0;
BA_ "UserSigValidity" SG_ 980 MoodLamp_NumRecommendColor 0;
BA_ "GenSigSendType" SG_ 980 MoodLamp_NumRecommendColor 4;
BA_ "Version" SG_ 980 AutoLt_HorVal_STD "22.12.04";
BA_ "NetworkRequestHoldingTime" SG_ 980 AutoLt_HorVal_STD 5000;
BA_ "NetworkRequest" SG_ 980 AutoLt_HorVal_STD 0;
BA_ "UserSigValidity" SG_ 980 AutoLt_HorVal_STD 0;
BA_ "GenSigSendType" SG_ 980 AutoLt_HorVal_STD 4;
BA_ "Description" SG_ 980 AutoLt_HorVal_STD "This signal is standard horizontal value of autolight sensor



Horizontal brightness(lux)=AutoLt_HorRes_STD*AutoLt_HorVal_STD

б╪ AutoLt_HorRes_STD : Horizontal resolution signal

Brightness 0~1,000lux : Resolution is 1lux and value is 0(0h)~1,000(3E8h)";
BA_ "Version" SG_ 2683310247 ROA_Dev_07 "23.07.02";
BA_ "UserSigValidity" SG_ 2683310247 ROA_Dev_07 0;
BA_ "GenSigSendType" SG_ 2683310247 ROA_Dev_07 2;
BA_ "Version" SG_ 2683310246 ROA_Dev_06 "23.07.02";
BA_ "UserSigValidity" SG_ 2683310246 ROA_Dev_06 0;
BA_ "GenSigSendType" SG_ 2683310246 ROA_Dev_06 2;
BA_ "Version" SG_ 2683310245 ROA_Dev_05 "23.07.02";
BA_ "UserSigValidity" SG_ 2683310245 ROA_Dev_05 0;
BA_ "GenSigSendType" SG_ 2683310245 ROA_Dev_05 2;
BA_ "Version" SG_ 2683310244 ROA_Dev_04 "23.07.02";
BA_ "UserSigValidity" SG_ 2683310244 ROA_Dev_04 0;
BA_ "GenSigSendType" SG_ 2683310244 ROA_Dev_04 2;
BA_ "Version" SG_ 2683310243 ROA_Dev_03 "23.07.02";
BA_ "UserSigValidity" SG_ 2683310243 ROA_Dev_03 0;
BA_ "GenSigSendType" SG_ 2683310243 ROA_Dev_03 2;
BA_ "Version" SG_ 2683310242 ROA_Dev_02 "23.07.02";
BA_ "UserSigValidity" SG_ 2683310242 ROA_Dev_02 0;
BA_ "GenSigSendType" SG_ 2683310242 ROA_Dev_02 2;
BA_ "Version" SG_ 2683310241 ROA_Dev_01 "23.07.02";
BA_ "UserSigValidity" SG_ 2683310241 ROA_Dev_01 0;
BA_ "GenSigSendType" SG_ 2683310241 ROA_Dev_01 2;
BA_ "Version" SG_ 2281701600 L_UWB_FRNK_FD_Crc10Val "23.01.02";
BA_ "UserSigValidity" SG_ 2281701600 L_UWB_FRNK_FD_Crc10Val 3;
BA_ "GenSigStartValue" SG_ 2281701600 L_UWB_FRNK_FD_Crc10Val 65535;
BA_ "GenSigSendType" SG_ 2281701600 L_UWB_FRNK_FD_Crc10Val 4;
BA_ "Description" SG_ 2281701600 L_UWB_FRNK_FD_Crc10Val "The data area for CRC calculation is based on the data length (DLC) of the message DB.

The CRC shall be calculated over the entire data block (excluding the CRC bytes) including the user data, alive counter and Data ID



- CRC Polynomial (0x1021) , Ini";
BA_ "Version" SG_ 2281701600 UWB_FRNK_SW_MCU_Ver_Major "23.01.02";
BA_ "UserSigValidity" SG_ 2281701600 UWB_FRNK_SW_MCU_Ver_Major 0;
BA_ "GenSigSendType" SG_ 2281701600 UWB_FRNK_SW_MCU_Ver_Major 4;
BA_ "Version" SG_ 2281701600 UWB_FRNK_SW_MCU_Ver_Minor "23.01.02";
BA_ "UserSigValidity" SG_ 2281701600 UWB_FRNK_SW_MCU_Ver_Minor 0;
BA_ "GenSigSendType" SG_ 2281701600 UWB_FRNK_SW_MCU_Ver_Minor 4;
BA_ "Version" SG_ 2281701600 UWB_FRNK_SW_IC_Ver_Major "23.01.02";
BA_ "UserSigValidity" SG_ 2281701600 UWB_FRNK_SW_IC_Ver_Major 0;
BA_ "GenSigSendType" SG_ 2281701600 UWB_FRNK_SW_IC_Ver_Major 4;
BA_ "Version" SG_ 2281701600 UWB_FRNK_SW_IC_Ver_Minor "23.01.02";
BA_ "UserSigValidity" SG_ 2281701600 UWB_FRNK_SW_IC_Ver_Minor 0;
BA_ "GenSigSendType" SG_ 2281701600 UWB_FRNK_SW_IC_Ver_Minor 4;
BA_ "Version" SG_ 2281701600 UWB_FRNK_DTC "23.01.02";
BA_ "UserSigValidity" SG_ 2281701600 UWB_FRNK_DTC 0;
BA_ "GenSigSendType" SG_ 2281701600 UWB_FRNK_DTC 4;
BA_ "Version" SG_ 2281701600 L_UWB_FRNK_FD_AlvCnt10Val "23.01.02";
BA_ "UserSigValidity" SG_ 2281701600 L_UWB_FRNK_FD_AlvCnt10Val 3;
BA_ "GenSigSendType" SG_ 2281701600 L_UWB_FRNK_FD_AlvCnt10Val 4;
BA_ "Description" SG_ 2281701600 L_UWB_FRNK_FD_AlvCnt10Val "For the first transmission request for a data element the counter shall be initialized with 0 and shall be incremented by 1 for every subsequent send request. 

When the counter reaches the maximum value(0xFF), then it shall restart with 0 for the next s";
BA_ "Version" SG_ 2281701600 UWB_FRNK_Status1 "24.04.04";
BA_ "UserSigValidity" SG_ 2281701600 UWB_FRNK_Status1 0;
BA_ "GenSigSendType" SG_ 2281701600 UWB_FRNK_Status1 4;
BA_ "Description" SG_ 2281701600 UWB_FRNK_Status1 "UWB_FRNK Processing Status 1";
BA_ "Version" SG_ 2281701600 UWB_FRNK_Status2 "24.04.04";
BA_ "UserSigValidity" SG_ 2281701600 UWB_FRNK_Status2 0;
BA_ "GenSigSendType" SG_ 2281701600 UWB_FRNK_Status2 4;
BA_ "Description" SG_ 2281701600 UWB_FRNK_Status2 "UWB_FRNK Processing Status 2";
BA_ "Version" SG_ 2281701600 UWB_FRNK_Status3 "24.04.04";
BA_ "UserSigValidity" SG_ 2281701600 UWB_FRNK_Status3 0;
BA_ "GenSigSendType" SG_ 2281701600 UWB_FRNK_Status3 4;
BA_ "Description" SG_ 2281701600 UWB_FRNK_Status3 "UWB_FRNK Processing Status 3";
BA_ "Version" SG_ 2281701600 UWB_FRNK_Status4 "24.04.04";
BA_ "UserSigValidity" SG_ 2281701600 UWB_FRNK_Status4 0;
BA_ "GenSigSendType" SG_ 2281701600 UWB_FRNK_Status4 4;
BA_ "Description" SG_ 2281701600 UWB_FRNK_Status4 "UWB_FRNK Processing Status 4";
BA_ "Version" SG_ 2281701600 UWB_FRNK_Status5 "24.04.04";
BA_ "UserSigValidity" SG_ 2281701600 UWB_FRNK_Status5 0;
BA_ "GenSigSendType" SG_ 2281701600 UWB_FRNK_Status5 4;
BA_ "Description" SG_ 2281701600 UWB_FRNK_Status5 "UWB_FRNK Processing Status 5";
BA_ "Version" SG_ 2281701600 UWB_FRNK_Status6 "24.04.04";
BA_ "UserSigValidity" SG_ 2281701600 UWB_FRNK_Status6 0;
BA_ "GenSigSendType" SG_ 2281701600 UWB_FRNK_Status6 4;
BA_ "Description" SG_ 2281701600 UWB_FRNK_Status6 "UWB_FRNK Processing Status 6";
BA_ "Version" SG_ 2281701600 UWB_FRNK_Status7 "24.04.04";
BA_ "UserSigValidity" SG_ 2281701600 UWB_FRNK_Status7 0;
BA_ "GenSigSendType" SG_ 2281701600 UWB_FRNK_Status7 4;
BA_ "Description" SG_ 2281701600 UWB_FRNK_Status7 "UWB_FRNK Processing Status 7";
BA_ "Version" SG_ 2281701600 UWB_FRNK_Status8 "24.04.04";
BA_ "UserSigValidity" SG_ 2281701600 UWB_FRNK_Status8 0;
BA_ "GenSigSendType" SG_ 2281701600 UWB_FRNK_Status8 4;
BA_ "Description" SG_ 2281701600 UWB_FRNK_Status8 "UWB_FRNK Processing Status 8";
BA_ "Version" SG_ 2281701600 UWB_FRNK_Status9 "24.04.04";
BA_ "UserSigValidity" SG_ 2281701600 UWB_FRNK_Status9 0;
BA_ "GenSigSendType" SG_ 2281701600 UWB_FRNK_Status9 4;
BA_ "Description" SG_ 2281701600 UWB_FRNK_Status9 "UWB_FRNK Processing Status 9";
BA_ "Version" SG_ 2281701600 UWB_FRNK_Status10 "24.04.04";
BA_ "UserSigValidity" SG_ 2281701600 UWB_FRNK_Status10 0;
BA_ "GenSigSendType" SG_ 2281701600 UWB_FRNK_Status10 4;
BA_ "Description" SG_ 2281701600 UWB_FRNK_Status10 "UWB_FRNK Processing Status 10";
BA_ "Version" SG_ 2281701600 UWB_FRNK_Status11 "24.04.04";
BA_ "UserSigValidity" SG_ 2281701600 UWB_FRNK_Status11 0;
BA_ "GenSigSendType" SG_ 2281701600 UWB_FRNK_Status11 4;
BA_ "Description" SG_ 2281701600 UWB_FRNK_Status11 "UWB_FRNK Processing Status 11";
BA_ "Version" SG_ 2281701600 UWB_FRNK_Status12 "24.04.04";
BA_ "UserSigValidity" SG_ 2281701600 UWB_FRNK_Status12 0;
BA_ "GenSigSendType" SG_ 2281701600 UWB_FRNK_Status12 4;
BA_ "Description" SG_ 2281701600 UWB_FRNK_Status12 "UWB_FRNK Processing Status 12";
BA_ "Version" SG_ 2281701600 UWB_FRNK_Status13 "24.04.04";
BA_ "UserSigValidity" SG_ 2281701600 UWB_FRNK_Status13 0;
BA_ "GenSigSendType" SG_ 2281701600 UWB_FRNK_Status13 4;
BA_ "Description" SG_ 2281701600 UWB_FRNK_Status13 "UWB_FRNK Processing Status 13";
BA_ "Version" SG_ 2281701600 UWB_FRNK_Status14 "24.04.04";
BA_ "UserSigValidity" SG_ 2281701600 UWB_FRNK_Status14 0;
BA_ "GenSigSendType" SG_ 2281701600 UWB_FRNK_Status14 4;
BA_ "Description" SG_ 2281701600 UWB_FRNK_Status14 "UWB_FRNK Processing Status 14";
BA_ "Version" SG_ 2281701600 UWB_FRNK_Status15 "24.04.04";
BA_ "UserSigValidity" SG_ 2281701600 UWB_FRNK_Status15 0;
BA_ "GenSigSendType" SG_ 2281701600 UWB_FRNK_Status15 4;
BA_ "Description" SG_ 2281701600 UWB_FRNK_Status15 "UWB_FRNK Processing Status 15";
BA_ "Version" SG_ 2281701600 UWB_FRNK_Status16 "24.04.04";
BA_ "UserSigValidity" SG_ 2281701600 UWB_FRNK_Status16 0;
BA_ "GenSigSendType" SG_ 2281701600 UWB_FRNK_Status16 4;
BA_ "Description" SG_ 2281701600 UWB_FRNK_Status16 "UWB_FRNK Processing Status 16";
BA_ "Version" SG_ 2281701600 UWB_FRNK_HW_Ver_Major "23.01.02";
BA_ "UserSigValidity" SG_ 2281701600 UWB_FRNK_HW_Ver_Major 0;
BA_ "GenSigSendType" SG_ 2281701600 UWB_FRNK_HW_Ver_Major 4;
BA_ "Version" SG_ 2281701600 UWB_FRNK_HW_Ver_Minor "23.01.02";
BA_ "UserSigValidity" SG_ 2281701600 UWB_FRNK_HW_Ver_Minor 0;
BA_ "GenSigSendType" SG_ 2281701600 UWB_FRNK_HW_Ver_Minor 4;
BA_ "Version" SG_ 2683310240 ROA_Dev_00 "23.07.02";
BA_ "UserSigValidity" SG_ 2683310240 ROA_Dev_00 0;
BA_ "GenSigSendType" SG_ 2683310240 ROA_Dev_00 2;
BA_ "Version" SG_ 2683310250 ROA_Dev_10 "23.07.02";
BA_ "UserSigValidity" SG_ 2683310250 ROA_Dev_10 0;
BA_ "GenSigSendType" SG_ 2683310250 ROA_Dev_10 2;
BA_ "Version" SG_ 2683310249 ROA_Dev_09 "23.07.02";
BA_ "UserSigValidity" SG_ 2683310249 ROA_Dev_09 0;
BA_ "GenSigSendType" SG_ 2683310249 ROA_Dev_09 2;
BA_ "Version" SG_ 2683310248 ROA_Dev_08 "23.07.02";
BA_ "UserSigValidity" SG_ 2683310248 ROA_Dev_08 0;
BA_ "GenSigSendType" SG_ 2683310248 ROA_Dev_08 2;
BA_ "UserSigValidity" SG_ 2549874733 SNI_L_DHRR_FD 0;
BA_ "UsrSigPurpose" SG_ 2549874733 SNI_L_DHRR_FD 8;
BA_ "UserSigValidity" SG_ 2549874733 CBV_RMR_L_DHRR_FD 0;
BA_ "UsrSigPurpose" SG_ 2549874733 CBV_RMR_L_DHRR_FD 8;
BA_ "UserSigValidity" SG_ 2549874733 CBV_NMCoID_L_DHRR_FD 0;
BA_ "UsrSigPurpose" SG_ 2549874733 CBV_NMCoID_L_DHRR_FD 8;
BA_ "UserSigValidity" SG_ 2549874733 CBV_NMCoSRB_L_DHRR_FD 0;
BA_ "UsrSigPurpose" SG_ 2549874733 CBV_NMCoSRB_L_DHRR_FD 8;
BA_ "UserSigValidity" SG_ 2549874733 CBV_AWB_L_DHRR_FD 0;
BA_ "UsrSigPurpose" SG_ 2549874733 CBV_AWB_L_DHRR_FD 8;
BA_ "UserSigValidity" SG_ 2549874733 CBV_PNIB_L_DHRR_FD 0;
BA_ "UsrSigPurpose" SG_ 2549874733 CBV_PNIB_L_DHRR_FD 8;
BA_ "UserSigValidity" SG_ 2549874733 NRR_L_DHRR_FD 0;
BA_ "UsrSigPurpose" SG_ 2549874733 NRR_L_DHRR_FD 8;
BA_ "UserSigValidity" SG_ 2549874733 NM_State_L_DHRR_FD 0;
BA_ "UsrSigPurpose" SG_ 2549874733 NM_State_L_DHRR_FD 8;
BA_ "UserSigValidity" SG_ 2549874733 PNI_L_DHRR_FD 0;
BA_ "UsrSigPurpose" SG_ 2549874733 PNI_L_DHRR_FD 8;
BA_ "UserSigValidity" SG_ 2549874733 PNI_L_DHRR_FD_1 0;
BA_ "UsrSigPurpose" SG_ 2549874733 PNI_L_DHRR_FD_1 8;
BA_ "UserSigValidity" SG_ 2549874733 PNI_L_DHRR_FD_2 0;
BA_ "UsrSigPurpose" SG_ 2549874733 PNI_L_DHRR_FD_2 8;
BA_ "UserSigValidity" SG_ 2549874733 PNI_L_DHRR_FD_3 0;
BA_ "UsrSigPurpose" SG_ 2549874733 PNI_L_DHRR_FD_3 8;
BA_ "UserSigValidity" SG_ 2549874720 SNI_L_UWB_BLE_MST_FD 0;
BA_ "UsrSigPurpose" SG_ 2549874720 SNI_L_UWB_BLE_MST_FD 8;
BA_ "UserSigValidity" SG_ 2549874720 CBV_RMR_L_UWB_BLE_MST_FD 0;
BA_ "UsrSigPurpose" SG_ 2549874720 CBV_RMR_L_UWB_BLE_MST_FD 8;
BA_ "UserSigValidity" SG_ 2549874720 CBV_NMCoID_L_UWB_BLE_MST_FD 0;
BA_ "UsrSigPurpose" SG_ 2549874720 CBV_NMCoID_L_UWB_BLE_MST_FD 8;
BA_ "UserSigValidity" SG_ 2549874720 CBV_NMCoSRB_L_UWB_BLE_MST_FD 0;
BA_ "UsrSigPurpose" SG_ 2549874720 CBV_NMCoSRB_L_UWB_BLE_MST_FD 8;
BA_ "UserSigValidity" SG_ 2549874720 CBV_AWB_L_UWB_BLE_MST_FD 0;
BA_ "UsrSigPurpose" SG_ 2549874720 CBV_AWB_L_UWB_BLE_MST_FD 8;
BA_ "UserSigValidity" SG_ 2549874720 CBV_PNIB_L_UWB_BLE_MST_FD 0;
BA_ "UsrSigPurpose" SG_ 2549874720 CBV_PNIB_L_UWB_BLE_MST_FD 8;
BA_ "UserSigValidity" SG_ 2549874720 NRR_L_UWB_BLE_MST_FD 0;
BA_ "UsrSigPurpose" SG_ 2549874720 NRR_L_UWB_BLE_MST_FD 8;
BA_ "UserSigValidity" SG_ 2549874720 NM_State_L_UWB_BLE_MST_FD 0;
BA_ "UsrSigPurpose" SG_ 2549874720 NM_State_L_UWB_BLE_MST_FD 8;
BA_ "UserSigValidity" SG_ 2549874720 PNI_L_UWB_BLE_MST_FD 0;
BA_ "UsrSigPurpose" SG_ 2549874720 PNI_L_UWB_BLE_MST_FD 8;
BA_ "UserSigValidity" SG_ 2549874720 PNI_L_UWB_BLE_MST_FD_1 0;
BA_ "UsrSigPurpose" SG_ 2549874720 PNI_L_UWB_BLE_MST_FD_1 8;
BA_ "UserSigValidity" SG_ 2549874720 PNI_L_UWB_BLE_MST_FD_2 0;
BA_ "UsrSigPurpose" SG_ 2549874720 PNI_L_UWB_BLE_MST_FD_2 8;
BA_ "UserSigValidity" SG_ 2549874720 PNI_L_UWB_BLE_MST_FD_3 0;
BA_ "UsrSigPurpose" SG_ 2549874720 PNI_L_UWB_BLE_MST_FD_3 8;
BA_ "UserSigValidity" SG_ 2549874726 SNI_L_UWB_RR_FD 0;
BA_ "UsrSigPurpose" SG_ 2549874726 SNI_L_UWB_RR_FD 8;
BA_ "UserSigValidity" SG_ 2549874726 CBV_RMR_L_UWB_RR_FD 0;
BA_ "UsrSigPurpose" SG_ 2549874726 CBV_RMR_L_UWB_RR_FD 8;
BA_ "UserSigValidity" SG_ 2549874726 CBV_NMCoID_L_UWB_RR_FD 0;
BA_ "UsrSigPurpose" SG_ 2549874726 CBV_NMCoID_L_UWB_RR_FD 8;
BA_ "UserSigValidity" SG_ 2549874726 CBV_NMCoSRB_L_UWB_RR_FD 0;
BA_ "UsrSigPurpose" SG_ 2549874726 CBV_NMCoSRB_L_UWB_RR_FD 8;
BA_ "UserSigValidity" SG_ 2549874726 CBV_AWB_L_UWB_RR_FD 0;
BA_ "UsrSigPurpose" SG_ 2549874726 CBV_AWB_L_UWB_RR_FD 8;
BA_ "UserSigValidity" SG_ 2549874726 CBV_PNIB_L_UWB_RR_FD 0;
BA_ "UsrSigPurpose" SG_ 2549874726 CBV_PNIB_L_UWB_RR_FD 8;
BA_ "UserSigValidity" SG_ 2549874726 NRR_L_UWB_RR_FD 0;
BA_ "UsrSigPurpose" SG_ 2549874726 NRR_L_UWB_RR_FD 8;
BA_ "UserSigValidity" SG_ 2549874726 NM_State_L_UWB_RR_FD 0;
BA_ "UsrSigPurpose" SG_ 2549874726 NM_State_L_UWB_RR_FD 8;
BA_ "UserSigValidity" SG_ 2549874726 PNI_L_UWB_RR_FD 0;
BA_ "UsrSigPurpose" SG_ 2549874726 PNI_L_UWB_RR_FD 8;
BA_ "UserSigValidity" SG_ 2549874726 PNI_L_UWB_RR_FD_1 0;
BA_ "UsrSigPurpose" SG_ 2549874726 PNI_L_UWB_RR_FD_1 8;
BA_ "UserSigValidity" SG_ 2549874726 PNI_L_UWB_RR_FD_2 0;
BA_ "UsrSigPurpose" SG_ 2549874726 PNI_L_UWB_RR_FD_2 8;
BA_ "UserSigValidity" SG_ 2549874726 PNI_L_UWB_RR_FD_3 0;
BA_ "UsrSigPurpose" SG_ 2549874726 PNI_L_UWB_RR_FD_3 8;
BA_ "UserSigValidity" SG_ 2549874721 SNI_L_UWB_BLE_SLV_FD 0;
BA_ "UsrSigPurpose" SG_ 2549874721 SNI_L_UWB_BLE_SLV_FD 8;
BA_ "UserSigValidity" SG_ 2549874721 CBV_RMR_L_UWB_BLE_SLV_FD 0;
BA_ "UsrSigPurpose" SG_ 2549874721 CBV_RMR_L_UWB_BLE_SLV_FD 8;
BA_ "UserSigValidity" SG_ 2549874721 CBV_NMCoID_L_UWB_BLE_SLV_FD 0;
BA_ "UsrSigPurpose" SG_ 2549874721 CBV_NMCoID_L_UWB_BLE_SLV_FD 8;
BA_ "UserSigValidity" SG_ 2549874721 CBV_NMCoSRB_L_UWB_BLE_SLV_FD 0;
BA_ "UsrSigPurpose" SG_ 2549874721 CBV_NMCoSRB_L_UWB_BLE_SLV_FD 8;
BA_ "UserSigValidity" SG_ 2549874721 CBV_AWB_L_UWB_BLE_SLV_FD 0;
BA_ "UsrSigPurpose" SG_ 2549874721 CBV_AWB_L_UWB_BLE_SLV_FD 8;
BA_ "UserSigValidity" SG_ 2549874721 CBV_PNIB_L_UWB_BLE_SLV_FD 0;
BA_ "UsrSigPurpose" SG_ 2549874721 CBV_PNIB_L_UWB_BLE_SLV_FD 8;
BA_ "UserSigValidity" SG_ 2549874721 NRR_L_UWB_BLE_SLV_FD 0;
BA_ "UsrSigPurpose" SG_ 2549874721 NRR_L_UWB_BLE_SLV_FD 8;
BA_ "UserSigValidity" SG_ 2549874721 NM_State_L_UWB_BLE_SLV_FD 0;
BA_ "UsrSigPurpose" SG_ 2549874721 NM_State_L_UWB_BLE_SLV_FD 8;
BA_ "UserSigValidity" SG_ 2549874721 PNI_L_UWB_BLE_SLV_FD 0;
BA_ "UsrSigPurpose" SG_ 2549874721 PNI_L_UWB_BLE_SLV_FD 8;
BA_ "UserSigValidity" SG_ 2549874721 PNI_L_UWB_BLE_SLV_FD_1 0;
BA_ "UsrSigPurpose" SG_ 2549874721 PNI_L_UWB_BLE_SLV_FD_1 8;
BA_ "UserSigValidity" SG_ 2549874721 PNI_L_UWB_BLE_SLV_FD_2 0;
BA_ "UsrSigPurpose" SG_ 2549874721 PNI_L_UWB_BLE_SLV_FD_2 8;
BA_ "UserSigValidity" SG_ 2549874721 PNI_L_UWB_BLE_SLV_FD_3 0;
BA_ "UsrSigPurpose" SG_ 2549874721 PNI_L_UWB_BLE_SLV_FD_3 8;
BA_ "UserSigValidity" SG_ 2549874723 SNI_L_UWB_FR_FD 0;
BA_ "UsrSigPurpose" SG_ 2549874723 SNI_L_UWB_FR_FD 8;
BA_ "UserSigValidity" SG_ 2549874723 CBV_RMR_L_UWB_FR_FD 0;
BA_ "UsrSigPurpose" SG_ 2549874723 CBV_RMR_L_UWB_FR_FD 8;
BA_ "UserSigValidity" SG_ 2549874723 CBV_NMCoID_L_UWB_FR_FD 0;
BA_ "UsrSigPurpose" SG_ 2549874723 CBV_NMCoID_L_UWB_FR_FD 8;
BA_ "UserSigValidity" SG_ 2549874723 CBV_NMCoSRB_L_UWB_FR_FD 0;
BA_ "UsrSigPurpose" SG_ 2549874723 CBV_NMCoSRB_L_UWB_FR_FD 8;
BA_ "UserSigValidity" SG_ 2549874723 CBV_AWB_L_UWB_FR_FD 0;
BA_ "UsrSigPurpose" SG_ 2549874723 CBV_AWB_L_UWB_FR_FD 8;
BA_ "UserSigValidity" SG_ 2549874723 CBV_PNIB_L_UWB_FR_FD 0;
BA_ "UsrSigPurpose" SG_ 2549874723 CBV_PNIB_L_UWB_FR_FD 8;
BA_ "UserSigValidity" SG_ 2549874723 NRR_L_UWB_FR_FD 0;
BA_ "UsrSigPurpose" SG_ 2549874723 NRR_L_UWB_FR_FD 8;
BA_ "UserSigValidity" SG_ 2549874723 NM_State_L_UWB_FR_FD 0;
BA_ "UsrSigPurpose" SG_ 2549874723 NM_State_L_UWB_FR_FD 8;
BA_ "UserSigValidity" SG_ 2549874723 PNI_L_UWB_FR_FD 0;
BA_ "UsrSigPurpose" SG_ 2549874723 PNI_L_UWB_FR_FD 8;
BA_ "UserSigValidity" SG_ 2549874723 PNI_L_UWB_FR_FD_1 0;
BA_ "UsrSigPurpose" SG_ 2549874723 PNI_L_UWB_FR_FD_1 8;
BA_ "UserSigValidity" SG_ 2549874723 PNI_L_UWB_FR_FD_2 0;
BA_ "UsrSigPurpose" SG_ 2549874723 PNI_L_UWB_FR_FD_2 8;
BA_ "UserSigValidity" SG_ 2549874723 PNI_L_UWB_FR_FD_3 0;
BA_ "UsrSigPurpose" SG_ 2549874723 PNI_L_UWB_FR_FD_3 8;
BA_ "UserSigValidity" SG_ 2549874732 SNI_L_DHRL_FD 0;
BA_ "UsrSigPurpose" SG_ 2549874732 SNI_L_DHRL_FD 8;
BA_ "UserSigValidity" SG_ 2549874732 CBV_RMR_L_DHRL_FD 0;
BA_ "UsrSigPurpose" SG_ 2549874732 CBV_RMR_L_DHRL_FD 8;
BA_ "UserSigValidity" SG_ 2549874732 CBV_NMCoID_L_DHRL_FD 0;
BA_ "UsrSigPurpose" SG_ 2549874732 CBV_NMCoID_L_DHRL_FD 8;
BA_ "UserSigValidity" SG_ 2549874732 CBV_NMCoSRB_L_DHRL_FD 0;
BA_ "UsrSigPurpose" SG_ 2549874732 CBV_NMCoSRB_L_DHRL_FD 8;
BA_ "UserSigValidity" SG_ 2549874732 CBV_AWB_L_DHRL_FD 0;
BA_ "UsrSigPurpose" SG_ 2549874732 CBV_AWB_L_DHRL_FD 8;
BA_ "UserSigValidity" SG_ 2549874732 CBV_PNIB_L_DHRL_FD 0;
BA_ "UsrSigPurpose" SG_ 2549874732 CBV_PNIB_L_DHRL_FD 8;
BA_ "UserSigValidity" SG_ 2549874732 NRR_L_DHRL_FD 0;
BA_ "UsrSigPurpose" SG_ 2549874732 NRR_L_DHRL_FD 8;
BA_ "UserSigValidity" SG_ 2549874732 NM_State_L_DHRL_FD 0;
BA_ "UsrSigPurpose" SG_ 2549874732 NM_State_L_DHRL_FD 8;
BA_ "UserSigValidity" SG_ 2549874732 PNI_L_DHRL_FD 0;
BA_ "UsrSigPurpose" SG_ 2549874732 PNI_L_DHRL_FD 8;
BA_ "UserSigValidity" SG_ 2549874732 PNI_L_DHRL_FD_1 0;
BA_ "UsrSigPurpose" SG_ 2549874732 PNI_L_DHRL_FD_1 8;
BA_ "UserSigValidity" SG_ 2549874732 PNI_L_DHRL_FD_2 0;
BA_ "UsrSigPurpose" SG_ 2549874732 PNI_L_DHRL_FD_2 8;
BA_ "UserSigValidity" SG_ 2549874732 PNI_L_DHRL_FD_3 0;
BA_ "UsrSigPurpose" SG_ 2549874732 PNI_L_DHRL_FD_3 8;
BA_ "UserSigValidity" SG_ 2549874727 SNI_L_UWB_TRNK_FD 0;
BA_ "UsrSigPurpose" SG_ 2549874727 SNI_L_UWB_TRNK_FD 8;
BA_ "UserSigValidity" SG_ 2549874727 CBV_RMR_L_UWB_TRNK_FD 0;
BA_ "UsrSigPurpose" SG_ 2549874727 CBV_RMR_L_UWB_TRNK_FD 8;
BA_ "UserSigValidity" SG_ 2549874727 CBV_NMCoID_L_UWB_TRNK_FD 0;
BA_ "UsrSigPurpose" SG_ 2549874727 CBV_NMCoID_L_UWB_TRNK_FD 8;
BA_ "UserSigValidity" SG_ 2549874727 CBV_NMCoSRB_L_UWB_TRNK_FD 0;
BA_ "UsrSigPurpose" SG_ 2549874727 CBV_NMCoSRB_L_UWB_TRNK_FD 8;
BA_ "UserSigValidity" SG_ 2549874727 CBV_AWB_L_UWB_TRNK_FD 0;
BA_ "UsrSigPurpose" SG_ 2549874727 CBV_AWB_L_UWB_TRNK_FD 8;
BA_ "UserSigValidity" SG_ 2549874727 CBV_PNIB_L_UWB_TRNK_FD 0;
BA_ "UsrSigPurpose" SG_ 2549874727 CBV_PNIB_L_UWB_TRNK_FD 8;
BA_ "UserSigValidity" SG_ 2549874727 NRR_L_UWB_TRNK_FD 0;
BA_ "UsrSigPurpose" SG_ 2549874727 NRR_L_UWB_TRNK_FD 8;
BA_ "UserSigValidity" SG_ 2549874727 NM_State_L_UWB_TRNK_FD 0;
BA_ "UsrSigPurpose" SG_ 2549874727 NM_State_L_UWB_TRNK_FD 8;
BA_ "UserSigValidity" SG_ 2549874727 PNI_L_UWB_TRNK_FD 0;
BA_ "UsrSigPurpose" SG_ 2549874727 PNI_L_UWB_TRNK_FD 8;
BA_ "UserSigValidity" SG_ 2549874727 PNI_L_UWB_TRNK_FD_1 0;
BA_ "UsrSigPurpose" SG_ 2549874727 PNI_L_UWB_TRNK_FD_1 8;
BA_ "UserSigValidity" SG_ 2549874727 PNI_L_UWB_TRNK_FD_2 0;
BA_ "UsrSigPurpose" SG_ 2549874727 PNI_L_UWB_TRNK_FD_2 8;
BA_ "UserSigValidity" SG_ 2549874727 PNI_L_UWB_TRNK_FD_3 0;
BA_ "UsrSigPurpose" SG_ 2549874727 PNI_L_UWB_TRNK_FD_3 8;
BA_ "UserSigValidity" SG_ 2549874724 SNI_L_UWB_FRNK_FD 0;
BA_ "UsrSigPurpose" SG_ 2549874724 SNI_L_UWB_FRNK_FD 8;
BA_ "UserSigValidity" SG_ 2549874724 CBV_RMR_L_UWB_FRNK_FD 0;
BA_ "UsrSigPurpose" SG_ 2549874724 CBV_RMR_L_UWB_FRNK_FD 8;
BA_ "UserSigValidity" SG_ 2549874724 CBV_NMCoID_L_UWB_FRNK_FD 0;
BA_ "UsrSigPurpose" SG_ 2549874724 CBV_NMCoID_L_UWB_FRNK_FD 8;
BA_ "UserSigValidity" SG_ 2549874724 CBV_NMCoSRB_L_UWB_FRNK_FD 0;
BA_ "UsrSigPurpose" SG_ 2549874724 CBV_NMCoSRB_L_UWB_FRNK_FD 8;
BA_ "UserSigValidity" SG_ 2549874724 CBV_AWB_L_UWB_FRNK_FD 0;
BA_ "UsrSigPurpose" SG_ 2549874724 CBV_AWB_L_UWB_FRNK_FD 8;
BA_ "UserSigValidity" SG_ 2549874724 CBV_PNIB_L_UWB_FRNK_FD 0;
BA_ "UsrSigPurpose" SG_ 2549874724 CBV_PNIB_L_UWB_FRNK_FD 8;
BA_ "UserSigValidity" SG_ 2549874724 NRR_L_UWB_FRNK_FD 0;
BA_ "UsrSigPurpose" SG_ 2549874724 NRR_L_UWB_FRNK_FD 8;
BA_ "UserSigValidity" SG_ 2549874724 NM_State_L_UWB_FRNK_FD 0;
BA_ "UsrSigPurpose" SG_ 2549874724 NM_State_L_UWB_FRNK_FD 8;
BA_ "UserSigValidity" SG_ 2549874724 PNI_L_UWB_FRNK_FD 0;
BA_ "UsrSigPurpose" SG_ 2549874724 PNI_L_UWB_FRNK_FD 8;
BA_ "UserSigValidity" SG_ 2549874724 PNI_L_UWB_FRNK_FD_1 0;
BA_ "UsrSigPurpose" SG_ 2549874724 PNI_L_UWB_FRNK_FD_1 8;
BA_ "UserSigValidity" SG_ 2549874724 PNI_L_UWB_FRNK_FD_2 0;
BA_ "UsrSigPurpose" SG_ 2549874724 PNI_L_UWB_FRNK_FD_2 8;
BA_ "UserSigValidity" SG_ 2549874724 PNI_L_UWB_FRNK_FD_3 0;
BA_ "UsrSigPurpose" SG_ 2549874724 PNI_L_UWB_FRNK_FD_3 8;
BA_ "UserSigValidity" SG_ 2549874722 SNI_L_UWB_FL_FD 0;
BA_ "UsrSigPurpose" SG_ 2549874722 SNI_L_UWB_FL_FD 8;
BA_ "UserSigValidity" SG_ 2549874722 CBV_RMR_L_UWB_FL_FD 0;
BA_ "UsrSigPurpose" SG_ 2549874722 CBV_RMR_L_UWB_FL_FD 8;
BA_ "UserSigValidity" SG_ 2549874722 CBV_NMCoID_L_UWB_FL_FD 0;
BA_ "UsrSigPurpose" SG_ 2549874722 CBV_NMCoID_L_UWB_FL_FD 8;
BA_ "UserSigValidity" SG_ 2549874722 CBV_NMCoSRB_L_UWB_FL_FD 0;
BA_ "UsrSigPurpose" SG_ 2549874722 CBV_NMCoSRB_L_UWB_FL_FD 8;
BA_ "UserSigValidity" SG_ 2549874722 CBV_AWB_L_UWB_FL_FD 0;
BA_ "UsrSigPurpose" SG_ 2549874722 CBV_AWB_L_UWB_FL_FD 8;
BA_ "UserSigValidity" SG_ 2549874722 CBV_PNIB_L_UWB_FL_FD 0;
BA_ "UsrSigPurpose" SG_ 2549874722 CBV_PNIB_L_UWB_FL_FD 8;
BA_ "UserSigValidity" SG_ 2549874722 NRR_L_UWB_FL_FD 0;
BA_ "UsrSigPurpose" SG_ 2549874722 NRR_L_UWB_FL_FD 8;
BA_ "UserSigValidity" SG_ 2549874722 NM_State_L_UWB_FL_FD 0;
BA_ "UsrSigPurpose" SG_ 2549874722 NM_State_L_UWB_FL_FD 8;
BA_ "UserSigValidity" SG_ 2549874722 PNI_L_UWB_FL_FD 0;
BA_ "UsrSigPurpose" SG_ 2549874722 PNI_L_UWB_FL_FD 8;
BA_ "UserSigValidity" SG_ 2549874722 PNI_L_UWB_FL_FD_1 0;
BA_ "UsrSigPurpose" SG_ 2549874722 PNI_L_UWB_FL_FD_1 8;
BA_ "UserSigValidity" SG_ 2549874722 PNI_L_UWB_FL_FD_2 0;
BA_ "UsrSigPurpose" SG_ 2549874722 PNI_L_UWB_FL_FD_2 8;
BA_ "UserSigValidity" SG_ 2549874722 PNI_L_UWB_FL_FD_3 0;
BA_ "UsrSigPurpose" SG_ 2549874722 PNI_L_UWB_FL_FD_3 8;
BA_ "UserSigValidity" SG_ 2549874816 SNI_GW_BDC_FD 0;
BA_ "UsrSigPurpose" SG_ 2549874816 SNI_GW_BDC_FD 8;
BA_ "UserSigValidity" SG_ 2549874816 CBV_RMR_GW_BDC_FD 0;
BA_ "UsrSigPurpose" SG_ 2549874816 CBV_RMR_GW_BDC_FD 8;
BA_ "UserSigValidity" SG_ 2549874816 CBV_NMCoID_GW_BDC_FD 0;
BA_ "UsrSigPurpose" SG_ 2549874816 CBV_NMCoID_GW_BDC_FD 8;
BA_ "UserSigValidity" SG_ 2549874816 CBV_NMCoSRB_GW_BDC_FD 0;
BA_ "UsrSigPurpose" SG_ 2549874816 CBV_NMCoSRB_GW_BDC_FD 8;
BA_ "UserSigValidity" SG_ 2549874816 CBV_AWB_GW_BDC_FD 0;
BA_ "UsrSigPurpose" SG_ 2549874816 CBV_AWB_GW_BDC_FD 8;
BA_ "UserSigValidity" SG_ 2549874816 CBV_PNIB_GW_BDC_FD 0;
BA_ "UsrSigPurpose" SG_ 2549874816 CBV_PNIB_GW_BDC_FD 8;
BA_ "UserSigValidity" SG_ 2549874816 NRR_GW_BDC_FD 0;
BA_ "UsrSigPurpose" SG_ 2549874816 NRR_GW_BDC_FD 8;
BA_ "UserSigValidity" SG_ 2549874816 NM_State_GW_BDC_FD 0;
BA_ "UsrSigPurpose" SG_ 2549874816 NM_State_GW_BDC_FD 8;
BA_ "UserSigValidity" SG_ 2549874816 PNI_GW_BDC_FD 0;
BA_ "UsrSigPurpose" SG_ 2549874816 PNI_GW_BDC_FD 8;
BA_ "UserSigValidity" SG_ 2549874816 PNI_GW_BDC_FD_1 0;
BA_ "UsrSigPurpose" SG_ 2549874816 PNI_GW_BDC_FD_1 8;
BA_ "UserSigValidity" SG_ 2549874816 PNI_GW_BDC_FD_2 0;
BA_ "UsrSigPurpose" SG_ 2549874816 PNI_GW_BDC_FD_2 8;
BA_ "UserSigValidity" SG_ 2549874816 PNI_GW_BDC_FD_3 0;
BA_ "UsrSigPurpose" SG_ 2549874816 PNI_GW_BDC_FD_3 8;
BA_ "UserSigValidity" SG_ 2549874725 SNI_L_UWB_RL_FD 0;
BA_ "UsrSigPurpose" SG_ 2549874725 SNI_L_UWB_RL_FD 8;
BA_ "UserSigValidity" SG_ 2549874725 CBV_RMR_L_UWB_RL_FD 0;
BA_ "UsrSigPurpose" SG_ 2549874725 CBV_RMR_L_UWB_RL_FD 8;
BA_ "UserSigValidity" SG_ 2549874725 CBV_NMCoID_L_UWB_RL_FD 0;
BA_ "UsrSigPurpose" SG_ 2549874725 CBV_NMCoID_L_UWB_RL_FD 8;
BA_ "UserSigValidity" SG_ 2549874725 CBV_NMCoSRB_L_UWB_RL_FD 0;
BA_ "UsrSigPurpose" SG_ 2549874725 CBV_NMCoSRB_L_UWB_RL_FD 8;
BA_ "UserSigValidity" SG_ 2549874725 CBV_AWB_L_UWB_RL_FD 0;
BA_ "UsrSigPurpose" SG_ 2549874725 CBV_AWB_L_UWB_RL_FD 8;
BA_ "UserSigValidity" SG_ 2549874725 CBV_PNIB_L_UWB_RL_FD 0;
BA_ "UsrSigPurpose" SG_ 2549874725 CBV_PNIB_L_UWB_RL_FD 8;
BA_ "UserSigValidity" SG_ 2549874725 NRR_L_UWB_RL_FD 0;
BA_ "UsrSigPurpose" SG_ 2549874725 NRR_L_UWB_RL_FD 8;
BA_ "UserSigValidity" SG_ 2549874725 NM_State_L_UWB_RL_FD 0;
BA_ "UsrSigPurpose" SG_ 2549874725 NM_State_L_UWB_RL_FD 8;
BA_ "UserSigValidity" SG_ 2549874725 PNI_L_UWB_RL_FD 0;
BA_ "UsrSigPurpose" SG_ 2549874725 PNI_L_UWB_RL_FD 8;
BA_ "UserSigValidity" SG_ 2549874725 PNI_L_UWB_RL_FD_1 0;
BA_ "UsrSigPurpose" SG_ 2549874725 PNI_L_UWB_RL_FD_1 8;
BA_ "UserSigValidity" SG_ 2549874725 PNI_L_UWB_RL_FD_2 0;
BA_ "UsrSigPurpose" SG_ 2549874725 PNI_L_UWB_RL_FD_2 8;
BA_ "UserSigValidity" SG_ 2549874725 PNI_L_UWB_RL_FD_3 0;
BA_ "UsrSigPurpose" SG_ 2549874725 PNI_L_UWB_RL_FD_3 8;
BA_ "UserSigValidity" SG_ 2549874857 SNI_L_SAL_FD 0;
BA_ "UsrSigPurpose" SG_ 2549874857 SNI_L_SAL_FD 8;
BA_ "UserSigValidity" SG_ 2549874857 CBV_RMR_L_SAL_FD 0;
BA_ "UsrSigPurpose" SG_ 2549874857 CBV_RMR_L_SAL_FD 8;
BA_ "UserSigValidity" SG_ 2549874857 CBV_NMCoID_L_SAL_FD 0;
BA_ "UsrSigPurpose" SG_ 2549874857 CBV_NMCoID_L_SAL_FD 8;
BA_ "UserSigValidity" SG_ 2549874857 CBV_NMCoSRB_L_SAL_FD 0;
BA_ "UsrSigPurpose" SG_ 2549874857 CBV_NMCoSRB_L_SAL_FD 8;
BA_ "UserSigValidity" SG_ 2549874857 CBV_AWB_L_SAL_FD 0;
BA_ "UsrSigPurpose" SG_ 2549874857 CBV_AWB_L_SAL_FD 8;
BA_ "UserSigValidity" SG_ 2549874857 CBV_PNIB_L_SAL_FD 0;
BA_ "UsrSigPurpose" SG_ 2549874857 CBV_PNIB_L_SAL_FD 8;
BA_ "UserSigValidity" SG_ 2549874857 NRR_L_SAL_FD 0;
BA_ "UsrSigPurpose" SG_ 2549874857 NRR_L_SAL_FD 8;
BA_ "UserSigValidity" SG_ 2549874857 NM_State_L_SAL_FD 0;
BA_ "UsrSigPurpose" SG_ 2549874857 NM_State_L_SAL_FD 8;
BA_ "UserSigValidity" SG_ 2549874857 PNI_L_SAL_FD 0;
BA_ "UsrSigPurpose" SG_ 2549874857 PNI_L_SAL_FD 8;
BA_ "UserSigValidity" SG_ 2549874857 PNI_L_SAL_FD_1 0;
BA_ "UsrSigPurpose" SG_ 2549874857 PNI_L_SAL_FD_1 8;
BA_ "UserSigValidity" SG_ 2549874857 PNI_L_SAL_FD_2 0;
BA_ "UsrSigPurpose" SG_ 2549874857 PNI_L_SAL_FD_2 8;
BA_ "UserSigValidity" SG_ 2549874857 PNI_L_SAL_FD_3 0;
BA_ "UsrSigPurpose" SG_ 2549874857 PNI_L_SAL_FD_3 8;
BA_ "UserSigValidity" SG_ 2549874718 SNI_L_WPC_FD 0;
BA_ "UsrSigPurpose" SG_ 2549874718 SNI_L_WPC_FD 8;
BA_ "UserSigValidity" SG_ 2549874718 CBV_RMR_L_WPC_FD 0;
BA_ "UsrSigPurpose" SG_ 2549874718 CBV_RMR_L_WPC_FD 8;
BA_ "UserSigValidity" SG_ 2549874718 CBV_NMCoID_L_WPC_FD 0;
BA_ "UsrSigPurpose" SG_ 2549874718 CBV_NMCoID_L_WPC_FD 8;
BA_ "UserSigValidity" SG_ 2549874718 CBV_NMCoSRB_L_WPC_FD 0;
BA_ "UsrSigPurpose" SG_ 2549874718 CBV_NMCoSRB_L_WPC_FD 8;
BA_ "UserSigValidity" SG_ 2549874718 CBV_AWB_L_WPC_FD 0;
BA_ "UsrSigPurpose" SG_ 2549874718 CBV_AWB_L_WPC_FD 8;
BA_ "UserSigValidity" SG_ 2549874718 CBV_PNIB_L_WPC_FD 0;
BA_ "UsrSigPurpose" SG_ 2549874718 CBV_PNIB_L_WPC_FD 8;
BA_ "UserSigValidity" SG_ 2549874718 NRR_L_WPC_FD 0;
BA_ "UsrSigPurpose" SG_ 2549874718 NRR_L_WPC_FD 8;
BA_ "UserSigValidity" SG_ 2549874718 NM_State_L_WPC_FD 0;
BA_ "UsrSigPurpose" SG_ 2549874718 NM_State_L_WPC_FD 8;
BA_ "UserSigValidity" SG_ 2549874718 PNI_L_WPC_FD 0;
BA_ "UsrSigPurpose" SG_ 2549874718 PNI_L_WPC_FD 8;
BA_ "UserSigValidity" SG_ 2549874718 PNI_L_WPC_FD_1 0;
BA_ "UsrSigPurpose" SG_ 2549874718 PNI_L_WPC_FD_1 8;
BA_ "UserSigValidity" SG_ 2549874718 PNI_L_WPC_FD_2 0;
BA_ "UsrSigPurpose" SG_ 2549874718 PNI_L_WPC_FD_2 8;
BA_ "UserSigValidity" SG_ 2549874718 PNI_L_WPC_FD_3 0;
BA_ "UsrSigPurpose" SG_ 2549874718 PNI_L_WPC_FD_3 8;
BA_ "UserSigValidity" SG_ 2549874728 SNI_L_TPMS_FD 0;
BA_ "UsrSigPurpose" SG_ 2549874728 SNI_L_TPMS_FD 8;
BA_ "UserSigValidity" SG_ 2549874728 CBV_RMR_L_TPMS_FD 0;
BA_ "UsrSigPurpose" SG_ 2549874728 CBV_RMR_L_TPMS_FD 8;
BA_ "UserSigValidity" SG_ 2549874728 CBV_NMCoID_L_TPMS_FD 0;
BA_ "UsrSigPurpose" SG_ 2549874728 CBV_NMCoID_L_TPMS_FD 8;
BA_ "UserSigValidity" SG_ 2549874728 CBV_NMCoSRB_L_TPMS_FD 0;
BA_ "UsrSigPurpose" SG_ 2549874728 CBV_NMCoSRB_L_TPMS_FD 8;
BA_ "UserSigValidity" SG_ 2549874728 CBV_AWB_L_TPMS_FD 0;
BA_ "UsrSigPurpose" SG_ 2549874728 CBV_AWB_L_TPMS_FD 8;
BA_ "UserSigValidity" SG_ 2549874728 CBV_PNIB_L_TPMS_FD 0;
BA_ "UsrSigPurpose" SG_ 2549874728 CBV_PNIB_L_TPMS_FD 8;
BA_ "UserSigValidity" SG_ 2549874728 NRR_L_TPMS_FD 0;
BA_ "UsrSigPurpose" SG_ 2549874728 NRR_L_TPMS_FD 8;
BA_ "UserSigValidity" SG_ 2549874728 NM_State_L_TPMS_FD 0;
BA_ "UsrSigPurpose" SG_ 2549874728 NM_State_L_TPMS_FD 8;
BA_ "UserSigValidity" SG_ 2549874728 PNI_L_TPMS_FD 0;
BA_ "UsrSigPurpose" SG_ 2549874728 PNI_L_TPMS_FD 8;
BA_ "UserSigValidity" SG_ 2549874728 PNI_L_TPMS_FD_1 0;
BA_ "UsrSigPurpose" SG_ 2549874728 PNI_L_TPMS_FD_1 8;
BA_ "UserSigValidity" SG_ 2549874728 PNI_L_TPMS_FD_2 0;
BA_ "UsrSigPurpose" SG_ 2549874728 PNI_L_TPMS_FD_2 8;
BA_ "UserSigValidity" SG_ 2549874728 PNI_L_TPMS_FD_3 0;
BA_ "UsrSigPurpose" SG_ 2549874728 PNI_L_TPMS_FD_3 8;
BA_ "UserSigValidity" SG_ 2549874730 SNI_L_DHL_FD 0;
BA_ "UsrSigPurpose" SG_ 2549874730 SNI_L_DHL_FD 8;
BA_ "UserSigValidity" SG_ 2549874730 CBV_RMR_L_DHL_FD 0;
BA_ "UsrSigPurpose" SG_ 2549874730 CBV_RMR_L_DHL_FD 8;
BA_ "UserSigValidity" SG_ 2549874730 CBV_NMCoID_L_DHL_FD 0;
BA_ "UsrSigPurpose" SG_ 2549874730 CBV_NMCoID_L_DHL_FD 8;
BA_ "UserSigValidity" SG_ 2549874730 CBV_NMCoSRB_L_DHL_FD 0;
BA_ "UsrSigPurpose" SG_ 2549874730 CBV_NMCoSRB_L_DHL_FD 8;
BA_ "UserSigValidity" SG_ 2549874730 CBV_AWB_L_DHL_FD 0;
BA_ "UsrSigPurpose" SG_ 2549874730 CBV_AWB_L_DHL_FD 8;
BA_ "UserSigValidity" SG_ 2549874730 CBV_PNIB_L_DHL_FD 0;
BA_ "UsrSigPurpose" SG_ 2549874730 CBV_PNIB_L_DHL_FD 8;
BA_ "UserSigValidity" SG_ 2549874730 NRR_L_DHL_FD 0;
BA_ "UsrSigPurpose" SG_ 2549874730 NRR_L_DHL_FD 8;
BA_ "UserSigValidity" SG_ 2549874730 NM_State_L_DHL_FD 0;
BA_ "UsrSigPurpose" SG_ 2549874730 NM_State_L_DHL_FD 8;
BA_ "UserSigValidity" SG_ 2549874730 PNI_L_DHL_FD 0;
BA_ "UsrSigPurpose" SG_ 2549874730 PNI_L_DHL_FD 8;
BA_ "UserSigValidity" SG_ 2549874730 PNI_L_DHL_FD_1 0;
BA_ "UsrSigPurpose" SG_ 2549874730 PNI_L_DHL_FD_1 8;
BA_ "UserSigValidity" SG_ 2549874730 PNI_L_DHL_FD_2 0;
BA_ "UsrSigPurpose" SG_ 2549874730 PNI_L_DHL_FD_2 8;
BA_ "UserSigValidity" SG_ 2549874730 PNI_L_DHL_FD_3 0;
BA_ "UsrSigPurpose" SG_ 2549874730 PNI_L_DHL_FD_3 8;
BA_ "UserSigValidity" SG_ 2549874731 SNI_L_DHR_FD 0;
BA_ "UsrSigPurpose" SG_ 2549874731 SNI_L_DHR_FD 8;
BA_ "UserSigValidity" SG_ 2549874731 CBV_RMR_L_DHR_FD 0;
BA_ "UsrSigPurpose" SG_ 2549874731 CBV_RMR_L_DHR_FD 8;
BA_ "UserSigValidity" SG_ 2549874731 CBV_NMCoID_L_DHR_FD 0;
BA_ "UsrSigPurpose" SG_ 2549874731 CBV_NMCoID_L_DHR_FD 8;
BA_ "UserSigValidity" SG_ 2549874731 CBV_NMCoSRB_L_DHR_FD 0;
BA_ "UsrSigPurpose" SG_ 2549874731 CBV_NMCoSRB_L_DHR_FD 8;
BA_ "UserSigValidity" SG_ 2549874731 CBV_AWB_L_DHR_FD 0;
BA_ "UsrSigPurpose" SG_ 2549874731 CBV_AWB_L_DHR_FD 8;
BA_ "UserSigValidity" SG_ 2549874731 CBV_PNIB_L_DHR_FD 0;
BA_ "UsrSigPurpose" SG_ 2549874731 CBV_PNIB_L_DHR_FD 8;
BA_ "UserSigValidity" SG_ 2549874731 NRR_L_DHR_FD 0;
BA_ "UsrSigPurpose" SG_ 2549874731 NRR_L_DHR_FD 8;
BA_ "UserSigValidity" SG_ 2549874731 NM_State_L_DHR_FD 0;
BA_ "UsrSigPurpose" SG_ 2549874731 NM_State_L_DHR_FD 8;
BA_ "UserSigValidity" SG_ 2549874731 PNI_L_DHR_FD 0;
BA_ "UsrSigPurpose" SG_ 2549874731 PNI_L_DHR_FD 8;
BA_ "UserSigValidity" SG_ 2549874731 PNI_L_DHR_FD_1 0;
BA_ "UsrSigPurpose" SG_ 2549874731 PNI_L_DHR_FD_1 8;
BA_ "UserSigValidity" SG_ 2549874731 PNI_L_DHR_FD_2 0;
BA_ "UsrSigPurpose" SG_ 2549874731 PNI_L_DHR_FD_2 8;
BA_ "UserSigValidity" SG_ 2549874731 PNI_L_DHR_FD_3 0;
BA_ "UsrSigPurpose" SG_ 2549874731 PNI_L_DHR_FD_3 8;
BA_REL_ "GenSigTimeoutTime" BU_SG_REL_ L_DHL_FD SG_ 980 Lamp_PuddleLmpOnReq_Copy_0 1500;
BA_REL_ "GenSigTimeoutTime" BU_SG_REL_ L_DHRL_FD SG_ 980 Lamp_PuddleLmpOnReq_Copy_0 1500;
BA_REL_ "GenSigTimeoutTime" BU_SG_REL_ L_DHRR_FD SG_ 980 Lamp_PuddleLmpOnReq_Copy_0 1500;
BA_REL_ "GenSigTimeoutTime" BU_SG_REL_ L_DHR_FD SG_ 980 Lamp_PuddleLmpOnReq_Copy_0 1500;
BA_REL_ "GenSigTimeoutTime" BU_SG_REL_ L_UWB_BLE_MST_FD SG_ 2281701600 UWB_FRNK_SW_MCU_Ver_Major 1500;
BA_REL_ "GenSigTimeoutTime" BU_SG_REL_ L_UWB_BLE_MST_FD SG_ 2281701600 UWB_FRNK_SW_MCU_Ver_Minor 1500;
BA_REL_ "GenSigTimeoutTime" BU_SG_REL_ L_UWB_BLE_MST_FD SG_ 2281701600 UWB_FRNK_SW_IC_Ver_Major 1500;
BA_REL_ "GenSigTimeoutTime" BU_SG_REL_ L_UWB_BLE_MST_FD SG_ 2281701600 UWB_FRNK_SW_IC_Ver_Minor 1500;
BA_REL_ "GenSigTimeoutTime" BU_SG_REL_ L_UWB_BLE_MST_FD SG_ 2281701600 UWB_FRNK_DTC 1500;
BA_REL_ "GenSigTimeoutTime" BU_SG_REL_ GW_BDC_FD SG_ 2281701600 UWB_FRNK_Status1 1500;
BA_REL_ "GenSigTimeoutTime" BU_SG_REL_ L_UWB_BLE_MST_FD SG_ 2281701600 UWB_FRNK_Status1 1500;
BA_REL_ "GenSigTimeoutTime" BU_SG_REL_ GW_BDC_FD SG_ 2281701600 UWB_FRNK_Status2 1500;
BA_REL_ "GenSigTimeoutTime" BU_SG_REL_ L_UWB_BLE_MST_FD SG_ 2281701600 UWB_FRNK_Status2 1500;
BA_REL_ "GenSigTimeoutTime" BU_SG_REL_ GW_BDC_FD SG_ 2281701600 UWB_FRNK_Status3 1500;
BA_REL_ "GenSigTimeoutTime" BU_SG_REL_ L_UWB_BLE_MST_FD SG_ 2281701600 UWB_FRNK_Status3 1500;
BA_REL_ "GenSigTimeoutTime" BU_SG_REL_ GW_BDC_FD SG_ 2281701600 UWB_FRNK_Status4 1500;
BA_REL_ "GenSigTimeoutTime" BU_SG_REL_ L_UWB_BLE_MST_FD SG_ 2281701600 UWB_FRNK_Status4 1500;
BA_REL_ "GenSigTimeoutTime" BU_SG_REL_ GW_BDC_FD SG_ 2281701600 UWB_FRNK_Status5 1500;
BA_REL_ "GenSigTimeoutTime" BU_SG_REL_ L_UWB_BLE_MST_FD SG_ 2281701600 UWB_FRNK_Status5 1500;
BA_REL_ "GenSigTimeoutTime" BU_SG_REL_ GW_BDC_FD SG_ 2281701600 UWB_FRNK_Status6 1500;
BA_REL_ "GenSigTimeoutTime" BU_SG_REL_ L_UWB_BLE_MST_FD SG_ 2281701600 UWB_FRNK_Status6 1500;
BA_REL_ "GenSigTimeoutTime" BU_SG_REL_ GW_BDC_FD SG_ 2281701600 UWB_FRNK_Status7 1500;
BA_REL_ "GenSigTimeoutTime" BU_SG_REL_ L_UWB_BLE_MST_FD SG_ 2281701600 UWB_FRNK_Status7 1500;
BA_REL_ "GenSigTimeoutTime" BU_SG_REL_ GW_BDC_FD SG_ 2281701600 UWB_FRNK_Status8 1500;
BA_REL_ "GenSigTimeoutTime" BU_SG_REL_ L_UWB_BLE_MST_FD SG_ 2281701600 UWB_FRNK_Status8 1500;
BA_REL_ "GenSigTimeoutTime" BU_SG_REL_ GW_BDC_FD SG_ 2281701600 UWB_FRNK_Status9 1500;
BA_REL_ "GenSigTimeoutTime" BU_SG_REL_ L_UWB_BLE_MST_FD SG_ 2281701600 UWB_FRNK_Status9 1500;
BA_REL_ "GenSigTimeoutTime" BU_SG_REL_ GW_BDC_FD SG_ 2281701600 UWB_FRNK_Status10 1500;
BA_REL_ "GenSigTimeoutTime" BU_SG_REL_ L_UWB_BLE_MST_FD SG_ 2281701600 UWB_FRNK_Status10 1500;
BA_REL_ "GenSigTimeoutTime" BU_SG_REL_ GW_BDC_FD SG_ 2281701600 UWB_FRNK_Status11 1500;
BA_REL_ "GenSigTimeoutTime" BU_SG_REL_ L_UWB_BLE_MST_FD SG_ 2281701600 UWB_FRNK_Status11 1500;
BA_REL_ "GenSigTimeoutTime" BU_SG_REL_ GW_BDC_FD SG_ 2281701600 UWB_FRNK_Status12 1500;
BA_REL_ "GenSigTimeoutTime" BU_SG_REL_ L_UWB_BLE_MST_FD SG_ 2281701600 UWB_FRNK_Status12 1500;
BA_REL_ "GenSigTimeoutTime" BU_SG_REL_ GW_BDC_FD SG_ 2281701600 UWB_FRNK_Status13 1500;
BA_REL_ "GenSigTimeoutTime" BU_SG_REL_ L_UWB_BLE_MST_FD SG_ 2281701600 UWB_FRNK_Status13 1500;
BA_REL_ "GenSigTimeoutTime" BU_SG_REL_ GW_BDC_FD SG_ 2281701600 UWB_FRNK_Status14 1500;
BA_REL_ "GenSigTimeoutTime" BU_SG_REL_ L_UWB_BLE_MST_FD SG_ 2281701600 UWB_FRNK_Status14 1500;
BA_REL_ "GenSigTimeoutTime" BU_SG_REL_ GW_BDC_FD SG_ 2281701600 UWB_FRNK_Status15 1500;
BA_REL_ "GenSigTimeoutTime" BU_SG_REL_ L_UWB_BLE_MST_FD SG_ 2281701600 UWB_FRNK_Status15 1500;
BA_REL_ "GenSigTimeoutTime" BU_SG_REL_ GW_BDC_FD SG_ 2281701600 UWB_FRNK_Status16 1500;
BA_REL_ "GenSigTimeoutTime" BU_SG_REL_ L_UWB_BLE_MST_FD SG_ 2281701600 UWB_FRNK_Status16 1500;
BA_REL_ "GenSigTimeoutTime" BU_SG_REL_ L_UWB_BLE_MST_FD SG_ 2281701600 UWB_FRNK_HW_Ver_Major 1500;
BA_REL_ "GenSigTimeoutTime" BU_SG_REL_ L_UWB_BLE_MST_FD SG_ 2281701600 UWB_FRNK_HW_Ver_Minor 1500;
VAL_ 980 BDC_FD_Crc5Val 0 "0x0x0~0xFFFF:CRCValue" 65535 "0x0x0~0xFFFF:CRCValue" ;
VAL_ 980 AutoLt_HorRes_STD 0 "1lux" 1 "20lux" 2 "Not Used" 3 "Error Indicator" ;
VAL_ 980 AutoLt_VerVal_STD 0 "0x0x0~0x7FE:Value" 2046 "0x0x0~0x7FE:Value" 2047 "Error Indicator" ;
VAL_ 980 AutoLt_VerRes_STD 0 "1lux" 1 "20lux" 2 "Not Used" 3 "Error Indicator" ;
VAL_ 980 MoodLamp_SlvColor_X 0 "0x0x00~0xFA:Color X : 0~250" 250 "0x0x00~0xFA:Color X : 0~250" 251 "Reserved : 251~254" 252 "Reserved : 251~254" 253 "Reserved : 251~254" 254 "Reserved : 251~254" 255 "Invalid : 255" ;
VAL_ 980 MoodLamp_SlvColor_Y 0 "0x0x00~0xFA:Color Y : 0~250" 250 "0x0x00~0xFA:Color Y : 0~250" 251 "Reserved : 251~254" 252 "Reserved : 251~254" 253 "Reserved : 251~254" 254 "Reserved : 251~254" 255 "Invalid : 255" ;
VAL_ 980 MoodLamp_SlvBrgtnsVal 0 "0x0x00~0xFA:Brightness 0~100%" 250 "0x0x00~0xFA:Brightness 0~100%" 251 "RESERVED" 252 "RESERVED" 253 "RESERVED" 254 "RESERVED" 255 "Invalid" ;
VAL_ 980 MoodLamp_SlvFadeInTimetVal 0 "0x0x00~0xFE:Fade in time 0~254" 254 "0x0x00~0xFE:Fade in time 0~254" 255 "Invalid" ;
VAL_ 980 BDC_FD_AlvCnt5Val 0 "0x0x0~0xFF:AlvCntValue" 255 "0x0x0~0xFF:AlvCntValue" ;
VAL_ 980 MoodLamp_SlvFadeOutTimetVal 0 "0x0x00~0xFE:Fade out time 0~254" 254 "0x0x00~0xFE:Fade out time 0~254" 255 "Invalid" ;
VAL_ 980 Lamp_LftTrnLmpCmdSta 0 "Off" 1 "On" 2 "Not Used" 3 "Error Indicator" ;
VAL_ 980 Lamp_RtTrnLmpCmdSta 0 "Off" 1 "On" 2 "Not Used" 3 "Error Indicator" ;
VAL_ 980 Lamp_LftTrnLmpCmd 0 "Inactive" 1 "BlinkingOff" 2 "BlinkingOn" 3 "Error Indicator" ;
VAL_ 980 Lamp_RtTrnLmpCmd 0 "Inactive" 1 "BlinkingOff" 2 "BlinkingOn" 3 "Error Indicator" ;
VAL_ 980 Lamp_TrnLmpMode 0 "Off" 1 "Hazard" 2 "LeftTurnNormal" 3 "RightTurnNormal" 4 "LeftTurnFault" 5 "RightTurnFault" 6 "RESERVED" 7 "Error Indicator" ;
VAL_ 980 Lamp_HzrdSwIND 0 "Inactive" 1 "IndOff" 2 "IndOn" 3 "Error Indicator" ;
VAL_ 980 Lamp_HdLmpEscortShortCmd_Copy_0 0 "Off" 1 "On" 2 "Not Used" 3 "Error Indicator" ;
VAL_ 980 Lamp_LightPopUpMsgType 0 "Default" 1 "A" 2 "B" 3 "Error Indicator" ;
VAL_ 980 Lamp_LightPopUpReq 0 "Light Sw Off" 1 "Tail Sw On" 2 "HeadLamp Low Sw On" 3 "AutoLight Sw On" ;
VAL_ 980 Lamp_HdLmpLoOffPopUpReq_Copy_0 0 "Default" 1 "Off" 2 "On" 3 "Error Indicator" ;
VAL_ 980 MoodLamp_SpeechRecogPosSta 0 "Default" 1 "Front Left" 2 "Front Right" 3 "Rear Left" 4 "Rear Right" 5 "Third Left" 6 "Third Right" 7 "Invalid" ;
VAL_ 980 MoodLamp_BttmSlvColor_X 0 "0x0x00~0xFA:Color X : 0~250" 250 "0x0x00~0xFA:Color X : 0~250" 251 "Reserved : 251~254" 252 "Reserved : 251~254" 253 "Reserved : 251~254" 254 "Reserved : 251~254" 255 "Invalid : 255" ;
VAL_ 980 MoodLamp_BttmSlvColor_Y 0 "0x0x00~0xFA:Color Y : 0~250" 250 "0x0x00~0xFA:Color Y : 0~250" 251 "Reserved : 251~254" 252 "Reserved : 251~254" 253 "Reserved : 251~254" 254 "Reserved : 251~254" 255 "Invalid : 255" ;
VAL_ 980 MoodLamp_BttmSlvBrgtnsVal 0 "0x0x00~0xFA:Brightness 0~100%" 250 "0x0x00~0xFA:Brightness 0~100%" 251 "RESERVED" 252 "RESERVED" 253 "RESERVED" 254 "RESERVED" 255 "Invalid" ;
VAL_ 980 MoodLamp_BttmSlvFadeInTimetVal 0 "0x0x00~0xFE:Fade In time 0~254" 254 "0x0x00~0xFE:Fade In time 0~254" 255 "Invalid" ;
VAL_ 980 MoodLamp_BttmSlvFadeOutTimetVal 0 "0x0x00~0xFE:Fade out time 0~254" 254 "0x0x00~0xFE:Fade out time 0~254" 255 "Invalid" ;
VAL_ 980 Lamp_FrontGroundLightOnReq 0 "Off" 1 "On" 2 "NotUsed" 3 "ErrorIndicator" ;
VAL_ 980 Lamp_SideGroundLightOnReq 0 "Off" 1 "On" 2 "NotUsed" 3 "ErrorIndicator" ;
VAL_ 980 Lamp_RearGroundLightOnReq 0 "Off" 1 "On" 2 "NotUsed" 3 "ErrorIndicator" ;
VAL_ 980 Lamp_HiPrioHzrdReq_Copy_0 0 "Off" 1 "High On" 2 "High Inactive" 3 "Reserved" 4 "Reserved" 5 "Reseved" 6 "Not Used" 7 "Error Indicator" ;
VAL_ 980 Lamp_FrFogLmpEnable 0 "Off" 1 "On" 2 "NotUsed" 3 "ErrorIndicator" ;
VAL_ 980 Lamp_RrFogLmpEnable 0 "Off" 1 "On" 2 "NotUsed" 3 "ErrorIndicator" ;
VAL_ 980 Lamp_LoPrioHzrdReq_Copy_0 0 "Off" 1 "Low On" 2 "Low Inactive" 3 "Reserved" 4 "Reserved" 5 "Reseved" 6 "Not Used" 7 "Error Indicator" ;
VAL_ 980 Lamp_ExtrnlTailLmpOnReq_Copy_0 0 "Off" 1 "On" 2 "Not Used" 3 "Error Indicator" ;
VAL_ 980 Lamp_HdLmpLoOnReq_Copy_0 0 "Off" 1 "On" 2 "Not Used" 3 "Error Indicator" ;
VAL_ 980 Lamp_HdLmpHiOnReq_Copy_0 0 "Off" 1 "On" 2 "Not Used" 3 "Error Indicator" ;
VAL_ 980 Lamp_DrlOnReq_Copy_0 0 "Off" 1 "On" 2 "Not Used" 3 "Error Indicator" ;
VAL_ 980 Lamp_BckUpLmpCmd_Copy_0 0 "Off" 1 "On" 2 "Not Used" 3 "Error Indicator" ;
VAL_ 980 Lamp_FrFogLmpOnReq_Copy_0 0 "Off" 1 "On" 2 "Not Used" 3 "Error Indicator" ;
VAL_ 980 Lamp_RrFogLmpOnReq_Copy_0 0 "Off" 1 "On" 2 "Not Used" 3 "Error Indicator" ;
VAL_ 980 Lamp_StcBendingLmpLftOnReq_Copy_ 0 "Off" 1 "On" 2 "Direct Off" 3 "Error Indicator" ;
VAL_ 980 Lamp_StcBendingLmpRtOnReq_Copy_0 0 "Off" 1 "On" 2 "Direct Off" 3 "Error Indicator" ;
VAL_ 980 Lamp_CornerLmpLftOnReq_Copy_0 0 "Off" 1 "On" 2 "Direct Off" 3 "Error Indicator" ;
VAL_ 980 Lamp_CornerLmpRtOnReq_Copy_0 0 "Off" 1 "On" 2 "Direct Off" 3 "Error Indicator" ;
VAL_ 980 Lamp_HbaCtrlModTyp_Copy_0 0 "H/Lamp High control Mode by BCM" 1 "H/Lamp High control Mode by HBA" 2 "Not Used" 3 "Error Indicator" ;
VAL_ 980 Lamp_IFSCtrlModTyp_Copy_0 0 "H/Lamp High control Mode by BCM" 1 "H/Lamp High control Mode by IFS" 2 "Not Used" 3 "Error Indicator" ;
VAL_ 980 Lamp_HdLmpWlcmCmd_Copy_0 0 "Off" 1 "On" 2 "Not Used" 3 "Error Indicator" ;
VAL_ 980 Lamp_PuddleLmpOnReq_Copy_0 0 "Off" 1 "On" 2 "Not Used" 3 "Error Indicator" ;
VAL_ 980 Lamp_ExtLampRSPAMode_Copy_0 0 "Off" 1 "On" 2 "Not Used" 3 "Error Indicator" ;
VAL_ 980 Lamp_IntTailLmpOnReq_Copy_0 0 "Off" 1 "On" 2 "Not Used" 3 "Error Indicator" ;
VAL_ 980 Lamp_AvTailLmpSta_Copy_0 0 "Off" 1 "On" 2 "Not Used" 3 "Error Indicator" ;
VAL_ 980 Lamp_AutoLtSnsrNightSta_Copy_0 0 "Off" 1 "Night" 2 "Not Used" 3 "Error Indicator" ;
VAL_ 980 Lamp_VendorInfo_Copy_0 0 "Not Used" 1 "TRW(BCS)" 2 "HELLA" 3 "TRW(BCS) STD" 4 "HELLA STD" 5 "Not Used" 6 "Not Used" 7 "Error Indicator" ;
VAL_ 980 Lamp_AutoLtSnsrHorVal_Copy_0 0 "0x0x0~0x3FE:Light Sensor Value" 1022 "0x0x0~0x3FE:Light Sensor Value" 1023 "Invalid" ;
VAL_ 980 MoodLamp_AIVoiceOptSta 0 "Default" 1 "No" 2 "Yes" 3 "Invalid" ;
VAL_ 980 MoodLamp_DualColorOptSta 0 "Default" 1 "Single(USM)" 2 "Dual(USM)" 3 "Invalid" ;
VAL_ 980 MoodLamp_MdLmpFadeSta 0 "Default" 1 "Off" 2 "On" 3 "Invalid" ;
VAL_ 980 MoodLamp_NumRecommendColor 0 "Default" 1 "Number of recommended color (1~14)" 2 "Number of recommended color (1~14)" 3 "Number of recommended color (1~14)" 4 "Number of recommended color (1~14)" 5 "Number of recommended color (1~14)" 6 "Number of recommended color (1~14)" 7 "Number of recommended color (1~14)" 8 "Number of recommended color (1~14)" 9 "Number of recommended color (1~14)" 10 "Number of recommended color (1~14)" 11 "Number of recommended color (1~14)" 12 "Number of recommended color (1~14)" 13 "Number of recommended color (1~14)" 14 "Number of recommended color (1~14)" 15 "Invalid" ;
VAL_ 980 AutoLt_HorVal_STD 0 "0x0x0~0x7FE:Value" 2046 "0x0x0~0x7FE:Value" 2047 "Error Indicator" ;
VAL_ 2281701600 L_UWB_FRNK_FD_Crc10Val 0 "0x0x0~0xFFFF:CRCValue" 65535 "0x0x0~0xFFFF:CRCValue" ;
VAL_ 2281701600 L_UWB_FRNK_FD_AlvCnt10Val 0 "0x0x0~0xFF:AlvCntValue" 255 "0x0x0~0xFF:AlvCntValue" ;
VAL_ 2281701600 UWB_FRNK_Status1 0 "Default" 1 "No_Ranging" 2 "URSK_Stored" 3 "UWB_Session_Setup" 4 "Ranging_Start(Not_In_Sync)" 5 "Ranging_Start(In_Sync)" 6 "Ranging_Stop(Max_Signal_Missed)" 7 "Fob_Ranging" 8 "RESERVED" 9 "RESERVED" 10 "RESERVED" 11 "RESERVED" 12 "RESERVED" 13 "RESERVED" 14 "RESERVED" 15 "Invalid" ;
VAL_ 2281701600 UWB_FRNK_Status2 0 "Default" 1 "No_Ranging" 2 "URSK_Stored" 3 "UWB_Session_Setup" 4 "Ranging_Start(Not_In_Sync)" 5 "Ranging_Start(In_Sync)" 6 "Ranging_Stop(Max_Signal_Missed)" 7 "Fob_Ranging" 8 "RESERVED" 9 "RESERVED" 10 "RESERVED" 11 "RESERVED" 12 "RESERVED" 13 "RESERVED" 14 "RESERVED" 15 "Invalid" ;
VAL_ 2281701600 UWB_FRNK_Status3 0 "Default" 1 "No_Ranging" 2 "URSK_Stored" 3 "UWB_Session_Setup" 4 "Ranging_Start(Not_In_Sync)" 5 "Ranging_Start(In_Sync)" 6 "Ranging_Stop(Max_Signal_Missed)" 7 "Fob_Ranging" 8 "RESERVED" 9 "RESERVED" 10 "RESERVED" 11 "RESERVED" 12 "RESERVED" 13 "RESERVED" 14 "RESERVED" 15 "Invalid" ;
VAL_ 2281701600 UWB_FRNK_Status4 0 "Default" 1 "No_Ranging" 2 "URSK_Stored" 3 "UWB_Session_Setup" 4 "Ranging_Start(Not_In_Sync)" 5 "Ranging_Start(In_Sync)" 6 "Ranging_Stop(Max_Signal_Missed)" 7 "Fob_Ranging" 8 "RESERVED" 9 "RESERVED" 10 "RESERVED" 11 "RESERVED" 12 "RESERVED" 13 "RESERVED" 14 "RESERVED" 15 "Invalid" ;
VAL_ 2281701600 UWB_FRNK_Status5 0 "Default" 1 "No_Ranging" 2 "URSK_Stored" 3 "UWB_Session_Setup" 4 "Ranging_Start(Not_In_Sync)" 5 "Ranging_Start(In_Sync)" 6 "Ranging_Stop(Max_Signal_Missed)" 7 "Fob_Ranging" 8 "RESERVED" 9 "RESERVED" 10 "RESERVED" 11 "RESERVED" 12 "RESERVED" 13 "RESERVED" 14 "RESERVED" 15 "Invalid" ;
VAL_ 2281701600 UWB_FRNK_Status6 0 "Default" 1 "No_Ranging" 2 "URSK_Stored" 3 "UWB_Session_Setup" 4 "Ranging_Start(Not_In_Sync)" 5 "Ranging_Start(In_Sync)" 6 "Ranging_Stop(Max_Signal_Missed)" 7 "Fob_Ranging" 8 "RESERVED" 9 "RESERVED" 10 "RESERVED" 11 "RESERVED" 12 "RESERVED" 13 "RESERVED" 14 "RESERVED" 15 "Invalid" ;
VAL_ 2281701600 UWB_FRNK_Status7 0 "Default" 1 "No_Ranging" 2 "URSK_Stored" 3 "UWB_Session_Setup" 4 "Ranging_Start(Not_In_Sync)" 5 "Ranging_Start(In_Sync)" 6 "Ranging_Stop(Max_Signal_Missed)" 7 "Fob_Ranging" 8 "RESERVED" 9 "RESERVED" 10 "RESERVED" 11 "RESERVED" 12 "RESERVED" 13 "RESERVED" 14 "RESERVED" 15 "Invalid" ;
VAL_ 2281701600 UWB_FRNK_Status8 0 "Default" 1 "No_Ranging" 2 "URSK_Stored" 3 "UWB_Session_Setup" 4 "Ranging_Start(Not_In_Sync)" 5 "Ranging_Start(In_Sync)" 6 "Ranging_Stop(Max_Signal_Missed)" 7 "Fob_Ranging" 8 "RESERVED" 9 "RESERVED" 10 "RESERVED" 11 "RESERVED" 12 "RESERVED" 13 "RESERVED" 14 "RESERVED" 15 "Invalid" ;
VAL_ 2281701600 UWB_FRNK_Status9 0 "Default" 1 "No_Ranging" 2 "URSK_Stored" 3 "UWB_Session_Setup" 4 "Ranging_Start(Not_In_Sync)" 5 "Ranging_Start(In_Sync)" 6 "Ranging_Stop(Max_Signal_Missed)" 7 "Fob_Ranging" 8 "RESERVED" 9 "RESERVED" 10 "RESERVED" 11 "RESERVED" 12 "RESERVED" 13 "RESERVED" 14 "RESERVED" 15 "Invalid" ;
VAL_ 2281701600 UWB_FRNK_Status10 0 "Default" 1 "No_Ranging" 2 "URSK_Stored" 3 "UWB_Session_Setup" 4 "Ranging_Start(Not_In_Sync)" 5 "Ranging_Start(In_Sync)" 6 "Ranging_Stop(Max_Signal_Missed)" 7 "Fob_Ranging" 8 "RESERVED" 9 "RESERVED" 10 "RESERVED" 11 "RESERVED" 12 "RESERVED" 13 "RESERVED" 14 "RESERVED" 15 "Invalid" ;
VAL_ 2281701600 UWB_FRNK_Status11 0 "Default" 1 "No_Ranging" 2 "URSK_Stored" 3 "UWB_Session_Setup" 4 "Ranging_Start(Not_In_Sync)" 5 "Ranging_Start(In_Sync)" 6 "Ranging_Stop(Max_Signal_Missed)" 7 "Fob_Ranging" 8 "RESERVED" 9 "RESERVED" 10 "RESERVED" 11 "RESERVED" 12 "RESERVED" 13 "RESERVED" 14 "RESERVED" 15 "Invalid" ;
VAL_ 2281701600 UWB_FRNK_Status12 0 "Default" 1 "No_Ranging" 2 "URSK_Stored" 3 "UWB_Session_Setup" 4 "Ranging_Start(Not_In_Sync)" 5 "Ranging_Start(In_Sync)" 6 "Ranging_Stop(Max_Signal_Missed)" 7 "Fob_Ranging" 8 "RESERVED" 9 "RESERVED" 10 "RESERVED" 11 "RESERVED" 12 "RESERVED" 13 "RESERVED" 14 "RESERVED" 15 "Invalid" ;
VAL_ 2281701600 UWB_FRNK_Status13 0 "Default" 1 "No_Ranging" 2 "URSK_Stored" 3 "UWB_Session_Setup" 4 "Ranging_Start(Not_In_Sync)" 5 "Ranging_Start(In_Sync)" 6 "Ranging_Stop(Max_Signal_Missed)" 7 "Fob_Ranging" 8 "RESERVED" 9 "RESERVED" 10 "RESERVED" 11 "RESERVED" 12 "RESERVED" 13 "RESERVED" 14 "RESERVED" 15 "Invalid" ;
VAL_ 2281701600 UWB_FRNK_Status14 0 "Default" 1 "No_Ranging" 2 "URSK_Stored" 3 "UWB_Session_Setup" 4 "Ranging_Start(Not_In_Sync)" 5 "Ranging_Start(In_Sync)" 6 "Ranging_Stop(Max_Signal_Missed)" 7 "Fob_Ranging" 8 "RESERVED" 9 "RESERVED" 10 "RESERVED" 11 "RESERVED" 12 "RESERVED" 13 "RESERVED" 14 "RESERVED" 15 "Invalid" ;
VAL_ 2281701600 UWB_FRNK_Status15 0 "Default" 1 "No_Ranging" 2 "URSK_Stored" 3 "UWB_Session_Setup" 4 "Ranging_Start(Not_In_Sync)" 5 "Ranging_Start(In_Sync)" 6 "Ranging_Stop(Max_Signal_Missed)" 7 "Fob_Ranging" 8 "RESERVED" 9 "RESERVED" 10 "RESERVED" 11 "RESERVED" 12 "RESERVED" 13 "RESERVED" 14 "RESERVED" 15 "Invalid" ;
VAL_ 2281701600 UWB_FRNK_Status16 0 "Default" 1 "No_Ranging" 2 "URSK_Stored" 3 "UWB_Session_Setup" 4 "Ranging_Start(Not_In_Sync)" 5 "Ranging_Start(In_Sync)" 6 "Ranging_Stop(Max_Signal_Missed)" 7 "Fob_Ranging" 8 "RESERVED" 9 "RESERVED" 10 "RESERVED" 11 "RESERVED" 12 "RESERVED" 13 "RESERVED" 14 "RESERVED" 15 "Invalid" ;
VAL_ 2549874733 SNI_L_DHRR_FD 0 "0x0x0~0xFF:NM Source Node ID" 255 "0x0x0~0xFF:NM Source Node ID" ;
VAL_ 2549874733 CBV_RMR_L_DHRR_FD 0 "Repeat Message State not requested" 1 "Repeat Message State requested" ;
VAL_ 2549874733 CBV_NMCoID_L_DHRR_FD 0 "NM Coordinator ID" 1 "NM Coordinator ID" 2 "NM Coordinator ID" 3 "NM Coordinator ID" ;
VAL_ 2549874733 CBV_NMCoSRB_L_DHRR_FD 0 "Start of synchronized shutdown is not requested by main coordinator" 1 "Start of synchronized shutdown is requested by main coordinator" ;
VAL_ 2549874733 CBV_AWB_L_DHRR_FD 0 "Node has not woken up the network (passive wakeup)" 1 "Node has woken up the network (active wakeup)" ;
VAL_ 2549874733 CBV_PNIB_L_DHRR_FD 0 "NM PDU contains no partial network cluster information in the user data area" 1 "NM PDU contains partial network cluster information in the user data area" ;
VAL_ 2549874733 NRR_L_DHRR_FD 0 "Default" 1 "0x1~0xFF:RESERVED" 255 "0x1~0xFF:RESERVED" ;
VAL_ 2549874733 NM_State_L_DHRR_FD 0 "Default" 1 "NM_RMS_BSM" 2 "NM_RMS_PBSM" 3 "RESERVED" 4 "NM_NS_RMS" 5 "RESERVED" 6 "RESERVED" 7 "RESERVED" 8 "NM_NS_RSS" 9 "RESERVED" 10 "RESERVED" 11 "RESERVED" 12 "RESERVED" 13 "RESERVED" 14 "RESERVED" 15 "RESERVED" 16 "NM_RMS_RSS" 17 "RESERVED" 18 "RESERVED" 19 "RESERVED" 20 "RESERVED" 21 "RESERVED" 22 "RESERVED" 23 "RESERVED" 24 "RESERVED" 25 "RESERVED" 26 "RESERVED" 27 "RESERVED" 28 "RESERVED" 29 "RESERVED" 30 "RESERVED" 31 "RESERVED" 32 "NM_RMS_NS" 33 "0x21~0xFF:RESERVED" 255 "0x21~0xFF:RESERVED" ;
VAL_ 2549874733 PNI_L_DHRR_FD 0 "0x0x0~0xFFFFFFFF:NM PNC Bit" 2147483647 "0x0x0~0xFFFFFFFF:NM PNC Bit" ;
VAL_ 2549874733 PNI_L_DHRR_FD_1 0 "0x0~0xFFFFFFFFFFFFFFFF:NM PNC Bit" ;
VAL_ 2549874733 PNI_L_DHRR_FD_2 0 "0x0~0xFFFFFFFFFFFFFFFF:NM PNC Bit" ;
VAL_ 2549874733 PNI_L_DHRR_FD_3 0 "0x0~0xFFFFFFFFFFFFFFFF:NM PNC Bit" ;
VAL_ 2549874720 SNI_L_UWB_BLE_MST_FD 0 "0x0x0~0xFF:NM Source Node ID" 255 "0x0x0~0xFF:NM Source Node ID" ;
VAL_ 2549874720 CBV_RMR_L_UWB_BLE_MST_FD 0 "Repeat Message State not requested" 1 "Repeat Message State requested" ;
VAL_ 2549874720 CBV_NMCoID_L_UWB_BLE_MST_FD 0 "NM Coordinator ID" 1 "NM Coordinator ID" 2 "NM Coordinator ID" 3 "NM Coordinator ID" ;
VAL_ 2549874720 CBV_NMCoSRB_L_UWB_BLE_MST_FD 0 "Start of synchronized shutdown is not requested by main coordinator" 1 "Start of synchronized shutdown is requested by main coordinator" ;
VAL_ 2549874720 CBV_AWB_L_UWB_BLE_MST_FD 0 "Node has not woken up the network (passive wakeup)" 1 "Node has woken up the network (active wakeup)" ;
VAL_ 2549874720 CBV_PNIB_L_UWB_BLE_MST_FD 0 "NM PDU contains no partial network cluster information in the user data area" 1 "NM PDU contains partial network cluster information in the user data area" ;
VAL_ 2549874720 NRR_L_UWB_BLE_MST_FD 0 "Default" 1 "0x1~0xFF:RESERVED" 255 "0x1~0xFF:RESERVED" ;
VAL_ 2549874720 NM_State_L_UWB_BLE_MST_FD 0 "Default" 1 "NM_RMS_BSM" 2 "NM_RMS_PBSM" 3 "RESERVED" 4 "NM_NS_RMS" 5 "RESERVED" 6 "RESERVED" 7 "RESERVED" 8 "NM_NS_RSS" 9 "RESERVED" 10 "RESERVED" 11 "RESERVED" 12 "RESERVED" 13 "RESERVED" 14 "RESERVED" 15 "RESERVED" 16 "NM_RMS_RSS" 17 "RESERVED" 18 "RESERVED" 19 "RESERVED" 20 "RESERVED" 21 "RESERVED" 22 "RESERVED" 23 "RESERVED" 24 "RESERVED" 25 "RESERVED" 26 "RESERVED" 27 "RESERVED" 28 "RESERVED" 29 "RESERVED" 30 "RESERVED" 31 "RESERVED" 32 "NM_RMS_NS" 33 "0x21~0xFF:RESERVED" 255 "0x21~0xFF:RESERVED" ;
VAL_ 2549874720 PNI_L_UWB_BLE_MST_FD 0 "0x0x0~0xFFFFFFFF:NM PNC Bit" 2147483647 "0x0x0~0xFFFFFFFF:NM PNC Bit" ;
VAL_ 2549874720 PNI_L_UWB_BLE_MST_FD_1 0 "0x0~0xFFFFFFFFFFFFFFFF:NM PNC Bit" ;
VAL_ 2549874720 PNI_L_UWB_BLE_MST_FD_2 0 "0x0~0xFFFFFFFFFFFFFFFF:NM PNC Bit" ;
VAL_ 2549874720 PNI_L_UWB_BLE_MST_FD_3 0 "0x0~0xFFFFFFFFFFFFFFFF:NM PNC Bit" ;
VAL_ 2549874726 SNI_L_UWB_RR_FD 0 "0x0x0~0xFF:NM Source Node ID" 255 "0x0x0~0xFF:NM Source Node ID" ;
VAL_ 2549874726 CBV_RMR_L_UWB_RR_FD 0 "Repeat Message State not requested" 1 "Repeat Message State requested" ;
VAL_ 2549874726 CBV_NMCoID_L_UWB_RR_FD 0 "NM Coordinator ID" 1 "NM Coordinator ID" 2 "NM Coordinator ID" 3 "NM Coordinator ID" ;
VAL_ 2549874726 CBV_NMCoSRB_L_UWB_RR_FD 0 "Start of synchronized shutdown is not requested by main coordinator" 1 "Start of synchronized shutdown is requested by main coordinator" ;
VAL_ 2549874726 CBV_AWB_L_UWB_RR_FD 0 "Node has not woken up the network (passive wakeup)" 1 "Node has woken up the network (active wakeup)" ;
VAL_ 2549874726 CBV_PNIB_L_UWB_RR_FD 0 "NM PDU contains no partial network cluster information in the user data area" 1 "NM PDU contains partial network cluster information in the user data area" ;
VAL_ 2549874726 NRR_L_UWB_RR_FD 0 "Default" 1 "0x1~0xFF:RESERVED" 255 "0x1~0xFF:RESERVED" ;
VAL_ 2549874726 NM_State_L_UWB_RR_FD 0 "Default" 1 "NM_RMS_BSM" 2 "NM_RMS_PBSM" 3 "RESERVED" 4 "NM_NS_RMS" 5 "RESERVED" 6 "RESERVED" 7 "RESERVED" 8 "NM_NS_RSS" 9 "RESERVED" 10 "RESERVED" 11 "RESERVED" 12 "RESERVED" 13 "RESERVED" 14 "RESERVED" 15 "RESERVED" 16 "NM_RMS_RSS" 17 "RESERVED" 18 "RESERVED" 19 "RESERVED" 20 "RESERVED" 21 "RESERVED" 22 "RESERVED" 23 "RESERVED" 24 "RESERVED" 25 "RESERVED" 26 "RESERVED" 27 "RESERVED" 28 "RESERVED" 29 "RESERVED" 30 "RESERVED" 31 "RESERVED" 32 "NM_RMS_NS" 33 "0x21~0xFF:RESERVED" 255 "0x21~0xFF:RESERVED" ;
VAL_ 2549874726 PNI_L_UWB_RR_FD 0 "0x0x0~0xFFFFFFFF:NM PNC Bit" 2147483647 "0x0x0~0xFFFFFFFF:NM PNC Bit" ;
VAL_ 2549874726 PNI_L_UWB_RR_FD_1 0 "0x0~0xFFFFFFFFFFFFFFFF:NM PNC Bit" ;
VAL_ 2549874726 PNI_L_UWB_RR_FD_2 0 "0x0~0xFFFFFFFFFFFFFFFF:NM PNC Bit" ;
VAL_ 2549874726 PNI_L_UWB_RR_FD_3 0 "0x0~0xFFFFFFFFFFFFFFFF:NM PNC Bit" ;
VAL_ 2549874721 SNI_L_UWB_BLE_SLV_FD 0 "0x0x0~0xFF:NM Source Node ID" 255 "0x0x0~0xFF:NM Source Node ID" ;
VAL_ 2549874721 CBV_RMR_L_UWB_BLE_SLV_FD 0 "Repeat Message State not requested" 1 "Repeat Message State requested" ;
VAL_ 2549874721 CBV_NMCoID_L_UWB_BLE_SLV_FD 0 "NM Coordinator ID" 1 "NM Coordinator ID" 2 "NM Coordinator ID" 3 "NM Coordinator ID" ;
VAL_ 2549874721 CBV_NMCoSRB_L_UWB_BLE_SLV_FD 0 "Start of synchronized shutdown is not requested by main coordinator" 1 "Start of synchronized shutdown is requested by main coordinator" ;
VAL_ 2549874721 CBV_AWB_L_UWB_BLE_SLV_FD 0 "Node has not woken up the network (passive wakeup)" 1 "Node has woken up the network (active wakeup)" ;
VAL_ 2549874721 CBV_PNIB_L_UWB_BLE_SLV_FD 0 "NM PDU contains no partial network cluster information in the user data area" 1 "NM PDU contains partial network cluster information in the user data area" ;
VAL_ 2549874721 NRR_L_UWB_BLE_SLV_FD 0 "Default" 1 "0x1~0xFF:RESERVED" 255 "0x1~0xFF:RESERVED" ;
VAL_ 2549874721 NM_State_L_UWB_BLE_SLV_FD 0 "Default" 1 "NM_RMS_BSM" 2 "NM_RMS_PBSM" 3 "RESERVED" 4 "NM_NS_RMS" 5 "RESERVED" 6 "RESERVED" 7 "RESERVED" 8 "NM_NS_RSS" 9 "RESERVED" 10 "RESERVED" 11 "RESERVED" 12 "RESERVED" 13 "RESERVED" 14 "RESERVED" 15 "RESERVED" 16 "NM_RMS_RSS" 17 "RESERVED" 18 "RESERVED" 19 "RESERVED" 20 "RESERVED" 21 "RESERVED" 22 "RESERVED" 23 "RESERVED" 24 "RESERVED" 25 "RESERVED" 26 "RESERVED" 27 "RESERVED" 28 "RESERVED" 29 "RESERVED" 30 "RESERVED" 31 "RESERVED" 32 "NM_RMS_NS" 33 "0x21~0xFF:RESERVED" 255 "0x21~0xFF:RESERVED" ;
VAL_ 2549874721 PNI_L_UWB_BLE_SLV_FD 0 "0x0x0~0xFFFFFFFF:NM PNC Bit" 2147483647 "0x0x0~0xFFFFFFFF:NM PNC Bit" ;
VAL_ 2549874721 PNI_L_UWB_BLE_SLV_FD_1 0 "0x0~0xFFFFFFFFFFFFFFFF:NM PNC Bit" ;
VAL_ 2549874721 PNI_L_UWB_BLE_SLV_FD_2 0 "0x0~0xFFFFFFFFFFFFFFFF:NM PNC Bit" ;
VAL_ 2549874721 PNI_L_UWB_BLE_SLV_FD_3 0 "0x0~0xFFFFFFFFFFFFFFFF:NM PNC Bit" ;
VAL_ 2549874723 SNI_L_UWB_FR_FD 0 "0x0x0~0xFF:NM Source Node ID" 255 "0x0x0~0xFF:NM Source Node ID" ;
VAL_ 2549874723 CBV_RMR_L_UWB_FR_FD 0 "Repeat Message State not requested" 1 "Repeat Message State requested" ;
VAL_ 2549874723 CBV_NMCoID_L_UWB_FR_FD 0 "NM Coordinator ID" 1 "NM Coordinator ID" 2 "NM Coordinator ID" 3 "NM Coordinator ID" ;
VAL_ 2549874723 CBV_NMCoSRB_L_UWB_FR_FD 0 "Start of synchronized shutdown is not requested by main coordinator" 1 "Start of synchronized shutdown is requested by main coordinator" ;
VAL_ 2549874723 CBV_AWB_L_UWB_FR_FD 0 "Node has not woken up the network (passive wakeup)" 1 "Node has woken up the network (active wakeup)" ;
VAL_ 2549874723 CBV_PNIB_L_UWB_FR_FD 0 "NM PDU contains no partial network cluster information in the user data area" 1 "NM PDU contains partial network cluster information in the user data area" ;
VAL_ 2549874723 NRR_L_UWB_FR_FD 0 "Default" 1 "0x1~0xFF:RESERVED" 255 "0x1~0xFF:RESERVED" ;
VAL_ 2549874723 NM_State_L_UWB_FR_FD 0 "Default" 1 "NM_RMS_BSM" 2 "NM_RMS_PBSM" 3 "RESERVED" 4 "NM_NS_RMS" 5 "RESERVED" 6 "RESERVED" 7 "RESERVED" 8 "NM_NS_RSS" 9 "RESERVED" 10 "RESERVED" 11 "RESERVED" 12 "RESERVED" 13 "RESERVED" 14 "RESERVED" 15 "RESERVED" 16 "NM_RMS_RSS" 17 "RESERVED" 18 "RESERVED" 19 "RESERVED" 20 "RESERVED" 21 "RESERVED" 22 "RESERVED" 23 "RESERVED" 24 "RESERVED" 25 "RESERVED" 26 "RESERVED" 27 "RESERVED" 28 "RESERVED" 29 "RESERVED" 30 "RESERVED" 31 "RESERVED" 32 "NM_RMS_NS" 33 "0x21~0xFF:RESERVED" 255 "0x21~0xFF:RESERVED" ;
VAL_ 2549874723 PNI_L_UWB_FR_FD 0 "0x0x0~0xFFFFFFFF:NM PNC Bit" 2147483647 "0x0x0~0xFFFFFFFF:NM PNC Bit" ;
VAL_ 2549874723 PNI_L_UWB_FR_FD_1 0 "0x0~0xFFFFFFFFFFFFFFFF:NM PNC Bit" ;
VAL_ 2549874723 PNI_L_UWB_FR_FD_2 0 "0x0~0xFFFFFFFFFFFFFFFF:NM PNC Bit" ;
VAL_ 2549874723 PNI_L_UWB_FR_FD_3 0 "0x0~0xFFFFFFFFFFFFFFFF:NM PNC Bit" ;
VAL_ 2549874732 SNI_L_DHRL_FD 0 "0x0x0~0xFF:NM Source Node ID" 255 "0x0x0~0xFF:NM Source Node ID" ;
VAL_ 2549874732 CBV_RMR_L_DHRL_FD 0 "Repeat Message State not requested" 1 "Repeat Message State requested" ;
VAL_ 2549874732 CBV_NMCoID_L_DHRL_FD 0 "NM Coordinator ID" 1 "NM Coordinator ID" 2 "NM Coordinator ID" 3 "NM Coordinator ID" ;
VAL_ 2549874732 CBV_NMCoSRB_L_DHRL_FD 0 "Start of synchronized shutdown is not requested by main coordinator" 1 "Start of synchronized shutdown is requested by main coordinator" ;
VAL_ 2549874732 CBV_AWB_L_DHRL_FD 0 "Node has not woken up the network (passive wakeup)" 1 "Node has woken up the network (active wakeup)" ;
VAL_ 2549874732 CBV_PNIB_L_DHRL_FD 0 "NM PDU contains no partial network cluster information in the user data area" 1 "NM PDU contains partial network cluster information in the user data area" ;
VAL_ 2549874732 NRR_L_DHRL_FD 0 "Default" 1 "0x1~0xFF:RESERVED" 255 "0x1~0xFF:RESERVED" ;
VAL_ 2549874732 NM_State_L_DHRL_FD 0 "Default" 1 "NM_RMS_BSM" 2 "NM_RMS_PBSM" 3 "RESERVED" 4 "NM_NS_RMS" 5 "RESERVED" 6 "RESERVED" 7 "RESERVED" 8 "NM_NS_RSS" 9 "RESERVED" 10 "RESERVED" 11 "RESERVED" 12 "RESERVED" 13 "RESERVED" 14 "RESERVED" 15 "RESERVED" 16 "NM_RMS_RSS" 17 "RESERVED" 18 "RESERVED" 19 "RESERVED" 20 "RESERVED" 21 "RESERVED" 22 "RESERVED" 23 "RESERVED" 24 "RESERVED" 25 "RESERVED" 26 "RESERVED" 27 "RESERVED" 28 "RESERVED" 29 "RESERVED" 30 "RESERVED" 31 "RESERVED" 32 "NM_RMS_NS" 33 "0x21~0xFF:RESERVED" 255 "0x21~0xFF:RESERVED" ;
VAL_ 2549874732 PNI_L_DHRL_FD 0 "0x0x0~0xFFFFFFFF:NM PNC Bit" 2147483647 "0x0x0~0xFFFFFFFF:NM PNC Bit" ;
VAL_ 2549874732 PNI_L_DHRL_FD_1 0 "0x0~0xFFFFFFFFFFFFFFFF:NM PNC Bit" ;
VAL_ 2549874732 PNI_L_DHRL_FD_2 0 "0x0~0xFFFFFFFFFFFFFFFF:NM PNC Bit" ;
VAL_ 2549874732 PNI_L_DHRL_FD_3 0 "0x0~0xFFFFFFFFFFFFFFFF:NM PNC Bit" ;
VAL_ 2549874727 SNI_L_UWB_TRNK_FD 0 "0x0x0~0xFF:NM Source Node ID" 255 "0x0x0~0xFF:NM Source Node ID" ;
VAL_ 2549874727 CBV_RMR_L_UWB_TRNK_FD 0 "Repeat Message State not requested" 1 "Repeat Message State requested" ;
VAL_ 2549874727 CBV_NMCoID_L_UWB_TRNK_FD 0 "NM Coordinator ID" 1 "NM Coordinator ID" 2 "NM Coordinator ID" 3 "NM Coordinator ID" ;
VAL_ 2549874727 CBV_NMCoSRB_L_UWB_TRNK_FD 0 "Start of synchronized shutdown is not requested by main coordinator" 1 "Start of synchronized shutdown is requested by main coordinator" ;
VAL_ 2549874727 CBV_AWB_L_UWB_TRNK_FD 0 "Node has not woken up the network (passive wakeup)" 1 "Node has woken up the network (active wakeup)" ;
VAL_ 2549874727 CBV_PNIB_L_UWB_TRNK_FD 0 "NM PDU contains no partial network cluster information in the user data area" 1 "NM PDU contains partial network cluster information in the user data area" ;
VAL_ 2549874727 NRR_L_UWB_TRNK_FD 0 "Default" 1 "0x1~0xFF:RESERVED" 255 "0x1~0xFF:RESERVED" ;
VAL_ 2549874727 NM_State_L_UWB_TRNK_FD 0 "Default" 1 "NM_RMS_BSM" 2 "NM_RMS_PBSM" 3 "RESERVED" 4 "NM_NS_RMS" 5 "RESERVED" 6 "RESERVED" 7 "RESERVED" 8 "NM_NS_RSS" 9 "RESERVED" 10 "RESERVED" 11 "RESERVED" 12 "RESERVED" 13 "RESERVED" 14 "RESERVED" 15 "RESERVED" 16 "NM_RMS_RSS" 17 "RESERVED" 18 "RESERVED" 19 "RESERVED" 20 "RESERVED" 21 "RESERVED" 22 "RESERVED" 23 "RESERVED" 24 "RESERVED" 25 "RESERVED" 26 "RESERVED" 27 "RESERVED" 28 "RESERVED" 29 "RESERVED" 30 "RESERVED" 31 "RESERVED" 32 "NM_RMS_NS" 33 "0x21~0xFF:RESERVED" 255 "0x21~0xFF:RESERVED" ;
VAL_ 2549874727 PNI_L_UWB_TRNK_FD 0 "0x0x0~0xFFFFFFFF:NM PNC Bit" 2147483647 "0x0x0~0xFFFFFFFF:NM PNC Bit" ;
VAL_ 2549874727 PNI_L_UWB_TRNK_FD_1 0 "0x0~0xFFFFFFFFFFFFFFFF:NM PNC Bit" ;
VAL_ 2549874727 PNI_L_UWB_TRNK_FD_2 0 "0x0~0xFFFFFFFFFFFFFFFF:NM PNC Bit" ;
VAL_ 2549874727 PNI_L_UWB_TRNK_FD_3 0 "0x0~0xFFFFFFFFFFFFFFFF:NM PNC Bit" ;
VAL_ 2549874724 SNI_L_UWB_FRNK_FD 0 "0x0x0~0xFF:NM Source Node ID" 255 "0x0x0~0xFF:NM Source Node ID" ;
VAL_ 2549874724 CBV_RMR_L_UWB_FRNK_FD 0 "Repeat Message State not requested" 1 "Repeat Message State requested" ;
VAL_ 2549874724 CBV_NMCoID_L_UWB_FRNK_FD 0 "NM Coordinator ID" 1 "NM Coordinator ID" 2 "NM Coordinator ID" 3 "NM Coordinator ID" ;
VAL_ 2549874724 CBV_NMCoSRB_L_UWB_FRNK_FD 0 "Start of synchronized shutdown is not requested by main coordinator" 1 "Start of synchronized shutdown is requested by main coordinator" ;
VAL_ 2549874724 CBV_AWB_L_UWB_FRNK_FD 0 "Node has not woken up the network (passive wakeup)" 1 "Node has woken up the network (active wakeup)" ;
VAL_ 2549874724 CBV_PNIB_L_UWB_FRNK_FD 0 "NM PDU contains no partial network cluster information in the user data area" 1 "NM PDU contains partial network cluster information in the user data area" ;
VAL_ 2549874724 NRR_L_UWB_FRNK_FD 0 "Default" 1 "0x1~0xFF:RESERVED" 255 "0x1~0xFF:RESERVED" ;
VAL_ 2549874724 NM_State_L_UWB_FRNK_FD 0 "Default" 1 "NM_RMS_BSM" 2 "NM_RMS_PBSM" 3 "RESERVED" 4 "NM_NS_RMS" 5 "RESERVED" 6 "RESERVED" 7 "RESERVED" 8 "NM_NS_RSS" 9 "RESERVED" 10 "RESERVED" 11 "RESERVED" 12 "RESERVED" 13 "RESERVED" 14 "RESERVED" 15 "RESERVED" 16 "NM_RMS_RSS" 17 "RESERVED" 18 "RESERVED" 19 "RESERVED" 20 "RESERVED" 21 "RESERVED" 22 "RESERVED" 23 "RESERVED" 24 "RESERVED" 25 "RESERVED" 26 "RESERVED" 27 "RESERVED" 28 "RESERVED" 29 "RESERVED" 30 "RESERVED" 31 "RESERVED" 32 "NM_RMS_NS" 33 "0x21~0xFF:RESERVED" 255 "0x21~0xFF:RESERVED" ;
VAL_ 2549874724 PNI_L_UWB_FRNK_FD 0 "0x0x0~0xFFFFFFFF:NM PNC Bit" 2147483647 "0x0x0~0xFFFFFFFF:NM PNC Bit" ;
VAL_ 2549874724 PNI_L_UWB_FRNK_FD_1 0 "0x0~0xFFFFFFFFFFFFFFFF:NM PNC Bit" ;
VAL_ 2549874724 PNI_L_UWB_FRNK_FD_2 0 "0x0~0xFFFFFFFFFFFFFFFF:NM PNC Bit" ;
VAL_ 2549874724 PNI_L_UWB_FRNK_FD_3 0 "0x0~0xFFFFFFFFFFFFFFFF:NM PNC Bit" ;
VAL_ 2549874722 SNI_L_UWB_FL_FD 0 "0x0x0~0xFF:NM Source Node ID" 255 "0x0x0~0xFF:NM Source Node ID" ;
VAL_ 2549874722 CBV_RMR_L_UWB_FL_FD 0 "Repeat Message State not requested" 1 "Repeat Message State requested" ;
VAL_ 2549874722 CBV_NMCoID_L_UWB_FL_FD 0 "NM Coordinator ID" 1 "NM Coordinator ID" 2 "NM Coordinator ID" 3 "NM Coordinator ID" ;
VAL_ 2549874722 CBV_NMCoSRB_L_UWB_FL_FD 0 "Start of synchronized shutdown is not requested by main coordinator" 1 "Start of synchronized shutdown is requested by main coordinator" ;
VAL_ 2549874722 CBV_AWB_L_UWB_FL_FD 0 "Node has not woken up the network (passive wakeup)" 1 "Node has woken up the network (active wakeup)" ;
VAL_ 2549874722 CBV_PNIB_L_UWB_FL_FD 0 "NM PDU contains no partial network cluster information in the user data area" 1 "NM PDU contains partial network cluster information in the user data area" ;
VAL_ 2549874722 NRR_L_UWB_FL_FD 0 "Default" 1 "0x1~0xFF:RESERVED" 255 "0x1~0xFF:RESERVED" ;
VAL_ 2549874722 NM_State_L_UWB_FL_FD 0 "Default" 1 "NM_RMS_BSM" 2 "NM_RMS_PBSM" 3 "RESERVED" 4 "NM_NS_RMS" 5 "RESERVED" 6 "RESERVED" 7 "RESERVED" 8 "NM_NS_RSS" 9 "RESERVED" 10 "RESERVED" 11 "RESERVED" 12 "RESERVED" 13 "RESERVED" 14 "RESERVED" 15 "RESERVED" 16 "NM_RMS_RSS" 17 "RESERVED" 18 "RESERVED" 19 "RESERVED" 20 "RESERVED" 21 "RESERVED" 22 "RESERVED" 23 "RESERVED" 24 "RESERVED" 25 "RESERVED" 26 "RESERVED" 27 "RESERVED" 28 "RESERVED" 29 "RESERVED" 30 "RESERVED" 31 "RESERVED" 32 "NM_RMS_NS" 33 "0x21~0xFF:RESERVED" 255 "0x21~0xFF:RESERVED" ;
VAL_ 2549874722 PNI_L_UWB_FL_FD 0 "0x0x0~0xFFFFFFFF:NM PNC Bit" 2147483647 "0x0x0~0xFFFFFFFF:NM PNC Bit" ;
VAL_ 2549874722 PNI_L_UWB_FL_FD_1 0 "0x0~0xFFFFFFFFFFFFFFFF:NM PNC Bit" ;
VAL_ 2549874722 PNI_L_UWB_FL_FD_2 0 "0x0~0xFFFFFFFFFFFFFFFF:NM PNC Bit" ;
VAL_ 2549874722 PNI_L_UWB_FL_FD_3 0 "0x0~0xFFFFFFFFFFFFFFFF:NM PNC Bit" ;
VAL_ 2549874816 SNI_GW_BDC_FD 0 "0x0x0~0xFF:NM Source Node ID" 255 "0x0x0~0xFF:NM Source Node ID" ;
VAL_ 2549874816 CBV_RMR_GW_BDC_FD 0 "Repeat Message State not requested" 1 "Repeat Message State requested" ;
VAL_ 2549874816 CBV_NMCoID_GW_BDC_FD 0 "NM Coordinator ID" 1 "NM Coordinator ID" 2 "NM Coordinator ID" 3 "NM Coordinator ID" ;
VAL_ 2549874816 CBV_NMCoSRB_GW_BDC_FD 0 "Start of synchronized shutdown is not requested by main coordinator" 1 "Start of synchronized shutdown is requested by main coordinator" ;
VAL_ 2549874816 CBV_AWB_GW_BDC_FD 0 "Node has not woken up the network (passive wakeup)" 1 "Node has woken up the network (active wakeup)" ;
VAL_ 2549874816 CBV_PNIB_GW_BDC_FD 0 "NM PDU contains no partial network cluster information in the user data area" 1 "NM PDU contains partial network cluster information in the user data area" ;
VAL_ 2549874816 NRR_GW_BDC_FD 0 "Default" 1 "0x1~0xFF:RESERVED" 255 "0x1~0xFF:RESERVED" ;
VAL_ 2549874816 NM_State_GW_BDC_FD 0 "Default" 1 "NM_RMS_BSM" 2 "NM_RMS_PBSM" 3 "RESERVED" 4 "NM_NS_RMS" 5 "RESERVED" 6 "RESERVED" 7 "RESERVED" 8 "NM_NS_RSS" 9 "RESERVED" 10 "RESERVED" 11 "RESERVED" 12 "RESERVED" 13 "RESERVED" 14 "RESERVED" 15 "RESERVED" 16 "NM_RMS_RSS" 17 "RESERVED" 18 "RESERVED" 19 "RESERVED" 20 "RESERVED" 21 "RESERVED" 22 "RESERVED" 23 "RESERVED" 24 "RESERVED" 25 "RESERVED" 26 "RESERVED" 27 "RESERVED" 28 "RESERVED" 29 "RESERVED" 30 "RESERVED" 31 "RESERVED" 32 "NM_RMS_NS" 33 "0x21~0xFF:RESERVED" 255 "0x21~0xFF:RESERVED" ;
VAL_ 2549874816 PNI_GW_BDC_FD 0 "0x0x0~0xFFFFFFFF:NM PNC Bit" 2147483647 "0x0x0~0xFFFFFFFF:NM PNC Bit" ;
VAL_ 2549874816 PNI_GW_BDC_FD_1 0 "0x0~0xFFFFFFFFFFFFFFFF:NM PNC Bit" ;
VAL_ 2549874816 PNI_GW_BDC_FD_2 0 "0x0~0xFFFFFFFFFFFFFFFF:NM PNC Bit" ;
VAL_ 2549874816 PNI_GW_BDC_FD_3 0 "0x0~0xFFFFFFFFFFFFFFFF:NM PNC Bit" ;
VAL_ 2549874725 SNI_L_UWB_RL_FD 0 "0x0x0~0xFF:NM Source Node ID" 255 "0x0x0~0xFF:NM Source Node ID" ;
VAL_ 2549874725 CBV_RMR_L_UWB_RL_FD 0 "Repeat Message State not requested" 1 "Repeat Message State requested" ;
VAL_ 2549874725 CBV_NMCoID_L_UWB_RL_FD 0 "NM Coordinator ID" 1 "NM Coordinator ID" 2 "NM Coordinator ID" 3 "NM Coordinator ID" ;
VAL_ 2549874725 CBV_NMCoSRB_L_UWB_RL_FD 0 "Start of synchronized shutdown is not requested by main coordinator" 1 "Start of synchronized shutdown is requested by main coordinator" ;
VAL_ 2549874725 CBV_AWB_L_UWB_RL_FD 0 "Node has not woken up the network (passive wakeup)" 1 "Node has woken up the network (active wakeup)" ;
VAL_ 2549874725 CBV_PNIB_L_UWB_RL_FD 0 "NM PDU contains no partial network cluster information in the user data area" 1 "NM PDU contains partial network cluster information in the user data area" ;
VAL_ 2549874725 NRR_L_UWB_RL_FD 0 "Default" 1 "0x1~0xFF:RESERVED" 255 "0x1~0xFF:RESERVED" ;
VAL_ 2549874725 NM_State_L_UWB_RL_FD 0 "Default" 1 "NM_RMS_BSM" 2 "NM_RMS_PBSM" 3 "RESERVED" 4 "NM_NS_RMS" 5 "RESERVED" 6 "RESERVED" 7 "RESERVED" 8 "NM_NS_RSS" 9 "RESERVED" 10 "RESERVED" 11 "RESERVED" 12 "RESERVED" 13 "RESERVED" 14 "RESERVED" 15 "RESERVED" 16 "NM_RMS_RSS" 17 "RESERVED" 18 "RESERVED" 19 "RESERVED" 20 "RESERVED" 21 "RESERVED" 22 "RESERVED" 23 "RESERVED" 24 "RESERVED" 25 "RESERVED" 26 "RESERVED" 27 "RESERVED" 28 "RESERVED" 29 "RESERVED" 30 "RESERVED" 31 "RESERVED" 32 "NM_RMS_NS" 33 "0x21~0xFF:RESERVED" 255 "0x21~0xFF:RESERVED" ;
VAL_ 2549874725 PNI_L_UWB_RL_FD 0 "0x0x0~0xFFFFFFFF:NM PNC Bit" 2147483647 "0x0x0~0xFFFFFFFF:NM PNC Bit" ;
VAL_ 2549874725 PNI_L_UWB_RL_FD_1 0 "0x0~0xFFFFFFFFFFFFFFFF:NM PNC Bit" ;
VAL_ 2549874725 PNI_L_UWB_RL_FD_2 0 "0x0~0xFFFFFFFFFFFFFFFF:NM PNC Bit" ;
VAL_ 2549874725 PNI_L_UWB_RL_FD_3 0 "0x0~0xFFFFFFFFFFFFFFFF:NM PNC Bit" ;
VAL_ 2549874857 SNI_L_SAL_FD 0 "0x0x0~0xFF:NM Source Node ID" 255 "0x0x0~0xFF:NM Source Node ID" ;
VAL_ 2549874857 CBV_RMR_L_SAL_FD 0 "Repeat Message State not requested" 1 "Repeat Message State requested" ;
VAL_ 2549874857 CBV_NMCoID_L_SAL_FD 0 "NM Coordinator ID" 1 "NM Coordinator ID" 2 "NM Coordinator ID" 3 "NM Coordinator ID" ;
VAL_ 2549874857 CBV_NMCoSRB_L_SAL_FD 0 "Start of synchronized shutdown is not requested by main coordinator" 1 "Start of synchronized shutdown is requested by main coordinator" ;
VAL_ 2549874857 CBV_AWB_L_SAL_FD 0 "Node has not woken up the network (passive wakeup)" 1 "Node has woken up the network (active wakeup)" ;
VAL_ 2549874857 CBV_PNIB_L_SAL_FD 0 "NM PDU contains no partial network cluster information in the user data area" 1 "NM PDU contains partial network cluster information in the user data area" ;
VAL_ 2549874857 NRR_L_SAL_FD 0 "Default" 1 "0x1~0xFF:RESERVED" 255 "0x1~0xFF:RESERVED" ;
VAL_ 2549874857 NM_State_L_SAL_FD 0 "Default" 1 "NM_RMS_BSM" 2 "NM_RMS_PBSM" 3 "RESERVED" 4 "NM_NS_RMS" 5 "RESERVED" 6 "RESERVED" 7 "RESERVED" 8 "NM_NS_RSS" 9 "RESERVED" 10 "RESERVED" 11 "RESERVED" 12 "RESERVED" 13 "RESERVED" 14 "RESERVED" 15 "RESERVED" 16 "NM_RMS_RSS" 17 "RESERVED" 18 "RESERVED" 19 "RESERVED" 20 "RESERVED" 21 "RESERVED" 22 "RESERVED" 23 "RESERVED" 24 "RESERVED" 25 "RESERVED" 26 "RESERVED" 27 "RESERVED" 28 "RESERVED" 29 "RESERVED" 30 "RESERVED" 31 "RESERVED" 32 "NM_RMS_NS" 33 "0x21~0xFF:RESERVED" 255 "0x21~0xFF:RESERVED" ;
VAL_ 2549874857 PNI_L_SAL_FD 0 "0x0x0~0xFFFFFFFF:NM PNC Bit" 2147483647 "0x0x0~0xFFFFFFFF:NM PNC Bit" ;
VAL_ 2549874857 PNI_L_SAL_FD_1 0 "0x0~0xFFFFFFFFFFFFFFFF:NM PNC Bit" ;
VAL_ 2549874857 PNI_L_SAL_FD_2 0 "0x0~0xFFFFFFFFFFFFFFFF:NM PNC Bit" ;
VAL_ 2549874857 PNI_L_SAL_FD_3 0 "0x0~0xFFFFFFFFFFFFFFFF:NM PNC Bit" ;
VAL_ 2549874718 SNI_L_WPC_FD 0 "0x0x0~0xFF:NM Source Node ID" 255 "0x0x0~0xFF:NM Source Node ID" ;
VAL_ 2549874718 CBV_RMR_L_WPC_FD 0 "Repeat Message State not requested" 1 "Repeat Message State requested" ;
VAL_ 2549874718 CBV_NMCoID_L_WPC_FD 0 "NM Coordinator ID" 1 "NM Coordinator ID" 2 "NM Coordinator ID" 3 "NM Coordinator ID" ;
VAL_ 2549874718 CBV_NMCoSRB_L_WPC_FD 0 "Start of synchronized shutdown is not requested by main coordinator" 1 "Start of synchronized shutdown is requested by main coordinator" ;
VAL_ 2549874718 CBV_AWB_L_WPC_FD 0 "Node has not woken up the network (passive wakeup)" 1 "Node has woken up the network (active wakeup)" ;
VAL_ 2549874718 CBV_PNIB_L_WPC_FD 0 "NM PDU contains no partial network cluster information in the user data area" 1 "NM PDU contains partial network cluster information in the user data area" ;
VAL_ 2549874718 NRR_L_WPC_FD 0 "Default" 1 "0x1~0xFF:RESERVED" 255 "0x1~0xFF:RESERVED" ;
VAL_ 2549874718 NM_State_L_WPC_FD 0 "Default" 1 "NM_RMS_BSM" 2 "NM_RMS_PBSM" 3 "RESERVED" 4 "NM_NS_RMS" 5 "RESERVED" 6 "RESERVED" 7 "RESERVED" 8 "NM_NS_RSS" 9 "RESERVED" 10 "RESERVED" 11 "RESERVED" 12 "RESERVED" 13 "RESERVED" 14 "RESERVED" 15 "RESERVED" 16 "NM_RMS_RSS" 17 "RESERVED" 18 "RESERVED" 19 "RESERVED" 20 "RESERVED" 21 "RESERVED" 22 "RESERVED" 23 "RESERVED" 24 "RESERVED" 25 "RESERVED" 26 "RESERVED" 27 "RESERVED" 28 "RESERVED" 29 "RESERVED" 30 "RESERVED" 31 "RESERVED" 32 "NM_RMS_NS" 33 "0x21~0xFF:RESERVED" 255 "0x21~0xFF:RESERVED" ;
VAL_ 2549874718 PNI_L_WPC_FD 0 "0x0x0~0xFFFFFFFF:NM PNC Bit" 2147483647 "0x0x0~0xFFFFFFFF:NM PNC Bit" ;
VAL_ 2549874718 PNI_L_WPC_FD_1 0 "0x0~0xFFFFFFFFFFFFFFFF:NM PNC Bit" ;
VAL_ 2549874718 PNI_L_WPC_FD_2 0 "0x0~0xFFFFFFFFFFFFFFFF:NM PNC Bit" ;
VAL_ 2549874718 PNI_L_WPC_FD_3 0 "0x0~0xFFFFFFFFFFFFFFFF:NM PNC Bit" ;
VAL_ 2549874728 SNI_L_TPMS_FD 0 "0x0x0~0xFF:NM Source Node ID" 255 "0x0x0~0xFF:NM Source Node ID" ;
VAL_ 2549874728 CBV_RMR_L_TPMS_FD 0 "Repeat Message State not requested" 1 "Repeat Message State requested" ;
VAL_ 2549874728 CBV_NMCoID_L_TPMS_FD 0 "NM Coordinator ID" 1 "NM Coordinator ID" 2 "NM Coordinator ID" 3 "NM Coordinator ID" ;
VAL_ 2549874728 CBV_NMCoSRB_L_TPMS_FD 0 "Start of synchronized shutdown is not requested by main coordinator" 1 "Start of synchronized shutdown is requested by main coordinator" ;
VAL_ 2549874728 CBV_AWB_L_TPMS_FD 0 "Node has not woken up the network (passive wakeup)" 1 "Node has woken up the network (active wakeup)" ;
VAL_ 2549874728 CBV_PNIB_L_TPMS_FD 0 "NM PDU contains no partial network cluster information in the user data area" 1 "NM PDU contains partial network cluster information in the user data area" ;
VAL_ 2549874728 NRR_L_TPMS_FD 0 "Default" 1 "0x1~0xFF:RESERVED" 255 "0x1~0xFF:RESERVED" ;
VAL_ 2549874728 NM_State_L_TPMS_FD 0 "Default" 1 "NM_RMS_BSM" 2 "NM_RMS_PBSM" 3 "RESERVED" 4 "NM_NS_RMS" 5 "RESERVED" 6 "RESERVED" 7 "RESERVED" 8 "NM_NS_RSS" 9 "RESERVED" 10 "RESERVED" 11 "RESERVED" 12 "RESERVED" 13 "RESERVED" 14 "RESERVED" 15 "RESERVED" 16 "NM_RMS_RSS" 17 "RESERVED" 18 "RESERVED" 19 "RESERVED" 20 "RESERVED" 21 "RESERVED" 22 "RESERVED" 23 "RESERVED" 24 "RESERVED" 25 "RESERVED" 26 "RESERVED" 27 "RESERVED" 28 "RESERVED" 29 "RESERVED" 30 "RESERVED" 31 "RESERVED" 32 "NM_RMS_NS" 33 "0x21~0xFF:RESERVED" 255 "0x21~0xFF:RESERVED" ;
VAL_ 2549874728 PNI_L_TPMS_FD 0 "0x0x0~0xFFFFFFFF:NM PNC Bit" 2147483647 "0x0x0~0xFFFFFFFF:NM PNC Bit" ;
VAL_ 2549874728 PNI_L_TPMS_FD_1 0 "0x0~0xFFFFFFFFFFFFFFFF:NM PNC Bit" ;
VAL_ 2549874728 PNI_L_TPMS_FD_2 0 "0x0~0xFFFFFFFFFFFFFFFF:NM PNC Bit" ;
VAL_ 2549874728 PNI_L_TPMS_FD_3 0 "0x0~0xFFFFFFFFFFFFFFFF:NM PNC Bit" ;
VAL_ 2549874730 SNI_L_DHL_FD 0 "0x0x0~0xFF:NM Source Node ID" 255 "0x0x0~0xFF:NM Source Node ID" ;
VAL_ 2549874730 CBV_RMR_L_DHL_FD 0 "Repeat Message State not requested" 1 "Repeat Message State requested" ;
VAL_ 2549874730 CBV_NMCoID_L_DHL_FD 0 "NM Coordinator ID" 1 "NM Coordinator ID" 2 "NM Coordinator ID" 3 "NM Coordinator ID" ;
VAL_ 2549874730 CBV_NMCoSRB_L_DHL_FD 0 "Start of synchronized shutdown is not requested by main coordinator" 1 "Start of synchronized shutdown is requested by main coordinator" ;
VAL_ 2549874730 CBV_AWB_L_DHL_FD 0 "Node has not woken up the network (passive wakeup)" 1 "Node has woken up the network (active wakeup)" ;
VAL_ 2549874730 CBV_PNIB_L_DHL_FD 0 "NM PDU contains no partial network cluster information in the user data area" 1 "NM PDU contains partial network cluster information in the user data area" ;
VAL_ 2549874730 NRR_L_DHL_FD 0 "Default" 1 "0x1~0xFF:RESERVED" 255 "0x1~0xFF:RESERVED" ;
VAL_ 2549874730 NM_State_L_DHL_FD 0 "Default" 1 "NM_RMS_BSM" 2 "NM_RMS_PBSM" 3 "RESERVED" 4 "NM_NS_RMS" 5 "RESERVED" 6 "RESERVED" 7 "RESERVED" 8 "NM_NS_RSS" 9 "RESERVED" 10 "RESERVED" 11 "RESERVED" 12 "RESERVED" 13 "RESERVED" 14 "RESERVED" 15 "RESERVED" 16 "NM_RMS_RSS" 17 "RESERVED" 18 "RESERVED" 19 "RESERVED" 20 "RESERVED" 21 "RESERVED" 22 "RESERVED" 23 "RESERVED" 24 "RESERVED" 25 "RESERVED" 26 "RESERVED" 27 "RESERVED" 28 "RESERVED" 29 "RESERVED" 30 "RESERVED" 31 "RESERVED" 32 "NM_RMS_NS" 33 "0x21~0xFF:RESERVED" 255 "0x21~0xFF:RESERVED" ;
VAL_ 2549874730 PNI_L_DHL_FD 0 "0x0x0~0xFFFFFFFF:NM PNC Bit" 2147483647 "0x0x0~0xFFFFFFFF:NM PNC Bit" ;
VAL_ 2549874730 PNI_L_DHL_FD_1 0 "0x0~0xFFFFFFFFFFFFFFFF:NM PNC Bit" ;
VAL_ 2549874730 PNI_L_DHL_FD_2 0 "0x0~0xFFFFFFFFFFFFFFFF:NM PNC Bit" ;
VAL_ 2549874730 PNI_L_DHL_FD_3 0 "0x0~0xFFFFFFFFFFFFFFFF:NM PNC Bit" ;
VAL_ 2549874731 SNI_L_DHR_FD 0 "0x0x0~0xFF:NM Source Node ID" 255 "0x0x0~0xFF:NM Source Node ID" ;
VAL_ 2549874731 CBV_RMR_L_DHR_FD 0 "Repeat Message State not requested" 1 "Repeat Message State requested" ;
VAL_ 2549874731 CBV_NMCoID_L_DHR_FD 0 "NM Coordinator ID" 1 "NM Coordinator ID" 2 "NM Coordinator ID" 3 "NM Coordinator ID" ;
VAL_ 2549874731 CBV_NMCoSRB_L_DHR_FD 0 "Start of synchronized shutdown is not requested by main coordinator" 1 "Start of synchronized shutdown is requested by main coordinator" ;
VAL_ 2549874731 CBV_AWB_L_DHR_FD 0 "Node has not woken up the network (passive wakeup)" 1 "Node has woken up the network (active wakeup)" ;
VAL_ 2549874731 CBV_PNIB_L_DHR_FD 0 "NM PDU contains no partial network cluster information in the user data area" 1 "NM PDU contains partial network cluster information in the user data area" ;
VAL_ 2549874731 NRR_L_DHR_FD 0 "Default" 1 "0x1~0xFF:RESERVED" 255 "0x1~0xFF:RESERVED" ;
VAL_ 2549874731 NM_State_L_DHR_FD 0 "Default" 1 "NM_RMS_BSM" 2 "NM_RMS_PBSM" 3 "RESERVED" 4 "NM_NS_RMS" 5 "RESERVED" 6 "RESERVED" 7 "RESERVED" 8 "NM_NS_RSS" 9 "RESERVED" 10 "RESERVED" 11 "RESERVED" 12 "RESERVED" 13 "RESERVED" 14 "RESERVED" 15 "RESERVED" 16 "NM_RMS_RSS" 17 "RESERVED" 18 "RESERVED" 19 "RESERVED" 20 "RESERVED" 21 "RESERVED" 22 "RESERVED" 23 "RESERVED" 24 "RESERVED" 25 "RESERVED" 26 "RESERVED" 27 "RESERVED" 28 "RESERVED" 29 "RESERVED" 30 "RESERVED" 31 "RESERVED" 32 "NM_RMS_NS" 33 "0x21~0xFF:RESERVED" 255 "0x21~0xFF:RESERVED" ;
VAL_ 2549874731 PNI_L_DHR_FD 0 "0x0x0~0xFFFFFFFF:NM PNC Bit" 2147483647 "0x0x0~0xFFFFFFFF:NM PNC Bit" ;
VAL_ 2549874731 PNI_L_DHR_FD_1 0 "0x0~0xFFFFFFFFFFFFFFFF:NM PNC Bit" ;
VAL_ 2549874731 PNI_L_DHR_FD_2 0 "0x0~0xFFFFFFFFFFFFFFFF:NM PNC Bit" ;
VAL_ 2549874731 PNI_L_DHR_FD_3 0 "0x0~0xFFFFFFFFFFFFFFFF:NM PNC Bit" ;
