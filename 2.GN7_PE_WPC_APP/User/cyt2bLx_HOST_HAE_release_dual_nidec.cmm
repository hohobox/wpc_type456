;Thanks for buying our HAE HSM product
;HSM framework empower customer's security
;version: 2021. 02. 19@hae

local &filePath
entry &filePath


gosub Main
enddo


Main:
(
	;gosub parsePath
	gosub initCpu
	gosub haltSys
	gosub flashSetup
	gosub eraseFlash
	gosub writeFw
	
	sys.down
	sys.up
	
	return
)

parsePath:
(
	&filePath=STRing.SCANAndExtract(STRing.UPpeR("&filePath"),"HOSTPATH=","")
    IF !OS.FILE("&filePath")
	(
		DIALOG.FILE *
		ENTRY &filePath
	)
	return
)

initCpu:
(
	SYStem.cpu CYT2BL4-CM0+
	;system.cpu
	RETURN
)

haltSys:
(
	sys.m.down
	sys.reset
	SYS.CONFIG DEBUGPORTTYPE JTAG
	SYS.JtagClock 10MHz
	
	sys.option enreset on
	sys.option waitidcode on
	sys.option coresightreset on
	
	sys.option cypressacquire on
	sys.up
	sys.option cypressacquire off
	
	GOSUB wdtDisable
	return
)


flashSetup:
(
	PRIVATE &nHostCodeLargeSectors  &nHostCodeSmallSectors
	PRIVATE &nHostWorkFlashLargeSectors &nHostWorkFlashSmallSectors

	; 4160KB(32KBx126 + 8KBx16)
	&nHostCodeLargeSectors=126.
	&nHostCodeSmallSectors=16.

	; 128KB(2KBx48 + 128Bx256)
	&nHostWorkFlashLargeSectors=48.
    &nHostWorkFlashSmallSectors=256.

	flash.reset

	; <code flash>
	; large
	FLASH.Create 1. (0x10000000)++(&nHostCodeLargeSectors*0x8000-0x1) 0x8000 TARGET LONG
	; small
	FLASH.Create 1. (0x10000000+&nHostCodeLargeSectors*0x8000)++(&nHostCodeSmallSectors*0x2000-0x1) 0x2000 TARGET LONG
	
	; <work flash>
	; large
	FLASH.Create 2. (0x14000000)++(&nHostWorkFlashLargeSectors*0x800-0x1) 0x800 TARGET LONG
	; small
	FLASH.Create 2. (0x14000000+&nHostWorkFlashLargeSectors*0x800)++(&nHostWorkFlashSmallSectors*0x80-0x1) 0x80 TARGET LONG
	
	gosub doFlashAlgorithm
	
	return
)

eraseFlash:
(
	;nidec DIALOG.YESNO "Program flash memory?"
	;LOCAL &progflash
	;ENTRY &progflash
	;nidec IF &progflash
	(
  		;CM0_ROM_Reserved       : ORIGIN = 0x10000000, LENGTH = 0x28000     /* 160KB      - ROM for CM0 Executable */
  		;FBL_ROM_Reserved       : ORIGIN = 0x10028000, LENGTH = 0x30000     /* 192KB      - ROM for FBL */
		;#if defined(_DualBank_)
  		;CODE_FLASH             : ORIGIN = 0x10058000, LENGTH = 0x101F7FFF- 0x10058000
  
		;CYT2BLXX_4M
		; hsm : 0x1000_0000--0x1002_7FFF
		; fbl : 0x1002_8000--0x1005_7FFF
		; app : 0x1005_8000--0x101F_7FFF
		
  		; CODE_DB_LS[32KB]  : 0x1000_0000--0x101F_7FFF (2016KB) 
  		; CODE_DB_SS[8KB]   : 0x101F_8000--0x1020_7FFF   (64KB)   
		
		;erase work flash(16KB) ; hsm		
		;flash.erase 0x1401C000++0x3fff
		
		;workflash is not dual mode
		;erase work flash(112KB) ; fbl+app ; 112 + 16 = 128KB
		;flash.erase 0x14000000++0x1BFFF ;
		
		IF "&WorkFlash_En"=="Yes"
		(
			flash.erase 0x14000000++0x1BFFF ;
		)
				
		;map A
		Data.Set AD:0x40240000 %Long 0x00111000  ;//Enable dual bank mode for 0x1200 0000		
				
		;erase fbl flash
		IF "&FBLFlash_En"=="Yes"
  		(		
			flash.erase 0x10028000++0x2FFFF
		)
		
		;erase code flash
		IF "&AppFlash_En"=="Yes"
  		(			
			flash.erase 0x10058000++0x1AFFFF ; 0x1DFFFF - 0x2FFFF
		)
		;flash.erase 0x10028000++0x1DFFFF			
				
		;map B
		Data.Set AD:0x40240000 %Long 0x00111100  ;//bank B
		
		;erase fbl flash
		IF "&FBLFlash_En"=="Yes"
  		(			
			flash.erase 0x10028000++0x2FFFF
		)
		
		;erase code flash
		IF "&AppFlash_En"=="Yes"
  		(			
			flash.erase 0x10058000++0x1AFFFF ; 0x1DFFFF - 0x2FFFF
		)
		;flash.erase 0x10028000++0x1DFFFF
	)	
	return
)

writeFw:
(
	Data.Set AD:0x40240000 %Long 0x00111000  ;map A
	
	flash.reprogram all
 	
	; fbl은 a, b bank에 모두 write한다.
	; rtsw는 a bank에만 write하고 b bank는 write 하지 않는다. (디버그이므로 양쪽 모두 라이팅할 필요 없음.시간 단축위해서.)
 
	;data.load.elf "&fbl_m4"
	;data.load.elf "&elf_m4"

	IF "&FBLFlash_En"=="Yes"
  	(
		PRINT "FBLFlash_En = Yes"
		data.load.auto "&fbl_m4_path" ; auto는 자동으로 파일 형식을 감지함.
		
		IF "&OEUK_En"=="Develop"
		( 
			PRINT "OEUK_En = Develop"
   			Data.load.binary "&oeuk_dev_path" 0x10057E00--0x10057FFF
   			;Data.SAVE.S3RECORD ".\FBL_OEUK_Develop.s19" 0x10028000--0x10057FFF /RECORDLEN 20 ; FBL OEUK Dump  		
		)	
		ELSE IF "&OEUK_En"=="GN7_PE";
		(
			PRINT "OEUK_En = GN7_PE"
			Data.load.binary "&oeuk_sop_gn7_pe_path" 0x10057E00--0x10057FFF
  			;Data.SAVE.S3RECORD ".\FBL_OEUK_GN7_PE.s19" 0x10028000--0x10057FFF /RECORDLEN 20 ; FBL OEUK Dump  	
		)
		ELSE IF "&OEUK_En"=="RX4_PE";
		(
			PRINT "OEUK_En = RX4_PE"
			Data.load.binary "&&oeuk_sop_rs4_pe_path" 0x10057E00--0x10057FFF
  			;Data.SAVE.S3RECORD ".\FBL_OEUK_RX4_PE.s19" 0x10028000--0x10057FFF /RECORDLEN 20 ; FFBL OEUK Dump  	
		)	
		ELSE
		(
		
		)
	)
	
	IF "&AppFlash_En"=="Yes"
  	(	
		PRINT "AppFlash_En = Yes"
		data.load.auto "&elf_m4_path"
	)
	
	flash.reprogram off
	
	Data.Set AD:0x40240000 %Long 0x00111100  ;map B

	flash.reprogram all

	;data.load.elf "&fbl_m4" 
	;data.load.elf "&elf_m4" 

	IF "&FBLFlash_En"=="Yes"
  	(
		data.load.auto "&fbl_m4_path" 

	
		IF "&OEUK_En"=="Develop"
		( 
   			Data.load.binary "&oeuk_dev_path" 0x10057E00--0x10057FFF
	   		;Data.SAVE.S3RECORD ".\FBL_OEUK_Develop.s19" 0x10028000--0x10057FFF /RECORDLEN 20 ; FBL OEUK Dump  		
		)	
		ELSE IF "&OEUK_En"=="GN7_PE";
		(
			Data.load.binary "&oeuk_sop_gn7_pe_path" 0x10057E00--0x10057FFF
  			;Data.SAVE.S3RECORD ".\FBL_OEUK_GN7_PE.s19" 0x10028000--0x10057FFF /RECORDLEN 20 ; FBL OEUK Dump  	
		)
		ELSE IF "&OEUK_En"=="RX4_PE";
		(
			Data.load.binary "&oeuk_sop_gn7_pe_path" 0x10057E00--0x10057FFF
  			;Data.SAVE.S3RECORD ".\FBL_OEUK_RX4_PE.s19" 0x10028000--0x10057FFF /RECORDLEN 20 ; FFBL OEUK Dump  	
		)	
		ELSE
		(
		
		)		
	)
		
	IF "&FBLFlash_En"=="Yes"
  	(	
		data.load.auto "&elf_m4_path" 
	)
	
	flash.reprogram off
	
	return
)

doFlashAlgorithm:
(
	PRIVATE &nSRamBaseAddress &sFirmwareRam &use_dualport &algoPath
	&nSRamBaseAddress=0x08000000
	&algoPath="~~/demo/arm/flash/long/traveo_ii.bin"
	
	&use_dualport="1"
	;&sFirmwareRam="0x0803f800++0x7ff"		;rev B
	;&sFirmwareRam="0x08000000++0x7ff"		;rev C
	;&sFirmwareRam="/FirmwareRAM &(sFirmwareRam)"
	&sFirmwareRam=""

	IF (("&use_dualport"!="1")||SYStem.ACCESS.DENIED())
	FLASH.TARGET &nSRamBaseAddress+0x1000   &nSRamBaseAddress+0x2000 0x1000 "&algoPath" /STACKSIZE 0x800 &sFirmwareRam
	ELSE
	FLASH.TARGET &nSRamBaseAddress+0x1000 E:&nSRamBaseAddress+0x2000 0x1000 "&algoPath" /STACKSIZE 0x800 &sFirmwareRam /DUALPORT

	FLASH.CLOCK AUTO
	return
)

wdtDisable:
(	
	;unlock
	Data.Set AD:0x4026C040 %Long 1
	Data.Set AD:0x4026C040 %Long 2
	
	;jk@devel - global disable
	;additional information refer to wdt_config debug_trigger_en reg in trm 
	Data.Set AD:0x4026C000 %Long 0
	
	;lock again
	Data.Set AD:0x4026C040 %Long 3

	return
)
