AUTOSAR XML (schema 4-0-3)
# (C) 2013 HYUNDAI AUTOEVER Co., Ltd.
# Confidential Proprietary Information. Distribution Limited.
# Do Not Copy Without Prior Permission
package /AUTRON
  ecuc definition collection ParameterDefinition_Com: module=Com
  module definition Com: refined-module-def=Com, variants pre-compile  # Configuration of the AUTOSAR COM module.
    container ComConfig  # This container contains the configuration parameters and sub containers of the AUTOSAR COM module. This container is a MultipleConfigurationContainer, i.e. this container and its sub-containers exist once per configuration set.
      integer ComConfigurationId: 0..4294967295, category=FIXED, set at pre-compile  # This ID is returned by a call to Com_GetConfigurationId.
      container ComGwMapping [0..*]  # Each instance of this container defines one mapping of the integrated signal gateway.
        choice container ComGwDestination [1..*]  # Each instance of this choice container allows to define one routing destination either by reference to an already configured COM signal / signal group or by a destination description container.
          container ComGwDestinationDescription [0..1]  # Description of a gateway destination. This container allows defining a gateway destination without the configuration of a complete COM signal. This allows adding / changing gateway relations post build without the configuration of new signals.
            integer ComBitPosition: 0..65535, category=NOT_SUPPORTED, set at pre-compile  # Starting position within the I-PDU. This parameter refers to the position in the I-PDU and not in the shadow buffer. If the endianness conversion is configured to Opaque the parameter ComBitPosition shall define the bit0 of the first byte like in little endian byte order
            enumeration ComSignalEndianness: {BIG_ENDIAN, LITTLE_ENDIAN, OPAQUE}, category=NOT_SUPPORTED, set at pre-compile  # Defines the endianness of the signal's network representation. | BIG_ENDIAN: Endianess of the signal's representation is big endian. LITTLE_ENDIAN: Endianess of the signal's representation is little endian. OPAQUE: : Endianess of the signal's representation is OPAQUE.
            string ComSignalInitValue [0..1]: category=NOT_SUPPORTED, set at pre-compile, default-value=0  # Initial value for this signal. The default value is 0. | In case the ComSignalType is UINT8, UINT16, UINT32, SINT8, SINT16, SINT32 the string shall be interpreted as defined in the chapter Integer Type in the AUTOSAR EcuC specification. In case the ComSignalType is FLOAT32, FLOAT64 the string shall be interpreted as defined in the chapter Float Type in the AUTOSAR EcuC specification. In case the ComSignalType is BOOLEAN the string shall be interpreted as defined in the chapter Boolean Type in the AUTOSAR EcuC specification. In case the ComSignal is a UINT8_N, UINT6_DYN the string shall be interpreted as a decimal representation of the characters separated by blanks, e.g. "97 98 100" means a string "abd", where the char "a" is in byte 0(lowest address), "b" is in byte 1, and "d" is in byte 2 and (highest address).
            enumeration ComTransferProperty [0..1]: {PENDING, TRIGGERED, TRIGGERED_ON_CHANGE, TRIGGERED_ON_CHANGE_WITHOUT_REPETITION, TRIGGERED_WITHOUT_REPETITION}, category=NOT_SUPPORTED, set at pre-compile  # Defines if a write access to this signal can trigger the transmission of the corresponding I-PDU. If the I-PDU is triggered, depends also on the transmission mode of the corresponding I-PDU. | PENDING: Transfer property of Signals is Pending. TRIGGERED: Transfer property of Signals is Triggered. TRIGGERED_ON_CHANGE: Transfer property of Signals is Triggered on change. TRIGGERED_ON_CHANGE_WITHOUT_REPETITION: Transfer property of Signals is Triggered on change without Repetition. TRIGGERED_WITHOUT_REPETITION: Transfer property of Signals is Triggered without Repetition.
            integer ComUpdateBitPosition [0..1]: 0..65535, category=NOT_SUPPORTED, set at pre-compile  # Bit position of update-bit inside I-PDU. | If this attribute is omitted then there is no update-bit. This setting must be consistently on sender and on receiver side. Range: 0..63 for CAN and LIN 0..2031 for FlexRay
            reference ComGwIPduRef: category=NOT_SUPPORTED, set at pre-compile, destination=ComIPdu  # Reference to an I-PDU of a Signal Gateway source or destination description.
            container ComFilter [0..1]: category=NOT_SUPPORTED  # This container contains the configuration parameters of the AUTOSAR COM module's Filters. | Note: On sender side the container is used to specify the transmission mode conditions.
              enumeration ComFilterAlgorithm: {ALWAYS, MASKED_NEW_DIFFERS_MASKED_OLD, MASKED_NEW_DIFFERS_X, MASKED_NEW_EQUALS_X, NEVER, NEW_IS_OUTSIDE, NEW_IS_WITHIN, ONE_EVERY_N}, category=NOT_SUPPORTED, set at pre-compile  # The range of values is specified in the [17] specification, chapter 2.2.2, Reception Filtering. ALWAYS: Filter algorithm for a Signal is ALWAYS. MASKED_NEW_DIFFERS_MASKED_OLD: Filter algorithm for a Signal is MASKED_NEW_DIFFERS_MASKED_OLD. MASKED_NEW_DIFFERS_X: Filter algorithm for a Signal is MASKED_NEW_DIFFERS_X. MASKED_NEW_EQUALS_X: Filter algorithm for a Signal is MASKED_NEW_EQUALS_X. NEVER: Filter algorithm for a Signal is NEVER. NEW_IS_OUTSIDE: Filter algorithm for a Signal is NEW_IS_OUTSIDE. NEW_IS_WITHIN: Filter algorithm for a Signal is NEW_IS_WITHIN. ONE_EVERY_N: Filter algorithm for a Signal is ONE_EVERY_N.
              integer ComFilterMask [0..1]: -2147483648..4294967295, category=NOT_SUPPORTED, set at pre-compile  # The name of this attribute corresponds to the parameter name in the [17] specification of Reception Filtering.
              integer ComFilterMax [0..1]: -2147483648..4294967295, category=NOT_SUPPORTED, set at pre-compile  # The name of this attribute corresponds to the parameter name in the [17] specification of Reception Filtering.
              integer ComFilterMin [0..1]: -2147483648..4294967295, category=NOT_SUPPORTED, set at pre-compile  # The name of this attribute corresponds to the parameter name in the [17] specification of Reception Filtering.
              integer ComFilterOffset [0..1]: 0..4294967294, category=NOT_SUPPORTED, set at pre-compile  # The name of this attribute corresponds to the parameter name in the [17] specification of Reception Filtering. | Range = 0..(ComFilterPeriod-1)
              integer ComFilterPeriod [0..1]: 2..4294967295, category=NOT_SUPPORTED, set at pre-compile  # This parameter defines the period of the ComFilterAlgorithm ONE_EVERY_N.
              integer ComFilterX [0..1]: -2147483648..4294967295, category=NOT_SUPPORTED, set at pre-compile  # The name of this attribute corresponds to the parameter name in the [17] specification of Reception Filtering.
          container ComGwSignal [0..1]  # This container allows specifying a gateway source or destination respectively with a reference to a ComSignal, a ComGroupSignal or a ComSignalGroup.
            function name ComGwSignalCallout [0..1]: set at pre-compile, origin=AUTOEVER  # This parameter defines the existence and the name of a callout function for the corresponding Signal Gateway. If this parameter is omitted no I-PDU callout shall take place and Signal Gateway performs the normal gateway process as defined in AUTOSAR
            enumeration ComGwSignalCalloutAction [0..1]: {ALWAYS, TIMEOUT_ONLY}, set at pre-compile, origin=AUTOEVER, default-value=DEFERRED  # For the definition of the two modes ALWAYS and TIMEOUT_ONLY. ALWAYS : The Signal Gateway callout function will be invoked at every gateway status. TIMEOUT_ONLY : The Signal Gateway callout function will be invoked at timeout gateway status only.
            choice reference ComGwSignalRef: category=FIXED, set at pre-compile, destination=[ComGroupSignal, ComSignal, ComSignalGroup]  # Reference to an object of a gateway relation. Either to a ComSignal, ComGroupSignal or to a SignalGroup.
        choice container ComGwSource  # This choice container allows the definition of the gateway source signal either by reference to an already configured COM signal / signal group or by a source description container.
          container ComGwSignal [0..1]  # This container allows specifying a gateway source or destination respectively with a reference to a ComSignal, a ComGroupSignal or a ComSignalGroup.
            boolean ComSignalGatewayDMTriggerEnable [0..1]: set at pre-compile, origin=AUTOEVER, default-value=false  # If true, it will trigger signal gateway when timeout is occurred. | true: enable signal gateway when timeout(Deadline Monitoring) false: disable signal gateway when timeout(Deadline Monitoring)
            choice reference ComGwSignalRef: category=FIXED, set at pre-compile, destination=[ComGroupSignal, ComSignal, ComSignalGroup]  # Reference to an object of a gateway relation. Either to a ComSignal, ComGroupSignal or to a SignalGroup.
          container ComGwSourceDescription [0..1]  # Description of a gateway source. This container allows defining a gateway source without the configuration of a complete COM signal. This allows adding / changing gateway relations post build without the configuration of new signals.
            integer ComBitPosition: 0..65535, category=NOT_SUPPORTED, set at pre-compile  # Starting position within the I-PDU. This parameter refers to the position in the I-PDU and not in the shadow buffer. If the endianness conversion is configured to Opaque the parameter ComBitPosition shall define the bit0 of the first byte like in little endian byte order
            integer ComBitSize [0..1]: 0..64, category=NOT_SUPPORTED, set at pre-compile  # Size in bits, for non-array signal types. | For ComSignalType UINT8_N and UINT8_DYN this size shall be configured by ComSignalLength.
            enumeration ComSignalEndianness: {BIG_ENDIAN, LITTLE_ENDIAN, OPAQUE}, category=NOT_SUPPORTED, set at pre-compile  # Defines the endianness of the signal's network representation. | BIG_ENDIAN: Endianess of the signal's representation is big endian. LITTLE_ENDIAN: Endianess of the signal's representation is little endian. OPAQUE: : Endianess of the signal's representation is OPAQUE.
            integer ComSignalLength [0..1]: 0..4095, category=NOT_SUPPORTED, set at pre-compile  # Description: | For ComSignalType UINT8_N this parameter specifies the length n in bytes. For ComSignalType UINT8_DYN it specifies the maximum length in bytes. For all other types this parameter shall be ignored. Range: 0..8 for normal CAN/ LIN I-PDUs, 0..254 for normal FlexRay I-PDUs, and 0..4095 for I-PDUs with ComIPduType TP.
            enumeration ComSignalType: {BOOLEAN, FLOAT32, FLOAT64, SINT16, SINT32, SINT8, UINT16, UINT32, UINT8, UINT8_DYN, UINT8_N}, category=NOT_SUPPORTED, set at pre-compile  # The AUTOSAR type of the signal. Whether or not the signal is signed or unsigned can be found by examining the value of this attribute. | This type could also be used to reserved appropriate storage in AUTOSAR COM. BOOLEAN: Signal Type is BOOLEAN. FLOAT32: Signal Type is FLOAT32. FLOAT64: Signal Type is FLOAT64. SINT16: Signal Type is SINT16. SINT32: Signal Type is SINT32. SINT8: Signal Type is SINT8. UINT16: Signal Type is UINT16. UINT32: Signal Type is UINT32. UINT8: Signal Type is UINT8. UINT8_DYN: Signal Type is UINT8_DYN. UINT8_N: Signal Type is UINT8_N.
            integer ComUpdateBitPosition [0..1]: 0..65535, category=NOT_SUPPORTED, set at pre-compile  # Bit position of update-bit inside I-PDU. | If this attribute is omitted then there is no update-bit. This setting must be consistently on sender and on receiver side. Range: 0..63 for CAN and LIN 0..2031 for FlexRay
            reference ComGwIPduRef: category=NOT_SUPPORTED, set at pre-compile, destination=ComIPdu  # Reference to an I-PDU of a Signal Gateway source or destination description.
      container ComIPdu [0..*]  # Contains the configuration parameters of the AUTOSAR COM module's I-PDUs.
        function name ComIPduCallout [0..1]: set at pre-compile  # This parameter defines the existence and the name of a callout function for the corresponding I-PDU. If this parameter is omitted no I-PDU callout shall take place for the corresponding I-PDU.
        boolean ComIPduCancellationSupport [0..1]: category=FIXED, set at pre-compile, default-value=false  # Defines for I-PDUs with ComIPduType NORMAL: | If the underlying IF-modul supports cancellation of transmit requests. Defines for I-PDUs with ComIPduType TP: If the underlying TP-module supports RX and TX cancellation of ongoing requests. true: If the underlying IF-modul supports cancellation of transmit requests in case of NORMAL and If the underlying TP-module supports RX and TX cancellation of ongoing requests in case of TP. false: the default value is assumed.
        enumeration ComIPduDirection: {RECEIVE, SEND}, category=FIXED, set at pre-compile  # The direction defines if this I-PDU, and therefore the contributing signals and signal groups, shall be sent or received. SEND: If the parameter value is configured as SEND, then all the Signals and Signal Groups are of "transmit" type. RECEIVE: if the parameter value is configured as RECEIVE, then all the Signals and Signal Groups are of "receive" type.
        integer ComIPduHandleId [0..1]: 0..65535, category=FIXED, set at pre-compile, symbolic-name-value=true  # The numerical value used as the ID of this I-PDU. The ComIPduHandleId is required by the API calls to receive I-PDUs from the PduR (ComIP-duDirection: Receive). For Tx-I-PDUs (ComIPduDirection: Send) this handle Id is used by the PduR to confirm the transmission of the ComIPdu. In case no Tx-Confirmation is configured for a Tx-I-PDU, the ComIPduHandleId is not used.
        enumeration ComIPduSignalProcessing: {DEFERRED, IMMEDIATE}, set at pre-compile, default-value=DEFERRED  # For the definition of the two modes Immediate and Deferred. IMMEDIATE: The signal indications/confirmations are performed in Com_RxIndication/Com_TxConfirmation. DEFERRED: The signal indications/confirmations are deferred for example to a cyclic task.
        function name ComIPduTriggerTransmitCallout [0..1]: set at pre-compile  # If there is a trigger transmit callout defined for this I-PDU this parameter contains the name of the callout function.
        enumeration ComIPduType: {NORMAL, TP}, category=FIXED, set at pre-compile, default-value=NORMAL  # Defines if this I-PDU is a normal I-PDU that can be sent unfragmented or if this is a large I-PDU that shall be sent via the Transport Protocol of the underlying bus. NORMAL: Defines this I-PDU as a normal I-PDU. TP: Defines this I-PDU is sent or received via TP
        reference ComIPduGroupRef [0..*]: category=FIXED, set at pre-compile, destination=ComIPduGroup  # Reference to the I-PDU groups this I-PDU belongs to.
        reference ComIPduSignalGroupRef [0..*]: category=FIXED, set at pre-compile, destination=ComSignalGroup  # References to all signal groups contained in this I-Pdu
        reference ComIPduSignalRef [0..*]: category=FIXED, set at pre-compile, destination=ComSignal  # References to all signals contained in this I-PDU.
        reference ComPduIdRef: category=FIXED, set at pre-compile, destination=Pdu  # Reference to the "global" Pdu structure to allow harmonization of handle IDs in the COM-Stack.
        container ComIPduCounter [0..1]  # This optional container contains the configuration parameters of PDU Counter.
          function name ComIPduCounterErrorNotification [0..1]: category=NOT_SUPPORTED, set at pre-compile  # Name of Com_CbkCounterErr callback function to be called. If this | parameter is omitted no I-PDU counter mismatch notification shall take place.
          integer ComIPduCounterSize: 1..8, category=NOT_SUPPORTED, set at pre-compile  # Size of PDU Counter expressed in bits
          integer ComIPduCounterStartPosition: 0..2031, category=NOT_SUPPORTED, set at pre-compile  # Position of PDU counter expressed in bits from start position of data content | of I-PDU (SDU). Note that PDU counter is not allowed to cross a byte border. The parameter ComIPduCounterStartPosition shall define the bit0 of the first byte like in little endian byte order.
          integer ComIPduCounterThreshold [0..1]: 0..255, category=NOT_SUPPORTED, set at pre-compile, default-value=0  # Threshold value of I-PDU counter algorithm, see COM590.
        container ComIPduReplication [0..1]  # This optional container contains the information needed for each I-PDU replicated.
          integer ComIPduReplicationQuorum: 1..3, category=NOT_SUPPORTED, set at pre-compile  # The number of identical I-PDUs needed for successful voting.
          reference ComIPduReplicaRef [1..2]: category=NOT_SUPPORTED, set at pre-compile, destination=Pdu  # Reference to replicas PduR PDUs of this IPDU.
        container ComTxIPdu [0..1]  # This container contains additional transmission related configuration parameters of the AUTOSAR COM module's I-PDUs.
          float ComMinimumDelayTime [0..1]: 0..3600, category=FIXED, set at pre-compile, origin=AUTOSAR_ECUC V3.0  # Defines the Minimum Delay Time (MDT) between successive transmissions of this I-PDU in seconds. The MDT is independent of the possible different transmission modes. There is only one minimum delay time parameter for one I-PDU. The minimum delay timer is not reset by changing the transmission mode. Hence, it is not allowed to violate the minimum delay time by transmission mode changes. It is not possible to monitor the minimum delay time for I-PDUs that are requested using the Com_TriggerTransmit API.
          enumeration ComTxIPduClearUpdateBit [0..1]: {Confirmation, Transmit, TriggerTransmit}, category=NOT_SUPPORTED, set at pre-compile  # Defines when the update-bits of signals or signal groups, contained in this I-PDU, will be cleared. Confirmation: The update-bits are cleared when the transmission of the I-PDU was confirmed. In case of Direct/N-Times transmission mode the update bits will be cleared with respect to the confirmation behaviour of COM305. Transmit: The update-bits are cleared directly after the invocation of PduR_ComTransmit. TriggerTransmit: The update-bits are cleared after the I-PDU was fetched via Com_TriggerTransmit.
          integer ComTxIPduUnusedAreasDefault: 0..255, set at pre-compile  # The AUTOSAR COM module fills not used areas of an I-PDU with this byte pattern. This attribute is mandatory to avoid undefined behaviour. This byte-pattern will be repeated throughout the I-PDU before any init-values or update-bits were set.
          container ComTxModeFalse [0..1]  # This container contains the configuration parameters of the AUTOSAR COM module's transmission modes in the case the ComFilter evaluates to false.
            container ComTxMode  # This container contains the configuration parameters of the AUTOSAR COM module's transmission modes.
              enumeration ComTxModeMode: {DIRECT, MIXED, NONE, PERIODIC}, category=FIXED, set at pre-compile  # The available transmission modes described in [18] shall be extended by the additional mode None. | The transmission mode None shall not have any further sub-attributes in the ComTxMode object. DIRECT: Transmission of an I-PDU with direct transmission mode is caused by the transfer of any signal assign to the I-PDU with the triggered transfer property. MIXED: Mixed transmission mode is a combination of the "Direct/N-Times" and the periodic transmission mode. NONE: In transmission mode "None" no transmission is initiated by AUTOSAR COM. PERIODIC: In periodic transmission mode, AUTOSAR COM issues periodic transmission request for an I-PDU to the under lying layer.
              integer ComTxModeNumberOfRepetitions [0..1]: 0..255, category=FIXED, set at pre-compile  # Defines the number of repetitions for the transmission mode DIRECT and the event driven part of transmission mode MIXED.
              float ComTxModeRepetitionPeriod [0..1]: 0..3600, category=FIXED, set at pre-compile  # Defines the repetition period in seconds of the multiple transmissions in case ComTxModeNumberOfRepetitions is configured greater than 1 and ComTxModeMode is configured to DIRECT or MIXED. In case of the mixed transmission mode only the event driven part is affected.
              float ComTxModeTimeOffset [0..1]: 0..3600, category=FIXED, set at pre-compile  # Defines the period in seconds between the start of the I-PDU by Com_IpduGroupControl and the first transmission request in case ComTxModeMode is configured to PERIODIC or MIXED. In case of the mixed transmission mode only the periodic part is affected.
              float ComTxModeTimePeriod [0..1]: 0..3600, category=FIXED, set at pre-compile  # Defines the repetition period in seconds of the periodic transmission requests in case ComTxModeMode is configured to PERIODIC or MIXED. In case of the mixed transmission mode only the periodic part is affected.
          container ComTxModeTrue [0..1]  # This container contains the configuration parameters of the AUTOSAR COM module's transmission modes in the case the ComFilter evaluates to true.
            container ComTxMode  # This container contains the configuration parameters of the AUTOSAR COM module's transmission modes.
              enumeration ComTxModeMode: {DIRECT, MIXED, NONE, PERIODIC}, category=FIXED, set at pre-compile  # The available transmission modes described in [18] shall be extended by the additional mode None. | The transmission mode None shall not have any further sub-attributes in the ComTxMode object. DIRECT: Transmission of an I-PDU with direct transmission mode is caused by the transfer of any signal assign to the I-PDU with the triggered transfer property. MIXED: Mixed transmission mode is a combination of the "Direct/N-Times" and the periodic transmission mode. NONE: In transmission mode "None" no transmission is initiated by AUTOSAR COM. PERIODIC: In periodic transmission mode, AUTOSAR COM issues periodic transmission request for an I-PDU to the under lying layer.
              integer ComTxModeNumberOfRepetitions [0..1]: 0..255, category=FIXED, set at pre-compile  # Defines the number of repetitions for the transmission mode DIRECT and the event driven part of transmission mode MIXED.
              float ComTxModeRepetitionPeriod [0..1]: 0..3600, category=FIXED, set at pre-compile  # Defines the repetition period in seconds of the multiple transmissions in case ComTxModeNumberOfRepetitions is configured greater than 1 and ComTxModeMode is configured to DIRECT or MIXED. In case of the mixed transmission mode only the event driven part is affected.
              float ComTxModeTimeOffset [0..1]: 0..3600, category=FIXED, set at pre-compile  # Defines the period in seconds between the start of the I-PDU by Com_IpduGroupControl and the first transmission request in case ComTxModeMode is configured to PERIODIC or MIXED. In case of the mixed transmission mode only the periodic part is affected.
              float ComTxModeTimePeriod [0..1]: 0..3600, category=FIXED, set at pre-compile  # Defines the repetition period in seconds of the periodic transmission requests in case ComTxModeMode is configured to PERIODIC or MIXED. In case of the mixed transmission mode only the periodic part is affected.
      container ComIPduGroup [0..*]  # Contains the configuration parameters of the AUTOSAR COM module's I-PDU groups.
        integer ComIPduGroupHandleId: 0..65535, category=FIXED, set at pre-compile, symbolic-name-value=true  # The numerical value used as the ID of this I-PDU Group . | The ComIPduGroupHandleId is required by the API calls to start and stop I-PDU Groups. Range: 0 .. (ComSupportedIPduGroups-1)
        reference ComIPduGroupGroupRef [0..*]: category=NOT_SUPPORTED, set at pre-compile, destination=ComIPduGroup  # References to all I-PDU groups that includes this I-PDU group. If this reference is omitted this I-PDU group does not belong to another I-PDU group.
      container ComSignal [0..*]  # Contains the configuration parameters of the AUTOSAR COM module's signals.
        integer ComBitPosition: 0..65535, category=FIXED, set at pre-compile  # Starting position within the I-PDU. This parameter refers to the position in the I-PDU and not in the shadow buffer. If the endianness conversion is configured to Opaque the parameter ComBitPosition shall define the bit0 of the first byte like in little endian byte order
        integer ComBitSize [0..1]: 0..64, category=FIXED, set at pre-compile  # Size in bits, for non-array signal types. | For ComSignalType UINT8_N and UINT8_DYN this size shall be configured by ComSignalLength.
        enumeration ComDataInvalidAction [0..1]: {NOTIFY, REPLACE}, set at pre-compile  # This parameter defines the action performed upon reception of an invalid signal. | Relating to signal groups the action in case if one of the included signals is an invalid signal. If Replace is used the ComSignalInitValue will be used for the replacement. NOTIFY: ComSignalInitValue will be used for notification. REPLACE: ComSignalInitValue will be used for the replacement.
        function name ComErrorNotification [0..1]: set at pre-compile  # Only valid on sender side: Name of Com_CbkTxErr callback function to be called. | If this parameter is omitted no error notification shall take place.
        float ComFirstTimeout [0..1]: 0..3600, set at pre-compile  # Defines the length of the first deadline monitoring timeout period in seconds. This timeout is used immediately after start (or restart) of the deadline monitoring service. The timeout period of the successive periods is configured by COM263_Conf.
        integer ComHandleId: 0..65535, category=FIXED, set at pre-compile, symbolic-name-value=true  # The numerical value used as the ID. | For signals it is required by the API calls Com_UpdateShadowSignal, Com_ReceiveShadowSignal and Com_InvalidateShadowSignal. For signals groups it is required by the Com_SendSignalGroup and Com_ReceiveSignalGroup calls.
        function name ComInvalidNotification [0..1]: set at pre-compile  # Only valid on receiver side: Name of Com_CbkInv callback function to be called. Name of the function which notifies the RTE about the reception of an invalidated signal/ signal group. Only applicable if ComDataInvalidAction is configured to NOTIFY.
        function name ComNotification [0..1]: set at pre-compile  # On sender side: Name of Com_CbkTxAck callback function to be called. | On receiver side: Name of Com_CbkRxAck callback function to be called. If this parameter is omitted no notification shall take place.
        enumeration ComRxDataTimeoutAction [0..1]: {NONE, REPLACE, SUBSTITUTE}, set at pre-compile  # This parameter defines the action performed upon expiration of the reception deadline monitoring timer. NONE: no replacement shall take place. REPLACE : signal shall be replaced by its ComSignalInitValue SUBSTITUTE: signal shall be replaced by its ComTimeoutSubstitutionValue
        string ComSignalDataInvalidValue [0..1]: set at pre-compile  # Defines the data invalid value of the signal. | In case the ComSignalType is UINT8, UINT16, UINT32, SINT8, SINT16, SINT32 the string shall be interpreted as defined in the chapter Integer Type in the AUTOSAR EcuC specification. In case the ComSignalType is FLOAT32, FLOAT64 the string shall be interpreted as defined in the chapter Float Type in the AUTOSAR EcuC specification. In case the ComSignalType is BOOLEAN the string shall be interpreted as defined in the chapter Boolean Type in the AUTOSAR EcuC specification. In case the ComSignal is a UINT8_N, UINT6_DYN the string shall be interpreted as a decimal representation of the characters separated by blanks, e.g. "97 98 100" means a string "abd", where the char "a" is in byte 0(lowest address), "b" is in byte 1, and "d" is in byte 2 and (highest address).
        enumeration ComSignalEndianness: {BIG_ENDIAN, LITTLE_ENDIAN, OPAQUE}, category=FIXED, set at pre-compile  # Defines the endianness of the signal's network representation. | BIG_ENDIAN: Endianess of the signal's representation is big endian. LITTLE_ENDIAN: Endianess of the signal's representation is little endian. OPAQUE: : Endianess of the signal's representation is OPAQUE.
        string ComSignalInitValue [0..1]: set at pre-compile, default-value=0  # Initial value for this signal. The default value is 0. | In case the ComSignalType is UINT8, UINT16, UINT32, SINT8, SINT16, SINT32 the string shall be interpreted as defined in the chapter Integer Type in the AUTOSAR EcuC specification. In case the ComSignalType is FLOAT32, FLOAT64 the string shall be interpreted as defined in the chapter Float Type in the AUTOSAR EcuC specification. In case the ComSignalType is BOOLEAN the string shall be interpreted as defined in the chapter Boolean Type in the AUTOSAR EcuC specification. In case the ComSignal is a UINT8_N, UINT6_DYN the string shall be interpreted as a decimal representation of the characters separated by blanks, e.g. "97 98 100" means a string "abd", where the char "a" is in byte 0(lowest address), "b" is in byte 1, and "d" is in byte 2 and (highest address).
        integer ComSignalLength [0..1]: 0..4095, category=FIXED, set at pre-compile  # Description: | For ComSignalType UINT8_N this parameter specifies the length n in bytes. For ComSignalType UINT8_DYN it specifies the maximum length in bytes. For all other types this parameter shall be ignored. Range: 0..8 for normal CAN/ LIN I-PDUs, 0..254 for normal FlexRay I-PDUs, and 0..4095 for I-PDUs with ComIPduType TP.
        enumeration ComSignalType: {BOOLEAN, FLOAT32, FLOAT64, SINT16, SINT32, SINT8, UINT16, UINT32, UINT8, UINT8_DYN, UINT8_N}, category=FIXED, set at pre-compile  # The AUTOSAR type of the signal. Whether or not the signal is signed or unsigned can be found by examining the value of this attribute. | This type could also be used to reserved appropriate storage in AUTOSAR COM. BOOLEAN: Signal Type is BOOLEAN. FLOAT32: Signal Type is FLOAT32. FLOAT64: Signal Type is FLOAT64. SINT16: Signal Type is SINT16. SINT32: Signal Type is SINT32. SINT8: Signal Type is SINT8. UINT16: Signal Type is UINT16. UINT32: Signal Type is UINT32. UINT8: Signal Type is UINT8. UINT8_DYN: Signal Type is UINT8_DYN. UINT8_N: Signal Type is UINT8_N.
        float ComTimeout [0..1]: 0..3600, set at pre-compile  # Defines the length of the deadline monitoring timeout period in seconds. The period for the first timeout period can be configured separately by COM183_Conf.
        function name ComTimeoutNotification [0..1]: set at pre-compile  # On sender side: Name of Com_CbkTxTOut callback function to be called. | On receiver side: Name of Com_CbkRxTOut callback function to be called.
        enumeration ComTransferProperty [0..1]: {PENDING, TRIGGERED, TRIGGERED_ON_CHANGE, TRIGGERED_ON_CHANGE_WITHOUT_REPETITION, TRIGGERED_WITHOUT_REPETITION}, category=FIXED, set at pre-compile  # Defines if a write access to this signal can trigger the transmission of the corresponding I-PDU. If the I-PDU is triggered, depends also on the transmission mode of the corresponding I-PDU. | PENDING: Transfer property of Signals is Pending. TRIGGERED: Transfer property of Signals is Triggered. TRIGGERED_ON_CHANGE: Transfer property of Signals is Triggered on change. TRIGGERED_ON_CHANGE_WITHOUT_REPETITION: Transfer property of Signals is Triggered on change without Repetition. TRIGGERED_WITHOUT_REPETITION: Transfer property of Signals is Triggered without Repetition.
        integer ComUpdateBitPosition [0..1]: 0..65535, category=NOT_SUPPORTED, set at pre-compile  # Bit position of update-bit inside I-PDU. | If this attribute is omitted then there is no update-bit. This setting must be consistently on sender and on receiver side. Range: 0..63 for CAN and LIN 0..2031 for FlexRay
        boolean ComSigReportIdsMEnable [0..1]: set at pre-compile, origin=AUTOEVER, default-value=false  # If true Com Module shall report to IdsM Module when received signal has wrong value by using configured filter function.
        string ComTimeoutSubstitutionValue [0..1]: set at pre-compile, default-value=0  # The signal substitution value will be used in case of a timeout and ComRxDataTimeoutAction is set to SUBSTITUTE. | In case of UINT8_N the default value is a string of length. ComSignalLength with all bytes set to 0x00. In case of UINT8_DYN the initial size shall be 0. In case the ComSignalType is UINT8, UINT16, UINT32, UINT64, SINT8, SINT16, SINT32, SINT64 the string shall be interpreted as defined in the chapter Integer Type in the AUTOSAR EcuC specification. In case the ComSignalType is FLOAT32, FLOAT64 the string shall be interpreted as defined in the chapter Float Type in the AUTOSAR EcuC specification. In case the ComSignalType is BOOLEAN the string shall be interpreted as defined in the chapter Boolean Type in the AUTOSAR EcuC specification. In case the ComSignal is a UINT8_N, UINT8_DYN the string shall be interpreted as a decimal representation of the characters separated by blanks, e.g. "97 98 100" means a string "abd", where the char "a" is in byte 0(lowest address), "b" is in byte 1, and "d" is in byte 2 and (highest address). For the ComSignalType UINT8_DYN the dynamic length shall be set to the number of configured characters. An empty string "" shall be interpreted as 0-sized dynamic signal.
        foreign reference ComSystemTemplateSystemSignalRef [0..1]: category=FIXED, set at pre-compile, destination-type=I-SIGNAL-TO-I-PDU-MAPPING  # Reference to the ISignalToIPduMapping that contains a reference to the ISignal (System Template) which this ComSignal (or ComGroupSignal) represents.
        container ComFilter [0..1]  # This container contains the configuration parameters of the AUTOSAR COM module's Filters. | Note: On sender side the container is used to specify the transmission mode conditions.
          enumeration ComFilterAlgorithm: {ALWAYS, MASKED_NEW_DIFFERS_MASKED_OLD, MASKED_NEW_DIFFERS_X, MASKED_NEW_EQUALS_X, NEVER, NEW_IS_OUTSIDE, NEW_IS_WITHIN, ONE_EVERY_N}, set at pre-compile  # The range of values is specified in the [17] specification, chapter 2.2.2, Reception Filtering. ALWAYS: Filter algorithm for a Signal is ALWAYS. MASKED_NEW_DIFFERS_MASKED_OLD: Filter algorithm for a Signal is MASKED_NEW_DIFFERS_MASKED_OLD. MASKED_NEW_DIFFERS_X: Filter algorithm for a Signal is MASKED_NEW_DIFFERS_X. MASKED_NEW_EQUALS_X: Filter algorithm for a Signal is MASKED_NEW_EQUALS_X. NEVER: Filter algorithm for a Signal is NEVER. NEW_IS_OUTSIDE: Filter algorithm for a Signal is NEW_IS_OUTSIDE. NEW_IS_WITHIN: Filter algorithm for a Signal is NEW_IS_WITHIN. ONE_EVERY_N: Filter algorithm for a Signal is ONE_EVERY_N.
          integer ComFilterMask [0..1]: -2147483648..4294967295, set at pre-compile  # The name of this attribute corresponds to the parameter name in the [17] specification of Reception Filtering.
          integer ComFilterMax [0..1]: -2147483648..4294967295, set at pre-compile  # The name of this attribute corresponds to the parameter name in the [17] specification of Reception Filtering.
          integer ComFilterMin [0..1]: -2147483648..4294967295, set at pre-compile  # The name of this attribute corresponds to the parameter name in the [17] specification of Reception Filtering.
          integer ComFilterOffset [0..1]: 0..4294967294, set at pre-compile  # The name of this attribute corresponds to the parameter name in the [17] specification of Reception Filtering. | Range = 0..(ComFilterPeriod-1)
          integer ComFilterPeriod [0..1]: 2..4294967295, set at pre-compile  # This parameter defines the period of the ComFilterAlgorithm ONE_EVERY_N.
          integer ComFilterX [0..1]: -2147483648..4294967295, set at pre-compile  # The name of this attribute corresponds to the parameter name in the [17] specification of Reception Filtering.
      container ComSignalGroup [0..*]  # Contains the configuration parameters of the AUTOSAR COM module's signal groups.
        enumeration ComDataInvalidAction [0..1]: {NOTIFY, REPLACE}, set at pre-compile  # This parameter defines the action performed upon reception of an invalid signal. | Relating to signal groups the action in case if one of the included signals is an invalid signal. If Replace is used the ComSignalInitValue will be used for the replacement. NOTIFY: ComSignalInitValue will be used for notification. REPLACE: ComSignalInitValue will be used for the replacement.
        function name ComErrorNotification [0..1]: set at pre-compile  # Only valid on sender side: Name of Com_CbkTxErr callback function to be called. | If this parameter is omitted no error notification shall take place.
        float ComFirstTimeout [0..1]: 0..3600, set at pre-compile  # Defines the length of the first deadline monitoring timeout period in seconds. This timeout is used immediately after start (or restart) of the deadline monitoring service. The timeout period of the successive periods is configured by COM263_Conf.
        integer ComHandleId: 0..65535, category=FIXED, set at pre-compile, symbolic-name-value=true  # The numerical value used as the ID. | For signals it is required by the API calls Com_UpdateShadowSignal, Com_ReceiveShadowSignal and Com_InvalidateShadowSignal. For signals groups it is required by the Com_SendSignalGroup and Com_ReceiveSignalGroup calls.
        function name ComInvalidNotification [0..1]: set at pre-compile  # Only valid on receiver side: Name of Com_CbkInv callback function to be called. Name of the function which notifies the RTE about the reception of an invalidated signal/ signal group. Only applicable if ComDataInvalidAction is configured to NOTIFY.
        function name ComNotification [0..1]: set at pre-compile  # On sender side: Name of Com_CbkTxAck callback function to be called. | On receiver side: Name of Com_CbkRxAck callback function to be called. If this parameter is omitted no notification shall take place.
        enumeration ComRxDataTimeoutAction [0..1]: {NONE, REPLACE, SUBSTITUTE}, set at pre-compile  # This parameter defines the action performed upon expiration of the reception deadline monitoring timer. NONE: no replacement shall take place. REPLACE : group signals shall be replaced by their ComSignalInitValue SUBSTITUTE: group signals shall be replaced by their ComTimeoutSubstitutionValue
        float ComTimeout [0..1]: 0..3600, set at pre-compile  # Defines the length of the deadline monitoring timeout period in seconds. The period for the first timeout period can be configured separately by COM183_Conf.
        function name ComTimeoutNotification [0..1]: set at pre-compile  # On sender side: Name of Com_CbkTxTOut callback function to be called. | On receiver side: Name of Com_CbkRxTOut callback function to be called.
        enumeration ComTransferProperty [0..1]: {PENDING, TRIGGERED, TRIGGERED_ON_CHANGE, TRIGGERED_ON_CHANGE_WITHOUT_REPETITION, TRIGGERED_WITHOUT_REPETITION}, category=FIXED, set at pre-compile  # Defines if a write access to this signal can trigger the transmission of the corresponding I-PDU. If the I-PDU is triggered, depends also on the transmission mode of the corresponding I-PDU. | PENDING: Transfer property of Signals is Pending. TRIGGERED: Transfer property of Signals is Triggered. TRIGGERED_ON_CHANGE: Transfer property of Signals is Triggered on change. TRIGGERED_ON_CHANGE_WITHOUT_REPETITION: Transfer property of Signals is Triggered on change without Repetition. TRIGGERED_WITHOUT_REPETITION: Transfer property of Signals is Triggered without Repetition.
        integer ComUpdateBitPosition [0..1]: 0..65535, category=NOT_SUPPORTED, set at pre-compile  # Bit position of update-bit inside I-PDU. | If this attribute is omitted then there is no update-bit. This setting must be consistently on sender and on receiver side. Range: 0..63 for CAN and LIN 0..2031 for FlexRay
        boolean ComSignalGroupArrayAccess [0..1]: multiplicity set at pre-compile, set at pre-compile  # Defines whether the uint8-array based access shall be used for this ComSignalGroup.
        foreign reference ComSystemTemplateSignalGroupRef [0..1]: category=FIXED, set at pre-compile, destination-type=I-SIGNAL-TO-I-PDU-MAPPING  # Reference to the ISignalToIPduMapping that contains a reference to the ISignalGroup (SystemTemplate) which this ComSignalGroup represents.
        container ComGroupSignal [0..*]  # This container contains the configuration parameters of group signals. I.e. signals that are included within a signal group.
          integer ComBitPosition: 0..65535, category=FIXED, set at pre-compile  # Starting position within the I-PDU. This parameter refers to the position in the I-PDU and not in the shadow buffer. If the endianness conversion is configured to Opaque the parameter ComBitPosition shall define the bit0 of the first byte like in little endian byte order
          integer ComBitSize [0..1]: 0..64, category=FIXED, set at pre-compile  # Size in bits, for non-array signal types. | For ComSignalType UINT8_N and UINT8_DYN this size shall be configured by ComSignalLength.
          integer ComHandleId: 0..65535, category=FIXED, set at pre-compile, symbolic-name-value=true  # The numerical value used as the ID. | For signals it is required by the API calls Com_UpdateShadowSignal, Com_ReceiveShadowSignal and Com_InvalidateShadowSignal. For signals groups it is required by the Com_SendSignalGroup and Com_ReceiveSignalGroup calls.
          string ComSignalDataInvalidValue [0..1]: set at pre-compile  # Defines the data invalid value of the signal. | In case the ComSignalType is UINT8, UINT16, UINT32, SINT8, SINT16, SINT32 the string shall be interpreted as defined in the chapter Integer Type in the AUTOSAR EcuC specification. In case the ComSignalType is FLOAT32, FLOAT64 the string shall be interpreted as defined in the chapter Float Type in the AUTOSAR EcuC specification. In case the ComSignalType is BOOLEAN the string shall be interpreted as defined in the chapter Boolean Type in the AUTOSAR EcuC specification. In case the ComSignal is a UINT8_N, UINT6_DYN the string shall be interpreted as a decimal representation of the characters separated by blanks, e.g. "97 98 100" means a string "abd", where the char "a" is in byte 0(lowest address), "b" is in byte 1, and "d" is in byte 2 and (highest address).
          enumeration ComSignalEndianness: {BIG_ENDIAN, LITTLE_ENDIAN, OPAQUE}, category=FIXED, set at pre-compile  # Defines the endianness of the signal's network representation. | BIG_ENDIAN: Endianess of the signal's representation is big endian. LITTLE_ENDIAN: Endianess of the signal's representation is little endian. OPAQUE: : Endianess of the signal's representation is OPAQUE.
          string ComSignalInitValue [0..1]: set at pre-compile, default-value=0  # Initial value for this signal. The default value is 0. | In case the ComSignalType is UINT8, UINT16, UINT32, SINT8, SINT16, SINT32 the string shall be interpreted as defined in the chapter Integer Type in the AUTOSAR EcuC specification. In case the ComSignalType is FLOAT32, FLOAT64 the string shall be interpreted as defined in the chapter Float Type in the AUTOSAR EcuC specification. In case the ComSignalType is BOOLEAN the string shall be interpreted as defined in the chapter Boolean Type in the AUTOSAR EcuC specification. In case the ComSignal is a UINT8_N, UINT6_DYN the string shall be interpreted as a decimal representation of the characters separated by blanks, e.g. "97 98 100" means a string "abd", where the char "a" is in byte 0(lowest address), "b" is in byte 1, and "d" is in byte 2 and (highest address).
          integer ComSignalLength [0..1]: 0..4095, category=FIXED, set at pre-compile  # Description: | For ComSignalType UINT8_N this parameter specifies the length n in bytes. For ComSignalType UINT8_DYN it specifies the maximum length in bytes. For all other types this parameter shall be ignored. Range: 0..8 for normal CAN/ LIN I-PDUs, 0..254 for normal FlexRay I-PDUs, and 0..4095 for I-PDUs with ComIPduType TP.
          enumeration ComSignalType: {BOOLEAN, FLOAT32, FLOAT64, SINT16, SINT32, SINT8, UINT16, UINT32, UINT8, UINT8_DYN, UINT8_N}, category=FIXED, set at pre-compile  # The AUTOSAR type of the signal. Whether or not the signal is signed or unsigned can be found by examining the value of this attribute. | This type could also be used to reserved appropriate storage in AUTOSAR COM. BOOLEAN: Signal Type is BOOLEAN. FLOAT32: Signal Type is FLOAT32. FLOAT64: Signal Type is FLOAT64. SINT16: Signal Type is SINT16. SINT32: Signal Type is SINT32. SINT8: Signal Type is SINT8. UINT16: Signal Type is UINT16. UINT32: Signal Type is UINT32. UINT8: Signal Type is UINT8. UINT8_DYN: Signal Type is UINT8_DYN. UINT8_N: Signal Type is UINT8_N.
          enumeration ComTransferProperty [0..1]: {PENDING, TRIGGERED_ON_CHANGE}, category=FIXED, set at pre-compile  # Optionally defines whether this group signal shall contribute to the TRIGGERED_ON_CHANGE transfer property of the signal group. If at least one group signal of a signal group has the "ComTransferProperty" configured all other group signals of that signal group shall have the attribute configured as well. | PENDING: Transfer property of Signals is Pending. TRIGGERED_ON_CHANGE: Transfer property of Signals is Triggered on change.
          boolean ComSigReportIdsMEnable [0..1]: set at pre-compile, origin=AUTOEVER, default-value=false  # If true Com Module shall report to IdsM Module when received signal has wrong value by using configured filter function.
          string ComTimeoutSubstitutionValue [0..1]: set at pre-compile, default-value=0  # The signal substitution value will be used in case of a timeout and ComRxDataTimeoutAction is set to SUBSTITUTE. | In case of UINT8_N the default value is a string of length. ComSignalLength with all bytes set to 0x00. In case of UINT8_DYN the initial size shall be 0. In case the ComSignalType is UINT8, UINT16, UINT32, UINT64, SINT8, SINT16, SINT32, SINT64 the string shall be interpreted as defined in the chapter Integer Type in the AUTOSAR EcuC specification. In case the ComSignalType is FLOAT32, FLOAT64 the string shall be interpreted as defined in the chapter Float Type in the AUTOSAR EcuC specification. In case the ComSignalType is BOOLEAN the string shall be interpreted as defined in the chapter Boolean Type in the AUTOSAR EcuC specification. In case the ComSignal is a UINT8_N, UINT8_DYN the string shall be interpreted as a decimal representation of the characters separated by blanks, e.g. "97 98 100" means a string "abd", where the char "a" is in byte 0(lowest address), "b" is in byte 1, and "d" is in byte 2 and (highest address). For the ComSignalType UINT8_DYN the dynamic length shall be set to the number of configured characters. An empty string "" shall be interpreted as 0-sized dynamic signal.
          foreign reference ComSystemTemplateSystemSignalRef [0..1]: category=FIXED, set at pre-compile, destination-type=I-SIGNAL-TO-I-PDU-MAPPING  # Reference to the ISignalToIPduMapping that contains a reference to the ISignal (System Template) which this ComSignal (or ComGroupSignal) represents.
          container ComFilter [0..1]  # This container contains the configuration parameters of the AUTOSAR COM module's Filters. | Note: On sender side the container is used to specify the transmission mode conditions.
            enumeration ComFilterAlgorithm: {ALWAYS, MASKED_NEW_DIFFERS_MASKED_OLD, MASKED_NEW_DIFFERS_X, MASKED_NEW_EQUALS_X, NEVER, NEW_IS_OUTSIDE, NEW_IS_WITHIN, ONE_EVERY_N}, set at pre-compile  # The range of values is specified in the [17] specification, chapter 2.2.2, Reception Filtering. ALWAYS: Filter algorithm for a Signal is ALWAYS. MASKED_NEW_DIFFERS_MASKED_OLD: Filter algorithm for a Signal is MASKED_NEW_DIFFERS_MASKED_OLD. MASKED_NEW_DIFFERS_X: Filter algorithm for a Signal is MASKED_NEW_DIFFERS_X. MASKED_NEW_EQUALS_X: Filter algorithm for a Signal is MASKED_NEW_EQUALS_X. NEVER: Filter algorithm for a Signal is NEVER. NEW_IS_OUTSIDE: Filter algorithm for a Signal is NEW_IS_OUTSIDE. NEW_IS_WITHIN: Filter algorithm for a Signal is NEW_IS_WITHIN. ONE_EVERY_N: Filter algorithm for a Signal is ONE_EVERY_N.
            integer ComFilterMask [0..1]: -2147483648..4294967295, set at pre-compile  # The name of this attribute corresponds to the parameter name in the [17] specification of Reception Filtering.
            integer ComFilterMax [0..1]: -2147483648..4294967295, set at pre-compile  # The name of this attribute corresponds to the parameter name in the [17] specification of Reception Filtering.
            integer ComFilterMin [0..1]: -2147483648..4294967295, set at pre-compile  # The name of this attribute corresponds to the parameter name in the [17] specification of Reception Filtering.
            integer ComFilterOffset [0..1]: 0..4294967294, set at pre-compile  # The name of this attribute corresponds to the parameter name in the [17] specification of Reception Filtering. | Range = 0..(ComFilterPeriod-1)
            integer ComFilterPeriod [0..1]: 2..4294967295, set at pre-compile  # This parameter defines the period of the ComFilterAlgorithm ONE_EVERY_N.
            integer ComFilterX [0..1]: -2147483648..4294967295, set at pre-compile  # The name of this attribute corresponds to the parameter name in the [17] specification of Reception Filtering.
      container ComTimeBase  # Contains the timebase parameters for Tx, Rx and routing.
        float ComGwTimeBase [0..1]: 0..3600, set at pre-compile  # The period between successive calls to Com_MainFunctionRouteSignals in seconds. This parameter may be used by the COM generator to transform the values of the signal gateway related timing configuration parameters of the COM module to internal implementation specific counter or tick values. The COM module's internal timing handling is implementation specific. | The COM module (generator) might rely on the fact that Com_MainFunctionRouteSignals is scheduled according to the value configured here.
        float ComRxTimeBase [0..1]: 0..3600, category=FIXED, set at pre-compile  # The period between successive calls to Com_MainFunctionRx in seconds. This parameter may be used by the COM generator to transform the values of the reception related timing configuration parameters of the COM module to internal implementation specific counter or tick values. The COM module's internal timing handling is implementation specific. | The COM module (generator) may rely on the fact that Com_MainFunctionRx is scheduled according to the value configured here.
        float ComTxTimeBase [0..1]: 0..3600, category=FIXED, set at pre-compile  # The period between successive calls to Com_MainFunctionTx in seconds. This parameter may be used by the COM generator to transform the values of the transmission related timing configuration parameters of the COM module to internal implementation specific counter or tick values. The COM module's internal timing handling is implementation specific. | The COM module (generator) may rely on the fact that Com_MainFunctionTx is scheduled according to the value configured here.
    container ComGeneral  # Contains the general configuration parameters of the module.
      boolean ComConfigurationUseDet [0..1]: set at pre-compile, default-value=false  # The error hook shall contain code to call the Det. | true: COM_DEV_ERROR_DETECT shall be set to ON as output of the configuration tool. false: COM_DEV_ERROR_DETECT shall be set to OFF as output of the configuration tool.
      boolean ComEnableMDTForCyclicTransmission [0..1]: category=FIXED, set at pre-compile, default-value=true  # Enables globally for the whole Com module the minimum delay time monitoring for cyclic and repeated transmissions (ComTxModeMode=PERIODIC or ComTxModeMode=MIXED for the cyclic transmissions, ComTxModeNumberOfRepetitions > 0 for repeated transmissions). | true: Enables globally for the whole Com module the minimum delay time monitoring for cyclic and repeated transmissions (ComTxModeMode=PERIODIC or ComTxModeMode=MIXED for the cyclic transmissions, ComTxModeNumberOfRepetitions > 0 for repeated transmissions). false: the default value is assumed
      boolean ComRetryFailedTransmitRequests [0..1]: set at pre-compile, default-value=false  # If this Parameter is set to true, retry of failed transmission requests is enabled. If this Parameter is not present, the default value is assumed. | true: retry of failed transmission requests is enabled. false: the default value is assumed
      integer ComSupportedIPduGroups: 0..65535, category=FIXED, set at pre-compile  # Defines the maximum number of supported I-PDU groups.
      boolean ComVersionInfoApi: set at pre-compile, default-value=false  # Activate/Deactivate the version information API (Com_GetVersionInfo). | True: version information API activated False: version information API deactivated
      boolean ComTxSignalValidationCheck [0..1]: set at pre-compile, origin=AUTOEVER, default-value=false  # If this Parameter is set to true, all the Tx signals will be checked by using value range. | true: enable validation check false: disable validation check
      boolean ComMainFunctionBasedTransmit [0..1]: category=FIXED, set at pre-compile, origin=AUTOEVER, default-value=true  # If this Parameter is set to true, all the transmission will be performed on Com_MainfunctionTx. | true: Mainfunction based transmission false: Event based transmission
      boolean ComRxInterruptBased [0..1]: set at pre-compile, origin=AUTOEVER, default-value=true  # If true the unnecessary suspend/resume interrupt will be removed. This parameter is allowed when lower layer is configured as interrupt based indication
      boolean ComTxInterruptBased [0..1]: set at pre-compile, origin=AUTOEVER, default-value=true  # If true the unnecessary suspend/resume interrupt will be removed. This parameter is allowed when lower layer is configured as interrupt based confirmation
      boolean ComEnableSignalGroupArrayApi: set at pre-compile, default-value=false  # Activate/Deactivate the signal group array access APIs (Com_SendSignalGroupArray, Com_ReceiveSignalGroupArray). | true: signal group array access APIs activated false: signal group array access APIs deactivated
      boolean ComBufferInitiateOnPduStartTime [0..1]: set at pre-compile, origin=AUTOEVER, default-value=false  # If true, Com Buffer will be initiated to default values when Pdu State changes Stop to Start Such as transiton of NOCOM to FULLCOM. If false, Com Buffer will not be initiated to default values when Pdu State changes Stop to Start Such as transiton of NOCOM to FULLCOM. If unset, It works same with setting false. When Booting time, Com Buffer is filled with default values whatever you choose. If true, it satisfies with AUTOSAR Com specification [COM222]. If false, it doesn't.
