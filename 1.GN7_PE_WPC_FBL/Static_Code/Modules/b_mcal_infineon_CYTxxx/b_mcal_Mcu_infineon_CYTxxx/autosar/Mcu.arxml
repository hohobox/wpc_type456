AUTOSAR XML (schema 4-2-2)
package /TS_T40D13M1I0R0
  ecuc definition collection MCU_EcuParameterDefinition: module=Mcu
  module definition Mcu [0..1]: post-build-variant-support=true, refined-module-def=Mcu, variants post-build  # Configuration of the Mcu (Microcontroller Unit) module.
    container McuGeneralConfiguration  # This container contains the configuration (parameters) of the MCU driver.
      boolean McuDevErrorDetect: set at pre-compile, default-value=true  # Switches the Default Error Tracer (Det) detection and notification ON or OFF. | * true: enabled (ON). * false: disabled (OFF).
      boolean McuGetRamStateApi: set at pre-compile, default-value=false  # Pre-processor switch to enable/disable the API Mcu_GetRamState. | (e.g. If the H/W does not support the functionality, this parameter can be used to disable the Api).
      boolean McuInitClock: set at pre-compile, default-value=true  # API switch for Mcu_InitClock(). If this parameter is set to FALSE, the clock initialization has to be disabled from the MCU driver. This concept applies when there are some write once clock registers and a bootloader is present. If this parameter is set to TRUE, the MCU driver is responsible of the clock initialization.
      boolean McuNoPll: set at pre-compile, default-value=true  # This parameter shall be set True, if the H/W does not have a PLL or the PLL circuitry is enabled after the power on without S/W intervention. In this case MCU_DistributePllClock has to be disabled and MCU_GetPllStatus has to return MCU_PLL_STATUS_UNDEFINED. Otherwise this parameters has to be set False.
      boolean McuPerformResetApi: set at pre-compile, default-value=true  # Pre-processor switch to enable / disable the use of the function Mcu_PerformReset()
      boolean McuVersionInfoApi: set at pre-compile, default-value=true  # Pre-processor switch to enable / disable the API to read out the modules version information.
      boolean McuSafetyFunctionApi: origin=Cypress, set at pre-compile, default-value=true  # Adds/removes the services Mcu_CheckClockStatus() and Mcu_CheckModeStatus() from the code.
      function name McuErrorCalloutFunction: origin=Cypress, set at pre-compile, default-value=ErrorCalloutHandler  # Error callout function. Syntax: void ErrorCalloutHandler (uint16 ModuleId, uint8 InstanceId, uint8 ApiId, uint8 ErrorId) The error callout function is called on every error. The ASIL level of this function limits the ASIL level of the Mcu driver.
      string McuIncludeFile [0..*]: multiplicity set at pre-compile, origin=Cypress, set at pre-compile, default-value=ErrorCalloutHandler.h  # A file that shall be included by Mcu_ExternalInclude.h. Any application specific symbol that is used by the Mcu configuration (e.g. Error callout function) should be included by configuring this parameter.
    container McuModuleConfiguration: multiplicity set at post-build  # This container contains the configuration (parameters) of the MCU driver.
      enumeration McuClockSrcFailureNotification: {DISABLED, ENABLED}, post-build-variant-value=true, set at post-build, default-value=DISABLED  # Enables/Disables clock failure notification. In case this feature is not supported by HW the setting should be disabled.
      boolean McuResetFailureNotification: origin=Cypress, post-build-variant-value=true, set at post-build, default-value=false  # Enables/Disables reset failure notification.
      integer McuNumberOfMcuModes: 1..255, post-build-variant-value=true, set at post-build, derivation=informal-formula=verbatim=l-5=number of configured mcumodesettingconf, default-value=1  # This parameter shall represent the number of Modes available for the MCU. calculationFormula = Number of configured McuModeSettingConf. Please try default value. | calculationFormula = Number of configured McuModeSettingConf
      integer McuRamSectors: 0..65535, post-build-variant-value=true, set at post-build, derivation=informal-formula=verbatim=l-5=number of configured mcuramsectorsettingconf, default-value=1  # This parameter shall represent the number of RAM sectors available for the MCU. calculationFormula = Number of configured McuRamSectorSettingConf. Please try default value. | calculationFormula = Number of configured McuRamSectorSettingConf
      integer McuResetSetting [0..1]: 1..255, multiplicity set at pre-compile, set at pre-compile, default-value=1  # This parameter relates to the MCU specific reset configuration. This applies to the function Mcu_PerformReset, which performs a microcontroller reset using the hardware feature of the microcontroller.
      enumeration McuResetSelect [0..1]: {MCU_SW_RESET}, multiplicity set at pre-compile, origin=Cypress, set at pre-compile, default-value=MCU_SW_RESET  # This parameter relates to the MCU specific reset configuration. This applies to the function Mcu_PerformReset, which performs a microcontroller reset using the hardware feature of the microcontroller.
      boolean McuEnableCacheFlushBeforeReset [0..1]: multiplicity set at post-build, origin=Cypress, post-build-variant-multiplicity=true, post-build-variant-value=true, set at post-build, default-value=false  # If this option is checked, cache is flushed before reset in Mcu_PerformReset API.
      integer McuRamWriteBufferTimeoutBeforeReset [0..1]: 1..4294967295, multiplicity set at post-build, origin=Cypress, post-build-variant-multiplicity=true, post-build-variant-value=true, set at post-build, default-value=1  # This parameter is used to specify the timeout count value for waiting RAMs write buffer empty before reset in Mcu_PerformReset API.
      boolean McuForcedResetEnable [0..1]: multiplicity set at post-build, origin=Cypress, post-build-variant-multiplicity=true, post-build-variant-value=true, set at post-build, default-value=false  # If this option is checked, reset is performed even if an error is occurred in Mcu_PerformReset API.
      boolean McuRam0Macro{0..15}RetainBeforeReset [0..1]: multiplicity set at post-build, origin=Cypress, post-build-variant-multiplicity=true, post-build-variant-value=true, set at post-build, default-value=false  # If this option is checked, RAM0 Macro {0..15} power mode is set to RETAINED before reset in Mcu_PerformReset API.
      boolean McuRam1RetainBeforeReset [0..1]: multiplicity set at post-build, origin=Cypress, post-build-variant-multiplicity=true, post-build-variant-value=true, set at post-build, default-value=false  # If this option is checked, RAM1 power mode is set to RETAINED before reset in Mcu_PerformReset API.
      boolean McuRam2RetainBeforeReset [0..1]: multiplicity set at post-build, origin=Cypress, post-build-variant-multiplicity=true, post-build-variant-value=true, set at post-build, default-value=false  # If this option is checked, RAM2 power mode is set to RETAINED before reset in Mcu_PerformReset API.
      boolean McuClearResetReasonRegister: origin=Cypress, post-build-variant-value=true, set at post-build, default-value=true  # If this option is checked, reset reason registers are cleared by Mcu_Init().
      boolean McuEnableDefaultClock: origin=Cypress, post-build-variant-value=true, set at post-build, default-value=true  # If this option is checked, clock initialization is done in the Mcu_Init() with McuDefaultClockSetting.
      reference McuDefaultClockSetting [0..1]: multiplicity set at post-build, origin=Cypress, post-build-variant-multiplicity=true, post-build-variant-value=true, set at post-build, destination=McuClockSettingConfig  # This clock setting config is the default one for the MCU. It will be used automatically when the Mcu is initialized.
      container McuLowVoltageDetectionCallbackFunctions  # This container contains callback functions for notifying error of the low voltage detection.
        function name McuHvLvd1Notification [0..1]: multiplicity set at pre-compile, origin=Cypress, set at pre-compile, default-value=Mcu_NotificationFunction_HvLvd1  # This parameter is used to specify the function name for notifying error of the high-voltage low voltage detection 1.
        function name McuHvLvd2Notification [0..1]: multiplicity set at pre-compile, origin=Cypress, set at pre-compile, default-value=Mcu_NotificationFunction_HvLvd2  # This parameter is used to specify the function name for notifying error of the high-voltage low voltage detection 2.
      container McuClockSettingConfig [1..*]: multiplicity set at post-build, post-build-variant-multiplicity=true  # This container contains the configuration (parameters) for the Clock settings of the MCU. Please see MCU031 for more information on the MCU clock settings.
        integer McuClockSettingId: 0..255, set at pre-compile, symbolic-name-value=true, default-value=1  # The Id of this McuClockSettingConfig to be used as argument for the API call "Mcu_InitClock". Please try default value.
        boolean McuUnlockWatchdogEnable: origin=Cypress, post-build-variant-value=true, set at post-build, default-value=true  # This parameter is used to enable the unlock watchdog.
        container McuClocksIn  # This container reflects every oscillator's frequency. Please note, that these values are not used for oscillator configuration. Rather these values must reflect oscillator values properly.
          boolean McuImoEnable: origin=Cypress, post-build-variant-value=true, set at post-build, default-value=true  # This parameter is used to enable the IMO clock.
          float McuImoFrequency: 0.0..4.8E7, origin=Cypress, post-build-variant-value=true, set at post-build, default-value=8000000.0  # This is the IMO Clock Frequency in Hz.
          float McuExtFrequency: 0.0..2.0E8, origin=Cypress, post-build-variant-value=true, set at post-build, default-value=0.0  # This is the External Clock Frequency in Hz. The proper value / the proper value's range is derivative-specific and can be found in the derivative's DataSheet.
          float McuAlthfFrequency: 0.0..4.0E8, origin=Cypress, post-build-variant-value=true, set at post-build, default-value=0.0  # This is the ALTHF Clock Frequency in Hz. The proper value / the proper value's range is derivative-specific and can be found in the derivative's DataSheet.
          float McuAltlfFrequency: 0.0..4294967295.0, origin=Cypress, post-build-variant-value=true, set at post-build, default-value=0.0  # This is the ALTLF Clock Frequency in Hz. The proper value / the proper value's range is derivative-specific and can be found in the derivative's DataSheet.
          float McuDsiOut{0..15}Frequency [0..1]: 0.0..4294967295.0, multiplicity set at post-build, origin=Cypress, post-build-variant-multiplicity=true, post-build-variant-value=true, set at post-build, default-value=0.0  # This is the DSIOUT{0..15} Clock Frequency in Hz. The proper value / the proper value's range is derivative-specific and can be found in the derivative's DataSheet.
          container McuEcoSettings [0..1]: multiplicity set at post-build, post-build-variant-multiplicity=true  # This container contains the configurations for the ECO setting.
            boolean McuEcoEnable: origin=Cypress, post-build-variant-value=true, set at post-build, default-value=true  # This parameter is used to enable the ECO clock.
            boolean McuAgcEnable: origin=Cypress, post-build-variant-value=true, set at post-build, default-value=true  # This parameter is used to enable the Automatic Gain Control.
            integer McuEcoAmpStabilizationTimeout [0..1]: 1..4294967295, multiplicity set at post-build, origin=Cypress, post-build-variant-multiplicity=true, post-build-variant-value=true, set at post-build, default-value=1  # This parameter is used to specify the timeout count value for checking ECO clock stabilization.
            float McuEcoFrequency: 0.0..3.334E7, origin=Cypress, post-build-variant-value=true, set at post-build, default-value=4000000.0  # This is the ECO Clock Frequency in Hz. The proper value / the proper value's range is derivative-specific and can be found in the derivative's DataSheet.
            container McuEcoPrescalerSettings [0..1]: multiplicity set at post-build, post-build-variant-multiplicity=true  # This container contains the configurations for the ECO prescaler setting.
              boolean McuEcoPrescalerEnable: origin=Cypress, post-build-variant-value=true, set at post-build, default-value=false  # This parameter is used to enable the ECO clock prescaler.
              float McuEcoPrescalerValue: 1.0..1024.99609375, origin=Cypress, post-build-variant-value=true, set at post-build, default-value=1.0  # This parameter is used to specify the prescaler value for ECO clock.
              integer McuEcoPrescalerEnableTimeout [0..1]: 1..4294967295, multiplicity set at post-build, origin=Cypress, post-build-variant-multiplicity=true, post-build-variant-value=true, set at post-build, default-value=1  # This parameter is used to specify the timeout count value for waiting the enabled ECO clock prescaler.
              float McuEcoPrescaledFrequency: 0.0..32768.0, origin=Cypress, post-build-variant-value=true, set at post-build, default-value=32768.0  # This is the ECO Clock Prescaled Frequency in Hz. The proper value / the proper value's range is derivative-specific and can be found in the derivative's DataSheet.
            container McuEcoTrimSettings [0..1]: multiplicity set at post-build, post-build-variant-multiplicity=true  # This container contains the configurations for the ECO trim setting.
              enumeration McuEcoAmplitudeTrimValue: {MCU_ECO_AMPLITUDE_TRIM_VP_LESS_THAN_0_35V, MCU_ECO_AMPLITUDE_TRIM_VP_LESS_THAN_0_40V, MCU_ECO_AMPLITUDE_TRIM_VP_LESS_THAN_0_45V, MCU_ECO_AMPLITUDE_TRIM_VP_LESS_THAN_0_50V, MCU_ECO_AMPLITUDE_TRIM_VP_LESS_THAN_0_55V, MCU_ECO_AMPLITUDE_TRIM_VP_LESS_THAN_0_60V, MCU_ECO_AMPLITUDE_TRIM_VP_LESS_THAN_0_65V, MCU_ECO_AMPLITUDE_TRIM_VP_LESS_THAN_0_70V, MCU_ECO_AMPLITUDE_TRIM_VP_LESS_THAN_0_75V, MCU_ECO_AMPLITUDE_TRIM_VP_LESS_THAN_0_80V, MCU_ECO_AMPLITUDE_TRIM_VP_LESS_THAN_0_85V, MCU_ECO_AMPLITUDE_TRIM_VP_LESS_THAN_0_90V, MCU_ECO_AMPLITUDE_TRIM_VP_LESS_THAN_0_95V, MCU_ECO_AMPLITUDE_TRIM_VP_LESS_THAN_1_00V, MCU_ECO_AMPLITUDE_TRIM_VP_LESS_THAN_1_05V, MCU_ECO_AMPLITUDE_TRIM_VP_LESS_THAN_1_10V_OR_MAX_SWING}, origin=Cypress, post-build-variant-value=true, set at post-build, default-value=MCU_ECO_AMPLITUDE_TRIM_VP_LESS_THAN_0_35V  # This parameter is used to specify the amplitude trim value. WARNING: If the crystal amplitude trim value exceeds the crystal limits, the crystal could be damaged or suffer premature aging due to excessive power dissipation.
              integer McuEcoFeedbackResistorTrimValue: 0..3, origin=Cypress, post-build-variant-value=true, set at post-build, default-value=0  # This parameter is used to specify the ECO feedback resistor trim value.
              integer McuEcoFilterTrimValue: 0..3, origin=Cypress, post-build-variant-value=true, set at post-build, default-value=0  # This parameter is used to specify the ECO low-pass filter frequency trim value.
              integer McuEcoGainTrimValue: 0..7, origin=Cypress, post-build-variant-value=true, set at post-build, default-value=0  # This parameter is used to specify the ECO amplifier gain trim value.
              enumeration McuEcoWatchdogTrimValue: {MCU_ECO_WATCHDOG_TRIM_VP_GREATER_THAN_0_05V, MCU_ECO_WATCHDOG_TRIM_VP_GREATER_THAN_0_10V, MCU_ECO_WATCHDOG_TRIM_VP_GREATER_THAN_0_15V, MCU_ECO_WATCHDOG_TRIM_VP_GREATER_THAN_0_20V, MCU_ECO_WATCHDOG_TRIM_VP_GREATER_THAN_0_25V, MCU_ECO_WATCHDOG_TRIM_VP_GREATER_THAN_0_30V, MCU_ECO_WATCHDOG_TRIM_VP_GREATER_THAN_0_35V, MCU_ECO_WATCHDOG_TRIM_VP_GREATER_THAN_0_40V}, origin=Cypress, post-build-variant-value=true, set at post-build, default-value=MCU_ECO_WATCHDOG_TRIM_VP_GREATER_THAN_0_20V  # This parameter is used to specify the watchdog trim value.
          container McuLpEcoSettings [0..1]: multiplicity set at post-build, post-build-variant-multiplicity=true  # This container contains the configurations for the LPECO setting.
            boolean McuLpEcoEnable: origin=Cypress, post-build-variant-value=true, set at post-build, default-value=true  # This parameter is used to enable the LPECO clock.
            boolean McuLpEcoStopForUpdate: origin=Cypress, post-build-variant-value=true, set at post-build, default-value=false  # This parameter is used to enable the stop which is performed before update LPECO clock settings when LPECO clock is running.
            boolean McuLpEcoAmplitudeDetectorEnable: origin=Cypress, post-build-variant-value=true, set at post-build, default-value=false  # This parameter is used to enable the minimum amplitude detector for LPECO clock.
            enumeration McuLpEcoMaximumAmplitude: {MCU_LPECO_AMPLITUDE_1_35V, MCU_LPECO_AMPLITUDE_1_80V}, origin=Cypress, post-build-variant-value=true, set at post-build, default-value=MCU_LPECO_AMPLITUDE_1_35V  # This parameter is used to specify the LPECO maximum oscillation amplitude. WARNING: If the selected maximum amplitude exceeds the crystal limits, the crystal could be permanently damaged or suffer premature aging due to excessive power dissipation.
            enumeration McuLpEcoLoadCapacitanceRange: {MCU_LPECO_LOAD_CAPACITANCE_TO_10PF, MCU_LPECO_LOAD_CAPACITANCE_TO_15PF, MCU_LPECO_LOAD_CAPACITANCE_TO_20PF, MCU_LPECO_LOAD_CAPACITANCE_TO_25PF}, origin=Cypress, post-build-variant-value=true, set at post-build, default-value=MCU_LPECO_LOAD_CAPACITANCE_TO_10PF  # This parameter is used to specify the LPECO load capacitange range of the crystal.
            integer McuLpEcoAmpStabilizationTimeout [0..1]: 1..4294967295, multiplicity set at post-build, origin=Cypress, post-build-variant-multiplicity=true, post-build-variant-value=true, set at post-build, default-value=1  # This parameter is used to specify the timeout count value for checking LPECO clock stabilization.
            float McuLpEcoFrequency: 0.0..8010000.0, origin=Cypress, post-build-variant-value=true, set at post-build, default-value=4000000.0  # This is the LPECO Clock Frequency in Hz. The proper value / the proper value's range is derivative-specific and can be found in the derivative's DataSheet.
            container McuLpEcoPrescalerSettings [0..1]: multiplicity set at post-build, post-build-variant-multiplicity=true  # This container contains the configurations for the LPECO prescaler setting.
              boolean McuLpEcoPrescalerEnable: origin=Cypress, post-build-variant-value=true, set at post-build, default-value=true  # This parameter is used to enable the LPECO clock prescaler.
              float McuLpEcoPrescalerValue: 1.0..1024.99609375, origin=Cypress, post-build-variant-value=true, set at post-build, default-value=1.0  # This parameter is used to specify the prescaler value for LPECO clock.
              integer McuLpEcoPrescalerEnableTimeout [0..1]: 1..4294967295, multiplicity set at post-build, origin=Cypress, post-build-variant-multiplicity=true, post-build-variant-value=true, set at post-build, default-value=1  # This parameter is used to specify the timeout count value for waiting the enabled LPECO clock prescaler.
              float McuLpEcoPrescaledFrequency: 0.0..32768.0, origin=Cypress, post-build-variant-value=true, set at post-build, default-value=32768.0  # This is the LPECO Clock Prescaled Frequency in Hz. The proper value / the proper value's range is derivative-specific and can be found in the derivative's DataSheet.
          container McuIloSettings  # This container contains the configurations for the ILO setting.
            boolean McuIlo0Enable: origin=Cypress, post-build-variant-value=true, set at post-build, default-value=true  # This parameter is used to enable the ILO0 clock.
            boolean McuIlo0OnBackupEnable: origin=Cypress, post-build-variant-value=true, set at post-build, default-value=false  # This parameter is used to enable the ILO0 remaining on if backup domain is present and powered even for XRES/BOD or HIBERNATE entry.
            boolean McuIlo0MonitorEnable [0..1]: multiplicity set at post-build, origin=Cypress, post-build-variant-multiplicity=true, post-build-variant-value=true, set at post-build, default-value=false  # This parameter is used to enable the internal ILO0 clock monitoring circuit.
            float McuIlo0Frequency: 0.0..35061.76, origin=Cypress, post-build-variant-value=true, set at post-build, default-value=32768.0  # This is the ILO0 Clock Frequency in Hz. The proper value / the proper value's range is derivative-specific and can be found in the derivative's DataSheet.
            container McuIlo1Settings [0..1]: multiplicity set at post-build, post-build-variant-multiplicity=true  # This container contains the configurations for the ILO1 setting.
              boolean McuIlo1Enable: origin=Cypress, post-build-variant-value=true, set at post-build, default-value=true  # This parameter is used to enable the ILO1 clock.
              boolean McuIlo1MonitorEnable: origin=Cypress, post-build-variant-value=true, set at post-build, default-value=false  # This parameter is used to enable the internal ILO1 clock monitoring circuit.
              float McuIlo1Frequency: 0.0..35061.76, origin=Cypress, post-build-variant-value=true, set at post-build, default-value=32768.0  # This is the ILO1 Clock Frequency in Hz. The proper value / the proper value's range is derivative-specific and can be found in the derivative's DataSheet.
          container McuWcoSettings [0..1]: multiplicity set at post-build, post-build-variant-multiplicity=true  # This container contains the configurations for the WCO setting.
            boolean McuWcoEnable: origin=Cypress, post-build-variant-value=true, set at post-build, default-value=false  # This parameter is used to enable the WCO clock.
            boolean McuWcoStopForUpdate: origin=Cypress, post-build-variant-value=true, set at post-build, default-value=false  # This parameter is used to enable the stop which is performed before update WCO clock settings when WCO clock is running.
            enumeration McuWcoType: {MCU_WCO_WATCH_CRYSTAL, MCU_WCO_CLOCK_SIGNAL}, origin=Cypress, post-build-variant-value=true, set at post-build, default-value=MCU_WCO_WATCH_CRYSTAL  # This parameter is used to specify the type for board-level connections to the WCO pins.
            enumeration McuWcoPrescaler: {MCU_WCO_SQUAREWAVE_32768HZ, MCU_WCO_SINEWAVE_60HZ, MCU_WCO_SINEWAVE_50HZ}, origin=Cypress, post-build-variant-value=true, set at post-build, default-value=MCU_WCO_SQUAREWAVE_32768HZ  # This parameter is used to specify the prescaler for real time clock used when McuWcoType is set as MCU_WCO_CLOCK_SIGNAL.
            integer McuWcoStabilizationTimeout [0..1]: 1..4294967295, multiplicity set at post-build, origin=Cypress, post-build-variant-multiplicity=true, post-build-variant-value=true, set at post-build, default-value=1  # This parameter is used to specify the timeout count value for checking WCO clock stabilization.
            float McuWcoFrequency: 0.0..32768.0, origin=Cypress, post-build-variant-value=true, set at post-build, default-value=32768.0  # This is the WCO Clock Frequency in Hz. The proper value / the proper value's range is derivative-specific and can be found in the derivative's DataSheet.
        container McuClockSettings  # This container contains the configurations for the clock common settings.
          integer McuPclkEnableTimeout [0..1]: 1..4294967295, multiplicity set at post-build, origin=Cypress, post-build-variant-multiplicity=true, post-build-variant-value=true, set at post-build, default-value=1  # This parameter is used to specify the timeout count value for checking pclk clock enabled.
          integer McuPeriGroupBusTransferTimeout [0..1]: 0..65534, multiplicity set at post-build, origin=Cypress, post-build-variant-multiplicity=true, post-build-variant-value=true, set at post-build, default-value=65534  # This parameter is used to specify the Bus transfer timeout value.
          enumeration McuBackupClockSource [0..1]: {MCU_CLOCK_WCO, MCU_CLOCK_ALTBAK, MCU_CLOCK_ILO0, MCU_CLOCK_LPECO_PRESCALE}, multiplicity set at post-build, origin=Cypress, post-build-variant-multiplicity=true, post-build-variant-value=true, set at post-build, default-value=MCU_CLOCK_WCO  # This parameter is used to specify the source clock of the backup clock.
          float McuBackupClockFrequency [0..1]: 0.0..32768.0, multiplicity set at post-build, origin=Cypress, post-build-variant-multiplicity=true, post-build-variant-value=true, set at post-build, default-value=32768.0  # This parameter shows the backup clock frequency in Hz.
          float McuFast0ClockFrequency: 0.0..3.5E8, origin=Cypress, post-build-variant-value=true, set at post-build, default-value=1.0E8  # This parameter shows the fast 0 clock frequency in Hz.
          float McuFast0ClockDivision: 1.0..256.96875, origin=Cypress, post-build-variant-value=true, set at post-build, default-value=1.0  # This parameter is used to specify the division value of the fast 0 clock.
          float McuFast1ClockFrequency [0..1]: 0.0..3.5E8, multiplicity set at post-build, origin=Cypress, post-build-variant-multiplicity=true, post-build-variant-value=true, set at post-build, default-value=1.0E8  # This parameter shows the fast 1 clock frequency in Hz.
          float McuFast1ClockDivision [0..1]: 1.0..256.96875, multiplicity set at post-build, origin=Cypress, post-build-variant-multiplicity=true, post-build-variant-value=true, set at post-build, default-value=1.0  # This parameter is used to specify the division value of the fast 1 clock.
          float McuMemClockFrequency [0..1]: 0.0..2.0E8, multiplicity set at post-build, origin=Cypress, post-build-variant-multiplicity=true, post-build-variant-value=true, set at post-build, default-value=1.0E8  # This parameter shows the memory clock frequency in Hz.
          integer McuMemClockDivision [0..1]: 1..256, multiplicity set at post-build, origin=Cypress, post-build-variant-multiplicity=true, post-build-variant-value=true, set at post-build, default-value=2  # This parameter is used to specify the division value of the memory clock.
          float McuTrcDbgClockFrequency [0..1]: 0.0..2.0E8, multiplicity set at post-build, origin=Cypress, post-build-variant-multiplicity=true, post-build-variant-value=true, set at post-build, default-value=1.0E8  # This parameter shows the trace and debug clock frequency in Hz.
          integer McuTrcDbgClockDivision [0..1]: 1..256, multiplicity set at post-build, origin=Cypress, post-build-variant-multiplicity=true, post-build-variant-value=true, set at post-build, default-value=3  # This parameter is used to specify the division value of the trace and debug clock.
          float McuSlowClockFrequency: 0.0..2.0E8, origin=Cypress, post-build-variant-value=true, set at post-build, default-value=5.0E7  # This parameter shows the slow clock frequency in Hz.
          integer McuSlowClockDivision: 1..256, origin=Cypress, post-build-variant-value=true, set at post-build, default-value=1  # This parameter is used to specify the division value of the slow clock.
          float McuPeriClockFrequency: 0.0..1.0E8, origin=Cypress, post-build-variant-value=true, set at post-build, default-value=5.0E7  # This parameter shows the peripheral clock frequency in Hz.
          integer McuPeriClockDivision: 1..256, origin=Cypress, post-build-variant-value=true, set at post-build, default-value=2  # This parameter is used to specify the division value of the peripheral clock.
          integer McuFlashWaitCycle: 0..15, origin=Cypress, post-build-variant-value=true, set at post-build, default-value=0  # This parameter is used to specify the wait cycle for accessing the FLASH memory.
          integer McuFastRomWaitCycle: 0..3, origin=Cypress, post-build-variant-value=true, set at post-build, default-value=0  # This parameter is used to specify the wait cycle for accessing the ROM on the fast clock domain.
          integer McuSlowRomWaitCycle: 0..3, origin=Cypress, post-build-variant-value=true, set at post-build, default-value=1  # This parameter is used to specify the wait cycle for accessing the ROM on the slow clock domain.
          integer McuFastRam0WaitCycle: 0..3, origin=Cypress, post-build-variant-value=true, set at post-build, default-value=0  # This parameter is used to specify the wait cycle for accessing the RAM0 on the fast clock domain.
          integer McuSlowRam0WaitCycle: 0..3, origin=Cypress, post-build-variant-value=true, set at post-build, default-value=1  # This parameter is used to specify the wait cycle for accessing the RAM0 on the slow clock domain.
          integer McuFastRam1WaitCycle [0..1]: 0..3, multiplicity set at post-build, origin=Cypress, post-build-variant-multiplicity=true, post-build-variant-value=true, set at post-build, default-value=0  # This parameter is used to specify the wait cycle for accessing the RAM1 on the fast clock domain.
          integer McuSlowRam1WaitCycle [0..1]: 0..3, multiplicity set at post-build, origin=Cypress, post-build-variant-multiplicity=true, post-build-variant-value=true, set at post-build, default-value=1  # This parameter is used to specify the wait cycle for accessing the RAM1 on the slow clock domain.
          integer McuFastRam2WaitCycle [0..1]: 0..3, multiplicity set at post-build, origin=Cypress, post-build-variant-multiplicity=true, post-build-variant-value=true, set at post-build, default-value=0  # This parameter is used to specify the wait cycle for accessing the RAM2 on the fast clock domain.
          integer McuSlowRam2WaitCycle [0..1]: 0..3, multiplicity set at post-build, origin=Cypress, post-build-variant-multiplicity=true, post-build-variant-value=true, set at post-build, default-value=1  # This parameter is used to specify the wait cycle for accessing the RAM2 on the slow clock domain.
          enumeration McuCsvReferenceClock: {MCU_CLOCK_IMO, MCU_CLOCK_EXTCLK, MCU_CLOCK_ECO, MCU_CLOCK_ALTHF}, origin=Cypress, post-build-variant-value=true, set at post-build, default-value=MCU_CLOCK_IMO  # This parameter is used to specify the reference clock of the clock supervisor.
          container McuClockPathSettings [0..*]: multiplicity set at post-build, post-build-variant-multiplicity=true  # This container contains the configurations for the clock path setting.
            enumeration McuClockPath: {MCU_CLOCK_PATH0, MCU_CLOCK_PATH1, MCU_CLOCK_PATH2, MCU_CLOCK_PATH3, MCU_CLOCK_PATH4, MCU_CLOCK_PATH5, MCU_CLOCK_PATH6, MCU_CLOCK_PATH7, MCU_CLOCK_PATH8, MCU_CLOCK_PATH9, MCU_CLOCK_PATH10, MCU_CLOCK_PATH11, MCU_CLOCK_PATH12, MCU_CLOCK_PATH13, MCU_CLOCK_PATH14, MCU_CLOCK_PATH15}, origin=Cypress, post-build-variant-value=true, set at post-build, default-value=MCU_CLOCK_PATH1  # This parameter is used to specify the clock path of this setting.
            float McuClockPathFrequency: 0.0..4.0E8, origin=Cypress, post-build-variant-value=true, set at post-build, default-value=8000000.0  # This parameter shows the current clock path frequency in Hz.
            enumeration McuClockPathSource: {MCU_CLOCK_IMO, MCU_CLOCK_EXTCLK, MCU_CLOCK_ECO, MCU_CLOCK_ILO0, MCU_CLOCK_ILO1, MCU_CLOCK_WCO, MCU_CLOCK_ALTHF, MCU_CLOCK_ALTLF, MCU_CLOCK_LPECO, MCU_CLOCK_DSI0, MCU_CLOCK_DSI1, MCU_CLOCK_DSI2, MCU_CLOCK_DSI3, MCU_CLOCK_DSI4, MCU_CLOCK_DSI5, MCU_CLOCK_DSI6, MCU_CLOCK_DSI7, MCU_CLOCK_DSI8, MCU_CLOCK_DSI9, MCU_CLOCK_DSI10, MCU_CLOCK_DSI11, MCU_CLOCK_DSI12, MCU_CLOCK_DSI13, MCU_CLOCK_DSI14, MCU_CLOCK_DSI15}, origin=Cypress, post-build-variant-value=true, set at post-build, default-value=MCU_CLOCK_IMO  # This parameter is used to specify the source clock for the current clock path.
          container McuFllSettings [0..1]: multiplicity set at post-build, post-build-variant-multiplicity=true  # This container contains the configurations for the FLL setting.
            boolean McuFllEnable: origin=Cypress, post-build-variant-value=true, set at post-build, default-value=false  # This parameter is used to enable the FLL clock.
            boolean McuFllStopForUpdate: origin=Cypress, post-build-variant-value=true, set at post-build, default-value=false  # This parameter is used to enable the stop which is performed before update FLL clock settings when FLL clock is running.
            boolean McuFllAutoDistributeEnable: origin=Cypress, post-build-variant-value=true, set at post-build, default-value=true  # This parameter is used to enable the automatic distribution of FLL clock.
            enumeration McuFllAutoDistributeType [0..1]: {MCU_DISTRIBUTE_AFTER_LOCKED, MCU_DISTRIBUTE_ONLY_LOCKED}, multiplicity set at post-build, origin=Cypress, post-build-variant-multiplicity=true, post-build-variant-value=true, set at post-build, default-value=MCU_DISTRIBUTE_AFTER_LOCKED  # This parameter is used to determine the automatic distribution type of FLL clock.
            integer McuFllStabilizationTimeout [0..1]: 1..4294967295, multiplicity set at post-build, origin=Cypress, post-build-variant-multiplicity=true, post-build-variant-value=true, set at post-build, default-value=1  # This parameter is used to specify the timeout count value for checking FLL Clock Stabilization.
            float McuFllFrequency: 0.0..2.0E8, origin=Cypress, post-build-variant-value=true, set at post-build, default-value=1.0E8  # This parameter shows the FLL clock frequency in Hz.
            enumeration McuFllSource: {MCU_CLOCK_IMO, MCU_CLOCK_EXTCLK, MCU_CLOCK_ECO, MCU_CLOCK_ILO0, MCU_CLOCK_ILO1, MCU_CLOCK_WCO, MCU_CLOCK_ALTHF, MCU_CLOCK_ALTLF, MCU_CLOCK_LPECO, MCU_CLOCK_DSI0, MCU_CLOCK_DSI1, MCU_CLOCK_DSI2, MCU_CLOCK_DSI3, MCU_CLOCK_DSI4, MCU_CLOCK_DSI5, MCU_CLOCK_DSI6, MCU_CLOCK_DSI7, MCU_CLOCK_DSI8, MCU_CLOCK_DSI9, MCU_CLOCK_DSI10, MCU_CLOCK_DSI11, MCU_CLOCK_DSI12, MCU_CLOCK_DSI13, MCU_CLOCK_DSI14, MCU_CLOCK_DSI15}, origin=Cypress, post-build-variant-value=true, set at post-build, default-value=MCU_CLOCK_IMO  # This parameter is used to specify the source clock of the FLL clock.
            integer McuFllReferenceDivision: 1..8191, origin=Cypress, post-build-variant-value=true, set at post-build, default-value=1  # This parameter is used to specify the reference division value of the FLL clock.
            integer McuFllOutputDivision: 1..2, origin=Cypress, post-build-variant-value=true, set at post-build, default-value=2  # This parameter is used to specify the output division value of the FLL clock.
            integer McuFllMultiplication: 0..262143, origin=Cypress, post-build-variant-value=true, set at post-build, default-value=25  # This parameter is used to specify the multiplication value of the FLL clock.
            boolean McuFllCcoEnable: origin=Cypress, post-build-variant-value=true, set at post-build, default-value=false  # This parameter is used to enable the CCO.
            integer McuFllCcoOffset: 0..255, origin=Cypress, post-build-variant-value=true, set at post-build, default-value=255  # This parameter is used to specify the allowed maximum value of the CCO offset.
            boolean McuFllCcoAutoUpdateDisable: origin=Cypress, post-build-variant-value=true, set at post-build, default-value=false  # This parameter is used to disable the CCO frequency update by FLL hardware.
            integer McuFllCcoFrequencyCode: 0..511, origin=Cypress, post-build-variant-value=true, set at post-build, default-value=0  # This parameter is used to specify the CCO frequency code of the FLL clock.
            integer McuFllCcoStabilizationTimeout [0..1]: 1..4294967295, multiplicity set at post-build, origin=Cypress, post-build-variant-multiplicity=true, post-build-variant-value=true, set at post-build, default-value=1  # This parameter is used to specify the timeout count value for checking FLL CCO Stabilization.
            integer McuFllLockTolerance: 1..256, origin=Cypress, post-build-variant-value=true, set at post-build, default-value=3  # This parameter is used to specify the lock tolerance which is the error threshold for when the FLL output is considered locked to the reference input.
            integer McuFllUpdateTolerance: 0..254, origin=Cypress, post-build-variant-value=true, set at post-build, default-value=0  # This parameter is used to specify the update tolerance which is the error threshold for when the FLL will update the CCO frequency settings.
            integer McuFllSettlingCount: 0..8191, origin=Cypress, post-build-variant-value=true, set at post-build, default-value=40  # This parameter is used to specify the number of undivided reference clock cycles to wait after changing the CCO trim until the loop measurement restarts.
            enumeration McuFllLoopFilterIGain: {MCU_FLL_LOOP_FILTER_GAIN_1_BY_256, MCU_FLL_LOOP_FILTER_GAIN_1_BY_128, MCU_FLL_LOOP_FILTER_GAIN_1_BY_64, MCU_FLL_LOOP_FILTER_GAIN_1_BY_32, MCU_FLL_LOOP_FILTER_GAIN_1_BY_16, MCU_FLL_LOOP_FILTER_GAIN_1_BY_8, MCU_FLL_LOOP_FILTER_GAIN_1_BY_4, MCU_FLL_LOOP_FILTER_GAIN_1_BY_2, MCU_FLL_LOOP_FILTER_GAIN_1, MCU_FLL_LOOP_FILTER_GAIN_2, MCU_FLL_LOOP_FILTER_GAIN_4, MCU_FLL_LOOP_FILTER_GAIN_8}, origin=Cypress, post-build-variant-value=true, set at post-build, default-value=MCU_FLL_LOOP_FILTER_GAIN_1_BY_256  # This parameter is used to specify the FLL loop filter integral gain setting.
            enumeration McuFllLoopFilterPGain: {MCU_FLL_LOOP_FILTER_GAIN_1_BY_256, MCU_FLL_LOOP_FILTER_GAIN_1_BY_128, MCU_FLL_LOOP_FILTER_GAIN_1_BY_64, MCU_FLL_LOOP_FILTER_GAIN_1_BY_32, MCU_FLL_LOOP_FILTER_GAIN_1_BY_16, MCU_FLL_LOOP_FILTER_GAIN_1_BY_8, MCU_FLL_LOOP_FILTER_GAIN_1_BY_4, MCU_FLL_LOOP_FILTER_GAIN_1_BY_2, MCU_FLL_LOOP_FILTER_GAIN_1, MCU_FLL_LOOP_FILTER_GAIN_2, MCU_FLL_LOOP_FILTER_GAIN_4, MCU_FLL_LOOP_FILTER_GAIN_8}, origin=Cypress, post-build-variant-value=true, set at post-build, default-value=MCU_FLL_LOOP_FILTER_GAIN_1_BY_256  # This parameter is used to specify the FLL loop filter proportional gain setting.
          container McuPllSettings [0..*]: multiplicity set at post-build, post-build-variant-multiplicity=true  # This container contains configurations for PLL clock setting.
            enumeration McuPllType: {MCU_CLOCK_PLL0, MCU_CLOCK_PLL1, MCU_CLOCK_PLL2, MCU_CLOCK_PLL3, MCU_CLOCK_PLL4, MCU_CLOCK_PLL5, MCU_CLOCK_PLL6, MCU_CLOCK_PLL7, MCU_CLOCK_PLL8, MCU_CLOCK_PLL9, MCU_CLOCK_PLL10, MCU_CLOCK_PLL11, MCU_CLOCK_PLL12, MCU_CLOCK_PLL13, MCU_CLOCK_PLL14}, origin=Cypress, post-build-variant-value=true, set at post-build, default-value=MCU_CLOCK_PLL0  # This parameter is used to specify the PLL clock type of this setting.
            boolean McuPllEnable: origin=Cypress, post-build-variant-value=true, set at post-build, default-value=false  # This parameter is used to enable the PLL clock.
            boolean McuPllStopForUpdate: origin=Cypress, post-build-variant-value=true, set at post-build, default-value=false  # This parameter is used to enable the stop which is performed before update PLL clock settings when PLL clock is running.
            boolean McuPllAutoDistributeEnable: origin=Cypress, post-build-variant-value=true, set at post-build, default-value=true  # This parameter is used to enable the automatic distribution of PLL clock.
            enumeration McuPllAutoDistributeType [0..1]: {MCU_DISTRIBUTE_AFTER_LOCKED, MCU_DISTRIBUTE_ONLY_LOCKED}, multiplicity set at post-build, origin=Cypress, post-build-variant-multiplicity=true, post-build-variant-value=true, set at post-build, default-value=MCU_DISTRIBUTE_AFTER_LOCKED  # This parameter is used to determine the automatic distribution type of PLL clock.
            integer McuPllStabilizationTimeout [0..1]: 1..4294967295, multiplicity set at post-build, origin=Cypress, post-build-variant-multiplicity=true, post-build-variant-value=true, set at post-build, default-value=1  # This parameter is used to enable the timeout count value for checking of PLL Clock Stabilization.
            float McuPllFrequency: 0.0..2.0E8, origin=Cypress, post-build-variant-value=true, set at post-build, default-value=2.0E8  # This parameter shows the PLL clock frequency in Hz.
            enumeration McuPllSource: {MCU_CLOCK_IMO, MCU_CLOCK_EXTCLK, MCU_CLOCK_ECO, MCU_CLOCK_ILO0, MCU_CLOCK_ILO1, MCU_CLOCK_WCO, MCU_CLOCK_ALTHF, MCU_CLOCK_ALTLF, MCU_CLOCK_LPECO, MCU_CLOCK_DSI0, MCU_CLOCK_DSI1, MCU_CLOCK_DSI2, MCU_CLOCK_DSI3, MCU_CLOCK_DSI4, MCU_CLOCK_DSI5, MCU_CLOCK_DSI6, MCU_CLOCK_DSI7, MCU_CLOCK_DSI8, MCU_CLOCK_DSI9, MCU_CLOCK_DSI10, MCU_CLOCK_DSI11, MCU_CLOCK_DSI12, MCU_CLOCK_DSI13, MCU_CLOCK_DSI14, MCU_CLOCK_DSI15}, origin=Cypress, post-build-variant-value=true, set at post-build, default-value=MCU_CLOCK_IMO  # This parameter is used to specify the source clock of the PLL clock.
            integer McuPllReferenceDivision: 1..20, origin=Cypress, post-build-variant-value=true, set at post-build, default-value=1  # This parameter is used to specify the reference division value of the PLL clock.
            integer McuPllOutputDivision: 2..16, origin=Cypress, post-build-variant-value=true, set at post-build, default-value=2  # This parameter is used to specify the output division value of the PLL clock.
            integer McuPllFeedbackDivision: 22..112, origin=Cypress, post-build-variant-value=true, set at post-build, default-value=50  # This parameter is used to specify the feedback division value of the PLL clock.
            enumeration McuPllLockSensitivity: {MCU_LOCK_SENSITIVITY_NORMAL, MCU_LOCK_SENSITIVITY_REDUCED}, origin=Cypress, post-build-variant-value=true, set at post-build, default-value=MCU_LOCK_SENSITIVITY_NORMAL  # This parameter is used to specify the sensitivity of the lock detection.
          container McuSscgPllSettings [0..*]: multiplicity set at post-build, post-build-variant-multiplicity=true  # This container contains configurations for SSCG PLL clock setting.
            enumeration McuSscgPllType: {MCU_CLOCK_SSCG_PLL0, MCU_CLOCK_SSCG_PLL1, MCU_CLOCK_SSCG_PLL2, MCU_CLOCK_SSCG_PLL3, MCU_CLOCK_SSCG_PLL4, MCU_CLOCK_SSCG_PLL5, MCU_CLOCK_SSCG_PLL6, MCU_CLOCK_SSCG_PLL7, MCU_CLOCK_SSCG_PLL8, MCU_CLOCK_SSCG_PLL9, MCU_CLOCK_SSCG_PLL10, MCU_CLOCK_SSCG_PLL11, MCU_CLOCK_SSCG_PLL12, MCU_CLOCK_SSCG_PLL13, MCU_CLOCK_SSCG_PLL14}, origin=Cypress, post-build-variant-value=true, set at post-build, default-value=MCU_CLOCK_SSCG_PLL0  # This parameter is used to specify the SSCG PLL clock type of this setting.
            boolean McuSscgPllEnable: origin=Cypress, post-build-variant-value=true, set at post-build, default-value=false  # This parameter is used to enable the SSCG PLL clock.
            boolean McuSscgPllStopForUpdate: origin=Cypress, post-build-variant-value=true, set at post-build, default-value=false  # This parameter is used to enable the stop which is performed before update SSCG PLL clock settings when SSCG PLL clock is running.
            boolean McuSscgPllAutoDistributeEnable: origin=Cypress, post-build-variant-value=true, set at post-build, default-value=true  # This parameter is used to enable the automatic distribution of SSCG PLL clock.
            enumeration McuSscgPllAutoDistributeType [0..1]: {MCU_DISTRIBUTE_AFTER_LOCKED, MCU_DISTRIBUTE_ONLY_LOCKED}, multiplicity set at post-build, origin=Cypress, post-build-variant-multiplicity=true, post-build-variant-value=true, set at post-build, default-value=MCU_DISTRIBUTE_AFTER_LOCKED  # This parameter is used to determine the automatic distribution type of SSCG PLL clock.
            integer McuSscgPllStabilizationTimeout [0..1]: 1..4294967295, multiplicity set at post-build, origin=Cypress, post-build-variant-multiplicity=true, post-build-variant-value=true, set at post-build, default-value=1  # This parameter is used to enable the timeout count value for checking of SSCG PLL Clock Stabilization.
            float McuSscgPllFrequency: 0.0..4.0E8, origin=Cypress, post-build-variant-value=true, set at post-build, default-value=4.0E8  # This parameter shows the SSCG PLL clock frequency in Hz.
            enumeration McuSscgPllSource: {MCU_CLOCK_IMO, MCU_CLOCK_EXTCLK, MCU_CLOCK_ECO, MCU_CLOCK_ILO0, MCU_CLOCK_ILO1, MCU_CLOCK_WCO, MCU_CLOCK_ALTHF, MCU_CLOCK_ALTLF, MCU_CLOCK_LPECO, MCU_CLOCK_DSI0, MCU_CLOCK_DSI1, MCU_CLOCK_DSI2, MCU_CLOCK_DSI3, MCU_CLOCK_DSI4, MCU_CLOCK_DSI5, MCU_CLOCK_DSI6, MCU_CLOCK_DSI7, MCU_CLOCK_DSI8, MCU_CLOCK_DSI9, MCU_CLOCK_DSI10, MCU_CLOCK_DSI11, MCU_CLOCK_DSI12, MCU_CLOCK_DSI13, MCU_CLOCK_DSI14, MCU_CLOCK_DSI15}, origin=Cypress, post-build-variant-value=true, set at post-build, default-value=MCU_CLOCK_IMO  # This parameter is used to specify the source clock of the SSCG PLL clock.
            integer McuSscgPllReferenceDivision: 1..16, origin=Cypress, post-build-variant-value=true, set at post-build, default-value=1  # This parameter is used to specify the reference division value of the SSCG PLL clock.
            integer McuSscgPllOutputDivision: 2..16, origin=Cypress, post-build-variant-value=true, set at post-build, default-value=2  # This parameter is used to specify the output division value of the SSCG PLL clock.
            float McuSscgPllFeedbackDivision: 16..200.999999940395355, origin=Cypress, post-build-variant-value=true, set at post-build, default-value=50  # This parameter is used to specify the feedback division value of the SSCG PLL clock.
            enumeration McuSscgPllLockSensitivity: {MCU_LOCK_SENSITIVITY_INTEGER, MCU_LOCK_SENSITIVITY_FRACTIONAL_OR_SPREADING}, origin=Cypress, post-build-variant-value=true, set at post-build, default-value=MCU_LOCK_SENSITIVITY_INTEGER  # This parameter is used to specify the sensitivity of the lock detection.
            boolean McuSscgPllFractionalDivisionEnable: origin=Cypress, post-build-variant-value=true, set at post-build, default-value=false  # This parameter is used to enable the fractional feedback division.
            boolean McuSscgPllFractionalDivisionDitheringEnable: origin=Cypress, post-build-variant-value=true, set at post-build, default-value=false  # This parameter is used to enable the dithering for the fractional feedback division.
            boolean McuSscgPllModulationEnable: origin=Cypress, post-build-variant-value=true, set at post-build, default-value=false  # This parameter is used to enable the SSCG modulation.
            enumeration McuSscgPllModulationMode: {MCU_SSCG_MODE_DOWN_SPREAD}, origin=Cypress, post-build-variant-value=true, set at post-build, default-value=MCU_SSCG_MODE_DOWN_SPREAD  # This parameter is used to specify the SSCG modulation mode.
            enumeration McuSscgPllModulationDepth: {MCU_SSCG_DEPTH_0_5_PERCENT, MCU_SSCG_DEPTH_1_0_PERCENT, MCU_SSCG_DEPTH_2_0_PERCENT, MCU_SSCG_DEPTH_3_0_PERCENT}, origin=Cypress, post-build-variant-value=true, set at post-build, default-value=MCU_SSCG_DEPTH_0_5_PERCENT  # This parameter is used to specify the SSCG modulation depth.
            enumeration McuSscgPllModulationRate: {MCU_SSCG_RATE_FPFD_BY_4096, MCU_SSCG_RATE_FPFD_BY_2048, MCU_SSCG_RATE_FPFD_BY_1024, MCU_SSCG_RATE_FPFD_BY_512, MCU_SSCG_RATE_FPFD_BY_256}, origin=Cypress, post-build-variant-value=true, set at post-build, default-value=MCU_SSCG_RATE_FPFD_BY_4096  # This parameter is used to specify the SSCG modulation rate.
            boolean McuSscgPllModulationDitheringEnable [0..0]: origin=Cypress, post-build-variant-value=true, set at post-build, default-value=false  # This parameter is used to enable the dithering for the SSCG modulation.
          container McuClockRootSettings [1..*]: multiplicity set at post-build, post-build-variant-multiplicity=true  # This container contains the configurations for the clock root setting.
            enumeration McuClockRoot: {MCU_CLOCK_ROOT0, MCU_CLOCK_ROOT1, MCU_CLOCK_ROOT2, MCU_CLOCK_ROOT3, MCU_CLOCK_ROOT4, MCU_CLOCK_ROOT5, MCU_CLOCK_ROOT6, MCU_CLOCK_ROOT7, MCU_CLOCK_ROOT8, MCU_CLOCK_ROOT9, MCU_CLOCK_ROOT10, MCU_CLOCK_ROOT11, MCU_CLOCK_ROOT12, MCU_CLOCK_ROOT13, MCU_CLOCK_ROOT14, MCU_CLOCK_ROOT15}, origin=Cypress, post-build-variant-value=true, set at post-build, default-value=MCU_CLOCK_ROOT0  # This parameter is used to specify the clock root of this setting.
            boolean McuClockRootEnable: origin=Cypress, post-build-variant-value=true, set at post-build, default-value=true  # This parameter is used to enable the current clock root.
            float McuClockRootFrequency: 0.0..4.0E8, origin=Cypress, post-build-variant-value=true, set at post-build, default-value=1.0E8  # This parameter shows the current clock root frequency in Hz.
            enumeration McuClockRootSource: {MCU_CLOCK_FLL, MCU_CLOCK_SSCG_PLL, MCU_CLOCK_PLL, MCU_CLOCK_PATH, MCU_CLOCK_IMO}, origin=Cypress, post-build-variant-value=true, set at post-build, default-value=MCU_CLOCK_FLL  # This parameter is used to specify the source clock of the current clock root.
            enumeration McuClockRootDivision: {MCU_CLK_DIV_1, MCU_CLK_DIV_2, MCU_CLK_DIV_4, MCU_CLK_DIV_8}, origin=Cypress, post-build-variant-value=true, set at post-build, default-value=MCU_CLK_DIV_1  # This parameter is used to specify the division value of the current clock root.
            reference McuClockRootSscgPllRef [0..1]: multiplicity set at post-build, origin=Cypress, post-build-variant-multiplicity=true, post-build-variant-value=true, set at post-build, destination=McuSscgPllSettings  # This parameter refers to the SSCG PLL clock configuration, which is set in the McuSscgPllSettings when the source clock is set to SSCG PLL.
            reference McuClockRootPllRef [0..1]: multiplicity set at post-build, origin=Cypress, post-build-variant-multiplicity=true, post-build-variant-value=true, set at post-build, destination=McuPllSettings  # This parameter refers to the PLL clock configuration, which is set in the McuPllSettings when the source clock is set to PLL.
            reference McuClockRootPathRef [0..1]: multiplicity set at post-build, origin=Cypress, post-build-variant-multiplicity=true, post-build-variant-value=true, set at post-build, destination=McuClockPathSettings  # This parameter refers to the path clock configuration, which is set in the McuClockPathSettings when the source clock is set to clock path.
          container McuPclkGroupSettings [0..*]: multiplicity set at post-build, post-build-variant-multiplicity=true  # This container contains the configurations for the PCLK group setting.
            enumeration McuPclkGroup: {MCU_PCLK_GROUP0, MCU_PCLK_GROUP1, MCU_PCLK_GROUP2, MCU_PCLK_GROUP3, MCU_PCLK_GROUP4, MCU_PCLK_GROUP5, MCU_PCLK_GROUP6, MCU_PCLK_GROUP7, MCU_PCLK_GROUP8, MCU_PCLK_GROUP9, MCU_PCLK_GROUP10, MCU_PCLK_GROUP11, MCU_PCLK_GROUP12, MCU_PCLK_GROUP13, MCU_PCLK_GROUP14, MCU_PCLK_GROUP15}, origin=Cypress, post-build-variant-value=true, set at post-build, default-value=MCU_PCLK_GROUP0  # This parameter is used to specify the PCLK group.
            container McuPclkDividerSettings [0..*]: multiplicity set at post-build, post-build-variant-multiplicity=true  # This container contains the configurations for the PCLK divider setting.
              enumeration McuPclkDividerType: {MCU_PCLK_DIVIDER_8, MCU_PCLK_DIVIDER_16, MCU_PCLK_DIVIDER_16_5, MCU_PCLK_DIVIDER_24_5}, origin=Cypress, post-build-variant-value=true, set at post-build, default-value=MCU_PCLK_DIVIDER_8  # This parameter is used to specify the pclk divider type of this setting. The pclk divider can be specified by the combination of the McuPclkDividerType and McuPclkDividerIndex.
              integer McuPclkDividerIndex: 0..256, origin=Cypress, post-build-variant-value=true, set at post-build, default-value=0  # This parameter is used to specify the pclk divider index of this setting. The pclk divider can be specified by the combination of the McuPclkDividerType and McuPclkDividerIndex.
              boolean McuPclkDividerEnable: origin=Cypress, post-build-variant-value=true, set at post-build, default-value=true  # This parameter is used to enable the current pclk divider.
              boolean McuPclkDividerStopForUpdate: origin=Cypress, post-build-variant-value=true, set at post-build, default-value=true  # This parameter is used to enable the stop which is performed before update pclk divider settings when pclk clock is running.
              float McuPclkDividerValue: 1.0..1.677721696875E7, origin=Cypress, post-build-variant-value=true, set at post-build, default-value=1.0  # This parameter is used to specify the division value of the current pclk divider.
              reference McuPclkPhaseAlignDividerRef [0..1]: multiplicity set at post-build, origin=Cypress, post-build-variant-multiplicity=true, post-build-variant-value=true, set at post-build, destination=McuPclkDividerSettings  # This parameter refers to the pclk divider configuration which is set in another McuPclkDividerSettings container to allow current pclk divider to be aligned to referred one.
            container McuPclkSettings [0..*]: multiplicity set at post-build, post-build-variant-multiplicity=true  # This container contains the configurations for the peripheral clock setting.
              enumeration McuPclk: {MCU_PCLK_CPUSS_CLOCK_TRACE_IN, MCU_PCLK_CXPI0_CLOCK_CH_EN0, MCU_PCLK_CXPI0_CLOCK_CH_EN1, MCU_PCLK_CXPI0_CLOCK_CH_EN2, MCU_PCLK_CXPI0_CLOCK_CH_EN3, MCU_PCLK_SMARTIO7_CLOCK, MCU_PCLK_SMARTIO8_CLOCK, MCU_PCLK_SMARTIO9_CLOCK, MCU_PCLK_SMARTIO12_CLOCK, MCU_PCLK_SMARTIO13_CLOCK, MCU_PCLK_SMARTIO14_CLOCK, MCU_PCLK_SMARTIO15_CLOCK, MCU_PCLK_SMARTIO17_CLOCK, MCU_PCLK_CANFD0_CLOCK_CAN0, MCU_PCLK_CANFD0_CLOCK_CAN1, MCU_PCLK_CANFD0_CLOCK_CAN2, MCU_PCLK_CANFD0_CLOCK_CAN3, MCU_PCLK_CANFD0_CLOCK_CAN4, MCU_PCLK_CANFD1_CLOCK_CAN0, MCU_PCLK_CANFD1_CLOCK_CAN1, MCU_PCLK_CANFD1_CLOCK_CAN2, MCU_PCLK_CANFD1_CLOCK_CAN3, MCU_PCLK_CANFD1_CLOCK_CAN4, MCU_PCLK_LCD0_CLOCK, MCU_PCLK_LIN0_CLOCK_CH_EN0, MCU_PCLK_LIN0_CLOCK_CH_EN1, MCU_PCLK_LIN0_CLOCK_CH_EN2, MCU_PCLK_LIN0_CLOCK_CH_EN3, MCU_PCLK_LIN0_CLOCK_CH_EN4, MCU_PCLK_LIN0_CLOCK_CH_EN5, MCU_PCLK_LIN0_CLOCK_CH_EN6, MCU_PCLK_LIN0_CLOCK_CH_EN7, MCU_PCLK_LIN0_CLOCK_CH_EN8, MCU_PCLK_LIN0_CLOCK_CH_EN9, MCU_PCLK_LIN0_CLOCK_CH_EN10, MCU_PCLK_LIN0_CLOCK_CH_EN11, MCU_PCLK_LIN0_CLOCK_CH_EN12, MCU_PCLK_LIN0_CLOCK_CH_EN13, MCU_PCLK_LIN0_CLOCK_CH_EN14, MCU_PCLK_LIN0_CLOCK_CH_EN15, MCU_PCLK_LIN0_CLOCK_CH_EN16, MCU_PCLK_LIN0_CLOCK_CH_EN17, MCU_PCLK_LIN0_CLOCK_CH_EN18, MCU_PCLK_LIN0_CLOCK_CH_EN19, MCU_PCLK_SCB0_CLOCK, MCU_PCLK_SCB1_CLOCK, MCU_PCLK_SCB2_CLOCK, MCU_PCLK_SCB3_CLOCK, MCU_PCLK_SCB4_CLOCK, MCU_PCLK_SCB5_CLOCK, MCU_PCLK_SCB6_CLOCK, MCU_PCLK_SCB7_CLOCK, MCU_PCLK_SCB8_CLOCK, MCU_PCLK_SCB9_CLOCK, MCU_PCLK_SCB10_CLOCK, MCU_PCLK_SCB11_CLOCK, MCU_PCLK_FLEXRAY0_CLK_FLEXRAY, MCU_PCLK_PASS0_CLOCK_SAR0, MCU_PCLK_PASS0_CLOCK_SAR1, MCU_PCLK_PASS0_CLOCK_SAR2, MCU_PCLK_TCPWM0_CLOCKS0, MCU_PCLK_TCPWM0_CLOCKS1, MCU_PCLK_TCPWM0_CLOCKS2, MCU_PCLK_TCPWM0_CLOCKS3, MCU_PCLK_TCPWM0_CLOCKS4, MCU_PCLK_TCPWM0_CLOCKS5, MCU_PCLK_TCPWM0_CLOCKS6, MCU_PCLK_TCPWM0_CLOCKS7, MCU_PCLK_TCPWM0_CLOCKS8, MCU_PCLK_TCPWM0_CLOCKS9, MCU_PCLK_TCPWM0_CLOCKS10, MCU_PCLK_TCPWM0_CLOCKS11, MCU_PCLK_TCPWM0_CLOCKS12, MCU_PCLK_TCPWM0_CLOCKS13, MCU_PCLK_TCPWM0_CLOCKS14, MCU_PCLK_TCPWM0_CLOCKS15, MCU_PCLK_TCPWM0_CLOCKS16, MCU_PCLK_TCPWM0_CLOCKS17, MCU_PCLK_TCPWM0_CLOCKS18, MCU_PCLK_TCPWM0_CLOCKS19, MCU_PCLK_TCPWM0_CLOCKS20, MCU_PCLK_TCPWM0_CLOCKS21, MCU_PCLK_TCPWM0_CLOCKS22, MCU_PCLK_TCPWM0_CLOCKS23, MCU_PCLK_TCPWM0_CLOCKS24, MCU_PCLK_TCPWM0_CLOCKS25, MCU_PCLK_TCPWM0_CLOCKS26, MCU_PCLK_TCPWM0_CLOCKS27, MCU_PCLK_TCPWM0_CLOCKS28, MCU_PCLK_TCPWM0_CLOCKS29, MCU_PCLK_TCPWM0_CLOCKS30, MCU_PCLK_TCPWM0_CLOCKS31, MCU_PCLK_TCPWM0_CLOCKS32, MCU_PCLK_TCPWM0_CLOCKS33, MCU_PCLK_TCPWM0_CLOCKS34, MCU_PCLK_TCPWM0_CLOCKS35, MCU_PCLK_TCPWM0_CLOCKS36, MCU_PCLK_TCPWM0_CLOCKS37, MCU_PCLK_TCPWM0_CLOCKS38, MCU_PCLK_TCPWM0_CLOCKS39, MCU_PCLK_TCPWM0_CLOCKS40, MCU_PCLK_TCPWM0_CLOCKS41, MCU_PCLK_TCPWM0_CLOCKS42, MCU_PCLK_TCPWM0_CLOCKS43, MCU_PCLK_TCPWM0_CLOCKS44, MCU_PCLK_TCPWM0_CLOCKS45, MCU_PCLK_TCPWM0_CLOCKS46, MCU_PCLK_TCPWM0_CLOCKS47, MCU_PCLK_TCPWM0_CLOCKS48, MCU_PCLK_TCPWM0_CLOCKS49, MCU_PCLK_TCPWM0_CLOCKS50, MCU_PCLK_TCPWM0_CLOCKS51, MCU_PCLK_TCPWM0_CLOCKS52, MCU_PCLK_TCPWM0_CLOCKS53, MCU_PCLK_TCPWM0_CLOCKS54, MCU_PCLK_TCPWM0_CLOCKS55, MCU_PCLK_TCPWM0_CLOCKS56, MCU_PCLK_TCPWM0_CLOCKS57, MCU_PCLK_TCPWM0_CLOCKS58, MCU_PCLK_TCPWM0_CLOCKS59, MCU_PCLK_TCPWM0_CLOCKS60, MCU_PCLK_TCPWM0_CLOCKS61, MCU_PCLK_TCPWM0_CLOCKS62, MCU_PCLK_TCPWM0_CLOCKS256, MCU_PCLK_TCPWM0_CLOCKS257, MCU_PCLK_TCPWM0_CLOCKS258, MCU_PCLK_TCPWM0_CLOCKS259, MCU_PCLK_TCPWM0_CLOCKS260, MCU_PCLK_TCPWM0_CLOCKS261, MCU_PCLK_TCPWM0_CLOCKS262, MCU_PCLK_TCPWM0_CLOCKS263, MCU_PCLK_TCPWM0_CLOCKS264, MCU_PCLK_TCPWM0_CLOCKS265, MCU_PCLK_TCPWM0_CLOCKS266, MCU_PCLK_TCPWM0_CLOCKS267, MCU_PCLK_TCPWM0_CLOCKS512, MCU_PCLK_TCPWM0_CLOCKS513, MCU_PCLK_TCPWM0_CLOCKS514, MCU_PCLK_TCPWM0_CLOCKS515, MCU_PCLK_TCPWM0_CLOCKS516, MCU_PCLK_TCPWM0_CLOCKS517, MCU_PCLK_TCPWM0_CLOCKS518, MCU_PCLK_TCPWM0_CLOCKS519, MCU_PCLK_TCPWM0_CLOCKS520, MCU_PCLK_TCPWM0_CLOCKS521, MCU_PCLK_TCPWM0_CLOCKS522, MCU_PCLK_TCPWM0_CLOCKS523, MCU_PCLK_TCPWM0_CLOCKS524, MCU_PCLK_TCPWM0_CLOCKS525, MCU_PCLK_TCPWM0_CLOCKS526, MCU_PCLK_TCPWM0_CLOCKS527, MCU_PCLK_TCPWM0_CLOCKS528, MCU_PCLK_TCPWM0_CLOCKS529, MCU_PCLK_TCPWM0_CLOCKS530, MCU_PCLK_TCPWM0_CLOCKS531, MCU_PCLK_TCPWM0_CLOCKS532, MCU_PCLK_TCPWM0_CLOCKS533, MCU_PCLK_TCPWM0_CLOCKS534, MCU_PCLK_TCPWM0_CLOCKS535, MCU_PCLK_TCPWM0_CLOCKS536, MCU_PCLK_TCPWM0_CLOCKS537, MCU_PCLK_TCPWM0_CLOCKS538, MCU_PCLK_TCPWM0_CLOCKS539, MCU_PCLK_TCPWM0_CLOCKS540, MCU_PCLK_TCPWM0_CLOCKS541, MCU_PCLK_TCPWM0_CLOCKS542, MCU_PCLK_TCPWM0_CLOCKS543, MCU_PCLK_TCPWM1_CLOCKS0, MCU_PCLK_TCPWM1_CLOCKS1, MCU_PCLK_TCPWM1_CLOCKS2, MCU_PCLK_TCPWM1_CLOCKS3, MCU_PCLK_TCPWM1_CLOCKS4, MCU_PCLK_TCPWM1_CLOCKS5, MCU_PCLK_TCPWM1_CLOCKS6, MCU_PCLK_TCPWM1_CLOCKS7, MCU_PCLK_TCPWM1_CLOCKS8, MCU_PCLK_TCPWM1_CLOCKS9, MCU_PCLK_TCPWM1_CLOCKS10, MCU_PCLK_TCPWM1_CLOCKS11, MCU_PCLK_TCPWM1_CLOCKS12, MCU_PCLK_TCPWM1_CLOCKS13, MCU_PCLK_TCPWM1_CLOCKS14, MCU_PCLK_TCPWM1_CLOCKS15, MCU_PCLK_TCPWM1_CLOCKS16, MCU_PCLK_TCPWM1_CLOCKS17, MCU_PCLK_TCPWM1_CLOCKS18, MCU_PCLK_TCPWM1_CLOCKS19, MCU_PCLK_TCPWM1_CLOCKS20, MCU_PCLK_TCPWM1_CLOCKS21, MCU_PCLK_TCPWM1_CLOCKS22, MCU_PCLK_TCPWM1_CLOCKS23, MCU_PCLK_TCPWM1_CLOCKS24, MCU_PCLK_TCPWM1_CLOCKS25, MCU_PCLK_TCPWM1_CLOCKS26, MCU_PCLK_TCPWM1_CLOCKS27, MCU_PCLK_TCPWM1_CLOCKS28, MCU_PCLK_TCPWM1_CLOCKS29, MCU_PCLK_TCPWM1_CLOCKS30, MCU_PCLK_TCPWM1_CLOCKS31, MCU_PCLK_TCPWM1_CLOCKS32, MCU_PCLK_TCPWM1_CLOCKS33, MCU_PCLK_TCPWM1_CLOCKS34, MCU_PCLK_TCPWM1_CLOCKS35, MCU_PCLK_TCPWM1_CLOCKS36, MCU_PCLK_TCPWM1_CLOCKS37, MCU_PCLK_TCPWM1_CLOCKS38, MCU_PCLK_TCPWM1_CLOCKS39, MCU_PCLK_TCPWM1_CLOCKS40, MCU_PCLK_TCPWM1_CLOCKS41, MCU_PCLK_TCPWM1_CLOCKS42, MCU_PCLK_TCPWM1_CLOCKS43, MCU_PCLK_TCPWM1_CLOCKS44, MCU_PCLK_TCPWM1_CLOCKS45, MCU_PCLK_TCPWM1_CLOCKS46, MCU_PCLK_TCPWM1_CLOCKS47, MCU_PCLK_TCPWM1_CLOCKS48, MCU_PCLK_TCPWM1_CLOCKS49, MCU_PCLK_TCPWM1_CLOCKS50, MCU_PCLK_TCPWM1_CLOCKS51, MCU_PCLK_TCPWM1_CLOCKS52, MCU_PCLK_TCPWM1_CLOCKS53, MCU_PCLK_TCPWM1_CLOCKS54, MCU_PCLK_TCPWM1_CLOCKS55, MCU_PCLK_TCPWM1_CLOCKS56, MCU_PCLK_TCPWM1_CLOCKS57, MCU_PCLK_TCPWM1_CLOCKS58, MCU_PCLK_TCPWM1_CLOCKS59, MCU_PCLK_TCPWM1_CLOCKS60, MCU_PCLK_TCPWM1_CLOCKS61, MCU_PCLK_TCPWM1_CLOCKS62, MCU_PCLK_TCPWM1_CLOCKS63, MCU_PCLK_TCPWM1_CLOCKS64, MCU_PCLK_TCPWM1_CLOCKS65, MCU_PCLK_TCPWM1_CLOCKS66, MCU_PCLK_TCPWM1_CLOCKS67, MCU_PCLK_TCPWM1_CLOCKS68, MCU_PCLK_TCPWM1_CLOCKS69, MCU_PCLK_TCPWM1_CLOCKS70, MCU_PCLK_TCPWM1_CLOCKS71, MCU_PCLK_TCPWM1_CLOCKS72, MCU_PCLK_TCPWM1_CLOCKS73, MCU_PCLK_TCPWM1_CLOCKS74, MCU_PCLK_TCPWM1_CLOCKS75, MCU_PCLK_TCPWM1_CLOCKS76, MCU_PCLK_TCPWM1_CLOCKS77, MCU_PCLK_TCPWM1_CLOCKS78, MCU_PCLK_TCPWM1_CLOCKS79, MCU_PCLK_TCPWM1_CLOCKS80, MCU_PCLK_TCPWM1_CLOCKS81, MCU_PCLK_TCPWM1_CLOCKS82, MCU_PCLK_TCPWM1_CLOCKS83, MCU_PCLK_TCPWM1_CLOCKS256, MCU_PCLK_TCPWM1_CLOCKS257, MCU_PCLK_TCPWM1_CLOCKS258, MCU_PCLK_TCPWM1_CLOCKS259, MCU_PCLK_TCPWM1_CLOCKS260, MCU_PCLK_TCPWM1_CLOCKS261, MCU_PCLK_TCPWM1_CLOCKS262, MCU_PCLK_TCPWM1_CLOCKS263, MCU_PCLK_TCPWM1_CLOCKS264, MCU_PCLK_TCPWM1_CLOCKS265, MCU_PCLK_TCPWM1_CLOCKS266, MCU_PCLK_TCPWM1_CLOCKS267, MCU_PCLK_TCPWM1_CLOCKS512, MCU_PCLK_TCPWM1_CLOCKS513, MCU_PCLK_TCPWM1_CLOCKS514, MCU_PCLK_TCPWM1_CLOCKS515, MCU_PCLK_TCPWM1_CLOCKS516, MCU_PCLK_TCPWM1_CLOCKS517, MCU_PCLK_TCPWM1_CLOCKS518, MCU_PCLK_TCPWM1_CLOCKS519, MCU_PCLK_TCPWM1_CLOCKS520, MCU_PCLK_TCPWM1_CLOCKS521, MCU_PCLK_TCPWM1_CLOCKS522, MCU_PCLK_TCPWM1_CLOCKS523, MCU_PCLK_TCPWM1_CLOCKS524}, origin=Cypress, post-build-variant-value=true, set at post-build, default-value=MCU_PCLK_CPUSS_CLOCK_TRACE_IN  # This parameter is used to specify the pclk clock.
              boolean McuPclkEnable: origin=Cypress, post-build-variant-value=true, set at post-build, default-value=true  # This parameter is used to enable the current pclk clock.
              float McuPclkFrequency: 0.0..1.0E8, origin=Cypress, post-build-variant-value=true, set at post-build, default-value=5.0E7  # This parameter shows the current pclk clock frequency in Hz.
              reference McuPclkDividerRef: origin=Cypress, post-build-variant-value=true, set at post-build, destination=McuPclkDividerSettings  # This parameter refers to the pclk divider configuration, which is set in the McuPclkDividerSettings.
          container McuPeriGroupSettings [0..*]: multiplicity set at post-build, post-build-variant-multiplicity=true  # This container contains the configurations for the peripheral group setting.
            enumeration McuPeriGroup: {MCU_PERI_GROUP0_MMIO0, MCU_PERI_GROUP1_MMIO1, MCU_PERI_GROUP2_MMIO2, MCU_PERI_GROUP3_MMIO3, MCU_PERI_GROUP4_MMIO4, MCU_PERI_GROUP5_MMIO5, MCU_PERI_GROUP6_MMIO6, MCU_PERI_GROUP7_MMIO7, MCU_PERI_GROUP8_MMIO8, MCU_PERI_GROUP9_MMIO9, MCU_PERI_GROUP10_MMIO10, MCU_PERI_GROUP11_MMIO11, MCU_PERI_GROUP12_MMIO12, MCU_PERI_GROUP13_MMIO13, MCU_PERI_GROUP14_MMIO14, MCU_PERI_GROUP15_MMIO15}, origin=Cypress, post-build-variant-value=true, set at post-build, default-value=MCU_PERI_GROUP0_MMIO0  # This parameter is used to specify the peripheral group.
            float McuPeriGroupClockFrequency: 0.0..1.0E8, origin=Cypress, post-build-variant-value=true, set at post-build, default-value=5.0E7  # This parameter shows the current peripheral group frequency in Hz.
            integer McuPeriGroupClockDivision [0..1]: 1..256, multiplicity set at post-build, origin=Cypress, post-build-variant-multiplicity=true, post-build-variant-value=true, set at post-build, default-value=1  # This parameter is used to specify the division value of the current peripheral group clock.
            container McuPeriGroupSlaveSettings [0..*]: multiplicity set at post-build, post-build-variant-multiplicity=true  # This container contains the configurations for the slave settings of the peripheral group.
              enumeration McuPeriGroupSlaveName: {MCU_PERI_GROUP0_SLAVE0_PERI, MCU_PERI_GROUP0_SLAVE1_PERI_MS, MCU_PERI_GROUP0_SLAVE2_PERI_PCLK, MCU_PERI_GROUP1_SLAVE0_CRYPTO, MCU_PERI_GROUP2_SLAVE0_CPUSS, MCU_PERI_GROUP2_SLAVE1_FAULT, MCU_PERI_GROUP2_SLAVE2_IPC, MCU_PERI_GROUP2_SLAVE3_PROT, MCU_PERI_GROUP2_SLAVE4_FLASHC, MCU_PERI_GROUP2_SLAVE5_SRSS, MCU_PERI_GROUP2_SLAVE6_BACKUP, MCU_PERI_GROUP2_SLAVE7_DW0, MCU_PERI_GROUP2_SLAVE8_DW1, MCU_PERI_GROUP2_SLAVE9_DMAC, MCU_PERI_GROUP2_SLAVE10_EFUSE, MCU_PERI_GROUP2_SLAVE10_AXI_DMAC, MCU_PERI_GROUP2_SLAVE11_DFT, MCU_PERI_GROUP2_SLAVE11_EFUSE, MCU_PERI_GROUP2_SLAVE12_DFT, MCU_PERI_GROUP3_SLAVE0_HSIOM, MCU_PERI_GROUP3_SLAVE1_GPIO, MCU_PERI_GROUP3_SLAVE2_SMARTIO, MCU_PERI_GROUP3_SLAVE3_TCPWM, MCU_PERI_GROUP3_SLAVE3_EVTGEN, MCU_PERI_GROUP3_SLAVE4_EVTGEN, MCU_PERI_GROUP3_SLAVE4_LCD, MCU_PERI_GROUP3_SLAVE5_EVTGEN, MCU_PERI_GROUP4_SLAVE0_SMIF, MCU_PERI_GROUP4_SLAVE0_SMIF0, MCU_PERI_GROUP4_SLAVE1_SMIF1, MCU_PERI_GROUP4_SLAVE1_SDHC, MCU_PERI_GROUP4_SLAVE1_ETH, MCU_PERI_GROUP4_SLAVE2_ETH, MCU_PERI_GROUP4_SLAVE2_ETH0, MCU_PERI_GROUP4_SLAVE3_ETH1, MCU_PERI_GROUP4_SLAVE3_LPDDR4, MCU_PERI_GROUP5_SLAVE0_LIN, MCU_PERI_GROUP5_SLAVE1_CXPI, MCU_PERI_GROUP5_SLAVE1_CANFD0, MCU_PERI_GROUP5_SLAVE2_CANFD0, MCU_PERI_GROUP5_SLAVE2_CANFD1, MCU_PERI_GROUP5_SLAVE3_CANFD1, MCU_PERI_GROUP5_SLAVE3_FLEXRAY, MCU_PERI_GROUP5_SLAVE3_TCPWM, MCU_PERI_GROUP5_SLAVE4_TCPWM, MCU_PERI_GROUP6_SLAVE0_SCB0, MCU_PERI_GROUP6_SLAVE1_SCB1, MCU_PERI_GROUP6_SLAVE2_SCB2, MCU_PERI_GROUP6_SLAVE3_SCB3, MCU_PERI_GROUP6_SLAVE4_SCB4, MCU_PERI_GROUP6_SLAVE5_SCB5, MCU_PERI_GROUP6_SLAVE6_SCB6, MCU_PERI_GROUP6_SLAVE7_SCB7, MCU_PERI_GROUP6_SLAVE8_SCB8, MCU_PERI_GROUP6_SLAVE9_SCB9, MCU_PERI_GROUP6_SLAVE10_SCB10, MCU_PERI_GROUP6_SLAVE11_SCB11, MCU_PERI_GROUP8_SLAVE0_I2S, MCU_PERI_GROUP8_SLAVE0_I2S0, MCU_PERI_GROUP8_SLAVE0_TDM, MCU_PERI_GROUP8_SLAVE1_TDM, MCU_PERI_GROUP8_SLAVE1_I2S1, MCU_PERI_GROUP8_SLAVE1_SG, MCU_PERI_GROUP8_SLAVE2_PWM, MCU_PERI_GROUP8_SLAVE2_SG, MCU_PERI_GROUP8_SLAVE2_I2S2, MCU_PERI_GROUP8_SLAVE3_DAC, MCU_PERI_GROUP8_SLAVE3_PWM, MCU_PERI_GROUP8_SLAVE3_MIXER, MCU_PERI_GROUP8_SLAVE4_DAC, MCU_PERI_GROUP8_SLAVE4_MIXER0, MCU_PERI_GROUP8_SLAVE5_MIXER0, MCU_PERI_GROUP8_SLAVE5_MIXER1, MCU_PERI_GROUP8_SLAVE6_MIXER1, MCU_PERI_GROUP9_SLAVE0_PASS, MCU_PERI_GROUP10_SLAVE0_VIDEOSS, MCU_PERI_GROUP10_SLAVE0_VIDEOSS_IP, MCU_PERI_GROUP10_SLAVE1_VIDEOSS_PD, MCU_PERI_GROUP10_SLAVE2_JPEGDEC, MCU_PERI_GROUP10_SLAVE2_VIDEOSS_JPEGDEC}, origin=Cypress, post-build-variant-value=true, set at post-build, default-value=MCU_PERI_GROUP0_SLAVE0_PERI  # This parameter is used to specify the slave of the peripheral group.
              boolean McuPeriGroupSlaveEnable: origin=Cypress, post-build-variant-value=true, set at post-build, default-value=true  # This parameter is used to enable the slave clock of the peripheral group.
          container McuLfClockSettings  # This container contains the configurations for the low frequency clock setting.
            float McuLfClockFrequency: 0.0..35061.76, origin=Cypress, post-build-variant-value=true, set at post-build, default-value=32768.0  # This parameter shows the LFCLK clock frequency in Hz.
            enumeration McuLfClockSource: {MCU_CLOCK_ILO0, MCU_CLOCK_ILO1, MCU_CLOCK_ECO_PRESCALE, MCU_CLOCK_WCO, MCU_CLOCK_ALTLF, MCU_CLOCK_LPECO_PRESCALE}, origin=Cypress, post-build-variant-value=true, set at post-build, default-value=MCU_CLOCK_ILO0  # This parameter is used to specify the source clock of the LFCLK clock.
          container McuPumpClockSettings [0..0]  # This container contains the configurations for the pump clock setting.
            boolean McuPumpClockEnable: origin=Cypress, post-build-variant-value=true, set at post-build, default-value=false  # This parameter is used to enable the pump clock.
            boolean McuPumpClockStopForUpdate: origin=Cypress, post-build-variant-value=true, set at post-build, default-value=false  # This parameter is used to enable the stop which is performed before update pump clock settings when pump clock is running.
            float McuPumpClockFrequency: 0.0..4.0E8, origin=Cypress, post-build-variant-value=true, set at post-build, default-value=1.0E8  # This parameter shows the pump clock frequency in Hz.
            enumeration McuPumpClockSource: {MCU_CLOCK_FLL, MCU_CLOCK_SSCG_PLL, MCU_CLOCK_PLL, MCU_CLOCK_PATH}, origin=Cypress, post-build-variant-value=true, set at post-build, default-value=MCU_CLOCK_FLL  # This parameter is used to specify the source clock of the pump clock.
            enumeration McuPumpClockDivision: {MCU_CLK_DIV_1, MCU_CLK_DIV_2, MCU_CLK_DIV_4, MCU_CLK_DIV_8, MCU_CLK_DIV_16}, origin=Cypress, post-build-variant-value=true, set at post-build, default-value=MCU_CLK_DIV_1  # This parameter is used to specify the division value of the pump clock.
            reference McuPumpClockSscgPllRef [0..1]: multiplicity set at post-build, origin=Cypress, post-build-variant-multiplicity=true, post-build-variant-value=true, set at post-build, destination=McuSscgPllSettings  # This parameter refers to the SSCG PLL clock configuration, which is set in the McuSscgPllSettings when the source clock is set to SSCG PLL.
            reference McuPumpClockPllRef [0..1]: multiplicity set at post-build, origin=Cypress, post-build-variant-multiplicity=true, post-build-variant-value=true, set at post-build, destination=McuPllSettings  # This parameter refers to the PLL clock configuration which is set in the McuPllSettings when the source clock is set to PLL.
            reference McuPumpClockPathRef [0..1]: multiplicity set at post-build, origin=Cypress, post-build-variant-multiplicity=true, post-build-variant-value=true, set at post-build, destination=McuClockPathSettings  # This parameter refers to the clock path configuration which is set in the McuClockPathSettings when the source clock is set to clock path.
          container McuTimerClockSettings [0..1]: multiplicity set at post-build, post-build-variant-multiplicity=true  # This container contains the configurations for the timer clock setting.
            boolean McuTimerClockEnable: origin=Cypress, post-build-variant-value=true, set at post-build, default-value=false  # This parameter is used to enable the timer clock.
            boolean McuTimerClockStopForUpdate: origin=Cypress, post-build-variant-value=true, set at post-build, default-value=false  # This parameter is used to enable the stop which is performed before update timer clock settings when timer clock is running.
            float McuTimerClockFrequency: 0.0..4.0E8, origin=Cypress, post-build-variant-value=true, set at post-build, default-value=8000000.0  # This parameter shows the timer clock frequency in Hz.
            enumeration McuTimerClockSource: {MCU_CLOCK_IMO, MCU_CLOCK_HF0DIV}, origin=Cypress, post-build-variant-value=true, set at post-build, default-value=MCU_CLOCK_IMO  # This parameter is used to specify the source clock of the timer clock.
            enumeration McuTimerClockInputDivision: {MCU_CLK_DIV_1, MCU_CLK_DIV_2, MCU_CLK_DIV_4, MCU_CLK_DIV_8}, origin=Cypress, post-build-variant-value=true, set at post-build, default-value=MCU_CLK_DIV_1  # This parameter is used to specify the division value of the source clock of the timer clock.
            integer McuTimerClockDivision: 1..256, origin=Cypress, post-build-variant-value=true, set at post-build, default-value=8  # This parameter is used to specify the division value of the timer clock.
          container McuClockOutputSettings [0..1]: multiplicity set at post-build, post-build-variant-multiplicity=true  # This container contains the configurations for the clock output setting.
            boolean McuClockOutput0Enable: origin=Cypress, post-build-variant-value=true, set at post-build, default-value=false  # This parameter is used to enable the clock output 0. Because the clock output function enabled by McuClockOutput0Enable is for testing purposes only, McuClockOutput0Enable must not be set true for production.
            float McuClockOutput0Frequency: 0.0..4.0E8, origin=Cypress, post-build-variant-value=true, set at post-build, default-value=0.0  # This parameter shows the clock output 0 frequency in Hz.
            enumeration McuClockOutput0Source: {MCU_CLOCK_LOW, MCU_CLOCK_ECO, MCU_CLOCK_ECO_PRESCALE, MCU_CLOCK_LPECO, MCU_CLOCK_LPECO_PRESCALE, MCU_CLOCK_EXTCLK, MCU_CLOCK_ALTHF, MCU_CLOCK_TIMER, MCU_CLOCK_FLL, MCU_CLOCK_SSCG_PLL0, MCU_CLOCK_SSCG_PLL1, MCU_CLOCK_SSCG_PLL2, MCU_CLOCK_SSCG_PLL3, MCU_CLOCK_SSCG_PLL4, MCU_CLOCK_SSCG_PLL5, MCU_CLOCK_SSCG_PLL6, MCU_CLOCK_SSCG_PLL7, MCU_CLOCK_SSCG_PLL8, MCU_CLOCK_SSCG_PLL9, MCU_CLOCK_SSCG_PLL10, MCU_CLOCK_SSCG_PLL11, MCU_CLOCK_SSCG_PLL12, MCU_CLOCK_SSCG_PLL13, MCU_CLOCK_SSCG_PLL14, MCU_CLOCK_PLL0, MCU_CLOCK_PLL1, MCU_CLOCK_PLL2, MCU_CLOCK_PLL3, MCU_CLOCK_PLL4, MCU_CLOCK_PLL5, MCU_CLOCK_PLL6, MCU_CLOCK_PLL7, MCU_CLOCK_PLL8, MCU_CLOCK_PLL9, MCU_CLOCK_PLL10, MCU_CLOCK_PLL11, MCU_CLOCK_PLL12, MCU_CLOCK_PLL13, MCU_CLOCK_PLL14, MCU_CLOCK_PATH0, MCU_CLOCK_PATH1, MCU_CLOCK_PATH2, MCU_CLOCK_PATH3, MCU_CLOCK_PATH4, MCU_CLOCK_PATH5, MCU_CLOCK_PATH6, MCU_CLOCK_PATH7, MCU_CLOCK_PATH8, MCU_CLOCK_PATH9, MCU_CLOCK_PATH10, MCU_CLOCK_PATH11, MCU_CLOCK_PATH12, MCU_CLOCK_PATH13, MCU_CLOCK_PATH14, MCU_CLOCK_PATH15, MCU_CLOCK_ROOT0, MCU_CLOCK_ROOT1, MCU_CLOCK_ROOT2, MCU_CLOCK_ROOT3, MCU_CLOCK_ROOT4, MCU_CLOCK_ROOT5, MCU_CLOCK_ROOT6, MCU_CLOCK_ROOT7, MCU_CLOCK_ROOT8, MCU_CLOCK_ROOT9, MCU_CLOCK_ROOT10, MCU_CLOCK_ROOT11, MCU_CLOCK_ROOT12, MCU_CLOCK_ROOT13, MCU_CLOCK_ROOT14, MCU_CLOCK_ROOT15, MCU_CLOCK_ILO0, MCU_CLOCK_ILO1, MCU_CLOCK_WCO, MCU_CLOCK_BACKUP, MCU_CLOCK_ALTLF, MCU_CLOCK_LF, MCU_CLOCK_IMO, MCU_CLOCK_SLEEP_CONTROLLER}, origin=Cypress, post-build-variant-value=true, set at post-build, default-value=MCU_CLOCK_LOW  # This parameter is used to specify the source clock of the clock output 0.
            enumeration McuClockOutput0Division: {MCU_CLK_DIV_1, MCU_CLK_DIV_2, MCU_CLK_DIV_4, MCU_CLK_DIV_8}, origin=Cypress, post-build-variant-value=true, set at post-build, default-value=MCU_CLK_DIV_1  # This parameter is used to specify the division value of the clock output 0.
            boolean McuClockOutput1Enable: origin=Cypress, post-build-variant-value=true, set at post-build, default-value=false  # This parameter is used to enable the clock output 1. Because the clock output function enabled by McuClockOutput1Enable is for testing purposes only, McuClockOutput1Enable must not be set true for production.
            float McuClockOutput1Frequency: 0.0..4.0E8, origin=Cypress, post-build-variant-value=true, set at post-build, default-value=0.0  # This parameter shows the clock output 1 frequency in Hz.
            enumeration McuClockOutput1Source: {MCU_CLOCK_LOW, MCU_CLOCK_ECO, MCU_CLOCK_ECO_PRESCALE, MCU_CLOCK_LPECO, MCU_CLOCK_LPECO_PRESCALE, MCU_CLOCK_EXTCLK, MCU_CLOCK_ALTHF, MCU_CLOCK_TIMER, MCU_CLOCK_FLL, MCU_CLOCK_SSCG_PLL0, MCU_CLOCK_SSCG_PLL1, MCU_CLOCK_SSCG_PLL2, MCU_CLOCK_SSCG_PLL3, MCU_CLOCK_SSCG_PLL4, MCU_CLOCK_SSCG_PLL5, MCU_CLOCK_SSCG_PLL6, MCU_CLOCK_SSCG_PLL7, MCU_CLOCK_SSCG_PLL8, MCU_CLOCK_SSCG_PLL9, MCU_CLOCK_SSCG_PLL10, MCU_CLOCK_SSCG_PLL11, MCU_CLOCK_SSCG_PLL12, MCU_CLOCK_SSCG_PLL13, MCU_CLOCK_SSCG_PLL14, MCU_CLOCK_PLL0, MCU_CLOCK_PLL1, MCU_CLOCK_PLL2, MCU_CLOCK_PLL3, MCU_CLOCK_PLL4, MCU_CLOCK_PLL5, MCU_CLOCK_PLL6, MCU_CLOCK_PLL7, MCU_CLOCK_PLL8, MCU_CLOCK_PLL9, MCU_CLOCK_PLL10, MCU_CLOCK_PLL11, MCU_CLOCK_PLL12, MCU_CLOCK_PLL13, MCU_CLOCK_PLL14, MCU_CLOCK_PATH0, MCU_CLOCK_PATH1, MCU_CLOCK_PATH2, MCU_CLOCK_PATH3, MCU_CLOCK_PATH4, MCU_CLOCK_PATH5, MCU_CLOCK_PATH6, MCU_CLOCK_PATH7, MCU_CLOCK_PATH8, MCU_CLOCK_PATH9, MCU_CLOCK_PATH10, MCU_CLOCK_PATH11, MCU_CLOCK_PATH12, MCU_CLOCK_PATH13, MCU_CLOCK_PATH14, MCU_CLOCK_PATH15, MCU_CLOCK_ROOT0, MCU_CLOCK_ROOT1, MCU_CLOCK_ROOT2, MCU_CLOCK_ROOT3, MCU_CLOCK_ROOT4, MCU_CLOCK_ROOT5, MCU_CLOCK_ROOT6, MCU_CLOCK_ROOT7, MCU_CLOCK_ROOT8, MCU_CLOCK_ROOT9, MCU_CLOCK_ROOT10, MCU_CLOCK_ROOT11, MCU_CLOCK_ROOT12, MCU_CLOCK_ROOT13, MCU_CLOCK_ROOT14, MCU_CLOCK_ROOT15, MCU_CLOCK_ILO0, MCU_CLOCK_ILO1, MCU_CLOCK_WCO, MCU_CLOCK_BACKUP, MCU_CLOCK_ALTLF, MCU_CLOCK_LF, MCU_CLOCK_IMO, MCU_CLOCK_SLEEP_CONTROLLER}, origin=Cypress, post-build-variant-value=true, set at post-build, default-value=MCU_CLOCK_LOW  # This parameter is used to specify the source clock of the clock output 1.
            enumeration McuClockOutput1Division: {MCU_CLK_DIV_1, MCU_CLK_DIV_2, MCU_CLK_DIV_4, MCU_CLK_DIV_8}, origin=Cypress, post-build-variant-value=true, set at post-build, default-value=MCU_CLK_DIV_1  # This parameter is used to specify the division value of the clock output 1.
          container McuCsvSettings [0..*]: multiplicity set at post-build, post-build-variant-multiplicity=true  # This container contains the configurations for the clock supervisor setting.
            enumeration McuCsvClock: {MCU_CLOCK_CSVREF, MCU_CLOCK_LF, MCU_CLOCK_ILO0, MCU_CLOCK_BACKUP, MCU_CLOCK_ROOT0, MCU_CLOCK_ROOT1, MCU_CLOCK_ROOT2, MCU_CLOCK_ROOT3, MCU_CLOCK_ROOT4, MCU_CLOCK_ROOT5, MCU_CLOCK_ROOT6, MCU_CLOCK_ROOT7, MCU_CLOCK_ROOT8, MCU_CLOCK_ROOT9, MCU_CLOCK_ROOT10, MCU_CLOCK_ROOT11, MCU_CLOCK_ROOT12, MCU_CLOCK_ROOT13, MCU_CLOCK_ROOT14, MCU_CLOCK_ROOT15}, origin=Cypress, post-build-variant-value=true, set at post-build, default-value=MCU_CLOCK_CSVREF  # This parameter is used to specify the monitoring clock of the clock supervisor.
            boolean McuCsvEnable: origin=Cypress, post-build-variant-value=true, set at post-build, default-value=true  # This parameter is used to enable the clock supervisor.
            integer McuCsvPeriod: 1..65536, origin=Cypress, post-build-variant-value=true, set at post-build, default-value=1  # This parameter is used to specify the number of monitored clock cycles within a period.
            integer McuCsvStartupDelay: 1..65536, origin=Cypress, post-build-variant-value=true, set at post-build, default-value=1  # This parameter is used to specify the startup delay of the clock supervisor in reference clock cycles.
            integer McuCsvLowerLimit: 1..65536, origin=Cypress, post-build-variant-value=true, set at post-build, default-value=1  # This parameter is used to specify the lower limit of the clock supervisor in reference clock cycles.
            integer McuCsvUpperLimit: 1..65536, origin=Cypress, post-build-variant-value=true, set at post-build, default-value=1  # This parameter is used to specify the upper limit of the clock supervisor in reference clock cycles.
            enumeration McuCsvAction [0..1]: {MCU_CSV_ACTION_FAULT, MCU_CSV_ACTION_RESET}, multiplicity set at post-build, origin=Cypress, post-build-variant-multiplicity=true, post-build-variant-value=true, set at post-build, default-value=MCU_CSV_ACTION_FAULT  # This parameter is used to specify the clock supervisor detection action.
        container McuClockReferencePoint [1..*]: multiplicity set at post-build, post-build-variant-multiplicity=true  # This container defines a reference point in the Mcu Clock tree. It defines the frequency which then can be used by other modules as an input value. Lower multiplicity is 1, as even in the simplest case (only one frequency is used), there is one frequency to be defined.
          enumeration McuClock: {MCU_CLOCK_IMO, MCU_CLOCK_ECO, MCU_CLOCK_ECO_PRESCALE, MCU_CLOCK_LPECO, MCU_CLOCK_LPECO_PRESCALE, MCU_CLOCK_EXTCLK, MCU_CLOCK_ILO0, MCU_CLOCK_ILO1, MCU_CLOCK_WCO, MCU_CLOCK_ALTHF, MCU_CLOCK_ALTLF, MCU_CLOCK_DSI0, MCU_CLOCK_DSI1, MCU_CLOCK_DSI2, MCU_CLOCK_DSI3, MCU_CLOCK_DSI4, MCU_CLOCK_DSI5, MCU_CLOCK_DSI6, MCU_CLOCK_DSI7, MCU_CLOCK_DSI8, MCU_CLOCK_DSI9, MCU_CLOCK_DSI10, MCU_CLOCK_DSI11, MCU_CLOCK_DSI12, MCU_CLOCK_DSI13, MCU_CLOCK_DSI14, MCU_CLOCK_DSI15, MCU_CLOCK_FLL, MCU_CLOCK_SSCG_PLL0, MCU_CLOCK_SSCG_PLL1, MCU_CLOCK_SSCG_PLL2, MCU_CLOCK_SSCG_PLL3, MCU_CLOCK_SSCG_PLL4, MCU_CLOCK_SSCG_PLL5, MCU_CLOCK_SSCG_PLL6, MCU_CLOCK_SSCG_PLL7, MCU_CLOCK_SSCG_PLL8, MCU_CLOCK_SSCG_PLL9, MCU_CLOCK_SSCG_PLL10, MCU_CLOCK_SSCG_PLL11, MCU_CLOCK_SSCG_PLL12, MCU_CLOCK_SSCG_PLL13, MCU_CLOCK_SSCG_PLL14, MCU_CLOCK_PLL0, MCU_CLOCK_PLL1, MCU_CLOCK_PLL2, MCU_CLOCK_PLL3, MCU_CLOCK_PLL4, MCU_CLOCK_PLL5, MCU_CLOCK_PLL6, MCU_CLOCK_PLL7, MCU_CLOCK_PLL8, MCU_CLOCK_PLL9, MCU_CLOCK_PLL10, MCU_CLOCK_PLL11, MCU_CLOCK_PLL12, MCU_CLOCK_PLL13, MCU_CLOCK_PLL14, MCU_CLOCK_PATH0, MCU_CLOCK_PATH1, MCU_CLOCK_PATH2, MCU_CLOCK_PATH3, MCU_CLOCK_PATH4, MCU_CLOCK_PATH5, MCU_CLOCK_PATH6, MCU_CLOCK_PATH7, MCU_CLOCK_PATH8, MCU_CLOCK_PATH9, MCU_CLOCK_PATH10, MCU_CLOCK_PATH11, MCU_CLOCK_PATH12, MCU_CLOCK_PATH13, MCU_CLOCK_PATH14, MCU_CLOCK_PATH15, MCU_CLOCK_ROOT0, MCU_CLOCK_ROOT1, MCU_CLOCK_ROOT2, MCU_CLOCK_ROOT3, MCU_CLOCK_ROOT4, MCU_CLOCK_ROOT5, MCU_CLOCK_ROOT6, MCU_CLOCK_ROOT7, MCU_CLOCK_ROOT8, MCU_CLOCK_ROOT9, MCU_CLOCK_ROOT10, MCU_CLOCK_ROOT11, MCU_CLOCK_ROOT12, MCU_CLOCK_ROOT13, MCU_CLOCK_ROOT14, MCU_CLOCK_ROOT15, MCU_PERI_GROUP0_MMIO0, MCU_PERI_GROUP1_MMIO1, MCU_PERI_GROUP2_MMIO2, MCU_PERI_GROUP3_MMIO3, MCU_PERI_GROUP4_MMIO4, MCU_PERI_GROUP5_MMIO5, MCU_PERI_GROUP6_MMIO6, MCU_PERI_GROUP7_MMIO7, MCU_PERI_GROUP8_MMIO8, MCU_PERI_GROUP9_MMIO9, MCU_PERI_GROUP10_MMIO10, MCU_PERI_GROUP11_MMIO11, MCU_PERI_GROUP12_MMIO12, MCU_PERI_GROUP13_MMIO13, MCU_PERI_GROUP14_MMIO14, MCU_PERI_GROUP15_MMIO15, MCU_CLOCK_LF, MCU_CLOCK_PUMPCLK, MCU_CLOCK_TIMER, MCU_CLOCK_BACKUP, MCU_CLOCK_FAST0, MCU_CLOCK_FAST1, MCU_CLOCK_MEM, MCU_CLOCK_TRC_DBG, MCU_CLOCK_SLOW, MCU_CLOCK_PERI, MCU_CLOCK_OUTPUT0, MCU_CLOCK_OUTPUT1, MCU_CLOCK_SLEEP_CONTROLLER, MCU_PCLK_CPUSS_CLOCK_TRACE_IN, MCU_PCLK_CXPI0_CLOCK_CH_EN0, MCU_PCLK_CXPI0_CLOCK_CH_EN1, MCU_PCLK_CXPI0_CLOCK_CH_EN2, MCU_PCLK_CXPI0_CLOCK_CH_EN3, MCU_PCLK_SMARTIO7_CLOCK, MCU_PCLK_SMARTIO8_CLOCK, MCU_PCLK_SMARTIO9_CLOCK, MCU_PCLK_SMARTIO12_CLOCK, MCU_PCLK_SMARTIO13_CLOCK, MCU_PCLK_SMARTIO14_CLOCK, MCU_PCLK_SMARTIO15_CLOCK, MCU_PCLK_SMARTIO17_CLOCK, MCU_PCLK_CANFD0_CLOCK_CAN0, MCU_PCLK_CANFD0_CLOCK_CAN1, MCU_PCLK_CANFD0_CLOCK_CAN2, MCU_PCLK_CANFD0_CLOCK_CAN3, MCU_PCLK_CANFD0_CLOCK_CAN4, MCU_PCLK_CANFD1_CLOCK_CAN0, MCU_PCLK_CANFD1_CLOCK_CAN1, MCU_PCLK_CANFD1_CLOCK_CAN2, MCU_PCLK_CANFD1_CLOCK_CAN3, MCU_PCLK_CANFD1_CLOCK_CAN4, MCU_PCLK_LCD0_CLOCK, MCU_PCLK_LIN0_CLOCK_CH_EN0, MCU_PCLK_LIN0_CLOCK_CH_EN1, MCU_PCLK_LIN0_CLOCK_CH_EN2, MCU_PCLK_LIN0_CLOCK_CH_EN3, MCU_PCLK_LIN0_CLOCK_CH_EN4, MCU_PCLK_LIN0_CLOCK_CH_EN5, MCU_PCLK_LIN0_CLOCK_CH_EN6, MCU_PCLK_LIN0_CLOCK_CH_EN7, MCU_PCLK_LIN0_CLOCK_CH_EN8, MCU_PCLK_LIN0_CLOCK_CH_EN9, MCU_PCLK_LIN0_CLOCK_CH_EN10, MCU_PCLK_LIN0_CLOCK_CH_EN11, MCU_PCLK_LIN0_CLOCK_CH_EN12, MCU_PCLK_LIN0_CLOCK_CH_EN13, MCU_PCLK_LIN0_CLOCK_CH_EN14, MCU_PCLK_LIN0_CLOCK_CH_EN15, MCU_PCLK_LIN0_CLOCK_CH_EN16, MCU_PCLK_LIN0_CLOCK_CH_EN17, MCU_PCLK_LIN0_CLOCK_CH_EN18, MCU_PCLK_LIN0_CLOCK_CH_EN19, MCU_PCLK_SCB0_CLOCK, MCU_PCLK_SCB1_CLOCK, MCU_PCLK_SCB2_CLOCK, MCU_PCLK_SCB3_CLOCK, MCU_PCLK_SCB4_CLOCK, MCU_PCLK_SCB5_CLOCK, MCU_PCLK_SCB6_CLOCK, MCU_PCLK_SCB7_CLOCK, MCU_PCLK_SCB8_CLOCK, MCU_PCLK_SCB9_CLOCK, MCU_PCLK_SCB10_CLOCK, MCU_PCLK_SCB11_CLOCK, MCU_PCLK_FLEXRAY0_CLK_FLEXRAY, MCU_PCLK_PASS0_CLOCK_SAR0, MCU_PCLK_PASS0_CLOCK_SAR1, MCU_PCLK_PASS0_CLOCK_SAR2, MCU_PCLK_TCPWM0_CLOCKS0, MCU_PCLK_TCPWM0_CLOCKS1, MCU_PCLK_TCPWM0_CLOCKS2, MCU_PCLK_TCPWM0_CLOCKS3, MCU_PCLK_TCPWM0_CLOCKS4, MCU_PCLK_TCPWM0_CLOCKS5, MCU_PCLK_TCPWM0_CLOCKS6, MCU_PCLK_TCPWM0_CLOCKS7, MCU_PCLK_TCPWM0_CLOCKS8, MCU_PCLK_TCPWM0_CLOCKS9, MCU_PCLK_TCPWM0_CLOCKS10, MCU_PCLK_TCPWM0_CLOCKS11, MCU_PCLK_TCPWM0_CLOCKS12, MCU_PCLK_TCPWM0_CLOCKS13, MCU_PCLK_TCPWM0_CLOCKS14, MCU_PCLK_TCPWM0_CLOCKS15, MCU_PCLK_TCPWM0_CLOCKS16, MCU_PCLK_TCPWM0_CLOCKS17, MCU_PCLK_TCPWM0_CLOCKS18, MCU_PCLK_TCPWM0_CLOCKS19, MCU_PCLK_TCPWM0_CLOCKS20, MCU_PCLK_TCPWM0_CLOCKS21, MCU_PCLK_TCPWM0_CLOCKS22, MCU_PCLK_TCPWM0_CLOCKS23, MCU_PCLK_TCPWM0_CLOCKS24, MCU_PCLK_TCPWM0_CLOCKS25, MCU_PCLK_TCPWM0_CLOCKS26, MCU_PCLK_TCPWM0_CLOCKS27, MCU_PCLK_TCPWM0_CLOCKS28, MCU_PCLK_TCPWM0_CLOCKS29, MCU_PCLK_TCPWM0_CLOCKS30, MCU_PCLK_TCPWM0_CLOCKS31, MCU_PCLK_TCPWM0_CLOCKS32, MCU_PCLK_TCPWM0_CLOCKS33, MCU_PCLK_TCPWM0_CLOCKS34, MCU_PCLK_TCPWM0_CLOCKS35, MCU_PCLK_TCPWM0_CLOCKS36, MCU_PCLK_TCPWM0_CLOCKS37, MCU_PCLK_TCPWM0_CLOCKS38, MCU_PCLK_TCPWM0_CLOCKS39, MCU_PCLK_TCPWM0_CLOCKS40, MCU_PCLK_TCPWM0_CLOCKS41, MCU_PCLK_TCPWM0_CLOCKS42, MCU_PCLK_TCPWM0_CLOCKS43, MCU_PCLK_TCPWM0_CLOCKS44, MCU_PCLK_TCPWM0_CLOCKS45, MCU_PCLK_TCPWM0_CLOCKS46, MCU_PCLK_TCPWM0_CLOCKS47, MCU_PCLK_TCPWM0_CLOCKS48, MCU_PCLK_TCPWM0_CLOCKS49, MCU_PCLK_TCPWM0_CLOCKS50, MCU_PCLK_TCPWM0_CLOCKS51, MCU_PCLK_TCPWM0_CLOCKS52, MCU_PCLK_TCPWM0_CLOCKS53, MCU_PCLK_TCPWM0_CLOCKS54, MCU_PCLK_TCPWM0_CLOCKS55, MCU_PCLK_TCPWM0_CLOCKS56, MCU_PCLK_TCPWM0_CLOCKS57, MCU_PCLK_TCPWM0_CLOCKS58, MCU_PCLK_TCPWM0_CLOCKS59, MCU_PCLK_TCPWM0_CLOCKS60, MCU_PCLK_TCPWM0_CLOCKS61, MCU_PCLK_TCPWM0_CLOCKS62, MCU_PCLK_TCPWM0_CLOCKS256, MCU_PCLK_TCPWM0_CLOCKS257, MCU_PCLK_TCPWM0_CLOCKS258, MCU_PCLK_TCPWM0_CLOCKS259, MCU_PCLK_TCPWM0_CLOCKS260, MCU_PCLK_TCPWM0_CLOCKS261, MCU_PCLK_TCPWM0_CLOCKS262, MCU_PCLK_TCPWM0_CLOCKS263, MCU_PCLK_TCPWM0_CLOCKS264, MCU_PCLK_TCPWM0_CLOCKS265, MCU_PCLK_TCPWM0_CLOCKS266, MCU_PCLK_TCPWM0_CLOCKS267, MCU_PCLK_TCPWM0_CLOCKS512, MCU_PCLK_TCPWM0_CLOCKS513, MCU_PCLK_TCPWM0_CLOCKS514, MCU_PCLK_TCPWM0_CLOCKS515, MCU_PCLK_TCPWM0_CLOCKS516, MCU_PCLK_TCPWM0_CLOCKS517, MCU_PCLK_TCPWM0_CLOCKS518, MCU_PCLK_TCPWM0_CLOCKS519, MCU_PCLK_TCPWM0_CLOCKS520, MCU_PCLK_TCPWM0_CLOCKS521, MCU_PCLK_TCPWM0_CLOCKS522, MCU_PCLK_TCPWM0_CLOCKS523, MCU_PCLK_TCPWM0_CLOCKS524, MCU_PCLK_TCPWM0_CLOCKS525, MCU_PCLK_TCPWM0_CLOCKS526, MCU_PCLK_TCPWM0_CLOCKS527, MCU_PCLK_TCPWM0_CLOCKS528, MCU_PCLK_TCPWM0_CLOCKS529, MCU_PCLK_TCPWM0_CLOCKS530, MCU_PCLK_TCPWM0_CLOCKS531, MCU_PCLK_TCPWM0_CLOCKS532, MCU_PCLK_TCPWM0_CLOCKS533, MCU_PCLK_TCPWM0_CLOCKS534, MCU_PCLK_TCPWM0_CLOCKS535, MCU_PCLK_TCPWM0_CLOCKS536, MCU_PCLK_TCPWM0_CLOCKS537, MCU_PCLK_TCPWM0_CLOCKS538, MCU_PCLK_TCPWM0_CLOCKS539, MCU_PCLK_TCPWM0_CLOCKS540, MCU_PCLK_TCPWM0_CLOCKS541, MCU_PCLK_TCPWM0_CLOCKS542, MCU_PCLK_TCPWM0_CLOCKS543, MCU_PCLK_TCPWM1_CLOCKS0, MCU_PCLK_TCPWM1_CLOCKS1, MCU_PCLK_TCPWM1_CLOCKS2, MCU_PCLK_TCPWM1_CLOCKS3, MCU_PCLK_TCPWM1_CLOCKS4, MCU_PCLK_TCPWM1_CLOCKS5, MCU_PCLK_TCPWM1_CLOCKS6, MCU_PCLK_TCPWM1_CLOCKS7, MCU_PCLK_TCPWM1_CLOCKS8, MCU_PCLK_TCPWM1_CLOCKS9, MCU_PCLK_TCPWM1_CLOCKS10, MCU_PCLK_TCPWM1_CLOCKS11, MCU_PCLK_TCPWM1_CLOCKS12, MCU_PCLK_TCPWM1_CLOCKS13, MCU_PCLK_TCPWM1_CLOCKS14, MCU_PCLK_TCPWM1_CLOCKS15, MCU_PCLK_TCPWM1_CLOCKS16, MCU_PCLK_TCPWM1_CLOCKS17, MCU_PCLK_TCPWM1_CLOCKS18, MCU_PCLK_TCPWM1_CLOCKS19, MCU_PCLK_TCPWM1_CLOCKS20, MCU_PCLK_TCPWM1_CLOCKS21, MCU_PCLK_TCPWM1_CLOCKS22, MCU_PCLK_TCPWM1_CLOCKS23, MCU_PCLK_TCPWM1_CLOCKS24, MCU_PCLK_TCPWM1_CLOCKS25, MCU_PCLK_TCPWM1_CLOCKS26, MCU_PCLK_TCPWM1_CLOCKS27, MCU_PCLK_TCPWM1_CLOCKS28, MCU_PCLK_TCPWM1_CLOCKS29, MCU_PCLK_TCPWM1_CLOCKS30, MCU_PCLK_TCPWM1_CLOCKS31, MCU_PCLK_TCPWM1_CLOCKS32, MCU_PCLK_TCPWM1_CLOCKS33, MCU_PCLK_TCPWM1_CLOCKS34, MCU_PCLK_TCPWM1_CLOCKS35, MCU_PCLK_TCPWM1_CLOCKS36, MCU_PCLK_TCPWM1_CLOCKS37, MCU_PCLK_TCPWM1_CLOCKS38, MCU_PCLK_TCPWM1_CLOCKS39, MCU_PCLK_TCPWM1_CLOCKS40, MCU_PCLK_TCPWM1_CLOCKS41, MCU_PCLK_TCPWM1_CLOCKS42, MCU_PCLK_TCPWM1_CLOCKS43, MCU_PCLK_TCPWM1_CLOCKS44, MCU_PCLK_TCPWM1_CLOCKS45, MCU_PCLK_TCPWM1_CLOCKS46, MCU_PCLK_TCPWM1_CLOCKS47, MCU_PCLK_TCPWM1_CLOCKS48, MCU_PCLK_TCPWM1_CLOCKS49, MCU_PCLK_TCPWM1_CLOCKS50, MCU_PCLK_TCPWM1_CLOCKS51, MCU_PCLK_TCPWM1_CLOCKS52, MCU_PCLK_TCPWM1_CLOCKS53, MCU_PCLK_TCPWM1_CLOCKS54, MCU_PCLK_TCPWM1_CLOCKS55, MCU_PCLK_TCPWM1_CLOCKS56, MCU_PCLK_TCPWM1_CLOCKS57, MCU_PCLK_TCPWM1_CLOCKS58, MCU_PCLK_TCPWM1_CLOCKS59, MCU_PCLK_TCPWM1_CLOCKS60, MCU_PCLK_TCPWM1_CLOCKS61, MCU_PCLK_TCPWM1_CLOCKS62, MCU_PCLK_TCPWM1_CLOCKS63, MCU_PCLK_TCPWM1_CLOCKS64, MCU_PCLK_TCPWM1_CLOCKS65, MCU_PCLK_TCPWM1_CLOCKS66, MCU_PCLK_TCPWM1_CLOCKS67, MCU_PCLK_TCPWM1_CLOCKS68, MCU_PCLK_TCPWM1_CLOCKS69, MCU_PCLK_TCPWM1_CLOCKS70, MCU_PCLK_TCPWM1_CLOCKS71, MCU_PCLK_TCPWM1_CLOCKS72, MCU_PCLK_TCPWM1_CLOCKS73, MCU_PCLK_TCPWM1_CLOCKS74, MCU_PCLK_TCPWM1_CLOCKS75, MCU_PCLK_TCPWM1_CLOCKS76, MCU_PCLK_TCPWM1_CLOCKS77, MCU_PCLK_TCPWM1_CLOCKS78, MCU_PCLK_TCPWM1_CLOCKS79, MCU_PCLK_TCPWM1_CLOCKS80, MCU_PCLK_TCPWM1_CLOCKS81, MCU_PCLK_TCPWM1_CLOCKS82, MCU_PCLK_TCPWM1_CLOCKS83, MCU_PCLK_TCPWM1_CLOCKS256, MCU_PCLK_TCPWM1_CLOCKS257, MCU_PCLK_TCPWM1_CLOCKS258, MCU_PCLK_TCPWM1_CLOCKS259, MCU_PCLK_TCPWM1_CLOCKS260, MCU_PCLK_TCPWM1_CLOCKS261, MCU_PCLK_TCPWM1_CLOCKS262, MCU_PCLK_TCPWM1_CLOCKS263, MCU_PCLK_TCPWM1_CLOCKS264, MCU_PCLK_TCPWM1_CLOCKS265, MCU_PCLK_TCPWM1_CLOCKS266, MCU_PCLK_TCPWM1_CLOCKS267, MCU_PCLK_TCPWM1_CLOCKS512, MCU_PCLK_TCPWM1_CLOCKS513, MCU_PCLK_TCPWM1_CLOCKS514, MCU_PCLK_TCPWM1_CLOCKS515, MCU_PCLK_TCPWM1_CLOCKS516, MCU_PCLK_TCPWM1_CLOCKS517, MCU_PCLK_TCPWM1_CLOCKS518, MCU_PCLK_TCPWM1_CLOCKS519, MCU_PCLK_TCPWM1_CLOCKS520, MCU_PCLK_TCPWM1_CLOCKS521, MCU_PCLK_TCPWM1_CLOCKS522, MCU_PCLK_TCPWM1_CLOCKS523, MCU_PCLK_TCPWM1_CLOCKS524}, origin=Cypress, post-build-variant-value=true, set at post-build, default-value=MCU_CLOCK_IMO  # Select the clock for this clock reference point and press calculate.
          float McuClockReferencePointFrequency: 0.0..4.0E8, scope=ECU, post-build-variant-value=true, set at post-build, default-value=5.0E7  # This is the frequency for the specific instance of the McuClockReferencePoint container. It is given in Hz. Press 'Calculate' to update value
      container McuDemEventParameterRefs [0..1]: multiplicity set at pre-compile  # Container for the references to DemEventParameter elements which shall be invoked using the API Dem_ReportErrorStatus API in case the corresponding error occurs. The EventId is taken from the referenced DemEventParameter's DemEventId symbolic name. The standardized errors are provided in the container and can be extended by vendor specific error references.
        symbolic name reference MCU_E_CLOCK_FAILURE [0..1]: multiplicity set at pre-compile, set at pre-compile, destination=DemEventParameter  # Reference to configured DEM event to report "Clock source failure".
        symbolic name reference MCU_E_RESET_FAILURE [0..1]: multiplicity set at pre-compile, origin=Cypress, set at pre-compile, destination=DemEventParameter  # Reference to configured DEM event to report "Reset failure". For example, in case where the RAM write buffer does not become empty before performing reset.
      container McuModeSettingConf [1..*]: multiplicity set at post-build, post-build-variant-multiplicity=true  # This container contains the configuration (parameters) for the Mode setting of the MCU. Please see MCU035 for more information on the MCU mode settings.
        integer McuMode: 0..255, set at pre-compile, symbolic-name-value=true, default-value=0  # The parameter represents the MCU Mode settings. Please try default value.
        enumeration McuTargetCpu: {MCU_CPU_CM0P, MCU_CPU_CM4, MCU_CPU_CM7_0, MCU_CPU_CM7_1}, origin=Cypress, post-build-variant-value=true, set at post-build, default-value=MCU_CPU_CM0P  # This parameter is used to specify the CPU to which this mode is set.
        enumeration McuCpuPowerMode: {MCU_CPUMODE_ACTIVE, MCU_CPUMODE_SLEEP, MCU_CPUMODE_DEEPSLEEP, MCU_CPUMODE_HIBERNATE}, origin=Cypress, post-build-variant-value=true, set at post-build, default-value=MCU_CPUMODE_ACTIVE  # This parameter is used to specify CPU power mode type.
        boolean McuEnableLowPowerTransition: origin=Cypress, post-build-variant-value=true, set at post-build, default-value=false  # This parameter is used to specify whether enter the low power state or not.
        enumeration McuMainCore0PowerMode [0..1]: {MCU_POWERMODE_OFF, MCU_POWERMODE_RESET, MCU_POWERMODE_RETAINED, MCU_POWERMODE_ENABLED}, multiplicity set at post-build, origin=Cypress, post-build-variant-multiplicity=true, post-build-variant-value=true, set at post-build, default-value=MCU_POWERMODE_ENABLED  # This parameter is used to specify the Main Core 0 power mode.
        enumeration McuMainCore1PowerMode [0..1]: {MCU_POWERMODE_OFF, MCU_POWERMODE_RESET, MCU_POWERMODE_RETAINED, MCU_POWERMODE_ENABLED}, multiplicity set at post-build, origin=Cypress, post-build-variant-multiplicity=true, post-build-variant-value=true, set at post-build, default-value=MCU_POWERMODE_ENABLED  # This parameter is used to specify the Main Core 1 power mode.
        boolean McuSleepOnExitIsrEnable: origin=Cypress, post-build-variant-value=true, set at post-build, default-value=false  # This parameter is used to enable the CPU enters sleep state on an exit from an ISR.
        boolean McuWakeupByPendingInterruptEnable: origin=Cypress, post-build-variant-value=true, set at post-build, default-value=false  # This parameter is used to enable the CPU wakes up by an interrupt transition from inactive state to pending state.
        boolean McuEnableCacheFlushBeforeModeChange: origin=Cypress, post-build-variant-value=true, set at post-build, default-value=false  # If this option is checked, cache is flushed before mode change.
        integer McuRamWriteBufferTimeout [0..1]: 1..4294967295, multiplicity set at post-build, origin=Cypress, post-build-variant-multiplicity=true, post-build-variant-value=true, set at post-build, default-value=1  # This parameter is used to specify the timeout count value for waiting RAMs write buffer empty.
        boolean McuFreezeIoRelease: origin=Cypress, post-build-variant-value=true, set at post-build, default-value=false  # This parameter is used to enable the release of freeze IO after wakeup from hibernate mode.
        boolean McuUpdateSystemResource: origin=Cypress, post-build-variant-value=true, set at post-build, default-value=true  # This parameter is used to specify whether update the system resource or not.
        integer McuMainCore0PowerUpDelay: 0..1023, origin=Cypress, post-build-variant-value=true, set at post-build, default-value=300  # This parameter is used to specify the delay after power domain power up of Main Core 0.
        integer McuMainCore1PowerUpDelay [0..1]: 0..1023, multiplicity set at post-build, origin=Cypress, post-build-variant-multiplicity=true, post-build-variant-value=true, set at post-build, default-value=300  # This parameter is used to specify the delay after power domain power up of Main Core 1.
        enumeration McuRam0Macro{0..15}PowerMode [0..1]: {MCU_POWERMODE_OFF, MCU_POWERMODE_RETAINED, MCU_POWERMODE_ENABLED}, multiplicity set at post-build, origin=Cypress, post-build-variant-multiplicity=true, post-build-variant-value=true, set at post-build, default-value=MCU_POWERMODE_ENABLED  # This parameter is used to specify the RAM0 Macro {0..15} power mode.
        enumeration McuRam1PowerMode [0..1]: {MCU_POWERMODE_ENABLED, MCU_POWERMODE_RETAINED, MCU_POWERMODE_OFF}, multiplicity set at post-build, origin=Cypress, post-build-variant-multiplicity=true, post-build-variant-value=true, set at post-build, default-value=MCU_POWERMODE_ENABLED  # This parameter is used to specify the RAM1 power mode.
        enumeration McuRam2PowerMode [0..1]: {MCU_POWERMODE_ENABLED, MCU_POWERMODE_RETAINED, MCU_POWERMODE_OFF}, multiplicity set at post-build, origin=Cypress, post-build-variant-multiplicity=true, post-build-variant-value=true, set at post-build, default-value=MCU_POWERMODE_ENABLED  # This parameter is used to specify the RAM2 power mode.
        integer McuRamPowerUpDelay: 0..1023, origin=Cypress, post-build-variant-value=true, set at post-build, default-value=150  # This parameter is used to specify the delay after power domain power up of Ram.
        integer McuLowPowerReadyTimeout [0..1]: 1..4294967295, multiplicity set at post-build, origin=Cypress, post-build-variant-multiplicity=true, post-build-variant-value=true, set at post-build, default-value=1  # This parameter is used to specify the timeout count value for waiting specified low power functions ready.
        boolean McuLinearCoreRegulatorDisable: origin=Cypress, post-build-variant-value=true, set at post-build, default-value=false  # This parameter is used to disable the linear core regulator.
        integer McuLinearCoreRegulatorEnableTimeout [0..1]: 1..4294967295, multiplicity set at post-build, origin=Cypress, post-build-variant-multiplicity=true, post-build-variant-value=true, set at post-build, default-value=1  # This parameter is used to specify the timeout count value for waiting the enabled linear core regulator ready.
        boolean McuDeepSleepRegulatorDisable: origin=Cypress, post-build-variant-value=true, set at post-build, default-value=false  # This parameter is used to disable the DeepSleep regulator.
        boolean McuVoltageReferenceBufferDisable: origin=Cypress, post-build-variant-value=true, set at post-build, default-value=false  # This parameter is used to disable the voltage reference buffer.
        integer McuVoltageReferenceBufferReadyTimeout [0..1]: 1..4294967295, multiplicity set at post-build, origin=Cypress, post-build-variant-multiplicity=true, post-build-variant-value=true, set at post-build, default-value=1  # This parameter is used to specify the timeout count value for waiting the enabled voltage reference buffer ready.
        boolean McuReferenceCurrentGeneratorDisable: origin=Cypress, post-build-variant-value=true, set at post-build, default-value=false  # This parameter is used to disable the reference current generator.
        integer McuReferenceCurrentGeneratorEnableTimeout [0..1]: 1..4294967295, multiplicity set at post-build, origin=Cypress, post-build-variant-multiplicity=true, post-build-variant-value=true, set at post-build, default-value=1  # This parameter is used to specify the timeout count value for waiting the enabled reference current generator.
        enumeration McuBandgapReferencePowerMode: {MCU_POWERMODE_NORMAL, MCU_POWERMODE_LOWPOWER}, origin=Cypress, post-build-variant-value=true, set at post-build, default-value=MCU_POWERMODE_NORMAL  # This parameter is used to specify power mode type of the bandgap reference circuits. Please note, ILO0 is required to be active for proper operation of MCU_POWERMODE_LOWPOWER. When switching from MCU_POWERMODE_LOWPOWER to MCU_POWERMODE_NORMAL, ILO0 needs to stay active for at least 5 more clock cycles.
        boolean McuBypassPllLevelShifter: origin=Cypress, post-build-variant-value=true, set at post-build, default-value=false  # This parameter is used to determine whether bypass level shifter inside the PLL or not.
        reference McuReferenceClockSetting [0..1]: multiplicity set at post-build, origin=Cypress, post-build-variant-multiplicity=true, post-build-variant-value=true, set at post-build, destination=McuClockSettingConfig  # If RUN mode clock settings are referenced here, these clock settings will be added to the mode settings (a complete Profile register set will be written here) before a state-switch is triggered in API function Mcu_SetMode().
        container McuHibernateSettings [0..1]: multiplicity set at post-build, post-build-variant-multiplicity=true  # This container contains the configurations for the HIBERNATE mode setting.
          boolean McuHibernateClearPendingWakeup [0..1]: multiplicity set at post-build, origin=Cypress, post-build-variant-multiplicity=true, post-build-variant-value=true, set at post-build, default-value=true  # This parameter is used to clear pending wakeup for hibernate mode.
          boolean McuHibernateFreezeIoEnable: origin=Cypress, post-build-variant-value=true, set at post-build, default-value=false  # This parameter is used to enable the freeze of the configuration, mode and state of all GPIOs and SIOs in the system when entering HIBERNATE mode.
          boolean McuHibernateWakeupByBackupAlarmEnable: origin=Cypress, post-build-variant-value=true, set at post-build, default-value=false  # This parameter is used to enable the system will wakeup from HIBERNATE mode by a backup domain alarm.
          boolean McuHibernateWakeupByWatchdogEnable: origin=Cypress, post-build-variant-value=true, set at post-build, default-value=false  # This parameter is used to enable the system will wakeup from HIBERNATE mode by watchdog matching.
          boolean McuHibernateWakeupByBackupCsvEnable [0..1]: multiplicity set at post-build, origin=Cypress, post-build-variant-multiplicity=true, post-build-variant-value=true, set at post-build, default-value=false  # This parameter is used to enable the system will wakeup from HIBERNATE mode by backup clock supervisor.
          boolean McuHibernateWakeupSenseMode [0..1]: multiplicity set at post-build, origin=Cypress, post-build-variant-multiplicity=true, post-build-variant-value=true, set at post-build, default-value=false  # This parameter is used to configure the system will wakeup from HIBERNATE mode by pending interrupt.
          boolean McuHibernateWakeupByWakeupPin{0..23}Enable [0..1]: multiplicity set at post-build, origin=Cypress, post-build-variant-multiplicity=true, post-build-variant-value=true, set at post-build, default-value=false  # This parameter is used to enable the system will wakeup from HIBERNATE mode by the corresponding pin if its input matches the McuHibernateWakeupPinPolarity setting.
          enumeration McuHibernateWakeupPin{0..23}Polarity [0..1]: {MCU_PIN_POLARITY_LOW, MCU_PIN_POLARITY_HIGH}, multiplicity set at post-build, origin=Cypress, post-build-variant-multiplicity=true, post-build-variant-value=true, set at post-build, default-value=MCU_PIN_POLARITY_LOW  # This parameter is used to specify the active polarity of the corresponding wakeup pin.
        container McuHvLvdSettings [0..*]: multiplicity set at post-build, post-build-variant-multiplicity=true  # This container contains the configurations for the HVLVD setting.
          enumeration McuHvLvdType: {MCU_HVLVD_HVLVD1, MCU_HVLVD_HVLVD2}, origin=Cypress, post-build-variant-value=true, set at post-build, default-value=MCU_HVLVD_HVLVD1  # This parameter is used to specify the HVLVD type of this setting.
          boolean McuHvLvdEnable: origin=Cypress, post-build-variant-value=true, set at post-build, default-value=false  # This parameter is used to enable the HVLVD voltage monitor.
          boolean McuHvLvdOnDeepSleepEnable: origin=Cypress, post-build-variant-value=true, set at post-build, default-value=false  # This parameter is used to keep the HVLVD enabled during DEEPSLEEP mode.
          boolean McuHvLvdStopForUpdate: origin=Cypress, post-build-variant-value=true, set at post-build, default-value=true  # This parameter is used to enable the stop which is performed before update HVLVD settings when HVLVD voltage monitor is running.
          enumeration McuHvLvdThreshold: {MCU_HVLVD_THRESHOLD_2_8V_TO_2_825V, MCU_HVLVD_THRESHOLD_2_9V_TO_2_925V, MCU_HVLVD_THRESHOLD_3_0V_TO_3_025V, MCU_HVLVD_THRESHOLD_3_1V_TO_3_125V, MCU_HVLVD_THRESHOLD_3_2V_TO_3_225V, MCU_HVLVD_THRESHOLD_3_3V_TO_3_325V, MCU_HVLVD_THRESHOLD_3_4V_TO_3_425V, MCU_HVLVD_THRESHOLD_3_5V_TO_3_525V, MCU_HVLVD_THRESHOLD_3_6V_TO_3_625V, MCU_HVLVD_THRESHOLD_3_7V_TO_3_725V, MCU_HVLVD_THRESHOLD_3_8V_TO_3_825V, MCU_HVLVD_THRESHOLD_3_9V_TO_3_925V, MCU_HVLVD_THRESHOLD_4_0V_TO_4_025V, MCU_HVLVD_THRESHOLD_4_1V_TO_4_125V, MCU_HVLVD_THRESHOLD_4_2V_TO_4_225V, MCU_HVLVD_THRESHOLD_4_3V_TO_4_325V, MCU_HVLVD_THRESHOLD_4_4V_TO_4_425V, MCU_HVLVD_THRESHOLD_4_5V_TO_4_525V, MCU_HVLVD_THRESHOLD_4_6V_TO_4_625V, MCU_HVLVD_THRESHOLD_4_7V_TO_4_725V, MCU_HVLVD_THRESHOLD_4_8V_TO_4_825V, MCU_HVLVD_THRESHOLD_4_9V_TO_4_925V, MCU_HVLVD_THRESHOLD_5_0V_TO_5_025V, MCU_HVLVD_THRESHOLD_5_1V_TO_5_125V, MCU_HVLVD_THRESHOLD_5_2V_TO_5_225V, MCU_HVLVD_THRESHOLD_5_3V_TO_5_325V}, origin=Cypress, post-build-variant-value=true, set at post-build, default-value=MCU_HVLVD_THRESHOLD_2_8V_TO_2_825V  # This parameter is used to specify the threshold value of the HVLVD voltage monitor.
          enumeration McuHvLvdAction: {MCU_LVD_ACTION_FAULT, MCU_LVD_ACTION_INTERRUPT}, origin=Cypress, post-build-variant-value=true, set at post-build, default-value=MCU_LVD_ACTION_FAULT  # This parameter is used to specify the HVLVD detection action.
          boolean McuHvLvdInterruptEnable: origin=Cypress, post-build-variant-value=true, set at post-build, default-value=false  # This parameter is used to enable the interrupt of the HVLVD voltage monitor.
          enumeration McuHvLvdTriggerEdge: {MCU_HVLVD_EDGE_RISING, MCU_HVLVD_EDGE_FALLING, MCU_HVLVD_EDGE_BOTH}, origin=Cypress, post-build-variant-value=true, set at post-build, default-value=MCU_HVLVD_EDGE_RISING  # This parameter is used to specify the HVLVD trigger edge.
        container McuSupplySupervisionSettings [0..1]: multiplicity set at post-build, post-build-variant-multiplicity=true  # This container contains the configurations for the supply supervision setting.
          boolean McuVdddBodEnable: origin=Cypress, post-build-variant-value=true, set at post-build, default-value=true  # This parameter is used to enable the BOD on vddd.
          enumeration McuVdddBodThreshold: {MCU_BOD_THRESHOLD_2_7V, MCU_BOD_THRESHOLD_3_0V}, origin=Cypress, post-build-variant-value=true, set at post-build, default-value=MCU_BOD_THRESHOLD_2_7V  # This parameter is used to specify the threshold value of the BOD on vddd.
          boolean McuVddaBodEnable: origin=Cypress, post-build-variant-value=true, set at post-build, default-value=false  # This parameter is used to enable the BOD on vdda.
          enumeration McuVddaBodThreshold: {MCU_BOD_THRESHOLD_2_7V, MCU_BOD_THRESHOLD_3_0V}, origin=Cypress, post-build-variant-value=true, set at post-build, default-value=MCU_BOD_THRESHOLD_2_7V  # This parameter is used to specify the threshold value of the BOD on vdda.
          enumeration McuVddaBodAction: {MCU_BOD_ACTION_NONE, MCU_BOD_ACTION_RESET, MCU_BOD_ACTION_FAULT}, origin=Cypress, post-build-variant-value=true, set at post-build, default-value=MCU_BOD_ACTION_NONE  # This parameter is used to specify the BOD on vdda action.
          boolean McuVccdBodEnable: origin=Cypress, post-build-variant-value=true, set at post-build, default-value=true  # This parameter is used to enable the BOD on vccd.
          boolean McuVdddOvdEnable: origin=Cypress, post-build-variant-value=true, set at post-build, default-value=true  # This parameter is used to enable the OVD on vddd.
          enumeration McuVdddOvdThreshold: {MCU_OVD_THRESHOLD_5_0V, MCU_OVD_THRESHOLD_5_5V}, origin=Cypress, post-build-variant-value=true, set at post-build, default-value=MCU_OVD_THRESHOLD_5_0V  # This parameter is used to specify the threshold value of the OVD on vddd.
          boolean McuVddaOvdEnable: origin=Cypress, post-build-variant-value=true, set at post-build, default-value=false  # This parameter is used to enable the OVD on vdda.
          enumeration McuVddaOvdThreshold: {MCU_OVD_THRESHOLD_5_0V, MCU_OVD_THRESHOLD_5_5V}, origin=Cypress, post-build-variant-value=true, set at post-build, default-value=MCU_OVD_THRESHOLD_5_0V  # This parameter is used to specify the threshold value of the OVD on vdda.
          enumeration McuVddaOvdAction: {MCU_OVD_ACTION_NONE, MCU_OVD_ACTION_RESET, MCU_OVD_ACTION_FAULT}, origin=Cypress, post-build-variant-value=true, set at post-build, default-value=MCU_OVD_ACTION_NONE  # This parameter is used to specify the OVD on vdda action.
          boolean McuVccdOvdEnable: origin=Cypress, post-build-variant-value=true, set at post-build, default-value=true  # This parameter is used to enable the OVD on vccd.
        container McuRegHcSettings [0..1]: multiplicity set at post-build, post-build-variant-multiplicity=true  # This container contains the configurations for the REGHC setting.
          boolean McuRegHcEnable: origin=Cypress, post-build-variant-value=true, set at post-build, default-value=false  # This parameter is used to enable the REGHC.
          boolean McuRegHcOnDeepSleepEnable [0..1]: multiplicity set at post-build, origin=Cypress, post-build-variant-multiplicity=true, post-build-variant-value=true, set at post-build, default-value=false  # This parameter is used to enable the REGHC during DEEPSLEEP mode.
          boolean McuRegHcPmicVadjDisable [0..1]: multiplicity set at post-build, origin=Cypress, post-build-variant-multiplicity=true, post-build-variant-value=true, set at post-build, default-value=false  # This parameter is used to disable the PMIC VADJ for REGHC.
          integer McuRegHcStabilizationTimeout [0..1]: 1..4294967295, multiplicity set at post-build, origin=Cypress, post-build-variant-multiplicity=true, post-build-variant-value=true, set at post-build, default-value=1  # This parameter is used to enable the timeout count value for checking of REGHC Stabilization.
        container McuPmicSettings [0..1]: multiplicity set at post-build, post-build-variant-multiplicity=true  # This container contains the configurations for the PMIC setting.
          boolean McuPmicEnable: origin=Cypress, post-build-variant-value=true, set at post-build, default-value=false  # This parameter is used to enable the PMIC.
          boolean McuPmicOnDeepSleepEnable: origin=Cypress, post-build-variant-value=true, set at post-build, default-value=false  # This parameter is used to enable the PMIC during DEEPSLEEP mode.
          boolean McuPmicVadjDisable: origin=Cypress, post-build-variant-value=true, set at post-build, default-value=false  # This parameter is used to disable the PMIC VADJ.
          integer McuPmicStabilizationTimeout [0..1]: 1..4294967295, multiplicity set at post-build, origin=Cypress, post-build-variant-multiplicity=true, post-build-variant-value=true, set at post-build, default-value=1  # This parameter is used to enable the timeout count value for checking of PMIC Stabilization.
        container McuDmaSettings [0..1]: multiplicity set at post-build, post-build-variant-multiplicity=true  # This container contains the configurations for the DMA setting.
          boolean McuDmaEnable [0..1]: multiplicity set at post-build, origin=Cypress, post-build-variant-multiplicity=true, post-build-variant-value=true, set at post-build, default-value=false  # This parameter is used to enable the DMA HW.
          boolean McuDataWire0Enable [0..1]: multiplicity set at post-build, origin=Cypress, post-build-variant-multiplicity=true, post-build-variant-value=true, set at post-build, default-value=false  # This parameter is used to enable the Data Wire 0 HW.
          boolean McuDataWire1Enable [0..1]: multiplicity set at post-build, origin=Cypress, post-build-variant-multiplicity=true, post-build-variant-value=true, set at post-build, default-value=false  # This parameter is used to enable the Data Wire 1 HW.
      container McuRamSectorSettingConf [0..*]: multiplicity set at post-build, post-build-variant-multiplicity=true  # This container contains the configuration (parameters) for the RAM Sector setting. Please see MCU030 for more information on RAM sec-tor settings.
        integer McuRamDefaultValue: 0..255, post-build-variant-value=true, set at post-build, default-value=0  # This parameter shall represent the Data pre-setting to be initialized
        integer McuRamSectionBaseAddress: 0..4294967295, post-build-variant-value=true, set at post-build, default-value=0  # This parameter shall represent the MCU RAM section base address
        integer McuRamSectionSize: 0..4294967295, post-build-variant-value=true, set at post-build, default-value=1  # This parameter represents the MCU RAM Section size in bytes.
    container McuPublishedInformation  # Container holding all MCU specific published information parameters.
      container McuResetReasonConf [1..*]: multiplicity set at published-information  # This container contains the configuration for the different type of reset reason that can be retrieved from Mcu_GetResetReason Api.
        integer McuResetReason: 0..255, scope=ECU, set at published-information, symbolic-name-value=true, default-value=0  # The parameter represents the different type of reset that a Micro supports. This parameter is referenced by the parameter EcuMResetReason in the ECU State manager module.
