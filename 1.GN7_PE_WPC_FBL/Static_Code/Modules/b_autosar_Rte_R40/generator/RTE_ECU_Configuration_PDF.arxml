AUTOSAR XML (schema 4-0-3)
# (C) 2021 HYUNDAI AUTOEVER Corp.
# Confidential Proprietary Information Distribution Limited
# Do Not Copy Without Prior Permission
package /AUTRON
  ecuc definition collection ParameterDefinition_Rte: module=Rte
  module definition Rte: refined-module-def=Rte, variants post-build/pre-compile  # Configuration of the Rte (Runtime Environment) module.
    container CommonPublishedInformation  # Common container, aggregated by all modules. It contains published information about vendor and versions.
      string ArReleaseVersion: category=FIXED, set at published-information, default-value=4.0.3, regular-expression=4\.0\.3  # Version of the AUTOSAR Release on which this implementation is based. The numbering contains three levels (major, minor, revision) which are defined by AUTOSAR.
      integer ModuleId: 2..2, category=FIXED, set at published-information, default-value=2  # Module ID of this module from Module List
      string SwVersion: category=FIXED, set at published-information, default-value=4.11.1, regular-expression=4\.[0-9]+\.[0-9]+  # Software version of this implementation. The numbering contains three levels (like major, minor, patch), its values are vendor specific.
      string VendorApiInfix [0..1]: category=NOT_SUPPORTED, set at published-information  # In driver modules which can be instantiated several times on a single ECU, BSW00347 requires that the name of APIs is extended by the VendorId and a vendor specific name. This parameter is used to specify the vendor specific name. In total, the implementation specific name is generated as follows: <ModuleName>_<VendorId>_<VendorApiInfix><Api name from SWS>. E.g. assuming that the VendorId of the implementer is 123 and the implementer chose a VendorApiInfix of "v11r456" a api name Can_Write defined in the SWS will translate to Can_123_v11r456Write. This parameter is mandatory for all modules with upper multiplicity > 1. It shall not be used for modules with upper multiplicity =1.
      integer VendorId: 76..76, category=NOT_SUPPORTED, set at published-information, default-value=76  # Vendor ID of the dedicated implementation of this module according to the AUTOSAR vendor list
    container RteBswGeneral  # General configuration parameters of the Bsw Scheduler section.
      boolean RteSchMVersionInfoApi: category=FIXED, set at pre-compile  # Enables the generation of the SchM_GetVersionInfo() API.
      boolean RteUseComShadowSignalApi: category=FIXED, set at pre-compile, symbolic-name-value=true, default-value=true  # This parameter defines whether the ComShadowSignalAPIs ((Com_UpdateShadowSignal, Com_InvalidateShadowSignal, Com_ReceiveShadowSignal) are used or not. If this parameter is set to true the ShadowSignal APIs and Signal APIs (Com_SendSignal, Com_InvalidateSignal, Com_ReceiveSignal) are used. If this parameter is set to false only the Signal APIs (Com_SendSignal, Com_InvalidateSignal, Com_ReceiveSignal) are used.
      string SchMUserDefinedfileName [0..1]: category=NOT_SUPPORTED, set at pre-compile, origin=AUTOEVER  # The parameter depicts a symbolic name for the inclusion of the user defined file name. This parameter will be configured if literal DI_EI is used.
    container RteBswModuleInstance [0..*]  # Represents one instance of a Bsw-Module configured on one ECU.
      foreign reference RteBswImplementationRef: set at pre-compile, destination-type=BSW-IMPLEMENTATION  # Reference to the BswImplementation for which the Rte /SchM is configured.
      foreign reference RteBswModuleConfigurationRef [0..1]: set at pre-compile, destination-type=BSW-MODULE-DESCRIPTION  # Reference to the ECU Configuration Values provided for this BswImplementation.
      container RteBswEventToTaskMapping [0..*]  # Maps a BswSchedulableEntity onto one OsTask based on the activating BswEvent.
        float RteBswActivationOffset [0..1]: category=NOT_SUPPORTED, set at pre-compile  # Activation offset in seconds.
        boolean RteBswImmediateRestart: category=NOT_SUPPORTED, set at pre-compile, default-value=false  # When RteBswImmediateRestart is set to true the BswSchedulableEntitiy shall be immediately re-started after termination if it was activated by this BswEvent while it was already started. This parameter shall not be set to true when the mapped BswEvent refers to a BswSchedulableEntitiy which minimumStartInterval attribute is > 0.
        integer RteBswPositionInTask [0..1]: 0..65535, set at pre-compile  # Each BswSchedulableEntity activation mapped to an OsTask has a specific position within the task execution. For periodic activation this is the order of execution. For event driver activation this is the order of evaluation which actual BswSchedulableEntity has to be executed. | For periodic activation this is the order of execution. For event driver activation this is the order of evaluation which actual BswSchedulableEntity has to be executed.
        enumeration RteOsSchedulePoint [0..1]: {CONDITIONAL, NONE, UNCONDITIONAL}, category=NOT_SUPPORTED, set at pre-compile  # Introduce a schedule point by explicitly calling Os Schedule service after the execution of the ExecutableEntity. The Rte generator is allowed to optimize several consecutive calls to Os schedule into one single call if the ExecutableEntity executions in between have been skipped. The absence of this parameter is interpreted as "NONE". It shall be considered an invalid configuration if the task is preemptable and the value of this parameter is not set to "NONE" or the parameter is absent. | The absence of this parameter is interpreted as "NONE". It shall be considered an invalid configuration if the task is preemptable and the value of this parameter is not set to "NONE" or the parameter is absent.
        foreign reference RteBswEventRef: set at pre-compile, destination-type=BSW-EVENT  # Reference to the BswEvent which is pointing to the BswSchedulableEntity being mapped. This allows a fine grained mapping of BswSchedulableEntites based on the activating BswEvent.
        reference RteBswMappedToTaskRef [0..1]: set at pre-compile, destination=OsTask  # Reference to the OsTask the BswSchedulableEntity activated by the RteBswEventRef is mapped to. If no reference to the OsTask is specified the BswSchedulableEntity activated by this BswEvent is executed in the context of the caller. | If no reference to the OsTask is specified the BswSchedulableEntity activated by this BswEvent is executed in the context of the caller.
        reference RteBswUsedOsAlarmRef [0..1]: set at pre-compile, destination=OsAlarm  # If an OsAlarm is used to activate the OsTask this BswEvent is mapped to it shall be referenced here.
        reference RteBswUsedOsEventRef [0..1]: set at pre-compile, destination=OsEvent  # If an OsEvent is used to activate the OsTask this BswEvent is mapped to it shall be referenced here.
        reference RteBswUsedOsSchTblExpiryPointRef [0..1]: category=NOT_SUPPORTED, set at pre-compile, destination=OsScheduleTableExpiryPoint  # If an OsScheduleTableExpiryPoint is used to activate the OsTask this BswEvent is mapped to it shall be referenced here.
        reference RteBswActivationOsAlarmRef [0..1]: category=NOT_SUPPORTED, set at pre-compile, origin=AUTOEVER, destination=OsAlarm  # Reference to the OsAlarm for MinimumStartInterval of a RunnableEntity. If the value of MinimumStartInterval is a nonzero value, the Alarm has to be set.
        reference RteBswTimeOutOsAlarmRef [0..1]: category=NOT_SUPPORTED, set at pre-compile, origin=AUTOEVER, destination=OsAlarm  # Reference to the OsAlarm for BswModeSwitchAckEvent Timeout of a RunnableEntity. If the value of TimeOut is a nonzero value, the Alarm has to be set.
      container RteBswExternalTriggerConfig [0..*]  # Defines the configuration of Inter Basic Software Module Entity Triggering.
        integer RteBswTriggerSourceQueueLength: 0..4294967295, set at pre-compile  # Length of trigger queue on the trigger source side. | The queue is implemented by the RTE. A value greater or equal to 1 requests an queued behavior. Setting the value of RteTriggerSourceQueueLength to 0 requests an none queued implementation of the trigger communication.
        foreign reference RteBswTriggerSourceRef: set at pre-compile, destination-type=TRIGGER  # Reference to a Trigger instance in the role releasedTrigger of the related BSW Module instance.
      container RteBswInternalTriggerConfig [0..*]  # Defines the configuration of internal Basic Software Module Entity Triggering.
        integer RteBswTriggerSourceQueueLength: 0..4294967295, set at pre-compile  # Length of trigger queue on the trigger source side. | The queue is implemented by the RTE. A value greater or equal to 1 requests an queued behavior. Setting the value of RteTriggerSourceQueueLength to 0 requests an none queued implementation of the trigger communication.
        foreign reference RteBswTriggerSourceRef: set at pre-compile, destination-type=BSW-INTERNAL-TRIGGERING-POINT  # Reference to a BswInternalTriggeringPoint of the related BSW Module instance.
      container RteBswExclusiveAreaImpl [0..*]  # Represents one ExclusiveArea of one BswImplementation. Used to specify the implementation means of this ExclusiveArea.
        enumeration RteExclusiveAreaImplMechanism: {ALL_INTERRUPT_BLOCKING, COOPERATIVE_RUNNABLE_PLACEMENT, OS_INTERRUPT_BLOCKING, OS_RESOURCE, USER_DEFINED_MACRO}, set at pre-compile  # To be used implementation mechanism for the specified ExclusiveArea.
        string SchMEnableMacroName [0..1]: category=NOT_SUPPORTED, set at pre-compile, origin=AUTOEVER  # The parameter depicts a symbolic name for the unambiguous identification of Enable macro name. This parameter will be configured if literal DI_EI is used.
        string SchMDisableMacroName [0..1]: category=NOT_SUPPORTED, set at pre-compile, origin=AUTOEVER  # The parameter depicts a symbolic name for the unambiguous identification of Disable macro name. This parameter will be configured if literal DI_EI is used.
        foreign reference RteBswExclusiveAreaRef: set at pre-compile, destination-type=EXCLUSIVE-AREA  # Reference to the ExclusiveArea for which the implementation mechanism shall be specified.
        reference RteBswExclusiveAreaOsResourceRef [0..1]: set at pre-compile, destination=OsResource  # Optional reference to an OsResource in case RteExclusiveAreaImplMechanism is configured to OS_RESOURCE for this ExclusiveArea.
      container RteBswRequiredModeGroupConnection [0..*]  # Defines the connection between one requiredModeGroup of this BSW Module instance and one providedModeGroup instance.
        foreign reference RteBswProvidedModeGroupRef: set at pre-compile, destination-type=MODE-DECLARATION-GROUP-PROTOTYPE  # References the providedModeGroupPrototype to which this requiredModeGroup shall be connected.
        foreign reference RteBswRequiredModeGroupRef: set at pre-compile, destination-type=MODE-DECLARATION-GROUP-PROTOTYPE  # References requiredModeGroupPrototype which shall be connected to the providedModeGroupPrototype.
        reference RteBswProvidedModeGrpModInstRef: set at pre-compile, destination=RteBswModuleInstance  # Reference to the RteBswModuleInstance configuration container which identifies the instance of the BSW Module. | Used with the RteBswProvidedModeGroupRef to unambiguously identify the ModeDeclarationGroupPrototype instance.
      container RteBswRequiredTriggerConnection [0..*]  # Defines the connection between one requiredTrigger of this BSW Module instance and one releasedTrigger instance.
        foreign reference RteBswReleasedTriggerRef: set at pre-compile, destination-type=TRIGGER  # References the releasedTrigger to which this requiredTrigger shall be connected.
        foreign reference RteBswRequiredTriggerRef: set at pre-compile, destination-type=TRIGGER  # References one requiredTrigger which shall be connected to the releasedTrigger.
        reference RteBswReleasedTriggerModInstRef: set at pre-compile, destination=RteBswModuleInstance  # Reference to the RteBswModuleInstance configuration container which identifies the instance of the BSW Module. | Used with the RteBswReleasedTriggerRef to unambiguously identify the Trigger instance.
    container RteGeneration  # This container holds the parameters for the configuration of the RTE Generation.
      enumeration RteCalibrationSupport: {DOUBLE_POINTERED, INITIALIZED_RAM, NONE, OVERLAY_RAM, SINGLE_POINTERED}, set at pre-compile, default-value=NONE  # The RTE generator shall have the option to switch off support for calibration for generated RTE code. This option shall influence complete RTE code at once.
      integer RteCodeVendorId: 0..65535, category=NOT_SUPPORTED, set at pre-compile  # Holds the vendor ID of the generated Rte code.
      boolean RteDevErrorDetect: category=FIXED, set at pre-compile, default-value=false  # The Rte shall log development errors to the Det module.
      boolean RteDevErrorDetectUninit: category=FIXED, set at pre-compile, default-value=false  # The Rte shall detect if it is started when its APIs are called, and the BSW Scheduler shall check if it is initialized when its APIs are called.
      enumeration RteGenerationMode: {COMPATIBILITY_MODE, VENDOR_MODE}, category=FIXED, set at pre-compile, default-value=COMPATIBILITY_MODE  # Switch between the two available generation modes of the RTE generator.
      enumeration RteIocInteractionReturnValue: {RTE_COM, RTE_IOC}, category=FIXED, set at pre-compile, default-value=RTE_IOC  # Defines whether the return value of RTE APIs is based on RTE-IOC interaction or RTE-COM interaction.
      boolean RteMeasurementSupport: category=FIXED, set at pre-compile, default-value=false  # The RTE generator shall have the option to switch off support for measurement for generated RTE code. This option shall influence complete RTE code at once.
      enumeration RteOptimizationMode: {MEMORY, RUNTIME}, category=FIXED, set at pre-compile, default-value=RUNTIME  # Switch between the two available optimization modes of the RTE generator.
      integer RteToolChainSignificantCharacters [0..1]: 0..65535, category=NOT_SUPPORTED, set at pre-compile, default-value=31  # If present, the RTE generator shall provide the list of C RTE identifiers whose name is not unique when only the first RteToolChainSignificantCharacters characters are considered.
      boolean RteValueRangeCheckEnabled: set at pre-compile, default-value=false  # If set to true the RTE generator shall enable the value range checking for the specified VariableDataPrototypes.
      linker symbol RteVfbTraceClientPrefix [0..*]: category=NOT_SUPPORTED, set at pre-compile  # Defines an additional prefix for all VFB trace functions to be generated. In this approach it is possible to have debugging and DLT trace functions at the same time.
      boolean RteVfbTraceEnabled: set at pre-compile, default-value=false  # The RTE generator shall globally enable VFB tracing when RteVfbTrace is set to "true".
      function name RteVfbTraceFunction [0..*]: set at pre-compile  # The RTE generator shall enable VFB tracing for a given hook function when there is a #define in the RTE configuration header file for the hook function name and tracing is globally enabled. | Example: #define Rte_WriteHook_i1_p1_a_Start This also applies to VFB trace functions with a RteVfbTraceClientPrefix, e.g. Rte_Dbg_WriteHook_I1_P1_a_Start.
      enumeration RteEndToEndProtectionWrapperMode [0..1]: {SINGLE, REDUNDANT}, set at pre-compile, origin=AUTOEVER, default-value=SINGLE
      reference RteTaskComMapping [0..1]: set at pre-compile, origin=AUTOEVER, destination=OsTask  # Reference to an OsTask.
    container RteImplicitCommunication [0..*]  # Configuration of the Implicit Communication behavior to be generated.
      boolean RteCoherentAccess: category=NOT_SUPPORTED, set at pre-compile, default-value=false  # If set to true the referenced VariableAccess'es of this RteImplicitCommunication container are in one CoherencyGroup. Data values for Coherent Implicit Read Accesses are read before the first reading RunnableEntity starts and are stable during the execution of all the reading RunnableEntitys; except Coherent Implicit Write Accesses belongs to the same Coherency Group. Data values written by Coherent Implicit Write Accesses are available for readers not belonging to the Coherency Group after the last writing RunnableEntity has terminated. Please note that a Coherent Implicit Data Access can be defined for VariableAccesses to same and different VariableDataElements. Nevertheless all Coherent Implicit Data Accesses of one Coherency Group have to be executed in the same task.
      boolean RteImmediateBufferUpdate: category=NOT_SUPPORTED, set at pre-compile, default-value=false  # If set to true the RTE will perform preemption area specific buffer update immediately before (for VariableAccess in the role dataReadAccess) resp. after (for VariableAccess in the role dataWriteAccess) Runnable execution.
      foreign reference RteVariableReadAccessRef [0..*]: category=NOT_SUPPORTED, set at pre-compile, destination-type=VARIABLE-ACCESS  # Reference to the VariableAccess in the dataReadAccess role.
      foreign reference RteVariableWriteAccessRef [0..*]: category=NOT_SUPPORTED, set at pre-compile, destination-type=VARIABLE-ACCESS  # Reference to the VariableAccess in the dataWriteAccess role.
      instance reference RteSoftwareComponentInstanceRef [1..*]: category=NOT_SUPPORTED, set at pre-compile, destination-context=ROOT-SW-COMPOSITION-PROTOTYPE, destination-type=SW-COMPONENT-PROTOTYPE  # Reference to a SwComponentPrototype. This denotes the instances of the VariableAccess belonging to the RteImplicitCommunication.
    container RteOsInteraction [1..*]  # Interaction of the Rte with the Os.
      boolean SynchronizedActivateOffset: set at pre-compile, origin=AUTOEVER, default-value=false  # Enables the synchronized activation offset amongs OsAlarms based on the specific OsCounter
      reference RteSynchronizedOsCounterRef [0..1]: set at pre-compile, origin=AUTOEVER, destination=OsCounter  # OsCounter which the OsAlarms in this RteOsInteraction, will work based on the synchronization with, should be referenced
      container RteModeToScheduleTableMapping [0..*]  # Provides configuration input in which Modes of a ModeDeclarionGroupPrototype of a Mode Manager a OsScheudleTable shall be active. | The Mode Manager is either specified as a SwComponentPrototype (RteModeSchtblMapSwc) or as a BSW-Module (RteModeSchtblMapBsw).
        foreign reference RteModeSchtblMapModeDeclarationRef [1..*]: category=NOT_SUPPORTED, set at pre-compile, destination-type=MODE-DECLARATION  # Reference to the ModeDeclarations.
        reference RteModeScheduleTableRef: category=NOT_SUPPORTED, set at pre-compile, destination=OsScheduleTable  # Reference to the OsScheduleTable which shall be active in the specified RteModeSchblMapModeDeclarationRefs.
        container RteModeSchtblMapBsw [0..1]  # Specifies an instance of a ModeDeclarationGroupPrototype of a Bsw-Module.
          foreign reference RteModeSchtblMapBswProvidedModeGroupRef: category=NOT_SUPPORTED, set at pre-compile, destination-type=MODE-DECLARATION-GROUP-PROTOTYPE  # Reference to an instance of a ModeDeclarationGroupPrototype of a Bsw-Module.
          reference RteModeSchtblMapBswInstanceRef: category=NOT_SUPPORTED, set at pre-compile, destination=RteBswModuleInstance  # Reference to an instance specification of a Bsw-Module.
        container RteModeSchtblMapSwc [0..1]  # Specifies an instance of a ModeDeclarationGroupPrototype of a SwComponentPrototype.
          foreign reference RteModeSchtblMapSwcPortRef: category=NOT_SUPPORTED, set at pre-compile, destination-type=P-PORT-PROTOTYPE  # Reference to the PPortPrototype of a SwComponentPrototype.
          reference RteModeSchtblMapSwcInstanceRef: category=NOT_SUPPORTED, set at pre-compile, destination=RteSwComponentInstance  # Reference to an instance specification of a SwComponentPrototype.
      container RteUsedOsActivation [0..*]  # Attributes used in the activation of OsTasks and Runnable Entities.
        float RteExpectedActivationOffset: 0..255.535, set at pre-compile  # Activation offset in seconds. Important: This is a requirement from the Rte towards the Os/Mcu setup. The Rte Generator shall assume this activation offset to be fulfilled. | Important: This is a requirement from the Rte towards the Os/Mcu setup. The Rte Generator shall assume this activation offset to be fulfilled.
        float RteExpectedTickDuration [0..1]: 0..255.535, category=NOT_SUPPORTED, set at pre-compile  # The expected tick duration in seconds which shall be configured to drive the OsScheduleTables or OsAlarm. Important: This is a requirement from the Rte towards the Os/Mcu setup. The Rte Generator shall assume this tick duration to be fulfilled. | Important: This is a requirement from the Rte towards the Os/Mcu setup. The Rte Generator shall assume this tick duration to be fulfilled.
        integer RteExpectedActivationPosition [0..1]: 0..255, set at pre-compile, origin=AUTOEVER  # Activation Position in Rte_Start or SchM_Init function.
        boolean AlarmSetMethodIsRelative: set at pre-compile, origin=AUTOEVER, default-value=false  # Configure the method to set the offset value in OsAlarm. Setting true means that the offset for OsAlarm will be set based on SetRelAlarm API supported by OS
        reference RteActivationOsAlarmRef [0..1]: set at pre-compile, destination=OsAlarm  # Reference to an OsAlarm.
        reference RteActivationOsSchTblRef [0..1]: category=NOT_SUPPORTED, set at pre-compile, destination=OsScheduleTable  # Reference to an OsScheduleTable.
        reference RteActivationOsTaskRef [0..1]: set at pre-compile, destination=OsTask  # Reference to an OsTask.
    container RtePostBuildVariantConfiguration [0..1]: multiple-configuration-container=true  # Specifies the PostbuildVariantSets for each of the PostBuild configurations of the RTE. The shortName of this container defines the name of the RtePostBuildVariant. | The shortName of this container defines the name of the RtePostBuildVariant.
      foreign reference RtePostBuildUsedPredefinedVariant [1..*]: category=NOT_SUPPORTED, set at pre-compile, destination-type=PREDEFINED-VARIANT  # Reference to the PredefinedVariant element which defines the values for PostBuildVariationCriterion elements.
    container RteSwComponentInstance [0..*]  # Representation of one SwComponentPrototype located on the to be configured ECU. All subcontainer configuration aspects are in relation to this SwComponentPrototype. The RteSwComponentInstance can be associated with either a AtomicSwComponentType or ParameterSwComponentType. | The RteSwComponentInstance can be associated with either a AtomicSwComponentType or ParameterSwComponentType.
      foreign reference RteSoftwareComponentInstanceRef [0..1]: set at pre-compile, destination-type=SW-COMPONENT-PROTOTYPE  # Reference to a SwComponentPrototype.
      container RteExternalTriggerConfig [0..*]  # Defines the configuration of External Trigger Event Communication for Software Components.
        integer RteTriggerSourceQueueLength: 0..4294967295, set at pre-compile  # Length of trigger queue on the trigger source side. | The queue is implemented by the RTE. A value greater or equal to 1 requests an queued behavior.Setting the value of RteTriggerSourceQueueLength to 0 requests an none queued implementation of the trigger communication.
        foreign reference RteSwcTriggerSourceRef: set at pre-compile, destination-type=TRIGGER  # The referenced Trigger instance has to belong to the same software component instance as the RteSwComponentInstance owning this parameter configures.
      container RteInternalTriggerConfig [0..*]  # Defines the configuration of Inter Runnable Triggering for Software Components.
        integer RteTriggerSourceQueueLength: 0..4294967295, set at pre-compile  # Length of trigger queue on the trigger source side.. | The queue is implemented by the RTE. A value greater or equal to 1 requests an queued behavior. Setting the value of RteTriggerSourceQueueLength to 0 requests an none queued implementation of the trigger communication.
        foreign reference RteSwcTriggerSourceRef: set at pre-compile, destination-type=INTERNAL-TRIGGERING-POINT  # The referenced InternalTriggeringPoint has to belong to the same software component instance as the RteSwComponentInstance owning this parameter configures.
      container RteEventToTaskMapping [0..*]  # Maps a RunnableEntity onto one OsTask based on the activating RTEEvent. Even if a RunnableEntity shall be executed via a direct function call this RteEventToTaskMapping shall be specified, but no RteMappedToTask and RtePositionInTask elements given. | Even if a RunnableEntity shall be executed via a direct function call this RteEventToTaskMapping shall be specified, but no RteMappedToTask and RtePositionInTask elements given.
        float RteActivationOffset [0..1]: 0..255.535, category=NOT_SUPPORTED, set at pre-compile  # Activation offset in seconds.
        boolean RteImmediateRestart: category=NOT_SUPPORTED, set at pre-compile, default-value=false  # When RteImmediateRestart is set to true the RunnableEntitiy shall be immediately re-started after termination if it was activated by this RTEEvent while it was already started. This parameter shall not be set to true when the mapped RTEEvent refers to a RunnableEntity which minimumStartInterval attribute is > 0.
        enumeration RteOsSchedulePoint [0..1]: {CONDITIONAL, NONE, UNCONDITIONAL}, category=NOT_SUPPORTED, set at pre-compile  # Introduce a schedule point by explicitly calling Os Schedule service after the execution of the ExecutableEntity. The Rte generator is allowed to optimize several consecutive calls to Os schedule into one single call if the ExecutableEntity executions in between have been skipped. The absence of this parameter is interpreted as "NONE". It shall be considered an invalid configuration if the task is preemptable and the value of this parameter is not set to "NONE" or the parameter is absent. | The absence of this parameter is interpreted as "NONE". It shall be considered an invalid configuration if the task is preemptable and the value of this parameter is not set to "NONE" or the parameter is absent.
        integer RtePositionInTask [0..1]: 0..65535, set at pre-compile  # Each RunnableEntity mapped to an OsTask has a specific position within the task execution. For periodic activation this is the order of execution. For event driver activation this is the order of evaluation which actual RunnableEntity has to be executed. | For periodic activation this is the order of execution. For event driver activation this is the order of evaluation which actual RunnableEntity has to be executed.
        foreign reference RteEventRef: set at pre-compile, destination-type=RTE-EVENT  # Reference to the description of the RTEEvent which is pointing to the RunnableEntity being mapped. This allows a fine grained mapping of RunnableEntites based on the activating RTEEvent.
        reference RteMappedToTaskRef [0..1]: set at pre-compile, destination=OsTask  # Reference to the OsTask the RunnableEntity activated by the RteEventRef is mapped to. If no reference to the OsTask is specified the RunnableEntity shall be executed via a direct function call. | If no reference to the OsTask is specified the RunnableEntity shall be executed via a direct function call.
        reference RteUsedOsAlarmRef [0..1]: set at pre-compile, destination=OsAlarm  # If an OsAlarm is used to activate the OsTask this RteEvent is mapped to it shall be referenced here.
        reference RteUsedOsEventRef [0..1]: set at pre-compile, destination=OsEvent  # If an OsEvent is used to activate the OsTask this RteEvent is mapped to it shall be referenced here.
        reference RteUsedOsSchTblExpiryPointRef [0..1]: set at pre-compile, destination=OsScheduleTableExpiryPoint  # If an OsScheduleTableExpiryPoint is used to activate the OsTask this RteEvent is mapped to it shall be referenced here.
        reference RteVirtuallyMappedToTaskRef [0..1]: category=NOT_SUPPORTED, set at pre-compile, destination=OsTask  # Optional reference to an OsTask where the activation of this RteEvent shall be evaluated. The actual execution of the Runnable Entity shall happen in the OsTask referenced by RteMappedToTaskRef.
        reference RteActivationOsAlarmRef [0..1]: category=NOT_SUPPORTED, set at pre-compile, origin=AUTOEVER, destination=OsAlarm  # Reference to the OsAlarm for MinimumStartInterval of a RunnableEntity. If the value of MinimumStartInterval is a nonzero value, the Alarm has to be set.
        reference RteReceiverUsedOsEventRef [0..1]: set at pre-compile, origin=AUTOEVER, destination=OsEvent  # Reference to the event Receiver api.
        reference RteWaitOsAlarmRef [0..1]: category=NOT_SUPPORTED, set at pre-compile, origin=AUTOEVER, destination=OsAlarm  # Reference to the OsAlarm for Timeout of a Server Call Point. If the value of Timeout is a nonzero value, the Alarm has to be set.
        reference RteWaitOsEventRef [0..1]: set at pre-compile, origin=AUTOEVER, destination=OsEvent  # Reference to the OsEvent for Rte_Call/Rte_Result APIs. If the wait-point for a Server Call Point is needed, the Event has to be set.
      container RteExclusiveAreaImplementation [0..*]  # Specifies the implementation to be used for the data consistency of this ExclusiveArea.
        enumeration RteExclusiveAreaImplMechanism: {ALL_INTERRUPT_BLOCKING, COOPERATIVE_RUNNABLE_PLACEMENT, OS_INTERRUPT_BLOCKING, OS_RESOURCE}, set at pre-compile  # To be used implementation mechanism for the specified ExclusiveArea.
        foreign reference RteExclusiveAreaRef: set at pre-compile, destination-type=EXCLUSIVE-AREA  # Reference to the ExclusiveArea.
        reference RteExclusiveAreaOsResourceRef [0..1]: set at pre-compile, destination=OsResource  # Optional reference to an OsResource in case RteExclusiveAreaImplMechanism is configured to OS_RESOURCE for this ExclusiveArea.
      container RteNvRamAllocation [0..*]  # Specifies the relationship between the AtomicSwComponentType's NVRAMMapping / NVRAM needs and the NvM module configuration.
        linker symbol RteNvmRamBlockLocationSymbol [0..1]: category=NOT_SUPPORTED, set at pre-compile  # This is the name of the linker object name where the NVRam Block will be mirrored by the Nvm. This symbol will be resolved into the parameter"NvmRamBlockDataAddress" from the "NvmBlockDescriptor". | This symbol will be resolved into the parameter "NvmRamBlockDataAddress" from the "NvmBlockDescriptor".
        linker symbol RteNvmRomBlockLocationSymbol [0..1]: category=NOT_SUPPORTED, set at pre-compile  # This is the name of the linker object name where the NVRom Block will be accessed by the Nvm. This symbol will be resolved into the parameter "NvmRomBlockDataAddress" from the "NvmBlockDescriptor". | This symbol will be resolved into the parameter "NvmRomBlockDataAddress" from the "NvmBlockDescriptor".
        foreign reference RteSwNvRamMappingRef: category=NOT_SUPPORTED, set at pre-compile, destination-type=SWC-SERVICE-DEPENDENCY  # Reference to the SwSeriveDependency which is used to specify the NvBlockNeeds.
        symbolic name reference RteNvmBlockRef: category=NOT_SUPPORTED, set at pre-compile, destination=NvMBlockDescriptor  # Reference to the used NvM block for storage of the NVRAMMapping information.
    container RteSwComponentType [0..*]  # Representation of one SwComponentType for the base of all configuration parameter which are affecting the whole type and not a specific instance.
      foreign reference RteComponentTypeRef: set at pre-compile, destination-type=SW-COMPONENT-TYPE
      foreign reference RteImplementationRef [0..1]: category=NOT_SUPPORTED, set at pre-compile, destination-type=SWC-IMPLEMENTATION
      container RteComponentTypeCalibration [0..1]  # Specifies for each ParameterSwComponentType or AtomicSwComponentType whether calibration is enabled. If references to SwAddrMethod are provided in RteCalibrationSwAddrMethodRef only ParameterDataPrototypes with the referenced SwAddrMethod shall have software calibration support enabled. | If references to SwAddrMethod are provided in RteCalibrationSwAddrMethodRef only ParameterDataPrototypes with the referenced SwAddrMethod shall have software calibration support enabled.
        boolean RteCalibrationSupportEnabled: set at pre-compile  # Enables calibration support for the specified ParameterSwComponentType or AtomicSwComponentType.
        foreign reference RteCalibrationSwAddrMethodRef [0..*]: category=NOT_SUPPORTED, set at pre-compile, destination-type=SW-ADDR-METHOD  # Reference to the SwAddrMethod for which software calibration support shall be enabled.
    container RteInitializationBehavior [1..*]  # Specifies the initialization strategy for variables allocated by RTE with the purpose to implement VariableDataPrototypes. The container defines a set of RteSectionInitializationPolicys and one RteInitializationStrategy which is applicable for this set.
      enumeration RteInitializationStrategy: {RTE_INITIALIZATION_STRATEGY_AT_DATA_DECLARATION, RTE_INITIALIZATION_STRATEGY_AT_DATA_DECLARATION_AND_PARTITION_RESTART, RTE_INITIALIZATION_STRATEGY_AT_RTE_START_AND_PARTITION_RESTART, RTE_INITIALIZATION_STRATEGY_NONE}, category=NOT_SUPPORTED, set at pre-compile  # Definition of the initialization strategy applicable for the SectionInitializationPolicys selected by RteSectionInitializationPolicy.
      enumeration RteSectionInitializationPolicy [1..*]: {NO_INIT, INIT}, category=NOT_SUPPORTED, set at pre-compile, default-value=INIT  # This parameter describes the SectionInitializationPolicys for which a particular RTE initialization strategy applies. | The SectionInitializationPolicy describes the intended initialization of MemorySections. The following values are standardized in AUTOSAR Methodology: * '''NO-INIT''': No initialization and no clearing is performed. Such data elements must not be read before one has written a value into it. * '''INIT''': To be used for data that are initialized by every reset to the specified value (initValue). * '''POWER-ON-INIT''': To be used for data that are initialized by "Power On" to the specified value (initValue). Note: there might be several resets between power on resets. * '''CLEARED''': To be used for data that are initialized by every reset to zero. * '''POWER-ON-CLEARED''': To be used for data that are initialized by "Power On" to zero. Note: there might be several resets between power on resets.
