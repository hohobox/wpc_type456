AUTOSAR XML (schema 4-0-3)
# (C) 2019 HYUNDAI AUTRON Co., Ltd.
# Confidential Proprietary Information. Distribution Limited.
# Do Not Copy Without Prior Permission
package /AUTRON
  ecuc definition collection ParameterDefinition_Os: module=Os
  module definition Os: refined-module-def=Os, variants pre-compile  # Configuration of the Os (Operating System) module.
    container OsAlarm [0..*]  # An OsAlarm may be used to asynchronously inform or activate a specific task. It is possible to start alarms automatically at system start-up depending on the application mode.
      reference OsAlarmAccessingApplication [0..*]: set at pre-compile, destination=OsApplication  # Reference to applications which have an access to this object.
      reference OsAlarmCounterRef: set at pre-compile, destination=OsCounter  # Reference to the assigned counter for that alarm
      choice container OsAlarmAction  # This container defines which type of notification is used when the alarm expires.
        container OsAlarmActivateTask [0..1]  # This container specifies the parameters to activate a task.
          reference OsAlarmActivateTaskRef: set at pre-compile, destination=OsTask  # Reference to the task that will be activated by that alarm action
        container OsAlarmCallback [0..1]  # This container specifies the parameters to call a callback OS alarm action.
          function name OsAlarmCallbackName: set at pre-compile  # Name of the function that is called when this alarm callback is triggered.
        container OsAlarmIncrementCounter [0..1]  # This container specifies the parameters to increment a counter.
          reference OsAlarmIncrementCounterRef: set at pre-compile, destination=OsCounter  # Reference to the counter that will be incremented by that alarm action
        container OsAlarmSetEvent [0..1]  # This container specifies the parameters to set an event
          reference OsAlarmSetEventRef: set at pre-compile, destination=OsEvent  # Reference to the event that will be set by that alarm action
          reference OsAlarmSetEventTaskRef: set at pre-compile, destination=OsTask  # Reference to the task that will be activated by that event
      container OsAlarmAutostart [0..1]  # If present this container defines if an alarm is started automatically at system start-up depending on the application mode.
        integer OsAlarmAlarmTime: 0..4294967295, set at pre-compile, default-value=1  # The relative or absolute tick value when the alarm expires for the first time. Note that for an alarm which is RELATIVE the value must be at bigger than 0.
        enumeration OsAlarmAutostartType: {ABSOLUTE, RELATIVE}, set at pre-compile, default-value=RELATIVE  # This specifies the type of autostart for the alarm. | ABSOLUTE : The alarm is started on startup via SetAbsAlarm(). RELATIVE : The alarm is started on startup via SetRelAlarm().
        integer OsAlarmCycleTime: 0..4294967295, set at pre-compile, default-value=1  # Cycle time of a cyclic alarm in ticks. If the value is 0 than the alarm is not cyclic.
        reference OsAlarmAppModeRef [1..*]: set at pre-compile, destination=OsAppMode  # Reference to the application modes for which the AUTOSTART shall be performed
    container OsAppMode [1..*]  # OsAppMode is the object used to define OSEK OS properties for an OSEK OS application mode. | No standard attributes are defined for AppMode. In a CPU, at least one AppMode object has to be defined. [source: OSEK OIL Spec. 2.5] An OsAppMode called OSDEFAULTAPPMODE must always be there for OSEK compatilbility.
    container OsApplication [0..*]  # An AUTOSAR OS must be capable of supporting a collection of OS objects (tasks, interrupts, alarms, hooks etc.) that form a cohesive functional unit. This collection of objects is termed an OS-Application. | All objects which belong to the same OS-Application have access to each other. Access means to allow to use these objects within API services. Access by other applications can be granted separately.
      integer OsApplicationCoreAssignment [0..1]: 0..65534, set at pre-compile, default-value=0  # ID of the core onto which the OsApplication is bound.
      boolean OsTrusted: set at pre-compile, default-value=false  # Parameter to specify if an OS-Application is trusted or not. | true: OS-Application is trusted false: OS-Application is not trusted (default)
      integer OsApplicationStackSize: 8..2147483644, set at pre-compile, origin=AUTRON, default-value=1024  # The stack size in OS-Application is designated.
      reference OsAppAlarmRef [0..*]: set at pre-compile, destination=OsAlarm  # Specifies the OsAlarms that belong to the OsApplication.
      reference OsAppCounterRef [0..*]: set at pre-compile, destination=OsCounter  # References the OsCounters that belong to the OsApplication.
      reference OsAppEcucPartitionRef [0..1]: set at pre-compile, destination=EcucPartition  # Denotes which "EcucPartition" is implemented by this "OSApplication".
      reference OsAppIsrRef [0..*]: set at pre-compile, destination=OsIsr  # references which OsIsrs belong to the OsApplication
      reference OsAppScheduleTableRef [0..*]: set at pre-compile, destination=OsScheduleTable  # References the OsScheduleTables that belong to the OsApplication.
      reference OsAppTaskRef [0..*]: set at pre-compile, destination=OsTask  # references which OsTasks belong to the OsApplication
      reference OsRestartTask [0..1]: set at pre-compile, destination=OsTask  # Optionally one task of an OS-Application may be defined as Restart Task. | Multiplicity = 1: Restart Task is activated by the Operating System if the protection hook requests it. Multiplicity = 0: No task is automatically started after a protection error happened.
      reference OsAppResourceRef [0..*]: set at pre-compile, destination=OsResource  # References the OsResources that belong to the OsApplication.
      container OsApplicationHooks  # Container to structure the OS-Application-specific hooks
        boolean OsAppErrorHook: category=FIXED, set at pre-compile, default-value=false  # Select the OS-Application error hook. | true: Hook is called false: Hook is not called
        boolean OsAppShutdownHook: category=FIXED, set at pre-compile, default-value=false  # Select the OS-Application specific shutdown hook for the OS-Application. | true: Hook is called false: Hook is not called
        boolean OsAppStartupHook: category=FIXED, set at pre-compile, default-value=false  # Select the OS-Application specific startup hook for the OS-Application. | true: Hook is called false: Hook is not called
      container OsApplicationTrustedFunction [0..*]  # Container to structure the configration parameters of trusted functions
        function name OsTrustedFunctionName: set at pre-compile  # Trusted function (as part of a trusted OS-Application) available to other OS-Applications. This also supersedes the OSEK OIL attribute TRUSTED in APPLICATION because the optionality of this parameter is describing that already.
    container OsCounter [0..*]  # Configuration information for the counters that belong to the OsApplication.
      integer OsCounterMaxAllowedValue: 1..4294967295, category=FIXED, set at pre-compile, default-value=1  # Maximum possible allowed value of the system counter in ticks.
      integer OsCounterMinCycle: 1..4294967295, category=FIXED, set at pre-compile, default-value=1  # The MINCYCLE attribute specifies the minimum allowed number of counter ticks for a cyclic alarm linked to the counter.
      integer OsCounterTicksPerBase: 1..4294967295, category=FIXED, set at pre-compile, default-value=1  # The TICKSPERBASE attribute specifies the number of ticks required to reach a counterspecific unit. The interpretation is implementation-specific.
      enumeration OsCounterType: {HARDWARE, SOFTWARE}, category=FIXED, set at pre-compile, default-value=SOFTWARE  # This parameter contains the natural type or unit of the counter. | HARDWARE : This counter is driven by some hardware e.g. a hardware timer unit. SOFTWARE : The counter is driven by some software which calls the IncrementCounter service.
      enumeration OsDrivingInterrupt [0..1]: {SYSTICK}, category=FIXED, set at pre-compile, origin=AUTRON  # Port Specific interrupt which drives the HARDWARE counter. On occurance of this interrupt the counter is incremented by 1.
      float OsSecondsPerTick [0..1]: 0..0.067, set at pre-compile, default-value=0.0000001  # Time of one counter tick in seconds.
      integer OsCounterHardwarePriority [0..1]: 1..7, category=FIXED, set at pre-compile, origin=AUTRON, default-value=1  # The hardware priority of the Counter ISR. If this parameter is not set, assign priority automatically.(CAT2 ISR max priority + 1)
      reference OsCounterAccessingApplication [0..*]: set at pre-compile, destination=OsApplication  # Reference to applications which have an access to this object.
      container OsDriver [0..1]  # This Container contains the information who will drive the counter. | This configuration is only valid if the counter has OsCounterType set to HARDWARE. If the container does not exist (multiplicity=0) the timer is managed by the OS internally (OSINTERNAL). If the container exists the OS can use the GPT interface to manage the timer. The user have to supply the GPT channel. If the counter is driven by some other (external to the OS) source (like a TPU for example) this must be described as a vendor specific extension.
        reference OsGptChannelRef [0..1]: category=NOT_SUPPORTED, set at pre-compile, destination=GptChannelConfiguration  # Reference to the GPT channel.
      container OsTimeConstant [0..*]  # Allows the user to define constants which can be e.g. used to compare time values with timer tick values. | A time value will be converted to a timer tick value during generation and can later on accessed via the OsConstName. The conversation is done by rounding time values to the nearest fitting tick value.
        float OsTimeValue: 0..4294967296, set at pre-compile, default-value=0.001  # This parameter contains the value of the constant in seconds.
        string OsConstName: set at pre-compile, origin=AUTRON  # The name which is accessed by the application to get the above OsTimeValue.
    container OsEvent [0..*]  # Representation of OS events in the configuration context. Adopted from the OSEK OIL specification.
      integer OsEventMask [0..1]: 0..4294967295, set at pre-compile, default-value=0  # If event mask would be set to AUTO in OIL, this parameter should be omitted here. This paramter will not be used by the OS and event mask will be provided by the Os generator.
    container OsIoc [0..1]  # Configuration of the IOC (Inter OS Application Communicator).
      container OsIocCommunication [0..*]  # Representation of a 1:1 or N:1 communication between software parts located in different OS-Applications that are bound to the same or to different cores. | The name shall begin with the name of the sending software service and be followed by a unique identifier delivered by the sending software service. In the case of RTE as user attention shall be paid on the fact that uniqueness for identifier names has to be reached over ports, data elements, object instances and maybe additional identification properties (E.g. Case 1:N mapping to 1:1). Example: - <NameSpace>_UniqueID
        integer OsIocBufferLength [0..1]: 0..4294967295, set at pre-compile, default-value=1  # This attribute defines the size of the IOC internal queue to be allocated for a queued communication. | This configuration information shall allow the optimization of the needed memory for communications requiring buffers within the RTE and within the IOC.
        container OsIocDataProperties [1..*]  # Data properties of the data to be transferred on the IOC communication channel.
          integer OsIocDataPropertyIndex [0..1]: 0..255, set at pre-compile, default-value=0  # This parameter is used to define in which order the data is send, e.g. whether IocSendGroup(A,B) or IocSendGroup(B,A) shall be used.
          string OsIocInitValue [0..1]: set at pre-compile  # Initial Value for the data to be transferred on the IOC communication channel.
          foreign reference OsIocDataTypeRef: set at pre-compile, destination-type=IMPLEMENTATION-DATA-TYPE  # This is the type of the data to be transferred on the IOC communication channel. This attribute is necessary to generate the parameter type of the Ioc functions. Additionally this information should be used to compute the data size for necessary data copy operations within the Ioc module. | If more than one attribute is defined, the IOC generator should generate an IocXxxGroup function (Xxx= CHOICE [Send, Receive, Write, Read]). N:1 communication (Multiplicity of OsIocSenderProperties > 1) is only allowed for multiplicity of OsIocDataRef = 1
        container OsIocReceiverProperties  # Representation of receiver properties for one communication. For each OsIocCommunication (1:1 or N:1) one receiver has to be defined. This container should be instanciated within an OsIocCommunication.
          enumeration OsIocFunctionImplementationKind [0..1]: {DO_NOT_CARE, FUNCTION, MACRO}, set at pre-compile, default-value=DO_NOT_CARE  # This parameter is used to select whether this communication is implemented as a macro or as a function. | DO_NOT_CARE : It is not defined whether a macro or a function is used. FUNCTION : Communication is implemented as a function. MACRO : Communication is implemented as a macro.
          function name OsIocReceiverPullCB [0..1]: set at pre-compile  # This attribute defines the name of a callback function that the IOC shall call on the receiving core for each data reception. | In case of non existence of this attribute no ReceiverPullCB notification shall be applied by the IOC. The name of the function shall begin with the name of the receiving module, followed with a callback name and followed by the IocId. Example: void RTE_ReceiverPullCB_RTE25 (void). If this attribute does not exist, it means that no ReceiverPullCB shall be called (No notification from IOC is required). If this attribute exists the IOC shall call the callback function on the receiving core.
          reference OsIocReceivingOsApplicationRef: set at pre-compile, destination=OsApplication  # This attribute is a reference to the receiving OsApplication instance defined in the configuration file of the OS. | This information allows for the generator to get additional information necessary for the code generation like: * The protection properties of the communicating OsApplications to find out which protections have to be crossed * The core identifiers to find out if an intra or an inter core communication has to be realized * Interrupt details in case of cross core notification to realize over IRQs
        container OsIocSenderProperties [1..*]  # Representation of sender properties for one communication. For each OsIocCommunication one (1:1) or many senders (N:1) have to be defined. Multiplicity > 1 (N:1 communication) is only allowed for Multiplicity of OsIocDataTypeRef = 1. | This container should be instanciated within an OsIocCommunication.
          enumeration OsIocFunctionImplementationKind [0..1]: {DO_NOT_CARE, FUNCTION, MACRO}, set at pre-compile, default-value=DO_NOT_CARE  # This parameter is used to select whether this communication is implemented as a macro or as a function. | DO_NOT_CARE : It is not defined whether a macro or a function is used. FUNCTION : Communication is implemented as a function. MACRO : Communication is implemented as a macro.
          integer OsIocSenderId [0..1]: 0..255, set at pre-compile, default-value=0  # Representation of a sender in a N:1 communication to distinguish between senders. | This parameter does not exist in 1:1 communication.
          reference OsIocSendingOsApplicationRef: set at pre-compile, destination=OsApplication  # This attribute is a reference to the sending OS-Application instance defined in the configuration file of the OS. | This information shall allows the generator to get additional information necessary for the code generation like: * The protection properties of the communicating OS-Applications to find out which protection boundaries have to be crossed. * The core identifiers to find out if an intra or an inter core communication has to be realized * Interrupt details in case of cross core notification to realize over IRQs
    container OsIsr [0..*]  # The OsIsr container represents an OSEK interrupt service routine.
      enumeration OsIsrCategory: {CATEGORY_1, CATEGORY_2}, category=FIXED, set at pre-compile, default-value=CATEGORY_2  # This attribute specifies the category of this ISR. | CATEGORY_1 : Interrupt is of category 1 CATEGORY_2 : Interrupt is of category 2 .
      enumeration OsIsrName: {CPUSS Inter Process Communication Interrupt #0(0), CPUSS Inter Process Communication Interrupt #1(1), CPUSS Inter Process Communication Interrupt #2(2), CPUSS Inter Process Communication Interrupt #3(3), CPUSS Inter Process Communication Interrupt #4(4), CPUSS Inter Process Communication Interrupt #5(5), CPUSS Inter Process Communication Interrupt #6(6), CPUSS Inter Process Communication Interrupt #7(7), CPUSS Fault Structure #0 Interrupt(8), CPUSS Fault Structure #1 Interrupt(9), CPUSS Fault Structure #2 Interrupt(10), CPUSS Fault Structure #3 Interrupt(11), BACKUP domain Interrupt(12), Multi Counter Watchdog Timer #0 interrupt(13), Multi Counter Watchdog Timer #1 interrupt(14), Hardware Watchdog Timer interrupt(15), Other combined Interrupts for SRSS [LVD, CLK_CAL](16), Serial Communication Block #0 [DeepSleep capable](17), Event gen DeepSleep domain interrupt(18), I/O Supply [V DDIO , V DDA , V DDD ] state change Interrupt(19), Consolidated Interrupt for GPIO_STD and GPIO_ENH, All Ports(20), GPIO_ENH Port #0 Interrupt(21), GPIO_STD Port #1 Interrupt(22), GPIO_STD Port #2 Interrupt(23), GPIO_STD Port #3 Interrupt(24), GPIO_STD Port #4 Interrupt(25), GPIO_STD Port #5 Interrupt(26), GPIO_STD Port #6 Interrupt(27), GPIO_STD Port #7 Interrupt(28), GPIO_STD Port #8 Interrupt(29), GPIO_STD Port #9 Interrupt(30), GPIO_STD Port #10 Interrupt(31), GPIO_STD Port #11 Interrupt(32), GPIO_STD Port #12 Interrupt(33), GPIO_STD Port #13 Interrupt(34), GPIO_STD Port #14 Interrupt(35), GPIO_STD Port #15 Interrupt(36), GPIO_STD Port #16 Interrupt(37), GPIO_STD Port #17 Interrupt(38), GPIO_STD Port #18 Interrupt(39), GPIO_STD Port #19 Interrupt(40), GPIO_STD Port #20 Interrupt(41), GPIO_STD Port #21 Interrupt(42), GPIO_STD Port #22 Interrupt(43), GPIO_STD Port #23 Interrupt(44), Active CRYPTO Accelerator Interrupt(45), Active FLASH Macro Interrupt(46), Active CM4 Floating Point operation fault(47), CM0+ CTI [Cross Trigger Interface] #0(48), CM0+ CTI #1(49), CM4 CTI #0(50), CM4 CTI #1(51), Event Generator Active domain interrupt(52), CAN0, Consolidated Interrupt #0 for all three channels(53), CAN0, Consolidated Interrupt #1 for all three channels(54), CAN1, Consolidated Interrupt #0 for all three channels(55), CAN1, Consolidated Interrupt #1 for all three channels(56), CAN0, Interrupt #0, Channel #0(57), CAN0, Interrupt #0, Channel #1(58), CAN0, Interrupt #0, Channel #2(59), CAN0, Interrupt #0, Channel #3(60), CAN0, Interrupt #1, Channel #0(61), CAN0, Interrupt #1, Channel #1(62), CAN0, Interrupt #1, Channel #2(63), CAN0, Interrupt #1, Channel #3(64), CAN1, Interrupt #0, Channel #0(65), CAN1, Interrupt #0, Channel #1(66), CAN1, Interrupt #0, Channel #2(67), CAN1, Interrupt #0, Channel #3(68), CAN1, Interrupt #1, Channel #0(69), CAN1, Interrupt #1, Channel #1(70), CAN1, Interrupt #1, Channel #2(71), CAN1, Interrupt #1, Channel #3(72), LIN0, Channel #0 Interrupt(73), LIN0, Channel #1 Interrupt(74), LIN0, Channel #2 Interrupt(75), LIN0, Channel #3 Interrupt(76), LIN0, Channel #4 Interrupt(77), LIN0, Channel #5 Interrupt(78), LIN0, Channel #6 Interrupt(79), LIN0, Channel #7 Interrupt(80), LIN0, Channel #8 Interrupt(81), LIN0, Channel #9 Interrupt(82), LIN0, Channel #10 Interrupt(83), LIN0, Channel #11 Interrupt(84), CXPI0 Channel #0 Interrupt(85), CXPI0 Channel #1 Interrupt(86), CXPI0 Channel #2 Interrupt(87), CXPI0 Channel #3 Interrupt(88), SCB1 Interrupt(89), SCB2 Interrupt(90), SCB3 Interrupt(91), SCB4 Interrupt(92), SCB5 Interrupt(93), SCB6 Interrupt(94), SCB7 Interrupt(95), SAR0, Channel #0 Interrupt(96), SAR0, Channel #1 Interrupt(97), SAR0, Channel #2 Interrupt(98), SAR0, Channel #3 Interrupt(99), SAR0, Channel #4 Interrupt(100), SAR0, Channel #5 Interrupt(101), SAR0, Channel #6 Interrupt(102), SAR0, Channel #7 Interrupt(103), SAR0, Channel #8 Interrupt(104), SAR0, Channel #9 Interrupt(105), SAR0, Channel #10 Interrupt(106), SAR0, Channel #11 Interrupt(107), SAR0, Channel #12 Interrupt(108), SAR0, Channel #13 Interrupt(109), SAR0, Channel #14 Interrupt(110), SAR0, Channel #15 Interrupt(111), SAR0, Channel #16 Interrupt(112), SAR0, Channel #17 Interrupt(113), SAR0, Channel #18 Interrupt(114), SAR0, Channel #19 Interrupt(115), SAR0, Channel #20 Interrupt(116), SAR0, Channel #21 Interrupt(117), SAR0, Channel #22 Interrupt(118), SAR0, Channel #23 Interrupt(119), SAR1, Channel #0 Interrupt(120), SAR1, Channel #1 Interrupt(121), SAR1, Channel #2 Interrupt(122), SAR1, Channel #3 Interrupt(123), SAR1, Channel #4 Interrupt(124), SAR1, Channel #5 Interrupt(125), SAR1, Channel #6 Interrupt(126), SAR1, Channel #7 Interrupt(127), SAR1, Channel #8 Interrupt(128), SAR1, Channel #9 Interrupt(129), SAR1, Channel #10 Interrupt(130), SAR1, Channel #11 Interrupt(131), SAR1, Channel #12 Interrupt(132), SAR1, Channel #13 Interrupt(133), SAR1, Channel #14 Interrupt(134), SAR1, Channel #15 Interrupt(135), SAR1, Channel #16 Interrupt(136), SAR1, Channel #17 Interrupt(137), SAR1, Channel #18 Interrupt(138), SAR1, Channel #19 Interrupt(139), SAR1, Channel #20 Interrupt(140), SAR1, Channel #21 Interrupt(141), SAR1, Channel #22 Interrupt(142), SAR1, Channel #23 Interrupt(143), SAR1, Channel #24 Interrupt(144), SAR1, Channel #25 Interrupt(145), SAR1, Channel #26 Interrupt(146), SAR1, Channel #27 Interrupt(147), SAR1, Channel #28 Interrupt(148), SAR1, Channel #29 Interrupt(149), SAR1, Channel #30 Interrupt(150), SAR1, Channel #31 Interrupt(151), SAR2, Channel #0 Interrupt(152), SAR2, Channel #1 Interrupt(153), SAR2, Channel #2 Interrupt(154), SAR2, Channel #3 Interrupt(155), SAR2, Channel #4 Interrupt(156), SAR2, Channel #5 Interrupt(157), SAR2, Channel #6 Interrupt(158), SAR2, Channel #7 Interrupt(159), CPUSS M-DMA0, Channel #0 Interrupt(160), CPUSS M-DMA0, Channel #1 Interrupt(161), CPUSS M-DMA0, Channel #2 Interrupt(162), CPUSS M-DMA0, Channel #3 Interrupt(163), CPUSS P-DMA0, Channel #0 Interrupt(164), CPUSS P-DMA0, Channel #1 Interrupt(165), CPUSS P-DMA0, Channel #2 Interrupt(166), CPUSS P-DMA0, Channel #3 Interrupt(167), CPUSS P-DMA0, Channel #4 Interrupt(168), CPUSS P-DMA0, Channel #5 Interrupt(169), CPUSS P-DMA0, Channel #6 Interrupt(170), CPUSS P-DMA0, Channel #7 Interrupt(171), CPUSS P-DMA0, Channel #8 Interrupt(172), CPUSS P-DMA0, Channel #9 Interrupt(173), CPUSS P-DMA0, Channel #10 Interrupt(174), CPUSS P-DMA0, Channel #11 Interrupt(175), CPUSS P-DMA0, Channel #12 Interrupt(176), CPUSS P-DMA0, Channel #13 Interrupt(177), CPUSS P-DMA0, Channel #14 Interrupt(178), CPUSS P-DMA0, Channel #15 Interrupt(179), CPUSS P-DMA0, Channel #16 Interrupt(180), CPUSS P-DMA0, Channel #17 Interrupt(181), CPUSS P-DMA0, Channel #18 Interrupt(182), CPUSS P-DMA0, Channel #19 Interrupt(183), CPUSS P-DMA0, Channel #20 Interrupt(184), CPUSS P-DMA0, Channel #21 Interrupt(185), CPUSS P-DMA0, Channel #22 Interrupt(186), CPUSS P-DMA0, Channel #23 Interrupt(187), CPUSS P-DMA0, Channel #24 Interrupt(188), CPUSS P-DMA0, Channel #25 Interrupt(189), CPUSS P-DMA0, Channel #26 Interrupt(190), CPUSS P-DMA0, Channel #27 Interrupt(191), CPUSS P-DMA0, Channel #28 Interrupt(192), CPUSS P-DMA0, Channel #29 Interrupt(193), CPUSS P-DMA0, Channel #30 Interrupt(194), CPUSS P-DMA0, Channel #31 Interrupt(195), CPUSS P-DMA0, Channel #32 Interrupt(196), CPUSS P-DMA0, Channel #33 Interrupt(197), CPUSS P-DMA0, Channel #34 Interrupt(198), CPUSS P-DMA0, Channel #35 Interrupt(199), CPUSS P-DMA0, Channel #36 Interrupt(200), CPUSS P-DMA0, Channel #37 Interrupt(201), CPUSS P-DMA0, Channel #38 Interrupt(202), CPUSS P-DMA0, Channel #39 Interrupt(203), CPUSS P-DMA0, Channel #40 Interrupt(204), CPUSS P-DMA0, Channel #41 Interrupt(205), CPUSS P-DMA0, Channel #42 Interrupt(206), CPUSS P-DMA0, Channel #43 Interrupt(207), CPUSS P-DMA0, Channel #44 Interrupt(208), CPUSS P-DMA0, Channel #45 Interrupt(209), CPUSS P-DMA0, Channel #46 Interrupt(210), CPUSS P-DMA0, Channel #47 Interrupt(211), CPUSS P-DMA0, Channel #48 Interrupt(212), CPUSS P-DMA0, Channel #49 Interrupt(213), CPUSS P-DMA0, Channel #50 Interrupt(214), CPUSS P-DMA0, Channel #51 Interrupt(215), CPUSS P-DMA0, Channel #52 Interrupt(216), CPUSS P-DMA0, Channel #53 Interrupt(217), CPUSS P-DMA0, Channel #54 Interrupt(218), CPUSS P-DMA0, Channel #55 Interrupt(219), CPUSS P-DMA0, Channel #56 Interrupt(220), CPUSS P-DMA0, Channel #57 Interrupt(221), CPUSS P-DMA0, Channel #58 Interrupt(222), CPUSS P-DMA0, Channel #59 Interrupt(223), CPUSS P-DMA0, Channel #60 Interrupt(224), CPUSS P-DMA0, Channel #61 Interrupt(225), CPUSS P-DMA0, Channel #62 Interrupt(226), CPUSS P-DMA0, Channel #63 Interrupt(227), CPUSS P-DMA0, Channel #64 Interrupt(228), CPUSS P-DMA0, Channel #65 Interrupt(229), CPUSS P-DMA0, Channel #66 Interrupt(230), CPUSS P-DMA0, Channel #67 Interrupt(231), CPUSS P-DMA0, Channel #68 Interrupt(232), CPUSS P-DMA0, Channel #69 Interrupt(233), CPUSS P-DMA0, Channel #70 Interrupt(234), CPUSS P-DMA0, Channel #71 Interrupt(235), CPUSS P-DMA0, Channel #72 Interrupt(236), CPUSS P-DMA0, Channel #73 Interrupt(237), CPUSS P-DMA0, Channel #74 Interrupt(238), CPUSS P-DMA0, Channel #75 Interrupt(239), CPUSS P-DMA0, Channel #76 Interrupt(240), CPUSS P-DMA0, Channel #77 Interrupt(241), CPUSS P-DMA0, Channel #78 Interrupt(242), CPUSS P-DMA0, Channel #79 Interrupt(243), CPUSS P-DMA0, Channel #80 Interrupt(244), CPUSS P-DMA0, Channel #81 Interrupt(245), CPUSS P-DMA0, Channel #82 Interrupt(246), CPUSS P-DMA0, Channel #83 Interrupt(247), CPUSS P-DMA0, Channel #84 Interrupt(248), CPUSS P-DMA0, Channel #85 Interrupt(249), CPUSS P-DMA0, Channel #86 Interrupt(250), CPUSS P-DMA0, Channel #87 Interrupt(251), CPUSS P-DMA0, Channel #88 Interrupt(252), CPUSS P-DMA0, Channel #89 Interrupt(253), CPUSS P-DMA0, Channel #90 Interrupt(254), CPUSS P-DMA0, Channel #91 Interrupt(255), CPUSS P-DMA1, Channel #0 Interrupt(256), CPUSS P-DMA1, Channel #1 Interrupt(257), CPUSS P-DMA1, Channel #2 Interrupt(258), CPUSS P-DMA1, Channel #3 Interrupt(259), CPUSS P-DMA1, Channel #4 Interrupt(260), CPUSS P-DMA1, Channel #5 Interrupt(261), CPUSS P-DMA1, Channel #6 Interrupt(262), CPUSS P-DMA1, Channel #7 Interrupt(263), CPUSS P-DMA1, Channel #8 Interrupt(264), CPUSS P-DMA1, Channel #9 Interrupt(265), CPUSS P-DMA1, Channel #10 Interrupt(266), CPUSS P-DMA1, Channel #11 Interrupt(267), CPUSS P-DMA1, Channel #12 Interrupt(268), CPUSS P-DMA1, Channel #13 Interrupt(269), CPUSS P-DMA1, Channel #14 Interrupt(270), CPUSS P-DMA1, Channel #15 Interrupt(271), CPUSS P-DMA1, Channel #16 Interrupt(272), CPUSS P-DMA1, Channel #17 Interrupt(273), CPUSS P-DMA1, Channel #18 Interrupt(274), CPUSS P-DMA1, Channel #19 Interrupt(275), CPUSS P-DMA1, Channel #20 Interrupt(276), CPUSS P-DMA1, Channel #21 Interrupt(277), CPUSS P-DMA1, Channel #22 Interrupt(278), CPUSS P-DMA1, Channel #23 Interrupt(279), CPUSS P-DMA1, Channel #24 Interrupt(280), CPUSS P-DMA1, Channel #25 Interrupt(281), CPUSS P-DMA1, Channel #26 Interrupt(282), CPUSS P-DMA1, Channel #27 Interrupt(283), CPUSS P-DMA1, Channel #28 Interrupt(284), CPUSS P-DMA1, Channel #29 Interrupt(285), CPUSS P-DMA1, Channel #30 Interrupt(286), CPUSS P-DMA1, Channel #31 Interrupt(287), CPUSS P-DMA1, Channel #32 Interrupt(288), CPUSS P-DMA1, Channel #33 Interrupt(289), CPUSS P-DMA1, Channel #34 Interrupt(290), CPUSS P-DMA1, Channel #35 Interrupt(291), CPUSS P-DMA1, Channel #36 Interrupt(292), CPUSS P-DMA1, Channel #37 Interrupt(293), CPUSS P-DMA1, Channel #38 Interrupt(294), CPUSS P-DMA1, Channel #39 Interrupt(295), CPUSS P-DMA1, Channel #40 Interrupt(296), CPUSS P-DMA1, Channel #41 Interrupt(297), CPUSS P-DMA1, Channel #42 Interrupt(298), CPUSS P-DMA1, Channel #43 Interrupt(299), TCPWM0 Group #0, Counter #0 Interrupt(300), TCPWM0 Group #0, Counter #1 Interrupt(301), TCPWM0 Group #0, Counter #2 Interrupt(302), TCPWM0 Group #0, Counter #3 Interrupt(303), TCPWM0 Group #0, Counter #4 Interrupt(304), TCPWM0 Group #0, Counter #5 Interrupt(305), TCPWM0 Group #0, Counter #6 Interrupt(306), TCPWM0 Group #0, Counter #7 Interrupt(307), TCPWM0 Group #0, Counter #8 Interrupt(308), TCPWM0 Group #0, Counter #9 Interrupt(309), TCPWM0 Group #0, Counter #10 Interrupt(310), TCPWM0 Group #0, Counter #11 Interrupt(311), TCPWM0 Group #0, Counter #12 Interrupt(312), TCPWM0 Group #0, Counter #13 Interrupt(313), TCPWM0 Group #0, Counter #14 Interrupt(314), TCPWM0 Group #0, Counter #15 Interrupt(315), TCPWM0 Group #0, Counter #16 Interrupt(316), TCPWM0 Group #0, Counter #17 Interrupt(317), TCPWM0 Group #0, Counter #18 Interrupt(318), TCPWM0 Group #0, Counter #19 Interrupt(319), TCPWM0 Group #0, Counter #20 Interrupt(320), TCPWM0 Group #0, Counter #21 Interrupt(321), TCPWM0 Group #0, Counter #22 Interrupt(322), TCPWM0 Group #0, Counter #23 Interrupt(323), TCPWM0 Group #0, Counter #24 Interrupt(324), TCPWM0 Group #0, Counter #25 Interrupt(325), TCPWM0 Group #0, Counter #26 Interrupt(326), TCPWM0 Group #0, Counter #27 Interrupt(327), TCPWM0 Group #0, Counter #28 Interrupt(328), TCPWM0 Group #0, Counter #29 Interrupt(329), TCPWM0 Group #0, Counter #30 Interrupt(330), TCPWM0 Group #0, Counter #31 Interrupt(331), TCPWM0 Group #0, Counter #32 Interrupt(332), TCPWM0 Group #0, Counter #33 Interrupt(333), TCPWM0 Group #0, Counter #34 Interrupt(334), TCPWM0 Group #0, Counter #35 Interrupt(335), TCPWM0 Group #0, Counter #36 Interrupt(336), TCPWM0 Group #0, Counter #37 Interrupt(337), TCPWM0 Group #0, Counter #38 Interrupt(338), TCPWM0 Group #0, Counter #39 Interrupt(339), TCPWM0 Group #0, Counter #40 Interrupt(340), TCPWM0 Group #0, Counter #41 Interrupt(341), TCPWM0 Group #0, Counter #42 Interrupt(342), TCPWM0 Group #0, Counter #43 Interrupt(343), TCPWM0 Group #0, Counter #44 Interrupt(344), TCPWM0 Group #0, Counter #45 Interrupt(345), TCPWM0 Group #0, Counter #46 Interrupt(346), TCPWM0 Group #0, Counter #47 Interrupt(347), TCPWM0 Group #0, Counter #48 Interrupt(348), TCPWM0 Group #0, Counter #49 Interrupt(349), TCPWM0 Group #0, Counter #50 Interrupt(350), TCPWM0 Group #0, Counter #51 Interrupt(351), TCPWM0 Group #0, Counter #52 Interrupt(352), TCPWM0 Group #0, Counter #53 Interrupt(353), TCPWM0 Group #0, Counter #54 Interrupt(354), TCPWM0 Group #0, Counter #55 Interrupt(355), TCPWM0 Group #0, Counter #56 Interrupt(356), TCPWM0 Group #0, Counter #57 Interrupt(357), TCPWM0 Group #0, Counter #58 Interrupt(358), TCPWM0 Group #0, Counter #59 Interrupt(359), TCPWM0 Group #0, Counter #60 Interrupt(360), TCPWM0 Group #0, Counter #61 Interrupt(361), TCPWM0 Group #0, Counter #62 Interrupt(362), TCPWM0 Group #1, Counter #0 Interrupt(363), TCPWM0 Group #1, Counter #1 Interrupt(364), TCPWM0 Group #1, Counter #2 Interrupt(365), TCPWM0 Group #1, Counter #3 Interrupt(366), TCPWM0 Group #1, Counter #4 Interrupt(367), TCPWM0 Group #1, Counter #5 Interrupt(368), TCPWM0 Group #1, Counter #6 Interrupt(369), TCPWM0 Group #1, Counter #7 Interrupt(370), TCPWM0 Group #1, Counter #8 Interrupt(371), TCPWM0 Group #1, Counter #9 Interrupt(372), TCPWM0 Group #1, Counter #10 Interrupt(372), TCPWM0 Group #1, Counter #11 Interrupt(374), TCPWM0 Group #2, Counter #0 Interrupt(375), TCPWM0 Group #2, Counter #1 Interrupt(376), TCPWM0 Group #2, Counter #2 Interrupt(377), TCPWM0 Group #2, Counter #3 Interrupt(378), TCPWM0 Group #2, Counter #4 Interrupt(379), TCPWM0 Group #2, Counter #5 Interrupt(380), TCPWM0 Group #2, Counter #6 Interrupt(381), TCPWM0 Group #2, Counter #7 Interrupt(382)}, set at pre-compile, origin=AUTRON  # Peripheral interrupt source for this Interrupt | Peripheral interrupt source for this Interrupt.
      integer OsIsrHardwarePriority: 1..7, set at pre-compile, origin=AUTRON, default-value=7  # The hardware priority of the ISR.
      string OsIsrComment [0..1]: set at pre-compile, origin=AUTRON  # The parameter can be used for another name of ISR or description field.
      reference OsIsrResourceRef [0..*]: set at pre-compile, destination=OsResource  # This reference defines the resources accessed by this ISR.
      container OsIsrTimingProtection [0..1]  # This container contains all parameters which are related to timing protection | If the container exists, the timing protection is used for this interrupt. If the container does not exist, the interrupt is not supervised regarding timing violations.
        float OsIsrAllInterruptLockBudget [0..1]: 0..4294967296, category=FIXED, set at pre-compile, default-value=0  # This parameter contains the maximum time for which the ISR is allowed to lock all interrupts (via SuspendAllInterrupts() or DisableAllInterrupts()) (in seconds).
        float OsIsrExecutionBudget [0..1]: 0..4294967296, set at pre-compile, default-value=0  # The parameter contains the maximum allowed execution time of the interrupt (in seconds).
        float OsIsrOsInterruptLockBudget [0..1]: 0..4294967296, category=FIXED, set at pre-compile, default-value=0  # This parameter contains the maximum time for which the ISR is allowed to lock all Category 2 interrupts (via SuspendOSInterrupts()) (in seconds).
        float OsIsrTimeFrame [0..1]: 0..4294967296, category=FIXED, set at pre-compile, default-value=0  # This parameter contains the minimum inter-arrival time between successive interrupts (in seconds).
        container OsIsrResourceLock [0..*]  # This container contains a list of times the interrupt uses resources.
          float OsIsrResourceLockBudget: 0..4294967296, category=FIXED, set at pre-compile, default-value=0  # This parameter contains the maximum time the interrupt is allowed to hold the given resource (in seconds).
          reference OsIsrResourceLockResourceRef: category=FIXED, set at pre-compile, destination=OsResource  # Reference to the resource the locking time is depending on
    container OsOS  # OS is the object used to define OSEK OS properties for an OSEK application. | Per CPU exactly one OS object has to be defined.
      integer OsNumberOfCores [0..1]: 1..65535, category=FIXED, set at pre-compile, default-value=1  # Maximum number of cores that are controlled by the OS. | The OS uses the value internally. It depends on the ECU HW.
      enumeration OsScalabilityClass [0..1]: {SC1, SC2, SC3, SC4}, category=FIXED, set at pre-compile, default-value=SC1  # A scalability class for each System Object "OS" has to be selected. In order to customize the operating system to the needs of the user and to take full advantage of the processor features the operating system can be scaled according to the scalability classes. | If the scalability class is omitted this translates to the OIL AUTO mechanism SC1 : Basic functionalities of OS SC2 : Functionality related to timing protection and synchronization SC3 : Functionality related to memory protection SC4 : Combination of SC1, SC2 and SC3 scalability classes.
      boolean OsStackMonitoring: category=FIXED, set at pre-compile, default-value=false  # Select stack monitoring of Tasks/Category 2 ISRs | true: Stacks are monitored false: Stacks are not monitored
      enumeration OsStatus: {EXTENDED, STANDARD}, category=FIXED, set at pre-compile, default-value=EXTENDED  # The Status attribute specifies whether a system with standard or extended status has to be used. Automatic assigment is not supported for this attribute. | STANDARD : The Standard status does the normal checks on calling operating system services. EXTENDED : The extended status allows for enhanced plausibility checks on calling operating system services.
      boolean OsUseGetServiceId: category=FIXED, set at pre-compile, default-value=true  # As defined by OSEK | true : provides the service identifier where the error has been risen. false : Does not provide the service identifier where the error has been risen.
      boolean OsUseParameterAccess: category=FIXED, set at pre-compile, default-value=true  # As defined by OSEK | true : Enables user parameter access. false : Disables user parameter access
      boolean OsUseResScheduler: category=FIXED, set at pre-compile, default-value=true  # The OsUseResScheduler attribute defines whether the resource RES_SCHEDULER is used within the application. | true : The task that takes this resource cannot be pre empted. false : The task that takes this resource can be pre empted.
      string OsProcessor: category=FIXED, set at pre-compile, origin=AUTRON, default-value=CYT2BL, max-length=50, min-length=1  # Os Processor name is designated by this parameter.
      enumeration OsProcessorSeries: {CYT2BL}, category=FIXED, set at pre-compile, origin=AUTRON, default-value=CYT2B9  # Os Processor name is designated by this parameter.
      string OsIncludeHeaderFile [0..1]: category=FIXED, set at pre-compile, origin=AUTRON  # Name of the header file if any to be included in Os build.
      integer OsUserStackSize: 8..2147483644, set at pre-compile, origin=AUTRON, default-value=1024  # This parameter gives User Stack size | The OS uses the value internally. It depends on the ECU HW.
      float OsWdgSecondsPerTick [0..1]: 0.0..4294967295.0, category=FIXED, set at pre-compile, origin=AUTRON, default-value=0.0  # Time of one hardware tick in seconds for Watchdog Timer.This is equal to width of 1 clock pulse in terms of seconds.
      integer OsSystemTimerClock: 4..160, category=FIXED, set at pre-compile, origin=AUTRON, default-value=80  # The clock frequency of timer in MHz unit which is used for HW type OS Counter
      enumeration OsStackFrame: {StackFrame4, StackFrame8, StackFrame16, StackFrame32}, category=FIXED, set at pre-compile, origin=AUTRON, default-value=StackFrame8  # This parameter gives frame size of the Stack in bytes. | The OS uses the value internally. It depends on the ECU HW.
      boolean OsFpuSupport: set at pre-compile, origin=AUTRON_v1.0.0, default-value=false  # The OsFpuSupport attribute defines whether to support saving and restoring FPU registers during context switching. If OsFpuSupport is 'true', 132 bytes of memory per Task or CAT2 ISR will be used additionally.
      container OsHooks  # Container to structure all hooks belonging to the OS
        boolean OsErrorHook: category=FIXED, set at pre-compile, default-value=true  # Error hook as defined by OSEK | true: Hook is called false: Hook is not called
        boolean OsPostTaskHook: category=FIXED, set at pre-compile, default-value=false  # Post-task hook as defined by OSEK | true: Hook is called false: Hook is not called
        boolean OsPreTaskHook: category=FIXED, set at pre-compile, default-value=false  # Pre-task hook as defined by OSEK | true: Hook is called false: Hook is not called
        boolean OsProtectionHook [0..1]: category=FIXED, set at pre-compile, default-value=false  # Switch to enable/disable the call to the (user supplied) protection hook. | true: Protection hook is called on protection error false: Protection hook is not called
        boolean OsShutdownHook: category=FIXED, set at pre-compile, default-value=false  # Shutdown hook as defined by OSEK | true: Hook is called false: Hook is not called
        boolean OsStartupHook: category=FIXED, set at pre-compile, default-value=false  # Startup hook as defined by OSEK | true: Hook is called false: Hook is not called
        boolean OsProfilingHook: category=FIXED, set at pre-compile, origin=AUTRON, default-value=false  # Provide following hook functions for profiling Task and Category 2 ISR state information - Os_IsrEntryHook() - Os_IsrExitHook() - Os_IsrKillHook() - Os_TaskActivationHook() - Os_TaskTerminationHook() - Os_TaskPreemptionHook() - Os_TaskRunningHook() - Os_TaskWaitingHook() - Os_TaskReleaseHook() - Os_TaskKillHook() - Os_IdleEntryHook() - Os_IdleExitHook()
      container OsMpuRegion [0..*]  # Container with details about memory area accessible to the Application
        integer OsMpuRegionNumber: 0..6, set at pre-compile, origin=AUTRON  # Defines the number of MPU region to be accessed.
        boolean OsMpuRegionEnabledOnStart: set at pre-compile, origin=AUTRON  # Enables a memory region before OS starts
        integer OsMpuRegionBaseAddress: 0..4294967295, set at pre-compile, origin=AUTRON  # The base address defines the start of the memory region. You must align this to a region-sized boundary. For example, if a region size of 8KB is programmed for a given region, the base address must be a multiple of 8KB.
        enumeration OsMpuRegionSize: {Size32bytes, Size64bytes, Size128bytes, Size256bytes, Size512bytes, Size1KB, Size2KB, Size4KB, Size8KB, Size16KB, Size32KB, Size64KB, Size128KB, Size256KB, Size512KB, Size1MB, Size2MB, Size4MB, Size8MB, Size16MB, Size32MB, Size64MB, Size128MB, Size256MB, Size512MB, Size1GB, Size2GB}, set at pre-compile, origin=AUTRON  # Specifies the size of the region specified by the Memory Region Number Register.
        enumeration OsMpuRegionRwPermission: {NONE_NONE, RW_NONE, RW_RO, RW_RW, RO_NONE, RO_RO}, set at pre-compile, origin=AUTRON  # Access permission. Defines the data access permissions. Each region can be given no access, read-only access, or read/write access permissions for Privileged or all modes. PrivilegedPermission_UserPermission
        integer OsMpuRegionSubregionDisable: 0..255, set at pre-compile, origin=AUTRON  # Each bit position represents a sub-region, 0-7 The meaning of each bit is: 0 = address range is part of this region 1 = address range is not part of this region. Each region can be split into eight equal sized non-overlapping subregions. An access to a memory address in a disabled subregion does not use the attributes and permissions defined for that region. Instead, it uses the attributes and permissions of a lower priority region or generates a background fault if no other regions overlap at that address. This enables increased protection and memory attribute granularity. All region sizes between 256 bytes and 4GB support eight subregions. Region sizes below 256 bytes do not support subregions, and the subregion disable field is SBZ/UNP for regions of less than 256 bytes in size.
        boolean OsMpuRegionExecutionPermission: set at pre-compile, origin=AUTRON  # Determines if a region of memory is executable
        enumeration OsMpuRegionAttribute: {StronglyOrdered, Device_Shareable, Device_NonShareable, Normal_WT_NoWA_Shareable, Normal_WT_NoWA_NonShareable, Normal_WB_NoWA_Shareable, Normal_WB_NoWA_NonShareable, Normal_NonCacheable_Shareable, Normal_NonCacheable_NonShareable, Normal_WB_WA_Shareable, Normal_WB_WA_NonShareable}, set at pre-compile, origin=AUTRON  # Each region has a number of attributes associated with it. These control how a memory access is performed when the processor accesses an address that falls within a given region. The attributes are: • Memory type, see Memory types on page 7-7, one of: - Strongly Ordered - Device - Normal. • Shared or Non-shared • Non-cacheable • Write-through cacheable • Write-back cacheable • Read allocation • Write allocation.
        string OsMpuRegionLinkerSection [0..1]: origin=AUTRON  # Linker sections that should be located in MPU region. ex) Code section : ".text.ECUC_PARTITION_NAME*" Read only data section : ".rodata.ECUC_PARTITION_NAME*" Variable section : ".data.ECUC_PARTITION_NAME*" ".bss.ECUC_PARTITION_NAME*"
        reference OsMpuRegionAccessingApplication [0..1]: set at pre-compile, origin=AUTRON, destination=OsApplication  # Reference to applications which have an access to this object.
    container OsResource [0..*]  # An OsResource object is used to co-ordinate the concurrent access by tasks and ISRs to a shared resource, e.g. the scheduler, any program sequence, memory or any hardware area.
      enumeration OsResourceProperty: {INTERNAL, LINKED, STANDARD}, set at pre-compile, default-value=STANDARD  # This specifies the type of the resource. | INTERNAL : The resource is an internal resource. LINKED : The resource is a linked resource (a second name for a existing resource). STANDARD : The resource is a standard resource.
      reference OsResourceAccessingApplication [0..*]: set at pre-compile, destination=OsApplication  # Reference to applications which have an access to this object.
      reference OsResourceLinkedResourceRef [0..1]: category=NOT_SUPPORTED, set at pre-compile, destination=OsResource  # The link to the resource. Must be valid if OsResourceProperty is LINKED. If OsResourceProperty is not LINKED the value is ignored.
    container OsScheduleTable [0..*]  # An OsScheduleTable addresses the synchronization issue by providing an encapsulation of a statically defined set of alarms that cannot be modified at runtime.
      integer OsScheduleTableDuration: 0..4294967295, set at pre-compile, default-value=1  # This parameter defines the modulus of the schedule table (in ticks).
      boolean OsScheduleTableRepeating: set at pre-compile, default-value=false  # This Paramter specifies the behaviour of the Schedule Table. | true: first expiry point on the schedule table shall be processed at final expiry point delay ticks after the final expiry point is processed. false: the schedule table processing stops when the final expiry point is processed.
      reference OsSchTblAccessingApplication [0..*]: set at pre-compile, destination=OsApplication  # Reference to applications which have an access to this object.
      reference OsScheduleTableCounterRef: set at pre-compile, destination=OsCounter  # This parameter contains a reference to the counter which drives the schedule table.
      container OsScheduleTableAutostart [0..1]  # This container specifies if and how the schedule table is started on startup of the Operating System. The options to start a schedule table correspond to the API calls to start schedule tables during runtime.
        enumeration OsScheduleTableAutostartType: {ABSOLUTE, RELATIVE, SYNCHRON}, set at pre-compile, default-value=RELATIVE  # This specifies the type of the autostart for the schedule table. | ABSOLUTE : The schedule table is started during startup with the StartScheduleTableAbs() service. RELATIVE : The schedule table is started during startup with the StartScheduleTableRel() service. SYNCHRON : The schedule table is started during startup with the StartScheduleTableSynchron() service.
        integer OsScheduleTableStartValue [0..1]: 0..4294967295, set at pre-compile, default-value=1  # Absolute autostart tick value when the schedule table starts. Only used if the OsScheduleTableAutostartType is ABSOLUTE. | Relative offset in ticks when the schedule table starts. Only used if the OsScheduleTableAutostartType is RELATIVE.
        reference OsScheduleTableAppModeRef [1..*]: set at pre-compile, destination=OsAppMode  # Reference in which application modes the schedule table should be started during startup
      container OsScheduleTableExpiryPoint [1..*]  # The point on a Schedule Table at which the OS activates tasks and/or sets events
        integer OsScheduleTblExpPointOffset: 0..4294967295, set at pre-compile, default-value=0  # The offset from zero (in ticks) at which the expiry point is to be processed.
        container OsScheduleTableEventSetting [0..*]  # Event that is triggered by that schedule table.
          reference OsScheduleTableSetEventRef: set at pre-compile, destination=OsEvent  # Reference to event that will be set by action
          reference OsScheduleTableSetEventTaskRef: set at pre-compile, destination=OsTask  # Reference to the task that will be activated by that event
        container OsScheduleTableTaskActivation [0..*]  # Task that is triggered by that schedule table.
          reference OsScheduleTableActivateTaskRef: set at pre-compile, destination=OsTask  # Reference to task that will be activated by action
        container OsScheduleTblAdjustableExpPoint [0..1]  # Adjustable expiry point
          integer OsScheduleTableMaxLengthen: 0..4294967295, set at pre-compile, default-value=0  # The maximum positive adjustment that can be made to the expiry point offset (in ticks).
          integer OsScheduleTableMaxShorten: 0..4294967295, set at pre-compile, default-value=0  # The maximum negative adjustment that can be made to the expiry point offset (in ticks).
      container OsScheduleTableSync [0..1]  # This container specifies the synchronization parameters of the schedule table.
        integer OsScheduleTblExplicitPrecision [0..1]: 0..4294967295, set at pre-compile, default-value=0  # This configuration is only valid if the explicit synchronisation is used.
        enumeration OsScheduleTblSyncStrategy: {EXPLICIT, IMPLICIT, NONE}, set at pre-compile, default-value=NONE  # AUTOSAR OS provides support for synchronisation in two ways: explicit and implicit. | EXPLICIT : The schedule table is driven by an OS counter but processing needs to be synchronized with a different counter which is not an OS counter object. IMPLICIT : The counter driving the schedule table is the counter with which synchronisation is required. NONE : No support for synchronisation(default).
    container OsSpinlock [0..*]  # An OsSpinlock object is used to co-ordinate concurrent access by TASKs/ISR2s on different cores to a shared resource.
      reference OsSpinlockAccessingApplication [1..*]: set at pre-compile, destination=OsApplication  # Reference to OsApplications that have an access to this object.
      reference OsSpinlockSuccessor [0..1]: set at pre-compile, destination=OsSpinlock  # Reference to OsApplications that have an access to this object. | To check whether a spinlock can be occupied (in a nested way) without any danger of deadlock, a linked list of spinlocks can be defined. A spinlock can only be occupied in the order of the linked list. It is allowed to skip a spinlock. If no linked list is specified, spinlocks cannot be nested.
    container OsTask [0..*]  # This container represents an OSEK task.
      integer OsTaskActivation: 1..4294967295, category=FIXED, set at pre-compile, default-value=1  # This attribute defines the maximum number of queued activation requests for the task. A value equal to "1" means that at any time only a single activation is permitted for this task. Note that the value must be a natural number starting at 1.
      integer OsTaskPriority: 0..4294967295, set at pre-compile, default-value=0  # The priority of a task is defined by the value of this attribute. This value has to be understood as a relative value, i.e. the values show only the relative ordering of the tasks. | OSEK OS defines the lowest priority as zero (0); larger values correspond to higher priorities.
      enumeration OsTaskSchedule: {FULL, NON}, category=FIXED, set at pre-compile, default-value=FULL  # The OsTaskSchedule attribute defines the preemptability of the task. | FULL : Task is preemptable. NON : Task is not preemptable.
      integer OsTaskStackSize [0..1]: 8..2147483644, set at pre-compile, origin=AUTRON, default-value=800  # The stack size in task is designated. The stack size can be unset for basic task.
      reference OsTaskAccessingApplication [0..*]: set at pre-compile, destination=OsApplication  # Reference to applications which have an access to this object.
      reference OsTaskEventRef [0..*]: set at pre-compile, destination=OsEvent  # This reference defines the list of events the extended task may react on.
      reference OsTaskResourceRef [0..*]: set at pre-compile, destination=OsResource  # This reference defines a list of resources accessed by this task.
      container OsTaskAutostart [0..1]  # This container determines whether the task is activated during the system start-up procedure or not for some specific application modes. | If the task shall be activated during the system start-up, this container is present and holds the references to the application modes in which the task is auto-started.
        reference OsTaskAppModeRef [1..*]: category=FIXED, set at pre-compile, destination=OsAppMode  # Reference to application modes in which that task is activated on startup of the OS
      container OsTaskTimingProtection [0..1]  # This container contains all parameters regarding timing protection of the task.
        float OsTaskAllInterruptLockBudget [0..1]: 0..4294967296, category=FIXED, set at pre-compile, default-value=0  # This parameter contains the maximum time for which the task is allowed to lock all interrupts (via SuspendAllInterrupts() or DisableAllInterrupts()) (in seconds).
        float OsTaskExecutionBudget [0..1]: 0..4294967296, set at pre-compile, default-value=0  # This parameter contains the maximum allowed execution time of the task (in seconds).
        float OsTaskOsInterruptLockBudget [0..1]: 0..4294967296, category=FIXED, set at pre-compile, default-value=0  # This parameter contains the maximum time for which the task is allowed to lock all Category 2 interrupts (via SuspendOSInterrupts()) (in seconds).
        float OsTaskTimeFrame [0..1]: 0..4294967296, category=FIXED, set at pre-compile, default-value=0  # The minimum inter-arrival time between activations and/or releases of a task (in seconds).
        container OsTaskResourceLock [0..*]  # This container contains the worst case time between getting and releasing a given resource (in seconds).
          float OsTaskResourceLockBudget: 0..4294967296, category=FIXED, set at pre-compile, default-value=0  # This parameter contains the maximum time the task is allowed to lock the resource (in seconds)
          reference OsTaskResourceLockResourceRef: category=FIXED, set at pre-compile, destination=OsResource  # Reference to the resource used by the task
