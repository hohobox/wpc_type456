AUTOSAR XML (schema 4-0-3)
# (C) 2013 HYUNDAI AUTRON Co., Ltd.
# Confidential Proprietary Information. Distribution Limited.
# Do Not Copy Without Prior Permission
package /AUTRON
  ecuc definition collection ParameterDefinition_CanTp: module=CanTp
  module definition CanTp: refined-module-def=CanTp, variants pre-compile  # Configuration of the CanTp (CAN Transport Protocol) module.
    container CanTpConfig  # This container contains the configuration parameters and sub containers of the AUTOSAR CanTp module. This container is a MultipleConfigurationContainer, i.e. this container and its sub-containers exist once per configuration set.
      float CanTpMainFunctionPeriod: 0..0.255, set at pre-compile  # Allow to configure the time for the MainFunction (as float in seconds). Please note: This period shall be the same as call cycle time of the periodic task were CanTp Main function is called.
      container CanTpChannel [1..*]  # This container contains the configuration parameters of the CanTp channel.
        enumeration CanTpChannelMode: {CANTP_MODE_FULL_DUPLEX, CANTP_MODE_HALF_DUPLEX}, category=FIXED, set at pre-compile  # The CAN Transport Layer supports half and full duplex channel modes. | Enum values: CANTP_MODE_FULL_DUPLEX. To use full duplex channel mode. CANTP_MODE_HALF_DUPLEX. To use half duplex channel mode.
        enumeration CanTpChannelLowerLayer [0..1]: {CanIf, CDD_Router}, set at pre-compile, origin=AUTOEVER, default-value=CanIf  # The CAN Transport Layer supports CanIf and CDD_Router as a lower layer. You can choose the lower layer between them. If this parameter is not configured, the lower layer is considered as CanIf. | Enum values: CanIf: Select CanIf as a Lower Layer CDD_Router: Select CDD_Router as a Lower Layer
        container CanTpRxNSdu [0..*]  # The following parameters needs to be configured for each CAN N-SDU that the CanTp module receives via the CanTpChannel.
          integer CanTpBs: 0..255, set at pre-compile, default-value=0  # Sets the number of N-PDUs the CanTp receiver allows the sender to send, before waiting for an authorization to continue transmission of the following N-PDUs.For further details on this parameter value see ISO 15765-2 specification.
          float CanTpNar: 0..65.535, set at pre-compile, default-value=1  # Value in seconds of the N_Ar timeout. N_Ar is the time for transmission of a CAN frame (any N_PDU) on the receiver side.
          float CanTpNbr: 0..65.535, set at pre-compile, default-value=0  # Value in seconds of the performance requirement for (N_Br + N_Ar). N_Br is the elapsed time between the receiving indication of a FF or CF or the transmit confirmation of a FC, until the transmit request of the next FC.
          float CanTpNcr: 0..65.535, set at pre-compile, default-value=1  # Value in seconds of the N_Cr timeout. N_Cr is the time until reception of the next Consecutive Frame N_PDU.
          enumeration CanTpRxAddressingFormat: {CANTP_EXTENDED, CANTP_MIXED, CANTP_STANDARD}, set at pre-compile  # Declares which communication addressing mode is supported for this Rx N-SDU. | Enum values: CANTP_STANDARD. To use normal addressing format. CANTP_EXTENDED. To use extended addressing format. CANTP_MIXED. To use mixed addressing format.
          integer CanTpRxDl: 0..65535, category=FIXED, set at pre-compile  # Data Length Code of this RxNsdu. In case of variable message length, this value indicates the minimum data length. | Depending on SF or FF N-SDU the value will be limited to 7 (6 for an extended addressing format) and 4095 respectively.
          integer CanTpRxNSduId: 0..65535, category=FIXED, set at pre-compile, symbolic-name-value=true  # Unique identifier user by the upper layer to call CanTp_CancelReceive, CanTp_ChangeParameter and CanTp_ReadParameter.
          enumeration CanTpRxPaddingActivation: {CANTP_OFF, CANTP_ON}, category=FIXED, set at pre-compile, symbolic-name-value=true  # Defines if the receive frame uses padding or not. | Definition of enumeration values: CANTP_ON: The N-PDU received uses padding for SF, FC and the last CF. (N-PDU length is always 8 bytes) CANTP_OFF: The N-PDU received does not use padding for SF, CF and the last CF. (N-PDU length is dynamic)
          enumeration CanTpRxTaType: {CANTP_CANFD_PHYSICAL, CANTP_CANFD_FUNCTIONAL, CANTP_FUNCTIONAL, CANTP_PHYSICAL}, category=CHANGEABLE, set at pre-compile  # Declares the communication type of this Rx N-SDU. | Definition of enumeration values: CANTP_FUNCTIONAL: The requested communication type is FUNCTIONAL. CANTP_PHYSICAL: The requested communication type is PHYSICAL.
          integer CanTpRxWftMax: 0..65535, set at pre-compile, default-value=0  # This parameter indicates how many Flow Control wait N-PDUs can be consecutively transmitted by the receiver. It is local to the node and is not transmitted inside the FC protocol data unit. | CanTpRxWftMax is used to avoid sender nodes being potentially hooked-up in case of a temporarily reception inability on the part of the receiver nodes, whereby the sender could be waiting continuously.
          float CanTpSTmin: 0..65.535, set at pre-compile, default-value=0.005  # Sets the duration of the minimum time the CanTp sender shall wait between the transmissions of two CF N-PDUs. | For further details on this parameter value see ISO 15765-2 specification.
          reference CanTpRxNSduRef: category=FIXED, set at pre-compile, destination=Pdu  # Reference to a Pdu in the COM-Stack.
          container CanTpNAe [0..1]: category=NOT_SUPPORTED  # Contains the parameters needed to configure each RxNSdu or TxNSdu with CanTpAddressingFormat set to CanTpMixed.
            integer CanTpNAe: 0..255, category=NOT_SUPPORTED, set at pre-compile  # If an RxNsdu or a TxNsdu is configured for mixed addressing | format, this parameter contains the transport protocol address extension value.
          container CanTpNSa [0..1]: category=NOT_SUPPORTED  # Contains the parameters needed to configure each RxNSdu or TxNSdu with CanTpAddressingFormat set to CanTpExtended.
            integer CanTpNSa: 0..255, category=NOT_SUPPORTED, set at pre-compile  # If an RxNSdu or a TxNSdu is configured for extended addressing format, this parameter contains the transport protocol source address's value.
          container CanTpNTa [0..1]: category=NOT_SUPPORTED  # The following parameters need to be configured for each RxNsdu or TxNsdu with the CanTpAddressingFormat set to CanTpExtended.
            integer CanTpNTa: 0..255, category=NOT_SUPPORTED, set at pre-compile  # If an RxNsdu or a TxNsdu is configured for extended addressing format, this parameter contains the transport protocol target address's value.
          container CanTpRxNPdu: category=FIXED  # Used for grouping of the ID of a PDU and the Reference to a PDU.
            integer CanTpRxNPduId: 0..65535, category=FIXED, set at pre-compile, symbolic-name-value=true  # The N-PDU identifier attached to the RxNsdu is identified by CanTpRxNSduId. | Each RxNsdu identifier is linked to only one SF/FF/CF N-PDU identifier. Nevertheless, in the case of extended or mixed addressing format, the same N-PDU identifier can be used for several N-SDU identifiers. The distinction is made by the N_TA or N_AE value (first data byte of SF or FF frames).
            reference CanTpRxNPduRef: category=FIXED, set at pre-compile, destination=Pdu  # Reference to a Pdu in the COM-Stack.
          container CanTpTxFcNPdu [0..1]: category=FIXED  # Used for grouping of the ID of a PDU and the Reference to a PDU.
            integer CanTpTxFcNPduConfirmationPduId: 0..65535, category=FIXED, set at pre-compile, symbolic-name-value=true  # Handle Id to be used by the CanIf to confirm the transmission of the CanTpTxFcNPdu to the CanIf module.
            reference CanTpTxFcNPduRef: category=FIXED, set at pre-compile, destination=Pdu  # Reference to a Pdu in the COM-Stack.
        container CanTpTxNSdu [0..*]  # The following parameters needs to be configured for each CAN N-SDU that the CanTp module transmits via the CanTpChannel.
          float CanTpNas: 0..65.535, set at pre-compile, default-value=1  # Value in second of the N_As timeout. N_As is the time for transmission of a CAN frame (any N_PDU) on the part of the sender.
          float CanTpNbs: 0..65.535, set at pre-compile, default-value=1  # Value in seconds of the N_Bs timeout. N_Bs is the time of transmission until reception of the next Flow Control N_PDU.
          float CanTpNcs: 0..65.535, set at pre-compile, default-value=0  # Value in seconds of the performance requirement of (N_Cs + N_As). N_Cs is the time which elapses between the transmit request of a CF N-PDU until the transmit request of the next CF N-PDU.
          boolean CanTpTc: category=FIXED, set at pre-compile, symbolic-name-value=true, default-value=true  # switch for enabling Transmit Cancellation. | True: Transmit Cancellation is Enabled False: Transmit Cancellation is Disabled
          enumeration CanTpTxAddressingFormat: {CANTP_EXTENDED, CANTP_MIXED, CANTP_STANDARD}, category=FIXED, set at pre-compile  # Declares which communication addressing format is supported for this TxNsdu. | Definition of Enumeration values: CANTP_EXTENDED to use normal addressing format. CANTP_EXTENDED to use extended addressing format (the N_TA container of this TxNsdu will be used). CANTP_MIXED to use mixed addressing format (the N_AE container of this TxNsdu will be used).
          integer CanTpTxDl: 0..65535, category=FIXED, set at pre-compile  # Data Length Code of this TxNsdu. In case of variable length message, this value indicates the minimum data length.
          integer CanTpTxNSduId: 0..65535, category=FIXED, set at pre-compile, symbolic-name-value=true  # Unique identifier to a structure that contains all useful information to process the transmission of a TxNsdu.
          enumeration CanTpTxPaddingActivation: {CANTP_OFF, CANTP_ON}, category=FIXED, set at pre-compile, symbolic-name-value=true  # Defines if the transmit frame use padding or not. | Definition of Enumeration values: CANTP_ON: The transmit N-PDU uses padding for SF, FC and the last CF. (N-PDU length is always 8 bytes) CANTP_OFF: The transmit N-PDU does not use padding for SF, CF and the last CF. (N-PDU length is dynamic)
          enumeration CanTpTxTaType: {CANTP_CANFD_PHYSICAL, CANTP_CANFD_FUNCTIONAL, CANTP_FUNCTIONAL, CANTP_PHYSICAL}, category=CHANGEABLE, set at pre-compile  # Declares the communication type of this TxNsdu. | Enumeration values: CANTP_PHYSICAL. Used for 1:1 communication. CANTP_FUNCTIONAL. Used for 1:n communication.
          reference CanTpTxNSduRef: category=FIXED, set at pre-compile, destination=Pdu  # Reference to a Pdu in the COM-Stack.
          container CanTpNAe [0..1]: category=NOT_SUPPORTED  # Contains the parameters needed to configure each RxNSdu or TxNSdu with CanTpAddressingFormat set to CanTpMixed.
            integer CanTpNAe: 0..255, category=NOT_SUPPORTED, set at pre-compile  # If an RxNsdu or a TxNsdu is configured for mixed addressing | format, this parameter contains the transport protocol address extension value.
          container CanTpNSa [0..1]: category=NOT_SUPPORTED  # Contains the parameters needed to configure each RxNSdu or TxNSdu with CanTpAddressingFormat set to CanTpExtended.
            integer CanTpNSa: 0..255, category=NOT_SUPPORTED, set at pre-compile  # If an RxNSdu or a TxNSdu is configured for extended addressing format, this parameter contains the transport protocol source address's value.
          container CanTpNTa [0..1]: category=NOT_SUPPORTED  # The following parameters need to be configured for each RxNsdu or TxNsdu with the CanTpAddressingFormat set to CanTpExtended.
            integer CanTpNTa: 0..255, category=NOT_SUPPORTED, set at pre-compile  # If an RxNsdu or a TxNsdu is configured for extended addressing format, this parameter contains the transport protocol target address's value.
          container CanTpRxFcNPdu [0..1]: category=FIXED  # Used for grouping of the ID of a PDU and the Reference to a PDU.
            integer CanTpRxFcNPduId: 0..65535, category=FIXED, set at pre-compile, symbolic-name-value=true  # N-PDU identifier attached to the FC N-PDU of this TxNsdu identified by CanTpTxNSduId. | Each TxNsdu identifier is linked to one Rx FC N-PDU identifier only. However, in the case of extended addressing format, the same FC N-PDU identifier can be used for several N-SDU identifiers. The distinction is made by means of the N_TA value (first data byte of FC frames).
            reference CanTpRxFcNPduRef: category=FIXED, set at pre-compile, destination=Pdu  # Reference to a Pdu in the COM-Stack.
          container CanTpTxNPdu: category=FIXED  # Used for grouping of the ID of a PDU and the Reference to a PDU.
            integer CanTpTxNPduConfirmationPduId: 0..65535, category=FIXED, set at pre-compile, symbolic-name-value=true  # Handle Id to be used by the CanIf to confirm the transmission of the CanTpTxNPdu to the CanIf module.
            reference CanTpTxNPduRef: category=FIXED, set at pre-compile, destination=Pdu  # Reference to a Pdu in the COM-Stack.
    container CanTpGeneral  # This container contains the general configuration parameters of the CanTp module.
      boolean CanTpChangeParameterApi: set at pre-compile, default-value=false  # This parameter, if set to true, enables the CanTp_ChangeParameterRequest Api for this Module. | True: CanTp_ChangeParameterRequest Api is Enabled False: CanTp_ChangeParameterRequest Api is Disabled
      boolean CanTpDevErrorDetect: set at pre-compile, symbolic-name-value=true, default-value=true  # Switches the Development Error Detection and Notification ON or OFF | True: Development Error Detection and Notification is enabled False: Development Error Detection and Notification is enabled
      integer CanTpPaddingByte: 0..255, set at pre-compile  # Used for the initialization of unused bytes with a certain value
      boolean CanTpReadParameterApi: set at pre-compile, default-value=false  # This parameter, if set to true, enables the CanTp_ReadParameterApi for this module. | True: CanTp_ReadParameterApi is enabled False: CanTp_ReadParameterApi is enabled
      boolean CanTpVersionInfoApi: category=FIXED, set at pre-compile, symbolic-name-value=true, default-value=false  # The function CanTp_GetVersionInfo is configurable (On/Off) by this configuration parameter. | True: CanTp_GetVersionInfo is enabled False: CanTp_GetVersionInfo is enabled
      boolean CanTpFlexibleDataRateSupport [0..1]: set at pre-compile, default-value=false  # Enable support for CAN FD frames.
