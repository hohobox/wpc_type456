AUTOSAR XML (schema 4-0-3)
# (C) 2021 HYUNDAI AUTOEVER Corp.
# Confidential Proprietary Information. Distribution Limited.
# Do Not Copy Without Prior Permission
package /AUTRON
  ecuc definition collection ParameterDefinition_CanSM: module=CanSM
  module definition CanSM: post-build-variant-support=true, refined-module-def=CanSM, variants pre-compile/post-build-selectable  # Configuration of the CanSM module
    container CanSMConfiguration: post-build-variant-multiplicity=true, multiple-configuration-container=true  # This container contains the global parameters of the CanSM and sub containers, which are for the CAN network specific configuration.
      integer CanSMModeRequestRepetitionMax: 0..255, set at pre-compile in variant pre-compile / post-build in variant post-build-selectable, post-build-variant-value=true, default-value=3  # Specifies the maximal amount of mode request repetitions without a respective mode indication from the CanIf module until the CanSM module reports a development error to the DET and tries to go back to no communication.
      float CanSMModeRequestRepetitionTime: 0..65.535, set at pre-compile in variant pre-compile / post-build in variant post-build-selectable, post-build-variant-value=true, default-value=0.03  # Specifies in which time duration the CanSM module shall repeat mode change requests by using the API of the CanIf module.
      container CanSMManagerNetwork [1..*]: post-build-variant-multiplicity=true  # This container contains the CAN network specific parameters of each CAN network
        integer CanSMBorCounterL1ToL2: 0..255, set at pre-compile in variant pre-compile / post-build in variant post-build, post-build-variant-value=true, default-value=125  # This threshold defines the count of bus-offs until the bus-off recovery switches from level 1 (short recovery time) to level 2 (long recovery time).
        float CanSMBorTimeL1: 0..65.535, set at pre-compile in variant pre-compile / post-build in variant post-build-selectable, post-build-variant-value=true, default-value=0.96  # This time parameter defines in seconds the duration of the bus-off recovery time in level 1 (short recovery time).
        float CanSMBorTimeL2: 0..65.535, set at pre-compile in variant pre-compile / post-build in variant post-build-selectable, post-build-variant-value=true, default-value=0.96  # This time parameter defines in seconds the duration of the bus-off recovery time in level 2 (long recovery time).
        float CanSMBorTimeTxEnsured: 0..65.535, set at pre-compile in variant pre-compile / post-build in variant post-build-selectable, post-build-variant-value=true, default-value=0.2  # This parameter defines in seconds the duration of the bus-off event check. This check assesses, if the recovery has been successful after the recovery reenables the transmit path. If a new bus-off occurs during this time period, the CanSM assesses this bus-off as sequential bus-off without successful recovery. Because a bus-off only can be detected, when PDUs are transmitted, the time has to be great enough to ensure that PDUs are transmitted again (e. g. time period of the fastest cyclic transmitted PDU of the COM module / ComTxModeTimePeriodFactor).
        boolean CanSMBorTxConfirmationPolling: category=FIXED, set at pre-compile, default-value=false  # This parameter shall configure, if the CanSM polls the CanIf_GetTxConfirmationState API to decide the bus-off state to be recovered instead of using the CanSMBorTimeTxEnsured parameter for this decision. | true: Confirmation polling is enabled. false: Confirmation polling is disabled
        symbolic name reference CanSMComMNetworkHandleRef: category=FIXED, set at pre-compile in variant pre-compile / post-build in variant post-build-selectable, post-build-variant-value=true, destination=ComMChannel  # Unique handle to identify one certain CAN network. Reference to one of the network handles configured for the ComM.
        symbolic name reference CanSMTransceiverId [0..1]: set at pre-compile in variant pre-compile / post-build in variant post-build-selectable, post-build-variant-value=true, destination=CanIfTrcvCfg  # ID of the CAN transceiver assigned to the configured network handle. Reference to one of the transceivers managed by the CanIf module.
        container CanSMController [1..*]: category=FIXED  # This container contains the controller IDs assigned to a CAN network.
          symbolic name reference CanSMControllerId: category=FIXED, set at pre-compile in variant pre-compile / post-build in variant post-build-selectable, post-build-variant-value=true, destination=CanIfCtrlCfg  # Unique handle to identify one certain CAN controller. Reference to one of the CAN controllers managed by the CanIf module.
        container CanSMDemEventParameterRefs [0..1]  # Container for the references to DemEventParameter elements which shall be invoked using the API Dem_ReportErrorStatus API in case the corresponding error occurs. The EventId is taken from the referenced DemEventParameter's DemEventId value. The standardized errors are provided in the container and can be extended by vendor specific error references.
          symbolic name reference CANSM_E_BUS_OFF [0..1]: set at pre-compile in variant pre-compile / post-build in variant post-build-selectable, post-build-variant-value=true, destination=DemEventParameter  # Reference to configured DEM event to report bus off errors for this CAN network.
          symbolic name reference CANSM_E_MODE_CHANGE [0..1]: set at pre-compile in variant pre-compile / post-build in variant post-build-selectable, origin=AUTOEVER, post-build-variant-value=true, destination=DemEventParameter  # Reference to configured DEM event to report mode change errors for this CAN network.
    container CanSMGeneral  # Container for general pre-compile parameters of the CanSM module
      boolean CanSMDevErrorDetect: set at pre-compile, default-value=true  # Enables and disables the development error detection and notification mechanism. | true: development error detection activated false: development error detection deactivated
      float CanSMMainFunctionTimePeriod: 0.001..65.535, set at pre-compile, default-value=0.01  # This parameter defines the cycle time of the function CanSM_MainFunction in seconds
      boolean CanSMPncSupport: set at pre-compile, default-value=false  # Enables or disables support of partial networking. | False: Partial Networking is disabled True: Partial Networking is enabled
      boolean CanSMVersionInfoApi: category=FIXED, set at pre-compile, default-value=true  # Activate/Deactivate the version information API (CanSM_GetVersionInfo). | true: version information API activated false: version information API deactivated
      boolean CanSmChangeBaudrateApi: category=NOT_SUPPORTED, set at pre-compile, default-value=false  # The support of the Can_ChangeBaudrate API is optional. | true: Can_ChangeBaudrate API shall be supported. false: Can_ChangeBaudrate API is not supported.
      function name CanSMUserTimeoutFunction [0..1]: set at pre-compile, origin=AUTOEVER  # This parameter defines the name of CANSM_DISPATCH_USERTIMEOUT_NAME. | If a timeout occurs when changing the mode. If timeout occurs over the set number of repetitions, this function is called.
      string CanSMUserTimeoutHeader [0..1]: set at pre-compile, symbolic-name-value=true, regular-expression=[a-zA-Z0-9_]([a-zA-Z0-9\._])*  # Name of the header file(s) to be included by the CanSM module for callout function.
