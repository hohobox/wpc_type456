AUTOSAR XML (schema 4-0-3)
# (C) 2021 HYUNDAI AUTOEVER Corp.
# Confidential Proprietary Information. Distribution Limited.
# Do Not Copy Without Prior Permission
package /AUTRON
  ecuc definition collection ParameterDefinition_CanIf: module=CanIf
  module definition CanIf: post-build-variant-support=true, refined-module-def=CanIf, variants pre-compile/post-build-selectable  # This container includes all necessary configuration sub-containers according the CAN Interface configuration structure.
    container CanIfCtrlDrvCfg [1..*]  # Configuration parameters for all the underlying CAN Driver modules are aggregated under this container. For each CAN Driver module a seperate instance of this container has to be provided.
      boolean CanIfCtrlDrvTxCancellation: set at pre-compile, default-value=false  # Selects whether transmit cancellation is supported and if the appropriate callback will be provided to the CAN Driver module. | True: Enabled False: Disabled
      reference CanIfCtrlDrvInitHohConfigRef: category=FIXED, set at pre-compile, destination=CanIfInitHohCfg  # Reference to the Init Hoh Configuration
      reference CanIfCtrlDrvNameRef: category=FIXED, set at pre-compile, destination=CanGeneral  # CAN Interface Driver Reference. | This reference can be used to get any information (Ex. Driver Name, Vendor ID) from the CAN driver. The CAN Driver name can be derived from the ShortName of the CAN driver module.
      container CanIfCtrlCfg [1..*]  # This container contains the configuration (parameters) of an adressed CAN controller by an underlying CAN Driver module. This container is configurable per CAN controller.
        integer CanIfCtrlId: 0..65535, category=FIXED, set at pre-compile, symbolic-name-value=true  # This parameter abstracts from the CAN Driver specific parameter Controller. Each controller of all connected CAN Driver modules shall be assigned to one specific ControllerId of the CanIf. | Range: 0..number of configured controllers of all CAN Driver modules
        boolean CanIfCtrlWakeupSupport: category=FIXED, set at pre-compile, default-value=false  # This parameter defines if a respective controller of the referenced CAN Driver modules is queriable for wake up events. | True: Enabled False: Disabled
        symbolic name reference CanIfCtrlCanCtrlRef: category=FIXED, set at pre-compile, destination=CanController  # This parameter references to the logical handle of the underlying CAN controller from the CAN Driver module to be served by the CAN Interface module. The following parameters of CanController config container shall be referenced by this link: CanControllerId, CanWakeupSourceRef | Range: 0..max. number of underlying supported CAN controllers
    container CanIfDispatchCfg  # Callback functions provided by upper layer modules of the CanIf. The callback functions defined in this container are common to all configured CAN Driver / CAN Transceiver Driver modules.
      function name CanIfDispatchUserCheckTrcvWakeFlagIndicationName [0..1]: set at pre-compile  # This parameter defines the name of <User_ClearTrcvWufFlagIndication>. | If CANIF_DISPATCH_USERCHECKTRCVWAKEFLAGINDICATION_UL equals CAN_SM the name of <User_CheckTrcvWakeFlagIndication> is fixed. If it equals CDD, the name is selectable. If CANIF_PUBLIC_PN_SUPPORT equals False, this parameter shall not be configurable.
      enumeration CanIfDispatchUserCheckTrcvWakeFlagIndicationUL [0..1]: {CAN_SM, CDD}, set at pre-compile  # This parameter defines the upper layer module to which the CheckTrcvWakeFlagIndication from the Driver modules have to be routed. | If CANIF_PUBLIC_PN_SUPPORT equals False, this parameter shall not be configurable. CAN_SM : CAN State Manager CDD :Complex Device Driver
      function name CanIfDispatchUserClearTrcvWufFlagIndicationName [0..1]: set at pre-compile  # This parameter defines the name of <User_ClearTrcvWufFlagIndication>. | If CANIF_DISPATCH_USERCLEARTRCVWUFFLAGINDICATION_UL equals CAN_SM the name of <User_ClearTrcvWufFlagIndication> is fixed. If it equals CDD, the name is selectable. If CANIF_PUBLIC_PN_SUPPORT equals False, this parameter shall not be configurable.
      enumeration CanIfDispatchUserClearTrcvWufFlagIndicationUL [0..1]: {CAN_SM, CDD}, set at pre-compile  # This parameter defines the upper layer module to which the ClearTrcvWufFlagIndication from the Driver modules have to be routed. | If CANIF_PUBLIC_PN_SUPPORT equals False, this parameter shall not be configurable. CAN_SM : CAN State Manager CDD :Complex Device Driver
      function name CanIfDispatchUserConfirmPnAvailabilityName: set at pre-compile  # This parameter defines the name of <User_ConfirmPnAvailability>. If CANIF_DISPATCH_USERCONFIRMPNAVAILABILITY_UL equals CAN_SM the name of <User_ConfirmPnAvailability> is fixed. If it equals CDD, the name is selectable. If CANIF_PUBLIC_PN_SUPPORT equals False, this parameter shall not be configurable.
      enumeration CanIfDispatchUserConfirmPnAvailabilityUL [0..1]: {CAN_SM, CDD}, set at pre-compile  # This parameter defines the upper layer module to which the ConfirmPnAvailability notification from the Driver modules have to be routed. If CANIF_PUBLIC_PN_SUPPORT equals False, this parameter shall not be configurable. | CAN_SM : CAN State Manager CDD :Complex Device Driver
      function name CanIfDispatchUserCtrlBusOffName [0..1]: set at pre-compile, max-length=32, min-length=1  # This parameter defines the name of <User_ControllerBusOff>. | This parameter depends on the parameter CANIF_USERCTRLBUSOFF_UL. If CANIF_USERCTRLBUSOFF_UL equals CAN_SM the name of <User_ControllerBusOff> is fixed. If CANIF_USERCTRLBUSOFF_UL equals CDD, the name of <User_ControllerBusOff> is selectable.
      enumeration CanIfDispatchUserCtrlBusOffUL: {CAN_SM, CDD}, set at pre-compile  # This parameter defines the upper layer (UL) module to which the notifications of all ControllerBusOff events from the CAN Driver modules have to be routed via <User_ControllerBusOff>. | There is no possibility to configure no upper layer (UL) module as the provider of <User_ControllerBusOff> CAN_SM : CAN State Manager CDD :Complex Device Driver
      function name CanIfDispatchUserCtrlModeIndicationName [0..1]: set at pre-compile, max-length=32, min-length=1  # This parameter defines the name of <User_ControllerModeIndication>. | This parameter depends on the parameter CANIF_USERCTRLMODEINDICATION_UL. If CANIF_USERCTRLMODEINDICATION_UL equals CAN_SM the name of <User_ControllerModeIndication> is fixed. If CANIF_USERCTRLMODEINDICATION_UL equals CDD, the name of <User_ControllerModeIndication> is selectable.
      enumeration CanIfDispatchUserCtrlModeIndicationUL: {CAN_SM, CDD}, set at pre-compile  # This parameter defines the upper layer (UL) module to which the notifications of all ControllerTransition events from the CAN Driver modules have to be routed | via <User_ControllerModeIndication>. CAN_SM : CAN State Manager CDD :Complex Device Driver
      function name CanIfDispatchUserTrcvModeIndicationName [0..1]: set at pre-compile, max-length=32, min-length=1  # This parameter defines the name of <User_TrcvModeIndication>. | This parameter depends on the parameter CANIF_USERTRCVMODEINDICATION_UL. If CANIF_USERTRCVMODEINDICATION_UL equals CAN_SM the name of <User_TrcvModeIndication> is fixed. If CANIF_USERTRCVMODEINDICATION_UL equals CDD, the name of <User_TrcvModeIndication> is selectable.
      enumeration CanIfDispatchUserTrcvModeIndicationUL [0..1]: {CAN_SM, CDD}, set at pre-compile  # This parameter defines the upper layer (UL) module to which the notifications of all TransceiverTransition events from the CAN Transceiver Driver modules have to be routed via <User_TrcvModeIndication>. If no UL module is configured, no upper layer callback function will be called. | CAN_SM : CAN State Manager CDD :Complex Device Driver
      function name CanIfDispatchUserValidateWakeupEventName [0..1]: set at pre-compile, max-length=32, min-length=1  # This parameter defines the name of <User_ValidateWakeupEvent>. This | parameter depends on the parameter CANIF_USERVALIDATEWAKEUPEVENT_UL. CANIF_USERVALIDATEWAKEUPEVENT_UL equals ECUM the name of <User_ValidateWakeupEvent> is fixed. CANIF_USERVALIDATEWAKEUPEVENT_UL equals CDD, the name of <User_ValidateWakeupEvent> is selectable. If parameter CANIF_WAKEUP_CHECK_VALIDATION_API is disabled, no <User_ValidateWakeupEvent> API can be configured.
      enumeration CanIfDispatchUserValidateWakeupEventUL [0..1]: {CDD, ECUM}, set at pre-compile  # This parameter defines the upper layer (UL) module to which the notifications about positive former requested wake up sources have to be routed via <User_ValidateWakeupEvent>. If parameter CANIF_WAKEUP_CHECK_VALIDATION_API is disabled, this parameter cannot be configured. | ECUM :ECU State Manager CDD :Complex Device Drive
    container CanIfInitCfg  # This container contains the init parameters of the CAN Interface. | At least one (if only on CanIf with one possible Configuration), but multiple (CanIf with different Configurations) instances of this container are possible.
      string CanIfInitCfgSet: set at pre-compile, max-length=32, min-length=1  # Selects the CAN Interface specific configuration setup. This type of the external data structure shall contain the post build initialization data for the CAN Interface for all underlying CAN Dirvers. | constant to CanIf_ConfigType
      container CanIfBufferCfg [0..*]  # This container contains the Txbuffer configuration. Multiple buffers with different sizes could be configured. If CanIfBufferSize (CANIF834_Conf) equals 0, the CanIf Tx L-PDU only refers via this CanIfBufferCfg the corresponding CanIfHthCfg.
        integer CanIfBufferSize: 0..255, set at pre-compile, default-value=0  # This parameter defines the number of CanIf Tx L-PDUs which can be buffered in one Txbuffer. If this value equals 0, the CanIf does not perform Txbuffering for the CanIf Tx L-PDUs which are assigned to this Txbuffer. If CanIfPublicTxBuffering equals False, this parameter equals 0 for all TxBuffer. If the CanHandleType of the referred HTH equals FULL, this parameter equals 0 for this TxBuffer.
        reference CanIfBufferHthRef [1..*]: category=FIXED, set at pre-compile, destination=CanIfHthCfg  # Reference to HTH, that defines the hardware object or the pool of hardware objects configured for transmission. All the CanIf Tx L-PDUs refer via the CanIfBufferCfg and this parameter to the HTHs if TxBuffering is enabled, or not. | Each HTH shall not be assigned to more than one buffer.
      container CanIfInitHohCfg [0..*]  # This container contains the references to the configuration setup of each underlying CAN Driver.
        reference CanIfInitRefCfgSet [0..1]: category=FIXED, set at pre-compile, destination=CanConfigSet  # Selects the CAN Interface specific configuration setup. This type of external data structure shall contain the post build initialization data for the CAN Interface for all underlying CAN Drivers.
        container CanIfHrhCfg [0..*]  # This container contains configuration parameters for each hardware receive object (HRH).
          boolean CanIfHrhSoftwareFilter: category=FIXED, set at pre-compile, default-value=true  # Selects the hardware receive objects by using the HRH range/list from CAN Driver configuration to define, for which HRH a software filtering has to be performed at during receive processing. | True: Software filtering is enabled False: Software filtering is enabled
          reference CanIfHrhCanCtrlIdRef: category=FIXED, set at pre-compile, destination=CanIfCtrlCfg  # Reference to controller Id to which the HRH belongs to. A controller can contain one or more HRHs.
          symbolic name reference CanIfHrhCanHandleTypeRef [0..1]: set at pre-compile, destination=CanHardwareObject  # The parameter refers to a particular HRH object in the CAN Driver Module configuration. The type of the HRH can either be Full-CAN or Basic-CAN. The type of HRHs is defined in the CAN Driver Module and hence it is derived from CAN Driver Configuration of a Hardware Object. If BasicCAN is configured, software filtering is enabled. | Please note that this reference is deprecated and is kept only for backward compatibility reasons. CanIfHthIdSymRef shall be used instead to get the CanHandleType and CanObjectId of CAN Driver. In the next major release this reference will be deleted.
          symbolic name reference CanIfHrhIdSymRef: set at pre-compile, destination=CanHardwareObject  # The parameter refers to a particular HRH object in the CanDrv configuration (see CanHardwareObject CAN324_Conf). | The CanIf receives the following information of the CanDrv module by this reference: - CanHandleType (see CAN323_Conf) - CanObjectId (see CAN326_Conf)
          container CanIfHrhRangeCfg [0..*]  # Defines the parameters required for configurating multiple CANID ranges for a given same HRH.
            integer CanIfHrhRangeRxPduLowerCanId: 0..536870911, set at pre-compile  # Lower CAN Identifier of a receive CAN L-PDU for identifier range definition, in which all CAN Ids shall pass the software filtering.
            enumeration CanIfHrhRangeRxPduRangeCanIdType: {EXTENDED, STANDARD}, set at pre-compile  # Specifies whether a configured Range of CAN Ids shall only consider standard CAN Ids or extended CAN Ids. | EXTENDED :All the CANIDs are of type extended only (29 bit). STANDARD: All the CANIDs are of type standard only (11bit).
            integer CanIfHrhRangeRxPduUpperCanId: 0..536870911, set at pre-compile  # Upper CAN Identifier of a receive CAN L-PDU for identifier range definition, in which all CAN Ids shall pass the software filtering.
        container CanIfHthCfg [0..*]  # This container contains parameters related to each HTH.
          reference CanIfHthCanCtrlIdRef: category=FIXED, set at pre-compile, destination=CanIfCtrlCfg  # Reference to controller Id to which the HTH belongs to. A controller can contain one or more HTHs.
          symbolic name reference CanIfHthCanHandleTypeRef [0..1]: set at pre-compile, destination=CanHardwareObject  # The parameter refers to a particular HTH object in the CAN Driver Module configuration. The type of the HTH can either be Full-CAN or Basic-CAN. The type of HTHs is defined in the CAN Driver Module and hence it is derived from CAN Driver Configuration of a Hardware Object. | Please note that this reference is deprecated and is kept only for backward compatibility reasons. CanIfHthIdSymRef shall be used instead to get the CanHandleType and CanObjectId of CAN Driver. In the next major release this reference will be deleted.
          symbolic name reference CanIfHthIdSymRef: set at pre-compile, destination=CanHardwareObject  # The parameter refers to a particular HTH object in the CanDrv configuration (see CanHardwareObject CAN324_Conf). | The CanIf receives the following information of the CanDrv module by this reference: - CanHandleType (see CAN323_Conf) - CanObjectId (see CAN326_Conf)
      container CanIfRxPduCfg [0..*]  # This container contains the configuration (parameters) of each receive CAN L-PDU. | The SHORT-NAME of "CanIfRxPduConfig" container itself represents the symolic name of Receive L-PDU.
        integer CanIfRxPduCanId [0..1]: 0..536870911, set at pre-compile, post-build-variant-value=true  # CAN Identifier of Receive CAN L-PDUs used by the CAN Interface. Exa: Software Filtering. This parameter is used if exactly one Can Identifier is assigned to the Pdu. If a range is assigned then the CanIfRxPduCanIdRange parameter shall be used. | Range: 11 Bit For Standard CAN Identifier ... 29 Bit For Extended CAN identifier
        enumeration CanIfRxPduCanIdType: {EXTENDED_CAN, STANDARD_CAN}, category=FIXED, set at pre-compile  # CAN Identifier of receive CAN L-PDUs used by the CAN Driver for CAN L-PDU reception. | EXTENDED_CAN:CanId is of type Extended STANDARD_CAN: Can Id is of Type Standard
        integer CanIfRxPduDlc: 0..64, set at pre-compile, with-auto=true  # Data Length code of received CAN L-PDUs used by the CAN Interface. Exa: DLC check. | The data area size of a CAN L-PDU can have a range from 0 to 64 bytes.
        integer CanIfRxPduId: 0..4294967295, category=FIXED, set at pre-compile, symbolic-name-value=true  # ECU wide unique, symbolic handle for receive CAN L-PDU. The CanIfRxPduId is configurable at pre-compile and post-built time. It shall fulfill ANSI/AUTOSAR definitions for constant defines. | Range: 0..max. number of defined CanRxPduIds
        boolean CanIfRxPduReadData: category=FIXED, set at pre-compile, default-value=false  # Enables and disables the Rx buffering for reading of received L-PDU data. | True: Enabled the Rx buffering for reading of received L-PDU data. False: Disabled the Rx buffering for reading of received L-PDU data.
        boolean CanIfRxPduReadNotifyStatus: category=FIXED, set at pre-compile, default-value=false  # Enables and disables receive indication for each receive CAN L-PDU for reading its notification status. | True: Enabled receive indication for each receive CAN L-PDU for reading its notification status. False: Disabled receive indication for each receive CAN L-PDU for reading its notification status.
        function name CanIfRxPduUserRxIndicationName [0..1]: set at pre-compile, max-length=32, min-length=1  # This parameter defines the name of the <User_RxIndication>. | This parameter depends on the parameter CANIF_RXPDU_USERRXINDICATION_UL. If CANIF_RXPDU_USERRXINDICATION_UL equals CAN_TP, CAN_NM, OSEK_NM, PDUR, XCP, J1939NM or J1939TP, the name of the <User_RxIndication> is fixed. If CANIF_RXPDU_USERRXINDICATION_UL equals CDD, the name of the <User_RxIndication> is selectable.
        enumeration CanIfRxPduUserRxIndicationUL [0..1]: {CAN_NM, OSEK_NM, CAN_TP, CDD, J1939TP, J1939NM, PDUR, XCP}, set at pre-compile  # This parameter defines the upper layer (UL) module to which the indication | the successfully received CANRXPDUID has to be routed via <User_RxIndication>. This <User_RxIndication> has to be invoked when the indication of the configured CANRXPDUID will be received by an Rx indication event from the CAN Driver module. If no upper layer (UL) module is configured, no <User_RxIndication> has to be called in case of an Rx indication event of the CANRXPDUID from the CAN Driver module. CAN_NM: CAN NM OSEK_NM: OSEK NM CAN_TP :CAN TP CDD :Complex Device Driver J1939TP: J1939Tp J1939NM: J1939Nm PDUR: PDU Router XCP :Extended Calibration Protocol
        integer CanIfRxPduCanIdMask [0..1]: 0..536870911, set at pre-compile, default-value=536870911  # This parameter may be used to keep parts of the CAN Identifier of dynamic transmit L-PDUs static. Range: 11 bits for Standard CAN Identifier, 29 bits for Extended CAN Identifier. | Identifier mask which denotes relevant bits in the CAN Identifier.
        boolean CanIfPduReportIdsMEnable [0..1]: set at pre-compile, origin=AUTRON, default-value=false  # If true CanIf Module shall report to IdsM Module when PDU received.
        reference CanIfRxPduBswSchExclAreaIdRef [0..1]: category=NOT_SUPPORTED, set at pre-compile, destination=RteBswExclusiveAreaImpl  # Reference to an exclusive area Id defined within the BSW Scheduler.
        reference CanIfRxPduHrhIdRef: category=FIXED, set at pre-compile, destination=CanIfHrhCfg  # The HRH to which Rx L-PDU belongs to, is referred through this parameter.
        reference CanIfRxPduRef: category=FIXED, set at pre-compile, destination=Pdu  # Reference to the "global" Pdu structure to allow harmonization of handle IDs in the COM-Stack.
        container CanIfRxPduCanIdRange [0..1]  # Optional container that allows to map a range of CAN Ids to one PduId.
          integer CanIfRxPduCanIdRangeLowerCanId: 0..536870911, set at pre-compile  # Lower CAN Identifier of a receive CAN L-PDU for identifier range definition, in which all CAN Ids are mapped to one PduId.
          integer CanIfRxPduCanIdRangeUpperCanId: 0..536870911, set at pre-compile  # Upper CAN Identifier of a receive CAN L-PDU for identifier range definition, in which all CAN Ids are mapped to one PduId.
        container CanIfTTRxFrameTriggering [0..1]  # This container is only included and valid if TTCAN Interface SWS is used and TTCAN is enabled.(Not used in the current implementation) | Frame trigger for TTCAN reception. CanIfTTRxFrameTriggering is only included, if the controller supports TTCAN and a joblist is used for reception.
          integer CanTTRxJoblistTimeMark [0..1]: 0..65535, category=NOT_SUPPORTED, set at pre-compile  # Defines the point in time, when the joblist execution funciton (JLEF) shall be called for the referenced rx trigger. Value is given in cycle time. This parameter is only configurable if a joblist is enabled by parameter CanIfTTJobList.(Not used in the current implementation)
          reference CanIfTTRxHwObjectTriggerIdRef: category=NOT_SUPPORTED, set at pre-compile, destination=CanTTHardwareObjectTrigger  # This parameter refers to a particular TTCAN hardware receive object Trigger of a hardware object in the TTCAN Driver Module, which is referred via plain CAN parameter CANIF_HRH_HANDLETYPE_REF. This parameter is only configurable if a joblist is enabled by parameter CanIfTTJobList.(Not used in the current implementation)
      container CanIfTxPduCfg [0..*]  # This container contains the configuration (parameters) of a transmit CAN L-PDU. It has to be configured as often as a transmit CAN L-PDU is needed. | The SHORT-NAME of "CanIfTxPduConfig" container represents the symolic name of Transmit L-PDU.
        integer CanIfTxPduCanId: 0..536870911, set at pre-compile, post-build-variant-value=true  # CAN Identifier of transmit CAN L-PDUs used by the CAN Driver for CAN L-PDU transmission. | Range: 11 Bit For Standard CAN Identifier ... 29 Bit For Extended CAN identifier
        enumeration CanIfTxPduCanIdType: {EXTENDED_CAN, STANDARD_CAN, EXTENDED_FD_CAN, STANDARD_FD_CAN}, category=FIXED, set at pre-compile  # Type of CAN Identifier of the transmit CAN L-PDU used by the CAN Driver module for CAN L-PDU transmission. | EXTENDED_CAN:The CANID is of type Extended STANDARD_CAN: The CANID is of type Standard (11 bits)
        integer CanIfTxPduDlc: 0..64, category=FIXED, set at pre-compile  # Data length code (in bytes) of transmit CAN L-PDUs used by the CAN Driver for CAN L-PDU transmission. | The data area size of a CAN L-Pdu can have a range from 0 to 64 bytes.
        integer CanIfTxPduId: 0..4294967295, category=FIXED, set at pre-compile, symbolic-name-value=true  # ECU wide unique, symbolic handle for transmit CAN L-PDU. The CanIfTxPduId is configurable at pre-compile and post-built time. | Range: 0..max. number of CantTxPduIds
        boolean CanIfTxPduPnFilterPdu [0..1]: category=NOT_SUPPORTED, set at pre-compile, default-value=false  # If CanIfPublicPnFilterSupport is enabled, by this parameter PDUs could be configured which will pass the CanIfPnFilter. | True: Enabled False: Disabled
        boolean CanIfTxPduReadNotifyStatus: category=FIXED, set at pre-compile, default-value=false  # Enables and disables transmit confirmation for each transmit CAN L-PDU for reading its notification status. | True: Enabled transmit confirmation for each transmit CAN L-PDU for reading its notification status False: Disabled transmit confirmation for each transmit CAN L-PDU for reading its notification status
        enumeration CanIfTxPduType: {DYNAMIC, STATIC}, category=FIXED, set at pre-compile, default-value=STATIC  # Defines the type of each transmit CAN L-PDU. | Static : CAN id is defined at compile time Dynamic :CAN id is defined at runtime
        function name CanIfTxPduUserTxConfirmationName [0..1]: set at pre-compile, max-length=32, min-length=1  # This parameter defines the name of the <User_TxConfirmation>. This | parameter depends on the parameter CANIF_TXPDU_USERTXCONFIRMATION_UL. If CANIF_TXPDU_USERTXCONFIRMATION_UL equals CAN_TP, CAN_NM, OSEK_NM, PDUR, XCP, J1939NM or J1939TP, the name of the <User_TxConfirmation> is fixed. If CANIF_TXPDU_USERTXCONFIRMATION_UL equals CDD, the name of the <User_TxConfirmation> is selectable.
        enumeration CanIfTxPduUserTxConfirmationUL [0..1]: {CAN_NM, OSEK_NM, CAN_TP, CDD, J1939TP, J1939NM, PDUR, XCP}, set at pre-compile  # This parameter defines the upper layer (UL) module to which the confirmation of the successfully transmitted CANTXPDUID has to be routed via the <User_TxConfirmation>. | This <User_TxConfirmation> has to be invoked when the confirmation of the configured CANTXPDUID will be received by a Tx confirmation event from the CAN Driver module. If no upper layer (UL) module is configured, no <User_TxConfirmation> has to be called in case of a Tx confirmation event of the CANTXPDUID from the CAN Driver module. CAN_NM :CAN NM OSEK_NM: OSEK NM CAN_TP :CAN TP CDD: Complex Device Driver J1939TP :J1939Tp J1939NM :J1939Nm PDUR :PDU Router XCP :Extended Calibration Protocol
        integer CanIfTxPduCanIdMask: 0..536870911, set at pre-compile  # This parameter may be used to keep parts of the CAN Identifier of dynamic transmit L-PDUs static. Range: 11 bits for Standard CAN Identifier, 29 bits for Extended CAN Identifier. | Identifier mask which denotes relevant bits in the CAN Identifier.
        boolean CanIfTxPduTruncation [0..1]: set at pre-compile, origin=AUTRON, default-value=false  # Enables/disables truncation of PDUs that exceed the configured size. | True: Enabled False: Disabled
        reference CanIfTxPduBswSchExclAreaIdRef [0..1]: category=NOT_SUPPORTED, set at pre-compile, destination=RteBswExclusiveAreaImpl  # Reference to an exclusive area Id defined within the BSW Scheduler.
        reference CanIfTxPduBufferRef: category=FIXED, set at pre-compile, destination=CanIfBufferCfg  # Configurable reference to a CanIf buffer configuration.
        reference CanIfTxPduRef: category=FIXED, set at pre-compile, destination=Pdu  # Reference to the "global" Pdu structure to allow harmonization of handle IDs in the COM-Stack.
        container CanIfTTTxFrameTriggering [0..1]  # This container is only included and valid if TTCAN Interface SWS is used and TTCAN is enabled.(Not used in the current implementation) | Frame trigger for TTCAN transmission. CanIfTTTxFrameTriggering is only included, if the controller supports TTCAN and a joblist is used.
          integer CanIfTTTxJoblistTimeMark [0..1]: 0..65535, category=NOT_SUPPORTED, set at pre-compile  # Defines the point in time, when the joblist execution funciton (JLEF) shall be called for the referenced tx frame trigger.(Not used in the current implementation) | Value is given in cycle time. This parameter is only configurable if a joblist is enabled by parameter CanIfTTJobList.
          reference CanIfTTTxHwObjectTriggerIdRef: category=NOT_SUPPORTED, set at pre-compile, destination=CanTTHardwareObjectTrigger  # This parameter refers to a particular TTCAN hardware transmit object Trigger of a hardware object in the TTCAN Driver Module.(Not used in the current implementation) | which is referred via plain CAN parameter CANIF_HTH_HANDLETYPE_REF. This parameter is only configurable if a joblist is enabled by parameter CanIfTTJobList.
    container CanIfPrivateCfg  # This container contains the private configuration (parameters) of the CAN Interface.
      boolean CanIfPrivateDlcCheck: set at pre-compile, default-value=true  # Selects whether the DLC check is supported. | True: Enabled False: Disabled
      enumeration CanIfPrivateSoftwareFilterType: {BINARY, INDEX, LINEAR, TABLE, IDTABLE}, category=FIXED, set at pre-compile  # Selects the desired software filter mechanism for reception only. | Each implemented software filtering method is identified by this enumeration number. Range: Types implemented software filtering methods BINARY: selects binary filter method INDEX: Selects index filter method Linear : selects linear filter method IDTABLE : selects idtable filter method Table: selects table filter method
      boolean CanIfSupportTTCAN: category=NOT_SUPPORTED, set at pre-compile, default-value=false  # Defines whether TTCAN is supported.(Not used in the current implementation) | TRUE: TTCAN is supported. FALSE: TTCAN is not supported, only normal CAN communication is possible.
      boolean CanIfSupportCANFD: set at pre-compile, default-value=false  # Defines whether CAN-FD is supported. | TRUE: CAN-FD is supported. FALSE: CAN-FD is not supported.
      boolean CanIfSupportCanCM: set at pre-compile, default-value=false  # Defines whether CanCM is supported. | TRUE: CanCM is supported. FALSE: CanCM is not supported.
      container CanIfTTGeneral [0..1]: category=NOT_SUPPORTED  # This container is only included and valid if TTCAN Interface SWS is used and TTCAN is enabled.(Not used in the current implementation) | This container contains the parameters, which define if and in which way TTCAN is supported. CanIfTTGeneral is only included, if the controller supports TTCAN.
        boolean CanIfTTJoblist: category=NOT_SUPPORTED, set at pre-compile, default-value=false  # Defines whether TTCAN is processed via a joblist.(Not used in the current implementation) | TRUE: Joblist is used. FALSE: No joblist is used. This parameter is only configurable if TTCAN is enabled by parameter CanIfSupportTTCAN.
        integer CanIfTTMaxIsrDelay: 0..65535, category=NOT_SUPPORTED, set at pre-compile  # Defines the maximum delay for the execution of the joblist execution function JLEF. This parameter is only configurable if a joblist is enabled by parameter CanIfTTJobList.(Not used in the current implementation)
    container CanIfPublicCfg  # This container contains the public configuration (parameters) of the CAN Interface.
      boolean CanIfPublicCancelTransmitSupport: category=NOT_SUPPORTED, set at pre-compile  # Configuration parameter to enable/disable dummy API for upper layer modules which allows to request the cancellation of an I-PDU. | TRUE: enable dummy API for upper layer modules which allows to request the cancellation of an I-PDU FALSE: disableis dummy API for upper layer modules which allows to request the cancellation of an I-PDU.
      string CanIfPublicCddHeaderFile [0..*]: set at pre-compile, max-length=32, min-length=1  # Defines header files for callback functions which shall be included in case of CDDs. Range of characters is 1.. 32.
      boolean CanIfPublicChangeBaudrateSupport: category=NOT_SUPPORTED, set at pre-compile, default-value=false  # Configuration parameter to enable/disable the API to change the baudrate of a CAN controller. | True: Configuration parameter to enable the API to change the baudrate of a CAN controller. False: Configuration parameter to disable the API to change the baudrate of a CAN controller.
      boolean CanIfPublicDevErrorDetect: category=FIXED, set at pre-compile, default-value=true  # Enables and disables the development error detection and notification mechanism. | True: Enabled the development error detection and notification mechanism. False: Disabled the development error detection and notification mechanism.
      enumeration CanIfPublicHandleTypeEnum: {UINT16, UINT8}, category=FIXED, set at pre-compile  # This parameter is used to configure the Can_HwHandleType. The Can_HwHandleType represents the hardware object handles of a CAN hardware unit. For CAN hardware units with more than 255 HW objects the extended range shall be used (UINT16). | Unit16: Can_HwHandleType 16 Unit8:Can_HwHandleType 8
      boolean CanIfPublicMultipleDrvSupport: category=NOT_SUPPORTED, set at pre-compile, default-value=true  # Selects support for multiple CAN Drivers. | True: Enabled support for multiple CAN Drivers. False: Disabled support for multiple CAN Drivers.
      integer CanIfPublicNumberOfCanHwUnits: 1..255, category=FIXED, set at pre-compile, default-value=1  # Number of served CAN hardware units.
      boolean CanIfPublicPnSupport: set at pre-compile, default-value=false  # Selects support of Partial Network features in CanIf. | True: Enabled support of Partial Network features in CanIf. False: Disabled support of Partial Network features in CanIf.
      boolean CanIfPublicReadRxPduDataApi: category=FIXED, set at pre-compile, default-value=false  # Enables / Disables the API CanIf_ReadRxPduData() for reading received L-PDU data. | True: Enabled the API CanIf_ReadRxPduData() for reading received L-PDU data. False: Disabled the API CanIf_ReadRxPduData() for reading received L-PDU data.
      boolean CanIfPublicReadRxPduNotifyStatusApi: category=FIXED, set at pre-compile, default-value=false  # Enables and disables the API for reading the received L-PDU data. | True: Enabled the API for reading the received L-PDU data. False: Disabled the API for reading the received L-PDU data.
      boolean CanIfPublicReadTxPduNotifyStatusApi: category=FIXED, set at pre-compile, default-value=false  # Enables and disables the API for reading the notification status of transmit and receive L-PDUs. | True: Enabled the API for reading the notification status of transmit and receive L-PDUs. False: Disabled the API for reading the notification status of transmit and receive L-PDUs.
      boolean CanIfPublicSetDynamicTxIdApi: category=FIXED, set at pre-compile, default-value=false  # Enables and disables the API for reconfiguration of the CAN Identifier for each Transmit L-PDU. | True: Enabled the API for reconfiguration of the CAN Identifier for each Transmit L-PDU. False: Disabled the API for reconfiguration of the CAN Identifier for each Transmit L-PDU.
      boolean CanIfPublicTxBuffering: category=NOT_SUPPORTED, set at pre-compile, default-value=false  # Enables and disables the buffering of transmit L-PDUs (rejected by the CanDrv) within the CAN Interface module. | True: Enabled the buffering of transmit L-PDUs (rejected by the CanDrv) within the CAN Interface module. False: Disabled the buffering of transmit L-PDUs (rejected by the CanDrv) within the CAN Interface module.
      boolean CanIfPublicTxConfirmPollingSupport: category=NOT_SUPPORTED, set at pre-compile  # Configuration parameter to enable/disable the API to poll for Tx Confirmation state. | True: Enabled the API to poll for Tx Confirmation state. False: Disabled the API to poll for Tx Confirmation state.
      boolean CanIfPublicVersionInfoApi: category=FIXED, set at pre-compile, default-value=false  # Enables and disables the API for reading the version information about the CAN Interface. | True: Enabled False: Disabled
      boolean CanIfPublicWakeupCheckValidByNM [0..1]: category=NOT_SUPPORTED, set at pre-compile, default-value=false  # If enabled, only NM messages shall validate a detected wake-up event | (see CANIF722) at the corresponding wake-up source in the CanIf. If disabled, all messages shall validate such a wake-up event. This parameter depends on CANIF_PUBLIC_WAKEUP_CHECK_VALID_API and shall only be configurable, if it is enabled. True: Enabled False: Disabled
      boolean CanIfPublicWakeupCheckValidSupport: category=FIXED, set at pre-compile, default-value=false  # Selects support for wake up validation | True: Enabled False: Disabled
      boolean CanIfMetaDataSupport: set at pre-compile, default-value=false  # Selects support for MetaData | True: Enabled False: Disabled
      boolean CanIfAutoeverTrcvDrvSupport [0..1]: origin=AUTRON, default-value=false  # Selects support for Autoever CanTrcv Drv | True: Enabled False: Disabled
      boolean CanIfExternalTrcvDrvSupport [0..1]: origin=AUTRON, default-value=false  # Selects support for External CanTrcv Drv | True: Enabled False: Disabled
      boolean CanIfCANFDID16BitSupport [0..1]: origin=AUTRON, default-value=false  # Selects support for CAN FD 16Bit CAN ID | True: Enabled False: Disabled
      boolean CanIfCANFDDiscreteDlcSupport [0..1]: origin=AUTRON, default-value=false  # Selects support for CAN FD discrete DLC | True: Enabled False: Disabled
      boolean CanIfBusloadDetectingSupport [0..1]: origin=AUTRON, default-value=false  # Selects support for CAN Busload Detecting If True, ComMBusloadDetetingApi should be True | True: Enabled False: Disabled
      enumeration CanIfPublicCanDrvVersion: {AR_403, AR_440}, set at pre-compile, origin=AUTRON, default-value=AR_403  # This parameter is used to provide CanDrv's Autosar version. It shall be same with provided information in CanDrv's Bsw Module Description file.
      boolean CanIfTxRxMonitoringSupport [0..1]: origin=AUTRON, default-value=false  # Selects support for CAN Transmit / Receive monitoring | True: Enabled False: Disabled
      boolean CanIfOptimizeQueueBufferSize [0..1]: origin=AUTRON, default-value=false  # Select to optimize the Queue Size of the CanIf Tx Buffer | True: Enabled The Data Field Size of the Basic Buffer is allocated to the largest CanIfTxPduDlc among the CanIfTxPdus using the Basic Buffer. False: Disabled The Data Field Size of the Basic Buffer is allocated as 64 bytes if the CanIfSupportCANFD setting is True, and 8 bytes if it is False.
    container CanIfTrcvDrvCfg [0..*]  # This container contains the configuration (parameters) of all addressed CAN transceivers by each underlying CAN Transceiver Driver module. For each CAN transceiver Driver a seperate instance of this container shall be provided.
      container CanIfTrcvCfg [1..*]  # This container contains the configuration (parameters) of one addressed CAN transceiver by the underlying CAN Transceiver Driver module. For each CAN transceiver a seperate instance of this container has to be provided.
        integer CanIfTrcvId: 0..65535, set at pre-compile, symbolic-name-value=true  # This parameter abstracts from the CAN Transceiver Driver specific parameter Transceiver. Each transceiver of all connected CAN Transceiver Driver modules shall be assigned to one specific TransceiverId of the CanIf. | Range: 0..number of configured transceivers of all CAN Transceiver Driver modules
        boolean CanIfTrcvWakeupSupport: category=NOT_SUPPORTED, set at pre-compile, default-value=false  # This parameter defines if a respective transceiver of the referenced CAN Transceiver Driver modules is queriable for wake up events. | True: Enabled False: Disabled
        symbolic name reference CanIfTrcvCanTrcvRef: set at pre-compile, destination=CanTrcvChannel  # This parameter references to the logical handle of the underlying CAN | transceiver from the CAN transceiver driver module to be served by the CAN Interface module. Range: 0..max. number of underlying supported CAN transceivers
