AUTOSAR XML (schema 4.0)
package /BSW_Crypto_76_HaeModule
  bsw implementation BswImplementation_Crypto_76_HaeModule: programming-language=C, sw-version=1.0.2, vendor-id=76, ar-release-version=4.4.0, behavior=BswInternalBehavior_Crypto_76_HaeModule, vendor-api-infix=HaeModule, vendor-specific-module-def=Crypto
  bsw module description Crypto: category=BSW_MODULE, module-id=255
    implemented-entrys:
      Crypto_76_HaeModule_Init
      Crypto_76_HaeModule_GetVersionInfo
      Crypto_76_HaeModule_ProcessJob
      Crypto_76_HaeModule_CancelJob
      Crypto_76_HaeModule_KeyElementSet
      Crypto_76_HaeModule_KeySetValid
      Crypto_76_HaeModule_KeyElementGet
      Crypto_76_HaeModule_KeyElementCopy
      Crypto_76_HaeModule_KeyElementPartialCopy
      Crypto_76_HaeModule_KeyCopy
      Crypto_76_HaeModule_KeyElementIdsGet
      Crypto_76_HaeModule_RandomSeed
      Crypto_76_HaeModule_KeyGenerate
      Crypto_76_HaeModule_KeyDerive
      Crypto_76_HaeModule_KeyExchangePubValCalc
      Crypto_76_HaeModule_KeyExchangeSecretCalc
      Crypto_HaeHsm_MainFunction
      Crypto_HaeCryptoLib_MainFunction
    bsw internal behavior BswInternalBehavior_Crypto_76_HaeModule: bsw-exclusive-area-policy{api-principle=COMMON, exclusive-area=GLOBALVAR_PROTECTION}
      exclusive area GLOBALVAR_PROTECTION
      bsw schedulable entity BswSE_Crypto_HaeHsm_MainFunction: can-enter-exclusive-area=GLOBALVAR_PROTECTION, implemented-entry=Crypto_HaeHsm_MainFunction
      bsw schedulable entity BswSE_Crypto_HaeCryptoLib_MainFunction: can-enter-exclusive-area=GLOBALVAR_PROTECTION, implemented-entry=Crypto_HaeCryptoLib_MainFunction
      bsw timing event BswTE_Crypto_HaeHsm_MainFunction: starts-on-event=BswSE_Crypto_HaeHsm_MainFunction, period=0.1
      bsw timing event BswTE_Crypto_HaeCryptoLib_MainFunction: starts-on-event=BswSE_Crypto_HaeCryptoLib_MainFunction, period=0.1
      bsw distinguished partition BswDistinguishedPartition_Crypto_76_HaeModule
  18 x bsw module entry, all with execution-context=TASK, sw-service-impl-policy=STANDARD, bsw-entry-kind=CONCRETE:
    Crypto_76_HaeModule_CancelJob: service-id=0x0e, is-reentrant=false, is-synchronous=true, call-type=REGULAR  # Crypto_CancelJob | This interface removes the provided job from the queue and cancels the processing of the job if possible.
      return type Std_ReturnType: implementation-data-type=Std_ReturnType
      sw service arg objectId: direction=IN, implementation-data-type=uint32  # Holds the identifier of the Crypto Driver Object.
      sw service arg job: direction=INOUT, implementation-data-type=Crypto_JobInfoType  # Pointer to the configuration of the job. Contains structures with job and primitive relevant information.
    Crypto_76_HaeModule_GetVersionInfo: service-id=0x01, is-reentrant=true, is-synchronous=true, call-type=REGULAR  # Crypto_GetVersionInfo | Returns the version information of this module.
      sw service arg versioninfo: direction=IN, implementation-data-type=Std_VersionInfoType  # Pointer to where to store the version information of this module.
    Crypto_76_HaeModule_Init: service-id=0x00, is-reentrant=true, is-synchronous=true, call-type=REGULAR  # Crypto_Init | Initializes the Crypto Driver.
      sw service arg configPtr: direction=IN, implementation-data-type=Crypto_ConfigType  # Pointer to a selected configuration structure
    Crypto_76_HaeModule_KeyCopy: service-id=0x10, is-reentrant=false, is-synchronous=true, call-type=REGULAR  # Crypto_KeyCopy | Copies a key with all its elements to another key in the same crypto driver. Note: If the actual key element is directly mapped to flash memory, there could be a bigger delay when calling this function (synchronous operation)
      return type Std_ReturnType: implementation-data-type=Std_ReturnType
      sw service arg cryptoKeyId: direction=IN, implementation-data-type=uint32  # Holds the identifier of the key whose key element shall be the source element.
      sw service arg targetCryptoKeyId: direction=IN, implementation-data-type=uint32  # Holds the identifier of the key whose key element shall be the destination element.
    Crypto_76_HaeModule_KeyDerive: service-id=0x08, is-reentrant=false, is-synchronous=true, call-type=REGULAR  # Crypto_KeyDerive | Derives a new key by using the key elements in the given key identified by the cryptoKeyId. The given key contains the key elements for the password, salt. The derived key is stored in the key element with the id 1 of the key identified by targetCryptoKeyId. The number of iterations is given in the key element CRYPTO_KE_KEYDERIVATION_ITERATIONS.
      return type Std_ReturnType: implementation-data-type=Std_ReturnType
      sw service arg cryptoKeyId: direction=IN, implementation-data-type=uint32  # Holds the identifier of the key which is used for key derivation.
      sw service arg targetCryptoKeyId: direction=IN, implementation-data-type=uint32  # Holds the identifier of the key which is used to store the derived key.
    Crypto_76_HaeModule_KeyElementCopy: service-id=0x0f, is-reentrant=false, is-synchronous=true, call-type=REGULAR  # Crypto_KeyElementCopy | Copies a key element to another key element in the same crypto driver. Note: If the actual key element is directly mapped to flash memory, there could be a bigger delay when calling this function (synchronous operation)
      return type Std_ReturnType: implementation-data-type=Std_ReturnType
      4 x sw service arg, all with direction=IN, implementation-data-type=uint32:
        cryptoKeyId  # Holds the identifier of the key whose key element shall be the source element.
        keyElementId  # Holds the identifier of the key element which shall be the source for the copy operation.
        targetCryptoKeyId  # Holds the identifier of the key whose key element shall be the destination element.
        targetKeyElementId  # Holds the identifier of the key element which shall be the destination for the copy operation.
    Crypto_76_HaeModule_KeyElementPartialCopy: service-id=0x13, is-reentrant=false, is-synchronous=true, call-type=REGULAR  # Crypto_KeyElementCopyPartial | Copies a key element to another key element in the same crypto driver. The keyElementSourceOffset and keyElementCopyLength allows to copy just a part of the source key element into the destination. The offset of the target key is also specified with this function. | Note: If the actual key element is directly mapped to flash memory, there could be a bigger delay when calling this function (synchronous operation).
      return type Std_ReturnType: implementation-data-type=Std_ReturnType
      7 x sw service arg, all with direction=IN, implementation-data-type=uint32:
        cryptoKeyId  # Holds the identifier of the key whose key element shall be the source element.
        keyElementId  # Holds the identifier of the key element which shall be the source for the copy operation.
        keyElementSourceOffset  # This is the offset of the of the source key element indicating the start index of the copy operation.
        keyElementTargetOffset  # This is the offset of the of the target key element indicating the start index of the copy operation.
        keyElementCopyLength  # Specifies the number of bytes that shall be copied.
        targetCryptoKeyId  # Holds the identifier of the key whose key element shall be the destination element.
        targetKeyElementId  # Holds the identifier of the key element which shall be the destination for the copy operation.
    Crypto_76_HaeModule_KeyElementGet: service-id=0x06, is-reentrant=true, is-synchronous=true, call-type=REGULAR  # Crypto_KeyElementGet | This interface shall be used to get a key element of the key identified by the cryptoKeyId and store the key element in the memory location pointed by the result pointer. Note: If the actual key element is directly mapped to flash memory, there could be a bigger delay when calling this function (synchronous operation).
      return type Std_ReturnType: implementation-data-type=Std_ReturnType
      4 x sw service arg:
        cryptoKeyId: direction=IN, implementation-data-type=uint32  # Holds the identifier of the key whose key element shall be returned.
        keyElementId: direction=IN, implementation-data-type=uint32  # Holds the identifier of the key element which shall be returned.
        resultPtr: direction=OUT, implementation-data-type=uint8  # Holds the pointer of the buffer for the returned key element
        resultLengthPtr: direction=INOUT, implementation-data-type=uint32  # Holds a pointer to a memory location in which the length information is stored. On calling this function this parameter shall contain the size of the buffer provided by resultPtr. If the key element is configured to allow partial access, this parameter contains the amount of data which should be read from the key element. The size may not be equal to the size of the provided buffer anymore. When the request has finished, the amount of data that has been stored shall be stored.
    Crypto_76_HaeModule_KeyElementIdsGet: service-id=0x11, is-reentrant=false, is-synchronous=true, call-type=REGULAR  # Crypto_KeyElementIdsGet | Used to retrieve information which key elements are available in a given key.
      return type Std_ReturnType: implementation-data-type=Std_ReturnType
      sw service arg cryptoKeyId: direction=IN, implementation-data-type=uint32  # Holds the identifier of the key whose available element ids shall be exported.
      sw service arg keyElementIdsPtr: direction=OUT, implementation-data-type=uint32  # Contains the pointer to the array where the ids of the key elements shall be stored.
      sw service arg keyElementIdsLengthPtr: direction=IN, implementation-data-type=uint32  # Holds a pointer to the memory location in which the number of key elements in the given key is stored. On calling this function, this parameter shall contain the size of the buffer provided by keyElementIdsPtr. When the request has finished, the actual number of key elements shall be stored.
    Crypto_76_HaeModule_KeyElementSet: service-id=0x04, is-reentrant=false, is-synchronous=true, call-type=REGULAR  # Crypto_KeyElementSet | Sets the given key element bytes to the key identified by cryptoKeyId.
      return type Std_ReturnType: implementation-data-type=Std_ReturnType
      4 x sw service arg, all with direction=IN:
        cryptoKeyId: implementation-data-type=uint32  # Holds the identifier of the key whose key element shall be set.
        keyElementId: implementation-data-type=uint32  # Holds the identifier of the key element which shall be set.
        keyPtr: implementation-data-type=uint8  # Holds the pointer to the key data which shall be set as key element.
        keyLength: implementation-data-type=uint32  # Contains the length of the key element in bytes.
    Crypto_76_HaeModule_KeyExchangePubValCalc: service-id=0x09, is-reentrant=false, is-synchronous=true, call-type=REGULAR  # Crypto_KeyExchangeCalcPubVal | Calculates the public value for the key exchange and stores the public key in the memory location pointed by the public value pointer.
      return type Std_ReturnType: implementation-data-type=Std_ReturnType
      sw service arg cryptoKeyId: direction=IN, implementation-data-type=uint32  # Holds the identifier of the key which shall be used for the key exchange protocol.
      sw service arg publicValuePtr: direction=OUT, implementation-data-type=uint8  # Contains the pointer to the data where the public value shall be stored.
      sw service arg publicValueLengthPtr: direction=INOUT, implementation-data-type=uint32  # Holds a pointer to the memory location in which the public value length information is stored. On calling this function, this parameter shall contain the size of the buffer provided by publicValuePtr. When the request has finished, the actual length of the returned value shall be stored.
    Crypto_76_HaeModule_KeyExchangeSecretCalc: service-id=0x0a, is-reentrant=false, is-synchronous=true, call-type=REGULAR  # Crypto_KeyExchangeCalcSecret | Calculates the shared secret key for the key exchange with the key material of the key identified by the cryptoKeyId and the partner public key. The shared secret key is stored as a key element in the same key.
      return type Std_ReturnType: implementation-data-type=Std_ReturnType
      sw service arg cryptoKeyId: direction=IN, implementation-data-type=uint32  # Holds the identifier of the key which shall be used for the key exchange protocol.
      sw service arg partnerPublicValuePtr: direction=IN, implementation-data-type=uint8  # Holds the pointer to the memory location which contains the partner's public value.
      sw service arg partnerPublicValueLength: direction=IN, implementation-data-type=uint32  # Contains the length of the partner's public value in bytes.
    Crypto_76_HaeModule_KeyGenerate: service-id=0x07, is-reentrant=false, is-synchronous=true, call-type=REGULAR  # Crypto_KeyGenerate | Generates new key material store it in the key identified by cryptoKeyId.
      return type Std_ReturnType: implementation-data-type=Std_ReturnType
      sw service arg cryptoKeyId: direction=IN, implementation-data-type=uint32  # Holds the identifier of the key which is to be updated with the generated value.
    Crypto_76_HaeModule_KeySetValid: service-id=0x05, is-reentrant=false, is-synchronous=true, call-type=REGULAR  # Crypto_KeySetValid | Sets the key state of the key identified by cryptoKeyId to valid.
      return type Std_ReturnType: implementation-data-type=Std_ReturnType
      sw service arg cryptoKeyId: direction=IN, implementation-data-type=uint32  # Holds the identifier of the key which shall be set to valid.
    Crypto_76_HaeModule_ProcessJob: service-id=0x03, is-reentrant=true, is-synchronous=false, call-type=REGULAR  # Crypto_ProcessJob | Performs the crypto primitive, that is configured in the job parameter.
      return type Std_ReturnType: implementation-data-type=Std_ReturnType
      sw service arg objectId: direction=IN, implementation-data-type=uint32  # Holds the identifier of the Crypto Driver Object.
      sw service arg job: direction=INOUT, implementation-data-type=Crypto_JobType  # Pointer to the configuration of the job. Contains structures with job and primitive relevant information but also pointer to result buffers.
    Crypto_76_HaeModule_RandomSeed: service-id=0x0d, is-reentrant=false, is-synchronous=true, call-type=REGULAR  # Crypto_RandomSeed | This function generates the internal seed state using the provided entropy source. Furthermore, this function can be used to update the seed state with new entropy
      return type Std_ReturnType: implementation-data-type=Std_ReturnType
      sw service arg cryptoKeyId: direction=IN, implementation-data-type=uint32  # Holds the identifier of the key for which a new seed shall be generated.
      sw service arg seedPtr: direction=IN, implementation-data-type=uint8  # Holds a pointer to the memory location which contains the data to feed the seed.
      sw service arg seedLength: direction=IN, implementation-data-type=uint32  # Contains the length of the seed in bytes.
    Crypto_HaeHsm_MainFunction: service-id=0x0c, is-reentrant=false, is-synchronous=true, call-type=SCHEDULED  # If asynchronous job processing is configured and there are job queues, the function is called cyclically to process queued jobs.
    Crypto_HaeCryptoLib_MainFunction: service-id=0x0c, is-reentrant=false, is-synchronous=true, call-type=SCHEDULED  # If asynchronous job processing is configured and there are job queues, the function is called cyclically to process queued jobs.
