AUTOSAR XML (schema 00047)
# (C) 2022 HYUNDAI AUTOEVER Corp.
# Confidential Proprietary Information. Distribution Limited.
# Do Not Copy Without Prior Permission
package /Bsw_Mem
  bsw implementation BswImplementation_Mem: sw-version=0.0.1, vendor-id=76, ar-release-version=4.4.0, behavior=BswInternalBehavior_Mem, vendor-api-infix=Pfls
  bsw module description Mem: module-id=91
    bsw internal behavior BswInternalBehavior_Mem
      exclusive area CRITICAL_SECTION
      bsw schedulable entity BswSE_Mem_76_Pfls_MainFunction: can-enter-exclusive-area=CRITICAL_SECTION, implemented-entry=Mem_MainFunction
      bsw timing event BswTE_Mem_76_Pfls_MainFunction: starts-on-event=BswSE_Mem_76_Pfls_MainFunction, period=0.005
      bsw distinguished partition BswDistinguishedPartition_Mem
  bsw module entry Mem_MainFunction: service-id=3, is-reentrant=false, is-synchronous=true, call-type=SCHEDULED, execution-context=TASK, sw-service-impl-policy=STANDARD
