AUTOSAR XML (schema 4-0-3)
standard types defined: Std_ReturnType, uint8, uint16
package /Autosar_Rte
  bsw implementation BswImplementation_0: programming-language=C, sw-version=4.11.1, used-code-generator=RteCodeGenerator, vendor-id=76, ar-release-version=4.0.3, behavior=BswInternalBehavior_0
    resource consumption ResourceConsumption_0
      6 x memory section, all with prefix=SectionNamePrefix_0:
        RTE_START_SEC_CODE: alignment=CODE, symbol=START
        RTE_STOP_SEC_CODE: alignment=CODE, symbol=STOP
        RTE_START_SEC_VAR_8: alignment=8, symbol=START
        RTE_STOP_SEC_VAR_8: alignment=8, symbol=STOP
        RTE_START_SEC_VAR_NO_INIT_8: alignment=8, symbol=START
        RTE_STOP_SEC_VAR_NO_INIT_8: alignment=8, symbol=STOP
      section name prefix SectionNamePrefix_0: symbol=RTE
  5 x bsw module entry, all with is-reentrant=true, is-synchronous=true, call-type=REGULAR, execution-context=UNSPECIFIED, sw-service-impl-policy=STANDARD:
    Rte_Start: service-id=0x70, role=Rte_Start
      return type Std_ReturnType: direction=OUT, implementation-data-type=Std_ReturnType
    Rte_Stop: service-id=0x71, role=Rte_Stop
      return type Std_ReturnType: direction=OUT, implementation-data-type=Std_ReturnType
    SchM_Init: service-id=0x00, role=SchM_Init
    SchM_Deinit: service-id=0x01, role=SchM_Deinit
    SchM_GetVersionInfo: service-id=0x02, role=SchM_GetVersionInfo
      sw service arg LpVersionInfo: direction=IN, implementation-data-type=Std_VersionInfoType
  bsw module description BswModuleDescription_0: provided-entrys=[Rte_Start, Rte_Stop, SchM_Init, SchM_Deinit, SchM_GetVersionInfo]
    bsw module dependency BswModuleDependency_0: target-module-id=2, required-entrys=[Rte_Start, Rte_Stop, SchM_Init, SchM_Deinit, SchM_GetVersionInfo]
    bsw internal behavior BswInternalBehavior_0
      static-memorys:
        34 x data:
          Rte_GucDcmApplicationUpdated_CurrentMode_modeSwitchPort_DcmApplicationUpdatedBswM: type=uint8
          Rte_GucCanSMState_BCAN_OldMode_modeSwitchPort_CanSMState_BCANBswM: type=uint8
          Rte_GucInitState_NewMode_modeSwitchPort_InitStateBswM: type=uint8
          Rte_GucDcmCommunicationControl_0_CurrentMode_modeSwitchPort_DcmCommunicationControl_0BswM: type=uint8
          Rte_GucEcuMode_OldMode_modeSwitchPort_EcuModeBswM: type=EcuM_StateType
          Rte_GucComMMode_BCAN_CurrentMode_modeSwitchPort_ComMMode_BCANBswM: type=uint8
          Rte_GucWakeupEvent_CurrentMode_modeSwitchPort_WakeupEventBswM: type=uint8
          Rte_GucDcmDiagnosticSessionControl_CurrentMode_modeSwitchPort_DcmDiagnosticSessionControlBswM: type=uint8
          Rte_GucCanSMState_BCAN_NewMode_modeSwitchPort_CanSMState_BCANBswM: type=uint8
          Rte_GucDcmDiagnosticSessionControl_OldMode_modeSwitchPort_DcmDiagnosticSessionControlBswM: type=uint8
          Rte_GuccurrentMode_CurrentMode_globalModeWdgM: type=uint8
          Rte_GuccurrentMode_CurrentMode_UM000_PComM: type=ComM_ModeType
          Rte_GuccurrentMode_OldMode_globalModeWdgM: type=uint8
          Rte_GucCanSMBORState_BCAN_NewMode_modeSwitchPort_CanSMBORState_BCANBswM: type=uint8
          Rte_GucComMMode_BCAN_NewMode_modeSwitchPort_ComMMode_BCANBswM: type=uint8
          Rte_GuccurrentMode_NewMode_globalModeWdgM: type=uint8
          Rte_GucDcmModeRapidPowerShutDown_CurrentMode_modeSwitchPort_DcmModeRapidPowerShutDownBswM: type=uint8
          Rte_GucCanSMState_BCAN_CurrentMode_modeSwitchPort_CanSMState_BCANBswM: type=uint8
          Rte_GucDcmApplicationUpdated_CurrentMode_modeNotificationPort_ApplicationUpdatedSWC_DiagnosticService: type=uint8
          Rte_GuccurrentMode_CurrentMode_mode_SE_InitWdgM: type=uint8
          Rte_GucDcmDiagnosticSessionControl_NewMode_modeSwitchPort_DcmDiagnosticSessionControlBswM: type=uint8
          Rte_GucComMMode_BCAN_OldMode_modeSwitchPort_ComMMode_BCANBswM: type=uint8
          Rte_GucDcmControlDTCSetting_CurrentMode_modeSwitchPort_DcmControlDTCSettingBswM: type=uint8
          Rte_GucCanSMBORState_BCAN_CurrentMode_modeSwitchPort_CanSMBORState_BCANBswM: type=uint8
          Rte_GucEcuMode_CurrentMode_modeSwitchPort_EcuModeBswM: type=EcuM_StateType
          Rte_GuccurrentMode_CurrentMode_UM002_PComM: type=ComM_ModeType
          Rte_GucInitState_OldMode_modeSwitchPort_InitStateBswM: type=uint8
          Rte_GucWakeupEvent_NewMode_modeSwitchPort_WakeupEventBswM: type=uint8
          Rte_GucCanSMBORState_BCAN_OldMode_modeSwitchPort_CanSMBORState_BCANBswM: type=uint8
          Rte_GucInitState_CurrentMode_modeSwitchPort_InitStateBswM: type=uint8
          Rte_GuccurrentMode_CurrentMode_mode_SE_WdgMTestWdgM: type=uint8
          Rte_GucWakeupEvent_OldMode_modeSwitchPort_WakeupEventBswM: type=uint8
          Rte_GucEcuMode_NewMode_modeSwitchPort_EcuModeBswM: type=EcuM_StateType
          Rte_GuccurrentMode_CurrentMode_UM001_PComM: type=ComM_ModeType
      5 x bsw called entity:
        BswCalledEntity_0: implemented-entry=Rte_Start
        BswCalledEntity_1: implemented-entry=Rte_Stop
        BswCalledEntity_3: implemented-entry=SchM_Init
        BswCalledEntity_4: implemented-entry=SchM_Deinit
        BswCalledEntity_5: implemented-entry=SchM_GetVersionInfo
  impl type Std_VersionInfoType: category=DATA_REFERENCE
    5 x element:
      vendorID: base-type=uint16
      moduleID: base-type=uint16
      sw_major_version: base-type=uint8
      sw_minor_version: base-type=uint8
      sw_patch_version: base-type=uint8
