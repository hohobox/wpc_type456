AUTOSAR XML (schema 4-0-3)
# (C) 2021 HYUNDAI AUTOEVER Corp.
# Confidential Proprietary Information. Distribution Limited.
# Do Not Copy Without Prior Permission
package /AUTRON
  ecuc definition collection Build_PDF: module=SCons
  module definition SCons: variants pre-compile  # Configuration of build system.
    container Build: category=FIXED
      enumeration McuFamilyType: {Auto, BCM8910X, MPC560XB, RH850F1K, RH850F1KM, RH850F1L, RH850U2A, S32GX, S32KX, S32VX, S6J32xx, S6J33xx, SPC58X, TC2XX, TC3XX, TDA2XX, TDA3XX, TDA4XX, CYT2B9XX, CYTxBxx, ORINX, VCP3, AXON}, category=FIXED
      string CANoePath [0..255]  # Give CANoe path e.g.)C:\Program Files\Vector CANoe 8.5\Exec64\CANoe64.exe
      string Trace32Path [0..255]  # Give Trace32 path e.g.)D:\ts_mirr\t32\T32_201602\bin\windows64\
      string IntTestDirectory [0..1]: category=FIXED  # Give integration test folder relative directory to perform integration test e.g.) Static_Code\b_autosar_swc_IntegrationTest
      string ReleaseDir [0..1]  # Give top directory for released project "D:\Released" will place released project under D:\Released folder e.g.) D:\Released\e_qe_sq_ibu_asr_swp_R181010 By default, released project will be on the same directory as the original project
      boolean DebugMode [0..1]: default-value=false  # Set for debugging mode for Toolset
      string ArianFolder [0..255]: category=FIXED  # Give ARIAN files top folder relative path
      string FBLFolder [0..1]  # Give FBL top directory. If not set, FBL generated result will be located under RTSW's generated folders. Relative to current project directory and it should be case-sensative. ex) FBL
      boolean CopyToCProject [0..1]: default-value=false  # By default, excluding list from .cproject will be used and copied to SCons.arxml. If set to true, excluding list from SCons.arxml will be used and copied to .cproject file.
      string EnvOptions [0..255]  # Give any additional environment key, value DO NOT SET THESE VALUES UNLESS YOU KNOW HOW
      multiline string PostBuildCommand [0..1]  # Give any commands after build process is finished. It will be excecuted after executable file (elf) is generated. e.g) echo hello call D:\Test.bat input1 input2 input3
      container Generation  # To generate configured modules.
        string McalGeneratorPath  # Give MCAL generator full path e.g.)F:\ts_mirr\xml\tc29x\TC29x_BC_PB_V520\bin\tresos_cmd.bat
        string JavaHomePath [0..1]  # Give full path for Java (JRE) e.g.)C:\ProgramData\Oracle\Java\javapath\java.exe
        string TransformerGeneratorPath [0..1]  # Give TransformerGenerator path e.g.) D:\ts_mirr\xml
        string ExternalGeneratorRootPath [0..1]  # Give External Generator Root path e.g.) D:\ts_mirr\xml
        string OverrideFolders [0..255]  # Give folders for generation source files that needs to be detected by SCons, separated by comma(,) e.g.) Static_Code, Configuration_App Files in the given folders will be used for generation process if same files are detected
        string McalAutosarVersion [0..1]  # This configuration is only for tresos MCAL generator. If this is not set, it defaults to null and a content type is applied as "asc". These content type versions are validated against different XSD schemas and their characteristics differ from each other. e.g) If xsi:schemaLocation in an arxml file of a mcal is as follows, <AUTOSAR xmlns="http://autosar.org/schema/r4.0" xmlns:xsi="http://www.w3.org/2001/XMLSchema-instance" xsi:schemaLocation="http://autosar.org/schema/r4.0 AUTOSAR_00047.xsd"> then this configuration should be set as "4.4.0" and a content type is applied as "asc:4.4.0". If a xsd filename is AUTOSAR_00046 and AUTOSAR_00047, AUTOSAR Classic version is 4.4.0. (AUTOSR_4-0-3.xsd -> 4.0.3) The schema releases match to the AUTOSAR standards as follows: AUTOSAR_00042.xsd AP Release 17-03 (covers CP 4.3.0, AP 17-03) AUTOSAR_00043.xsd AP Release 17-10 (covers CP 4.3.0, AP 17-10) AUTOSAR_00044.xsd CP Release 4.3.1 (covers CP 4.3.1, AP 17-10) AUTOSAR_00045.xsd AP Release 18-03 (covers CP 4.3.1, AP 18-03) AUTOSAR_00046.xsd CP Release 4.4.0/AP Release 18-10 (covers CP 4.4.0, AP 18-10) AUTOSAR_00047.xsd AP Release 19-03 (covers CP 4.4.0, AP 19-03) AUTOSAR_00048.xsd CP and AP Release 19-11 (covers 4.5.0)
        container Module [1..65535]: multiple-configuration-container=true
          enumeration ModuleName: {Adc, Arti, Atm, Base, BndM, BswM, CDD_Router, Can, CanCM, CanIf, CanNm, CanSM, CanTSyn, CanTp, CanTrcv, CanXL, CanXLTrcv, Cdd, ChargM, CnV2xM, CnV2xMsg, CnV2xNet, CnV2xSec, CoSvAb, Com, ComM, ComXf, CorTst, Crc, CryIf, Crypto, Crypto_76_HaeModule, CryptoLib, Csm, CtrlRam, CV2x, Dcm, Dds, Dem, Det, Dio, Dlt, DoIP, DualM, E2EXf, Ea, EcuM, Eep, Eol, Eth, EthDiag, EthIf, EthSM, EthSwt, EthTSyn, EthTrcv, FBL, Fee, FiM, Fls, FlsLoader, FlsTst, Fota, Fr, FrArTp, FrIf, FrNm, FrSM, FrTSyn, FrTp, FrTrcv, Fw, Gpt, HTMSS, HwResource, Icu, IdsM, IEEE1722Tp, IoHwAb, IpduM, Irq, J1939Dcm, J1939Nm, J1939Rm, J1939Tp, KeyM, LdCom, Lin, LinIf, LinNm, LinSM, LinTrcv, LSduR, McalLib, Mcl, Mcu, Mem, MemAcc, MemIf, Mka, MuxDemuxIf, Nm, NvM, Ocu, Os, OsImp, OsProfiler, Os_Common, OsekNm, PduR, Pm, Port, ProvAd, Ptn, Pwm, RamTst, RegMon, Resource, ResourceM, RomTst, Rte, Sd, SecOc, Sent, Smu, SoAd, SomeIpTp, SomeIpXf, Spi, StbM, SwCluC, T1Ad, TcpIp, Tm, Ttcan, TtcanIf, Uart, UdpNm, V2xBtp, V2xFac, V2xGn, V2xM, WEth, WEthTrcv, Wdg, WdgIf, WdgM, Xcp, Other}  # Select modules to be generated.
          string InputFilesList [1..255]  # List input file names for generation (seperated by comma and exclude file extension for arxml but include extension if not) e.g.) Ecud_WdgM, Ecud_WdgIf, Os.template
          string ExpectedFilesList [1..255]  # List expected file names to be generated (seperated by comma) e.g.) WdgM_Cfg.h,WdgM_Cfg.c, Os_Lsl.ld, Swcd_Bsw_Dcm.arxml
          string BswDefines [0..255]  # Give BSWDEFINES for generator, seperate by comma. e.g.) ldfile, Build\bcm89103_gnu.ld
          string BswIncludePath [0..255]  # Give BSW_INCLUDE_PATH for generator, seperate by comma. e.g.) Configuration\Test_Config, Configuration\System\Bswmd
          string BswFlags [0..255]  # Give BSW_FLAGS for generator, seperate by comma(,) e.g.) -P=xxxx Only supports -P/PDF option for TcpIp module only for now
          boolean IsMCAL  # Check if module is given by MCAL vendor
          string McalDefineTarget [0..1]  # Give BSWDEFINES for generator, seperate by comma. e.g.) ldfile, Build\bcm89103_gnu.ld
          string McalDefineDerivate [0..1]  # Give BSWDEFINES for generator, seperate by comma. e.g.) ldfile, Build\bcm89103_gnu.ld
          string MCAL_GeneratorPostfix [0..1]  # Give MCAL generator name postfix (For RH850F1x the generator name has postfix, Wdg_X1x.exe) e.g) X1x
          boolean Used  # Check if module is used
          string TestInputFilesList [0..255]: category=FIXED  # List input file names for integration test (seperated by comma and exclude file arxml extension) e.g.) Ecud_Pm_IntTst, Ecud_EcuM_IntTst
          string GeneratorName [0..1]  # If generator name does not match module name or extension is not .exe then Give generator file name with extension. ex) TSync.exe or TSync.bat
          boolean AUTOSAR44 [0..1]  # Check if module is based on AUTOSAR 44 which uses yml as an input.
          multiline string ModuleOptions [0..1]  # Give any options that must be passed to module generator (for AR44 only) separate each option with new line. e.g.) msnAlias: Os ORTI: above will set yml file like below OsCommon: ModuleOptions: msnAlias: Os ORTI:
      container Compile  # To generate configured modules.
        string ArchivePath  # Give Archive executor path for the compiler e.g.) F:\ts_mirr\tasking\tricore.vx42r2ctc\bin\artc.exe
        string CSuffixes  # Enter suffixes to be compiled seperated by comma(,) e.g.) c, C, ppc,asm,S,s
        string CompilerLicense [0..1]  # Give Compiler license path or ip address separated by comma(,) e.g) ip=10.5.33.161, path=Build/license.ghslic
        string CompilerPath  # Give Compiler path for the compiler e.g.) d:/ts_mirr/gh/V800.V2013.5.5.p42/ccrh850.exe
        string DefaultCompileOption [1..65535]  # Give Default Compile Option (CCFLAGS) values seperated by comma (,) e.g.) -Wall, -Wextra, -mcpu=cortex-m7,mthumb
        string DefaultDefineOption [0..65535]  # Give Default Define Option (CPPDEFINES) values seperated by comma (,) e.g.) __SC1__, __OS_HANDLES__ These values will have prefix -D e.i) -D__SC1__
        string LibraryDirectory [0..65535]  # Give library directory relative to project directory e.g) Static_Code/Modules/b_autosar_sys_CryptoLib/lib/CycurLib/bin
        string LibraryFiles [0..255]  # Give library file names without lib seperated by comma (,) e.g) c, nosys, gcc Actual file names would be libc.a, libnosys.a, libgcc.a
        string LinkDiscriptFile  # Give Link Discription file (.ld) directory relative to the project e.g) Build\xxxx.ld
        string LinkOption [1..255]  # Give Link option (LINKFLAGS) for linking process e.g) -e _RESET, -map,-keepmap
        string LinkerPath  # Give Linker path for the compiler e.g.) F:\ts_mirr\tasking\tricore.vx42r2ctc\bin\ltce.exe
        string ObjectFiles [0..65535]  # Give library file path(s) and name(s) e.g) D:\ts_mirr\gh\V800.V2015.1.7.p8\lib\rh850\crt.o
        string ReleaseExceptedDirectory [1..255]  # Enter extra release excepted folder e.g.) test_folder These folders are excepted already ['.svn', 'Debug_FBL', 'Debug', 'FBL_Output', 'FBL']
        string ReleaseExceptedFile [1..65535]  # Enter release excepted file pattern (ignore CASE) e.g.) .AIS, .bak, .etc These file patterns are excepted already .static_wa, .dblite , .cproject, .project, .zip, _LibFileList.xml, _FBL.arxml , _FBL.py , _FBL, _FBL.ld, .AIS, InstallTools.bat
        enumeration CompilerType: {armds, armgcc, multiide, tasking, ti}, category=FIXED  # Select compiler type 1. multiide : ghs compiler 2. tasking : tasking compiler 3. armgcc : gcc compiler supporing arm 4. armds : ARM Development Studio
        string OverrideFolders [0..255]  # Give folders for compile source files that needs to be detected by SCons, separated by comma(,) e.g.) Static_Code Files in the given folders will be used for compile process if same files are detected.
        boolean RecursiveHeaderPath [0..1]  # If set to true, header path will be passed to compiler recursively. ex) If Adc.h is under directory dir/subdir then compile option '-I' will be as below... -Idir -Idir/subdir
        container Pattern [1..255]: multiple-configuration-container=true
          enumeration PatternType: {MCAL, BSW, ASW, FBL}  # Check corresponding pattern for you build option
          string CompileOption [1..65535]  # Give Compile Option (CCFLAGS) values seperated by comma (,) e.g.) -Wall, -Wextra, -mcpu=cortex-m7,mthumb
          string DefineOption [0..65535]  # Give Define Option (CPPDEFINES) values seperated by comma (,) e.g.) __SC1__, __OS_HANDLES__ These values will have prefix -D e.i) -D__SC1__
          string SourcePath [1..65535]  # Give source path(s) where the options should be used e.g) Static_Code\Modules\b_autosar_mcal_BCM8910x
          boolean IsInternalFile  # Check 'True' if the pattern is for library option 'False' will not create library file unless listed in "Xxx_LibFileList.xml" file
          string InternalLibPath [1..65535]  # Give internal library (.a) files to be archived into a single library(.a) file e.g) Static_Code\Modules\b_autosar_sys_CryptoLib\lib\CycurLib\bin\libcycurlib_RH850.a
        choice container CompileCmdChoice [1..3]  # Select Build process type for excluding files/folders settings Possible options are stated below. Build : Exclude files/folders for Build process Release : Exclude files/folders for Release process Compile : Exclude files/folders for Compile only process MAKE SURE ABOVE STRING MATCHES ARGUMENT PARAMETER TO BUILD.BAT FILE e.g) .\Build\build.bat Build or .\Build\build.bat Release or .\Build\build.bat Compile
          container Release
            string ExcludeList [1..65535]  # Enter files/folders to exclude path relative to project directory. e.g) Static_Code\Test_Folder
          container Build
            string ExcludeList [1..65535]  # Enter files/folders to exclude path relative to project directory. e.g) Static_Code\Test_Folder
          container Compile
            string ExcludeList [1..65535]  # Enter files/folders to exclude path relative to project directory. e.g) Static_Code\Test_Folder
        container CompilerVendorSpecific [0..1]  # Defines settings for defining and utilizing specific features of the compiler. Do not set for compilers that are not used.
          container Tasking [0..1]  # TASKING compiler
            container ElfPatch [0..1]  # Tasking Compiler - ELF Patch Configuration
              boolean ElfPatchSupport  # Determines whether to support the ELF Patch feature. If set to true, the feature is supported, and the remaining settings do not support the feature.
              container RenameSection [0..255]: multiple-configuration-container=true  # Sets the ELF Patch feature to rename sections based on section name or rename sections based on symbol name.
                string ScriptFile  # An ELF patch command file contains one or more commands to rename a section.
                string ElfPatchOptions [0..1]  # elfpatch.exe options
              container ModificationFiles [0..255]: multiple-configuration-container=true  # Sets the function to apply ELF Patch by mixing the following two methods. 1. Data Reference Modification File (Modification of references to global variables or functions inside C functions or Modification of data references inside C structures) or 2. ELF Symbol Renaming Command File (To rename an ELF symbol)
                string OutputFileName  # Sets the file names to be specified as the names of the elf, hex, and sre files after the ELF Patch and Patch.
                container ModificationPatch [1..255]: multiple-configuration-container=true
                  enumeration PatchMethodSelection: {DataReferenceModification, SymbolRenamingCommand}  # This is the method to choose how to apply the ELF Patch. There are two methods to choose from: > DataReferenceModification: Data Reference Modification File (Modification of references to global variables or functions inside C functions or Modification of data references inside C structures) > SymbolRenamingCommand: ELF Symbol Renaming Command File (To rename an ELF symbol)
                  string ScriptFile  # An ELF patch data reference modification (DRM) file or an ELF symbol renaming command file (SRF)
                  string PatchApplicableFile  # A patched file
                  string ElfPatchOptions [0..1]  # elfpatch.exe options
          container MultiIDE [0..1]  # Green Hills Software's MULTI IDE compiler
