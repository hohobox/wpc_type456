AUTOSAR XML (schema 4-0-3)
package /AUTRON
  module config SCons
    FBL (Build): McuFamilyType=CYT2B9XX, CopyToCProject=1
      Compile:
        CSuffixes = c
        CSuffixes = s
        CSuffixes = arm
        CompilerPath = D:\ts_mirr\gh\ARM.V2017.1.4\comp_201714\ccarm.exe
        RecursiveHeaderPath = 0
        CompilerType = multiide
        CompilerLicense = ip=192.168.10.162
        LinkOption = --nocpp
        LibraryDirectory = D:\ts_mirr\gh\ARM.V2017.1.4\comp_201714\lib\thumb2
        LinkOption = -Mn
        LinkOption = -delete
        LinkOption = -keepmap
        ReleaseExceptedDirectory = ext_lib
        ReleaseExceptedDirectory = lib
        DefaultCompileOption = -cpu=cortexm4f
        DefaultCompileOption = -thumb
        DefaultCompileOption = -thumb_lib
        DefaultCompileOption = --short_enum
        DefaultCompileOption = -align4
        DefaultCompileOption = --no_commons
        DefaultCompileOption = --no_alternative_tokens
        DefaultCompileOption = -asm3g
        DefaultCompileOption = -preprocess_assembly_files
        DefaultCompileOption = -nostartfiles
        DefaultCompileOption = -globalcheck=normal
        DefaultCompileOption = -globalcheck_qualifiers
        DefaultCompileOption = --prototype_errors
        DefaultCompileOption = -Wformat
        DefaultCompileOption = -Wimplicit-int
        DefaultCompileOption = -Wshadow
        DefaultCompileOption = -Wtrigraphs
        DefaultCompileOption = -Wundef
        DefaultCompileOption = -reject_duplicates
        DefaultCompileOption = -c
        DefaultCompileOption = -list
        DefaultCompileOption = -OI
        DefaultCompileOption = -Olink
        DefaultCompileOption = -Ointerproc
        DefaultCompileOption = -Omax
        DefaultCompileOption = -dwarf2
        DefaultCompileOption = -G
        DefaultCompileOption = -D__ghs__
        DefaultCompileOption = -D__GHS__
        DefaultCompileOption = -DCY_USE_PSVP=0
        DefaultCompileOption = -DCPU_BOARD_REVC
        DefaultCompileOption = -Osize
        DefaultCompileOption = -D_DualBank_
        LinkOption = -fsingle
        DefaultCompileOption = -fpu=vfpv4_d16
        LinkDiscriptFile = Build\\CYTXXXX_lite.ld
        ObjectFiles = D:\ts_mirr\gh\ARM.V2017.1.4\comp_201714\lib\thumb2\crt0.o
        LinkOption = -cpu=cortexm4f
        LinkOption = --preprocess_linker_directive_full
        LinkOption = -nostartfiles
        LinkOption = -D_LINK_flash_=1
        LinkOption = -D_CORE_cm4_=1
        LinkOption = -DCYT2B9XX
        LinkerPath = D:\ts_mirr\gh\ARM.V2017.1.4\comp_201714\ccarm.exe
        ReleaseExceptedDirectory = report
        LinkOption = -ignore_debug_references
        DefaultCompileOption = -DCYT2BL4CAS
        DefaultCompileOption = -Dtviibe4m
        DefaultCompileOption = -Dcyt2bl
        DefaultDefineOption = MCAL_SUPPORT_MOBILGENE_1_0
        LibraryFiles = HKMC_CryptoLib
        LibraryFiles = HKMC_ASK_Server
        LibraryFiles = HSM_Driver_CYT2BLX_rel
        LibraryFiles = HKMC_SecureFlash2_Except_Crypto
        LibraryDirectory = CryptoLib\HKMC_ASK_Server
        LibraryDirectory = CryptoLib\HKMC_CryptoLib
        LibraryDirectory = CryptoLib\HKMC_SecureFlash2
        LibraryDirectory = CryptoLib\HSM_V2.11.0\HSM_Driver
        CSuffixes = asm
        CSuffixes = asm
        CSuffixes = asm
        CSuffixes = asm
        DefaultCompileOption = -fsingle
        3 x CompileCmdChoice:
          Build
            Build:
              ExcludeList = Static_Code\Modules\b_autosar_com_CanTrcv_R40\delivery\CanTrcv_Version.c
              ExcludeList = Static_Code\Modules\b_autosar_com_CanIf_R40\delivery\CanIf_Version.c
              ExcludeList = Static_Code\Modules\b_autosar_sys_WdgM_R40\delivery\WdgM_Version.c
              ExcludeList = Static_Code\Modules\b_autosar_per_IoHwAb_R40\delivery\IoHwAb_Version.c
              ExcludeList = Static_Code\Modules\b_autosar_mem_MemIf_R40\delivery\MemIf_Version.c
              ExcludeList = Static_Code\Modules\b_autosar_com_IpduM_R40
              ExcludeList = Generated\Mcal_Output\src\Wdg_66_IA_Trigger_Asm_IAR.s
              ExcludeList = Static_Code\Modules\b_autosar_com_CanNm_R40\delivery\src\CanNm_Version.c
              ExcludeList = Generated/Mcal_Output/src/Wdg_66_IA_Trigger_Asm_IAR.s
              ExcludeList = Static_Code/Modules/b_autosar_com_CanIf_R40/delivery/CanIf_Version.c
              ExcludeList = Static_Code/Modules/b_autosar_com_CanTrcv_R40/delivery/CanTrcv_Version.c
              ExcludeList = Static_Code/Modules/b_autosar_com_PduR_R40/delivery/PduR_Version.c
              ExcludeList = Static_Code/Modules/b_autosar_com_TcpIp_R40/delivery/TcpIp_Version.c
              ExcludeList = Static_Code/Modules/b_autosar_mem_MemIf_R40/delivery/MemIf_Version.c
              ExcludeList = Static_Code/Modules/b_autosar_sys_ComM_R40/delivery/ComM_Version.c
              ExcludeList = Static_Code/Modules/b_autosar_sys_WdgM_R40/delivery/WdgM_Version.c
              ExcludeList = Static_Code/Modules/b_autosar_com_CanSm_R40/delivery/CanSM_Version.c
              ExcludeList = Static_Code/Modules/b_autosar_com_CanIf_R40/delivery/src/CanIf_Version.c
              ExcludeList = Static_Code/Modules/b_autosar_com_CanSm_R40/delivery/src/CanSM_Version.c
              ExcludeList = Static_Code/Modules/b_autosar_com_CanTrcv_R40/delivery/src/CanTrcv_Version.c
              ExcludeList = Static_Code/Modules/b_autosar_sys_WdgM_R40/delivery/src/WdgM_Version.c
              ExcludeList = Static_Code/Modules/b_mcal_infineon_CYTxxx/b_mcal_Lin_infineon_CYTxxx/src/Lin.c
              ExcludeList = Static_Code/Modules/b_mcal_infineon_CYTxxx/b_mcal_Lin_infineon_CYTxxx/include/Lin.h
              ExcludeList = Static_Code/Modules/b_mcal_infineon_CYTxxx/b_mcal_Lin_infineon_CYTxxx
              ExcludeList = Static_Code/Modules/b_mcal_infineon_CYTxxx/b_mcal_Ocu_infineon_CYTxxx
              ExcludeList = Static_Code/Modules/b_mcal_infineon_CYTxxx/b_mcal_Icu_infineon_CYTxxx
              ExcludeList = Static_Code/Modules/b_mcal_infineon_CYTxxx/b_mcal_Pwm_infineon_CYTxxx
              ExcludeList = Static_Code/Modules/b_mcal_infineon_CYTxxx/b_mcal_Fee_infineon_CYTxxx
              ExcludeList = Static_Code/Modules/b_mcal_infineon_CYTxxx/b_mcal_Fls_infineon_CYTxxx
              ExcludeList = Static_Code/Modules/b_mcal_infineon_CYTxxx/b_mcal_Fls_infineon_CYTxxx/include/Fls.h
              ExcludeList = Static_Code/Modules/b_mcal_infineon_CYTxxx/b_mcal_Can_infineon_CYTxxx/lib_src/Can_BitSearch_IAR.s
              ExcludeList = Static_Code\Integration_Code\integration_Fota_F\usercode\infineon_ucb
              ExcludeList = Static_Code/Modules/b_mcal_infineon_CYTxxx/b_pf_autosar_cypress_bundle/Startup_Files_Multi/tviibe4m/src/system/rev_a/system_tviibe4m_cm4.c
              ExcludeList = Static_Code/Modules/b_mcal_infineon_CYTxxx/b_pf_autosar_cypress_bundle/Startup_Files_Multi/common/src
              ExcludeList = Static_Code/Modules/b_mcal_infineon_CYTxxx/b_pf_autosar_cypress_bundle/Startup_Files_Multi/tviibe4m/src/drivers
          Compile
            Compile:
              ExcludeList = Static_Code\Modules\b_autosar_com_CanTrcv_R40\delivery\CanTrcv_Version.c
              ExcludeList = Static_Code\Modules\b_autosar_com_CanIf_R40\delivery\CanIf_Version.c
              ExcludeList = Static_Code\Modules\b_autosar_sys_WdgM_R40\delivery\WdgM_Version.c
              ExcludeList = Static_Code\Modules\b_autosar_per_IoHwAb_R40\delivery\IoHwAb_Version.c
              ExcludeList = Static_Code\Modules\b_autosar_mem_MemIf_R40\delivery\MemIf_Version.c
              ExcludeList = Static_Code\Modules\b_autosar_com_IpduM_R40
              ExcludeList = Generated\Mcal_Output\src\Wdg_66_IA_Trigger_Asm_IAR.s
              ExcludeList = Static_Code\Modules\b_autosar_com_CanNm_R40\delivery\src\CanNm_Version.c
              ExcludeList = Generated/Mcal_Output/src/Wdg_66_IA_Trigger_Asm_IAR.s
              ExcludeList = Static_Code/Modules/b_autosar_com_CanIf_R40/delivery/CanIf_Version.c
              ExcludeList = Static_Code/Modules/b_autosar_com_CanTrcv_R40/delivery/CanTrcv_Version.c
              ExcludeList = Static_Code/Modules/b_autosar_com_PduR_R40/delivery/PduR_Version.c
              ExcludeList = Static_Code/Modules/b_autosar_com_TcpIp_R40/delivery/TcpIp_Version.c
              ExcludeList = Static_Code/Modules/b_autosar_mem_MemIf_R40/delivery/MemIf_Version.c
              ExcludeList = Static_Code/Modules/b_autosar_sys_ComM_R40/delivery/ComM_Version.c
              ExcludeList = Static_Code/Modules/b_autosar_sys_WdgM_R40/delivery/WdgM_Version.c
              ExcludeList = Static_Code/Modules/b_autosar_com_CanSm_R40/delivery/CanSM_Version.c
              ExcludeList = Static_Code/Modules/b_autosar_com_CanIf_R40/delivery/src/CanIf_Version.c
              ExcludeList = Static_Code/Modules/b_autosar_com_CanSm_R40/delivery/src/CanSM_Version.c
              ExcludeList = Static_Code/Modules/b_autosar_com_CanTrcv_R40/delivery/src/CanTrcv_Version.c
              ExcludeList = Static_Code/Modules/b_autosar_sys_WdgM_R40/delivery/src/WdgM_Version.c
              ExcludeList = Static_Code/Modules/b_mcal_infineon_CYTxxx/b_mcal_Lin_infineon_CYTxxx/src/Lin.c
              ExcludeList = Static_Code/Modules/b_mcal_infineon_CYTxxx/b_mcal_Lin_infineon_CYTxxx/include/Lin.h
              ExcludeList = Static_Code/Modules/b_mcal_infineon_CYTxxx/b_mcal_Lin_infineon_CYTxxx
              ExcludeList = Static_Code/Modules/b_mcal_infineon_CYTxxx/b_mcal_Ocu_infineon_CYTxxx
              ExcludeList = Static_Code/Modules/b_mcal_infineon_CYTxxx/b_mcal_Icu_infineon_CYTxxx
              ExcludeList = Static_Code/Modules/b_mcal_infineon_CYTxxx/b_mcal_Pwm_infineon_CYTxxx
              ExcludeList = Static_Code/Modules/b_mcal_infineon_CYTxxx/b_mcal_Fee_infineon_CYTxxx
              ExcludeList = Static_Code/Modules/b_mcal_infineon_CYTxxx/b_mcal_Fls_infineon_CYTxxx
              ExcludeList = Static_Code/Modules/b_mcal_infineon_CYTxxx/b_mcal_Fls_infineon_CYTxxx/include/Fls.h
              ExcludeList = Static_Code/Modules/b_mcal_infineon_CYTxxx/b_mcal_Can_infineon_CYTxxx/lib_src/Can_BitSearch_IAR.s
              ExcludeList = Static_Code\Integration_Code\integration_Fota_F\usercode\infineon_ucb
              ExcludeList = Static_Code/Modules/b_mcal_infineon_CYTxxx/b_pf_autosar_cypress_bundle/Startup_Files_Multi/tviibe4m/src/system/rev_a/system_tviibe4m_cm4.c
              ExcludeList = Static_Code/Modules/b_mcal_infineon_CYTxxx/b_pf_autosar_cypress_bundle/Startup_Files_Multi/common/src
              ExcludeList = Static_Code/Modules/b_mcal_infineon_CYTxxx/b_pf_autosar_cypress_bundle/Startup_Files_Multi/tviibe4m/src/drivers
          Release
            Release
        3 x Pattern, all with CompileOption=--no_alternative_tokens, CompileOption=--no_commons, CompileOption=--prototype_errors, CompileOption=--short_enum, CompileOption=-DCPU_BOARD_REVC, CompileOption=-DCY_USE_PSVP=0, CompileOption=-D__ghs__, CompileOption=-G, CompileOption=-OI, CompileOption=-Ointerproc, CompileOption=-Olink, CompileOption=-Omax, CompileOption=-Wformat, CompileOption=-Wimplicit-int, CompileOption=-Wshadow, CompileOption=-Wtrigraphs, CompileOption=-Wundef, CompileOption=-align4, CompileOption=-asm3g, CompileOption=-c, CompileOption=-dwarf2, CompileOption=-globalcheck=normal, CompileOption=-globalcheck_qualifiers, CompileOption=-list, CompileOption=-nostartfiles, CompileOption=-preprocess_assembly_files, CompileOption=-reject_duplicates, CompileOption=-thumb, CompileOption=-thumb_lib, CompileOption=-cpu=cortexm4f, CompileOption=-DCYT2BL4CAS, CompileOption=-Dcyt2bl, CompileOption=-Dtviibe4m, CompileOption=-Osize, CompileOption=-fsingle, CompileOption=-fpu=vfpv4_d16, DefineOption=MCAL_SUPPORT_MOBILGENE_1_0:
          ASW: PatternType=ASW, SourcePath=Static_Code\Reference_Code, IsInternalFile=0, CompileOption=--gnu_asm, DefineOption=DCM_FOTA_USED_FBL
          BSW: PatternType=BSW, IsInternalFile=1, SourcePath=Static_Code\Integration_Code, SourcePath=Static_Code\Modules\b_autosar_HwResource, SourcePath=Static_Code\Modules\b_autosar_Rte_R40, SourcePath=Static_Code\Modules\b_autosar_cdd_CanCM, SourcePath=Static_Code\Modules\b_autosar_com_CanIf_R40, SourcePath=Static_Code\Modules\b_autosar_com_CanSm_R40, SourcePath=Static_Code\Modules\b_autosar_com_CanTp_R40, SourcePath=Static_Code\Modules\b_autosar_com_CanTrcv_R40, SourcePath=Static_Code\Modules\b_autosar_com_Com_R40, SourcePath=Static_Code\Modules\b_autosar_com_IpduM_R40, SourcePath=Static_Code\Modules\b_autosar_com_Nm_R40, SourcePath=Static_Code\Modules\b_autosar_com_OsekNm, SourcePath=Static_Code\Modules\b_autosar_com_PduR_R40, SourcePath=Static_Code\Modules\b_autosar_diag_Dcm_R40, SourcePath=Static_Code\Modules\b_autosar_diag_Dem_R40, SourcePath=Static_Code\Modules\b_autosar_diag_Det_R40, SourcePath=Static_Code\Modules\b_autosar_diag_FiM_R40, SourcePath=Static_Code\Modules\b_autosar_mem_MemIf_R40, SourcePath=Static_Code\Modules\b_autosar_mem_NvM_R40, SourcePath=Static_Code\Modules\b_autosar_mem_RamTst_R40, SourcePath=Static_Code\Modules\b_autosar_mem_RomTst_R40, SourcePath=Static_Code\Modules\b_autosar_per_IoHwAb_R40, SourcePath=Static_Code\Modules\b_autosar_sys_BswM_R40, SourcePath=Static_Code\Modules\b_autosar_sys_ComM_R40, SourcePath=Static_Code\Modules\b_autosar_sys_Crc_R40, SourcePath=Static_Code\Modules\b_autosar_sys_E2E_R40, SourcePath=Static_Code\Modules\b_autosar_sys_EcuM_R40, SourcePath=Static_Code\Modules\b_autosar_sys_WdgIf_R40, SourcePath=Static_Code\Modules\b_autosar_sys_WdgM_R40, SourcePath=Generated\Bsw_Output, SourcePath=Static_Code\Modules\b_autosar_com_ComXf_R43, SourcePath=Static_Code\Modules\b_autosar_sys_E2EXf_R40, SourcePath=Static_Code\Modules\b_autosar_sys_Os_cytxxx_R40, DefineOption=FEE_DECLARATION_MAINFUNCTION, SourcePath=Static_Code\Modules\b_autosar_imp_Os_cytxxx, CompileOption=--gnu_asm, CompileOption=-D_DualBank_, SourcePath=Static_Code\Modules\b_autosar_sys_Csm_R40, SourcePath=Static_Code\Modules\b_autosar_sys_CryptoLib, SourcePath=CryptoLib, SourcePath=Static_Code\Modules\b_autosar_cdd_DataLog, DefineOption=__GHS__, DefineOption=MCAL_SUPPORT_MOBILGENE, SourcePath=Static_Code\Modules\Crypto_76_HaeModule_R44, DefineOption=DCM_FOTA_USED_FBL
          MCAL: PatternType=MCAL, IsInternalFile=0, CompileOption=-C99, SourcePath=Generated\Mcal_Output, SourcePath=Static_Code\Modules\b_mcal_infineon_CYTxxx
      Generation:
        TransformerGeneratorPath = D:\ts_mirr\xml
        McalGeneratorPath = D:\ts_mirr\xml\eb-tresos-TRAVEO-II_V1.16.0\bin\tresos_cmd.bat
        JavaHomePath = D:\ts_mirr\xml\eb-tresos-TRAVEO-II_V1.16.0\jre_x86_64\win32\bin\javaw.exe
        48 x Module, all with Used=1:
          Adc: IsMCAL=1, MCAL_GeneratorPostfix=_TS_T40D13M1I0R0, McalDefineDerivate=CYT2B0, McalDefineTarget=MXS40, ModuleName=Adc, InputFilesList=Ecud_Resource, InputFilesList=Ecud_Adc, ExpectedFilesList=Adc_PBcfg.h, ExpectedFilesList=Adc_Irq.c, ExpectedFilesList=Adc_PBcfg.c, ExpectedFilesList=Adc_ExternalInclude.h, ExpectedFilesList=Adc_Irq.h, ExpectedFilesList=Adc_Cfg.h
          Can: InputFilesList=Ecud_Mcu, InputFilesList=Ecud_Resource, InputFilesList=Ecud_Can, InputFilesList=Ecud_Os_Mcal, IsMCAL=1, MCAL_GeneratorPostfix=_TS_T40D13M1I0R0, McalDefineDerivate=CYT2B0, McalDefineTarget=MXS40, ModuleName=Can, InputFilesList=Ecud_EcuM_Mcal, ExpectedFilesList=Can_ExternalInclude.h, ExpectedFilesList=Can_Irq.c, ExpectedFilesList=Can_PBcfg.c, ExpectedFilesList=Can_PBcfg.h, ExpectedFilesList=Can_Cfg.h
          Dio: ExpectedFilesList=Dio_Cfg_Include.h, InputFilesList=Ecud_Dio, InputFilesList=Ecud_Resource, IsMCAL=1, MCAL_GeneratorPostfix=_TS_T40D13M1I0R0, McalDefineDerivate=CYT2B0, McalDefineTarget=MXS40, ModuleName=Dio, ExpectedFilesList=Dio_Cfg_Internal.h, ExpectedFilesList=Dio_Cfg.h
          Gpt: InputFilesList=Ecud_Gpt, IsMCAL=1, MCAL_GeneratorPostfix=_TS_T40D13M1I0R0, McalDefineDerivate=CYT2B0, McalDefineTarget=MXS40, ModuleName=Gpt, InputFilesList=Ecud_Resource, InputFilesList=Ecud_EcuM_Mcal, ExpectedFilesList=Gpt_Cfg.h, ExpectedFilesList=Gpt_Irq.c, ExpectedFilesList=Gpt_PBcfg.c, ExpectedFilesList=Gpt_PBcfg.h, ExpectedFilesList=Gpt_Cfg_Include.h
          Mcu: ExpectedFilesList=Mcu_Cfg_Arch.h, InputFilesList=Ecud_Resource, InputFilesList=Ecud_Mcu, IsMCAL=1, MCAL_GeneratorPostfix=_TS_T40D13M1I0R0, McalDefineDerivate=CYT2B0, McalDefineTarget=MXS40, ModuleName=Mcu, ExpectedFilesList=Mcu_Cfg.h, ExpectedFilesList=Mcu_ExternalInclude.h, ExpectedFilesList=Mcu_PBcfg_Arch.h, ExpectedFilesList=Mcu_PBcfg.h, ExpectedFilesList=Mcu_Irq.c, ExpectedFilesList=Mcu_PBcfg.c
          Port: ExpectedFilesList=Port_Cfg_Der_Internal_Defaults.h, InputFilesList=Ecud_Port, IsMCAL=1, MCAL_GeneratorPostfix=_TS_T40D13M1I0R0, McalDefineDerivate=CYT2B0, McalDefineTarget=MXS40, ModuleName=Port, InputFilesList=Ecud_Resource, ExpectedFilesList=Port_Cfg_Der_Internal_User.h, ExpectedFilesList=Port_Cfg_Der.h, ExpectedFilesList=Port_Cfg_Include.h, ExpectedFilesList=Port_Cfg.h, ExpectedFilesList=Port_PBcfg_Der.c, ExpectedFilesList=Port_PBcfg.c
          Spi: IsMCAL=1, MCAL_GeneratorPostfix=_TS_T40D13M1I0R0, McalDefineDerivate=CYT2B0, McalDefineTarget=MXS40, ModuleName=Spi, ExpectedFilesList=Spi_Cfg_Der.h, ExpectedFilesList=Spi_Cfg.h, ExpectedFilesList=Spi_ExternalInclude.h, ExpectedFilesList=Spi_Irq.c, ExpectedFilesList=Spi_MainFunction_Handling.c, ExpectedFilesList=Spi_PBCfg_Der.c, ExpectedFilesList=Spi_PBCfg.c, InputFilesList=Ecud_Mcu, InputFilesList=Ecud_Spi, InputFilesList=Ecud_Resource
          Wdg: InputFilesList=Ecud_Resource, IsMCAL=1, MCAL_GeneratorPostfix=_TS_T40D13M1I0R0, McalDefineDerivate=CYT2B0, McalDefineTarget=MXS40, ModuleName=Wdg, InputFilesList=Ecud_Wdg, ExpectedFilesList=Wdg_66_IA_Cfg_Arch.h, ExpectedFilesList=Wdg_66_IA_Cfg.h, ExpectedFilesList=Wdg_66_IA_IncludeFiles.h, ExpectedFilesList=Wdg_66_IA_PBcfg.h, ExpectedFilesList=Wdg_66_IA_Irq.c, ExpectedFilesList=Wdg_66_IA_PBcfg.c, ExpectedFilesList=Wdg_66_IA_Trigger_Asm_GHS.s, ExpectedFilesList=Wdg_66_IA_Trigger_Asm_IAR.s
          BswM: IsMCAL=0, ModuleName=BswM, ExpectedFilesList=BswM.h, ExpectedFilesList=BswM_ActionList.h, ExpectedFilesList=BswM_Cfg.h, ExpectedFilesList=BswM_PCTypes.h, ExpectedFilesList=BswM_Ram.h, ExpectedFilesList=BswM_Rule.h, ExpectedFilesList=BswM.c, ExpectedFilesList=BswM_ActionList.c, ExpectedFilesList=BswM_Cfg.c, ExpectedFilesList=BswM_Ram.c, ExpectedFilesList=BswM_Rule.c, GeneratorName=BswM.exe, InputFilesList=Ecud_BswM, InputFilesList=Ecud_Os, InputFilesList=Ecud_Com, InputFilesList=Ecud_ComM, InputFilesList=Ecud_EcuC, InputFilesList=Ecud_EcuM, InputFilesList=Ecud_Rte, InputFilesList=Bswmd_BswM, InputFilesList=Bswmd_Dcm, InputFilesList=Bswmd_EcuM, InputFilesList=EcuM_PortInterface, InputFilesList=Swcd_Bsw_BswM, InputFilesList=Ecud_PduR, InputFilesList=Swcd_Bsw_EcuM, InputFilesList=AUTOSAR_DataTypes, InputFilesList=MODE_PortInterfaces
          Bswmd_KeyM: AUTOSAR44=1, BswDefines=B, ExpectedFilesList=Bswmd_KeyM.arxml, InputFilesList=Ecud_KeyM, IsMCAL=0, ModuleName=KeyM
          Bswmd_Csm: BswDefines=B, ExpectedFilesList=Bswmd_Csm.arxml, InputFilesList=Ecud_CryIf, InputFilesList=Ecud_Csm, IsMCAL=0, ModuleName=Csm, AUTOSAR44=1, InputFilesList=Ecud_Crypto_76_HaeModule
          Bswmd_CryIf: AUTOSAR44=1, BswDefines=B, ExpectedFilesList=Bswmd_CryIf.arxml, InputFilesList=Ecud_CryIf, IsMCAL=0, ModuleName=CryIf, InputFilesList=Ecud_Crypto_76_HaeModule
          Bswmd_Crypto_76_HaeModule: ModuleName=Crypto_76_HaeModule, InputFilesList=Ecud_Crypto_76_HaeModule, ExpectedFilesList=Bswmd_Crypto_76_HaeModule.arxml, BswDefines=B, IsMCAL=0, AUTOSAR44=1, GeneratorName=Crypto_76_HaeModule.bat
          Bswmd_WdgIf: BswDefines=B, ExpectedFilesList=Bswmd_WdgIf.arxml, GeneratorName=WdgIf.exe, IsMCAL=0, ModuleName=WdgIf, InputFilesList=Ecud_Wdg, InputFilesList=Ecud_WdgIf, InputFilesList=Bswmd_Wdg
          Bswmd_WdgM: BswDefines=B, ExpectedFilesList=Bswmd_WdgM.arxml, GeneratorName=WdgM.exe, IsMCAL=0, ModuleName=WdgM, InputFilesList=Ecud_WdgIf, InputFilesList=Ecud_WdgM, InputFilesList=Ecud_EcuC, InputFilesList=Ecud_Mcu, InputFilesList=Ecud_Os
          CanIf: ExpectedFilesList=CanIf_Cfg.c, IsMCAL=0, ModuleName=CanIf, ExpectedFilesList=CanIf_Cbk.h, ExpectedFilesList=CanIf_Cfg.h, ExpectedFilesList=CanIf_UserInc.h, ExpectedFilesList=CanIf_Can.h, GeneratorName=CanIf.exe, InputFilesList=Ecud_CanIf, InputFilesList=Bswmd_CanIf, InputFilesList=Ecud_Can, InputFilesList=Ecud_CanTp, InputFilesList=Bswmd_Can, InputFilesList=Ecud_PduR, InputFilesList=Ecud_EcuC, InputFilesList=Bswmd_CanTrcv, InputFilesList=Ecud_CanTrcv, ExpectedFilesList=CanIf_CanTrcv.h
          CanSM: InputFilesList=Ecud_CanSM, IsMCAL=0, ModuleName=CanSM, ExpectedFilesList=CanSM_Cfg.c, ExpectedFilesList=CanSM_Cfg.h, GeneratorName=CanSM.exe, InputFilesList=Bswmd_CanSM, InputFilesList=Ecud_CanIf, InputFilesList=Bswmd_CanIf, InputFilesList=Ecud_ComM, InputFilesList=Bswmd_ComM, InputFilesList=Ecud_CanTrcv, InputFilesList=Bswmd_CanTrcv
          CanTp: IsMCAL=0, ModuleName=CanTp, ExpectedFilesList=CanTp_Cfg.h, ExpectedFilesList=CanTp_Cfg.c, GeneratorName=CanTp.exe, InputFilesList=Ecud_CanIf, InputFilesList=Ecud_PduR, InputFilesList=Bswmd_CanTp, InputFilesList=Ecud_CanTp, InputFilesList=Ecud_EcuC, BswDefines=411
          CanTrcv: BswDefines=Prefix, IsMCAL=0, ModuleName=CanTrcv, ExpectedFilesList=CanTrcv.h, ExpectedFilesList=CanTrcv_Cfg.c, ExpectedFilesList=CanTrcv_Driver.h, ExpectedFilesList=CanTrcv_Cfg.h, GeneratorName=CanTrcv.exe, InputFilesList=Ecud_CanTrcv, InputFilesList=Ecud_Dio, InputFilesList=Bswmd_CanTrcv, InputFilesList=Ecud_Spi
          Com: BswDefines=Lend, InputFilesList=Ecud_EcuC, IsMCAL=0, ModuleName=Com, ExpectedFilesList=Com_Cbk.h, ExpectedFilesList=Com_Cfg.c, ExpectedFilesList=Com_Cfg.h, GeneratorName=Com.exe, InputFilesList=Ecud_Com, InputFilesList=Bswmd_Com, InputFilesList=Ecud_PduR, InputFilesList=Bswmd_PduR, InputFilesList=Ecud_CanIf, InputFilesList=Bswmd_CanIf, InputFilesList=Ecud_ComM
          ComM: IsMCAL=0, ModuleName=ComM, ExpectedFilesList=ComM_Cfg.c, ExpectedFilesList=ComM_Cfg.h, GeneratorName=ComM.exe, InputFilesList=Bswmd_ComM, InputFilesList=Ecud_ComM, InputFilesList=Ecud_EcuC, InputFilesList=Ecud_Com, InputFilesList=Bswmd_Com, InputFilesList=Ecud_CanSM, InputFilesList=Ecud_CanIf
          Crc: ExpectedFilesList=Crc_Cfg.h, GeneratorName=Crc.exe, IsMCAL=0, ModuleName=Crc, InputFilesList=Ecud_Crc, InputFilesList=Bswmd_Crc
          KeyM: AUTOSAR44=1, ExpectedFilesList=KeyM_Cfg.h, ExpectedFilesList=KeyM_Cfg.c, InputFilesList=Csm_ECU_Configuration_PDF, InputFilesList=KeyM_ECU_Configuration_PDF, InputFilesList=Bswmd_KeyM, InputFilesList=Ecud_KeyM, InputFilesList=Ecud_Csm, IsMCAL=0, ModuleName=KeyM, InputFilesList=Ecud_Crypto_76_HaeModule, InputFilesList=Bswmd_Crypto_76_HaeModule, InputFilesList=AUTOSAR_Crypto_76_HaeModule_ECU_Configuration_PDF
          Dcm: IsMCAL=0, ModuleName=Dcm, ExpectedFilesList=Dcm_Cfg.c, ExpectedFilesList=Dcm_Cfg.h, ExpectedFilesList=Dcm_Routine.c, GeneratorName=Dcm.exe, InputFilesList=Bswmd_PduR, InputFilesList=Ecud_ComM, ExpectedFilesList=Dcm_Routine.h, InputFilesList=Ecud_Dcm, InputFilesList=Ecud_EcuC, InputFilesList=Bswmd_ComM, InputFilesList=Ecud_PduR, InputFilesList=Bswmd_Dcm
          Det: IsMCAL=0, ModuleName=Det, ExpectedFilesList=Det_Cfg.c, ExpectedFilesList=Det_Cfg.h, GeneratorName=Det.exe, InputFilesList=Ecud_Det, InputFilesList=Bswmd_Det
          EcuM: IsMCAL=0, ModuleName=EcuM, ExpectedFilesList=EcuM_Cfg.c, ExpectedFilesList=EcuM_Cfg.h, ExpectedFilesList=EcuM_Generated_Callouts.c, ExpectedFilesList=EcuM_Generated_Callouts.h, ExpectedFilesList=EcuM_Generated_Types.h, ExpectedFilesList=EcuM_Lcfg.c, ExpectedFilesList=EcuM_PBcfg.c, GeneratorName=EcuM.exe, InputFilesList=Bswmd_Can, InputFilesList=Bswmd_CanIf, InputFilesList=Bswmd_CanSM, InputFilesList=Bswmd_CanTp, InputFilesList=Bswmd_Com, InputFilesList=Bswmd_ComM, InputFilesList=Bswmd_Dcm, InputFilesList=Bswmd_Det, InputFilesList=Bswmd_Dio, InputFilesList=Bswmd_Gpt, InputFilesList=Bswmd_Mcu, InputFilesList=Bswmd_PduR, InputFilesList=Bswmd_Port, InputFilesList=Bswmd_Wdg, InputFilesList=Bswmd_WdgM, InputFilesList=Ecud_Can, InputFilesList=Ecud_CanIf, InputFilesList=Ecud_CanSM, InputFilesList=Ecud_CanTp, InputFilesList=Ecud_Com, InputFilesList=Ecud_ComM, InputFilesList=Ecud_Dcm, InputFilesList=Ecud_Det, InputFilesList=Ecud_Dio, InputFilesList=Ecud_EcuC, InputFilesList=Ecud_EcuM, InputFilesList=Ecud_Gpt, InputFilesList=Ecud_Mcu, InputFilesList=Ecud_Os, InputFilesList=Ecud_PduR, InputFilesList=Ecud_Port, InputFilesList=Ecud_Wdg, InputFilesList=Ecud_WdgM, InputFilesList=Bswmd_EcuM, InputFilesList=Bswmd_Csm, InputFilesList=Ecud_Csm, InputFilesList=Bswmd_CryIf, InputFilesList=Ecud_CryIf, InputFilesList=Ecud_Fota, InputFilesList=Bswmd_Fota, InputFilesList=Bswmd_Spi, InputFilesList=Ecud_Spi, ExpectedFilesList=EcuM_Dem_Cfg.h, InputFilesList=Bswmd_CanTrcv, InputFilesList=Ecud_CanTrcv, InputFilesList=Ecud_Crypto_76_HaeModule, InputFilesList=Bswmd_Crypto_76_HaeModule, InputFilesList=AUTOSAR_Crypto_76_HaeModule_ECU_Configuration_PDF
          HwResource: ExpectedFilesList=HwResource.h, GeneratorName=HwResource.exe, InputFilesList=Ecud_HwResource, IsMCAL=0, ModuleName=HwResource
          Os: ExpectedFilesList=Os_PCfg.c, InputFilesList=Ecud_Os, ModuleName=Os, ExpectedFilesList=Os_PCfg.h, ExpectedFilesList=Os_Vector.c, ExpectedFilesList=Os_LSL.ld, GeneratorName=Os.exe, IsMCAL=0, InputFilesList=Bswmd_Os, BswDefines=ldfile
          OsImp: ExpectedFilesList=Os_Imp_Cfg.h, GeneratorName=OsImp.exe, IsMCAL=0, ModuleName=OsImp, InputFilesList=Bswmd_OsImp, InputFilesList=Ecud_OsImp, ExpectedFilesList=Os_Imp_Cfg.c
          Os_Common: ModuleName=Os_Common, IsMCAL=0, InputFilesList=Ecud_Os, InputFilesList=Bswmd_Os, ExpectedFilesList=Os_Cfg.c, ExpectedFilesList=Os_Cfg.h, BswDefines=ORTI, BswDefines=rteiocspinlock, ExpectedFilesList=Os_Types.h, GeneratorName=Os_Common.exe, InputFilesList=Ecud_EcuC, InputFilesList=AUTOSAR_DataTypes, InputFilesList=Swcd_ComM
          PduR: IsMCAL=0, ModuleName=PduR, ExpectedFilesList=PduR_Cfg.c, ExpectedFilesList=PduR_Cfg.h, ExpectedFilesList=PduR_Com.h, ExpectedFilesList=PduR_Incl.h, ExpectedFilesList=PduR_CallBk.c, GeneratorName=PduR.exe, InputFilesList=Bswmd_CanIf, InputFilesList=Bswmd_CanTp, InputFilesList=Bswmd_Com, InputFilesList=Bswmd_Dcm, InputFilesList=Ecud_CanIf, InputFilesList=Ecud_CanTp, InputFilesList=Ecud_Com, InputFilesList=Ecud_Dcm, InputFilesList=Ecud_EcuC, InputFilesList=Ecud_PduR, InputFilesList=Bswmd_PduR, BswDefines=411
          Rte: IsMCAL=0, ModuleName=Rte, BswDefines=genmemmap, BswDefines=EXCLFUNC, BswDefines=StrictUnconnRPortChk, BswDefines=CustomPrefix, BswDefines=Macro, BswDefines=GenMemMapOption::Ghs, BswDefines=validate, ExpectedFilesList=Rte.c, ExpectedFilesList=Rte_PBCfg.c, GeneratorName=Rte.exe, BswDefines=IOC, InputFilesList=AUTOSAR_DataTypes, InputFilesList=AUTOSAR_DataTypes_Etc, InputFilesList=App_Dcm, InputFilesList=App_Mode, InputFilesList=App_WdgM, InputFilesList=Bswmd_Adc, InputFilesList=Bswmd_BswM, InputFilesList=Bswmd_Can, InputFilesList=Bswmd_CanIf, InputFilesList=Bswmd_CanSM, InputFilesList=Bswmd_CanTp, InputFilesList=Bswmd_Com, InputFilesList=Bswmd_ComM, InputFilesList=Bswmd_Crc, InputFilesList=Bswmd_Dcm, InputFilesList=Bswmd_Det, InputFilesList=Bswmd_Dio, InputFilesList=Bswmd_EcuM, InputFilesList=Bswmd_Gpt, InputFilesList=Bswmd_Mcu, InputFilesList=Bswmd_Os, InputFilesList=Bswmd_PduR, InputFilesList=Bswmd_Port, InputFilesList=Bswmd_Wdg, InputFilesList=Bswmd_WdgIf, InputFilesList=Bswmd_WdgM, InputFilesList=ECUCD_EcucValueCollection, InputFilesList=EcuM_PortInterface, InputFilesList=Ecud_Com, InputFilesList=Ecud_Det, InputFilesList=Ecud_EcuC, InputFilesList=Ecud_Os, InputFilesList=Ecud_Rte, InputFilesList=MODE_PortInterfaces, InputFilesList=Swcd_Bsw_BswM, InputFilesList=Swcd_Bsw_Dcm, InputFilesList=Swcd_Bsw_EcuM, InputFilesList=Swcd_ComM, InputFilesList=Swcd_Det, InputFilesList=Swcd_WdgM, InputFilesList=Swcd_WdgM_Fixed, InputFilesList=Bswmd_KeyM, InputFilesList=Swcd_Bsw_KeyM, InputFilesList=EcuExtract, InputFilesList=Swcd_Bsw_Os, InputFilesList=Bswmd_Fota, ExpectedFilesList=BswMdt.arxml, ExpectedFilesList=Rte_Cbk.h, ExpectedFilesList=Rte_Cfg.h, ExpectedFilesList=Rte_DataHandleType.h, ExpectedFilesList=Rte_Hook.h, ExpectedFilesList=Rte_MemMap.h, ExpectedFilesList=Rte_Main.h, ExpectedFilesList=Rte_Type.h, ExpectedFilesList=Rte_PBCfg.h, InputFilesList=Ecud_Fota, InputFilesList=Ecud_Mem_76_Pfls, InputFilesList=Bswmd_Mem_76_Pfls, InputFilesList=Bswmd_Csm, InputFilesList=Swcd_Bsw_Csm, InputFilesList=Swcd_CanTp, InputFilesList=Swcd_Fota, InputFilesList=BCAN, InputFilesList=Bswmd_Spi, InputFilesList=Bswmd_CanTrcv, BswDefines=ParameterDirection, ExpectedFilesList=SchM_WdgIf_Type.h, ExpectedFilesList=SchM_WdgIf.h, ExpectedFilesList=SchM_Os_Type.h, ExpectedFilesList=SchM_Os.h, InputFilesList=Ecud_Crypto_76_HaeModule, InputFilesList=Bswmd_Crypto_76_HaeModule
          Swcd_Bsw_KeyM: AUTOSAR44=1, BswDefines=S, ExpectedFilesList=Swcd_Bsw_KeyM.arxml, InputFilesList=Ecud_KeyM, IsMCAL=0, ModuleName=KeyM
          Swcd_Bsw_Csm: AUTOSAR44=1, BswDefines=S, ExpectedFilesList=Swcd_Bsw_Csm.arxml, IsMCAL=0, ModuleName=Csm, InputFilesList=Bswmd_Csm, InputFilesList=Ecud_HwResource, InputFilesList=Ecud_Csm
          Swcd_Bsw_Dcm: BswDefines=S, ExpectedFilesList=Swcd_Bsw_Dcm.arxml, GeneratorName=Dcm.exe, IsMCAL=0, ModuleName=Dcm, InputFilesList=Ecud_ComM, InputFilesList=Ecud_Dcm, InputFilesList=Ecud_EcuC, InputFilesList=Ecud_PduR, InputFilesList=Bswmd_Dcm
          Swcd_Bsw_EcuM: BswDefines=S, ExpectedFilesList=Swcd_Bsw_EcuM.arxml, GeneratorName=EcuM.exe, IsMCAL=0, ModuleName=EcuM, InputFilesList=Ecud_EcuM
          Swcd_WdgM: BswDefines=S, ExpectedFilesList=Swcd_WdgM.arxml, GeneratorName=WdgM.exe, IsMCAL=0, ModuleName=WdgM, InputFilesList=Bswmd_WdgM, InputFilesList=Ecud_EcuC, InputFilesList=Ecud_Mcu, InputFilesList=Ecud_Os, InputFilesList=Ecud_WdgIf, InputFilesList=Ecud_WdgM
          Swcd_Fota: ModuleName=Fota, ExpectedFilesList=Swcd_Fota.arxml, IsMCAL=0, AUTOSAR44=1, BswDefines=S, InputFilesList=Ecud_Fota, InputFilesList=Bswmd_Fota
          WdgIf: IsMCAL=0, ModuleName=WdgIf, ExpectedFilesList=WdgIf.c, ExpectedFilesList=WdgIf.h, ExpectedFilesList=WdgIf_Cfg.h, ExpectedFilesList=WdgIf_Types.h, ExpectedFilesList=WdgIf_Version.c, ExpectedFilesList=WdgIf_Version.h, GeneratorName=WdgIf.exe, InputFilesList=Bswmd_Wdg, InputFilesList=Bswmd_WdgIf, InputFilesList=Ecud_Wdg, InputFilesList=Ecud_WdgIf
          WdgM: IsMCAL=0, ModuleName=WdgM, ExpectedFilesList=WdgM_Cfg.c, ExpectedFilesList=WdgM_Cfg.h, ExpectedFilesList=WdgM_GenExterns.h, GeneratorName=WdgM.exe, InputFilesList=Bswmd_WdgM, InputFilesList=Ecud_EcuC, InputFilesList=Ecud_Mcu, InputFilesList=Ecud_Os, InputFilesList=Ecud_WdgIf, InputFilesList=Ecud_WdgM, ExpectedFilesList=WdgM_Dem_Cfg.h
          Bswmd_Fota: BswDefines=B, ExpectedFilesList=Bswmd_Fota.arxml, InputFilesList=Ecud_Fota, IsMCAL=0, ModuleName=Fota, InputFilesList=Ecud_Csm, InputFilesList=Ecud_CryIf, AUTOSAR44=1
          Fota: AUTOSAR44=1, ExpectedFilesList=Fota_Cfg.h, ExpectedFilesList=Fota_Cfg.c, InputFilesList=Fota_ECU_Configuration_PDF, InputFilesList=Bswmd_Fota, InputFilesList=Ecud_Fota, InputFilesList=Csm_ECU_Configuration_PDF, InputFilesList=CryIf_ECU_Configuration_PDF, InputFilesList=Mem_76_Pfls_ECU_Configuration_PDF, InputFilesList=Bswmd_Csm, InputFilesList=Bswmd_CryIf, InputFilesList=Bswmd_Mem_76_Pfls, InputFilesList=Ecud_Csm, InputFilesList=Ecud_CryIf, InputFilesList=Ecud_Mem_76_Pfls, IsMCAL=0, ModuleName=Fota, InputFilesList=Ecud_Crypto_76_HaeModule, InputFilesList=Bswmd_Crypto_76_HaeModule, InputFilesList=AUTOSAR_Crypto_76_HaeModule_ECU_Configuration_PDF
          Bswmd_Mem_76_Pfls: BswDefines=B, ExpectedFilesList=Bswmd_Mem_76_Pfls.arxml, InputFilesList=Mem_76_Pfls_ECU_Configuration_PDF, InputFilesList=Ecud_Mem_76_Pfls, IsMCAL=0, ModuleName=Mem, AUTOSAR44=1
          Mem_76_Pfls: AUTOSAR44=1, ExpectedFilesList=Mem_76_Pfls_Cfg.h, ExpectedFilesList=Mem_76_Pfls_Cfg.c, InputFilesList=Mem_76_Pfls_ECU_Configuration_PDF, InputFilesList=Ecud_Mem_76_Pfls, InputFilesList=Bswmd_Mem_76_Pfls, IsMCAL=0, ModuleName=Mem
          CryIf: AUTOSAR44=1, ExpectedFilesList=CryIf_Cfg.c, ExpectedFilesList=CryIf_Cfg.h, InputFilesList=CryIf_ECU_Configuration_PDF, InputFilesList=ECUConfigurationParameters, InputFilesList=Ecud_CryIf, InputFilesList=Bswmd_CryIf, IsMCAL=0, ModuleName=CryIf, InputFilesList=Ecud_Crypto_76_HaeModule, InputFilesList=Bswmd_Crypto_76_HaeModule, InputFilesList=AUTOSAR_Crypto_76_HaeModule_ECU_Configuration_PDF
          Csm: IsMCAL=0, ModuleName=Csm, AUTOSAR44=1, ExpectedFilesList=Csm_Cfg.c, ExpectedFilesList=Csm_Cfg.h, InputFilesList=CryIf_ECU_Configuration_PDF, InputFilesList=Csm_ECU_Configuration_PDF, InputFilesList=Bswmd_CryIf, InputFilesList=ECUConfigurationParameters, InputFilesList=Ecud_CryIf, InputFilesList=Bswmd_Csm, InputFilesList=Ecud_Csm, InputFilesList=Ecud_Crypto_76_HaeModule, InputFilesList=Bswmd_Crypto_76_HaeModule, InputFilesList=AUTOSAR_Crypto_76_HaeModule_ECU_Configuration_PDF
          Bswmd_EcuM: ModuleName=EcuM, GeneratorName=EcuM.exe, InputFilesList=Ecud_EcuM, ExpectedFilesList=Bswmd_EcuM.arxml, BswDefines=B, IsMCAL=0
          Crypto_76_HaeModule: InputFilesList=Ecud_Crypto_76_HaeModule, InputFilesList=Bswmd_Crypto_76_HaeModule, InputFilesList=Ecud_CryIf, ExpectedFilesList=Crypto_76_HaeModule_Cfg.c, ExpectedFilesList=Crypto_76_HaeModule_Cfg.h, ModuleName=Crypto_76_HaeModule, GeneratorName=Crypto_76_HaeModule.bat, IsMCAL=0, AUTOSAR44=1
