AUTOSAR XML (schema 4-1-2)
package /AUTOSAR
  composition sw component type CSWC_RootComposition
    component SWC_AppMode: type=SWC_AppMode
    component SWC_DiagnosticService: type=SWC_DiagnosticService
    component SWC_WdgMTest: type=SWC_WdgMTest
