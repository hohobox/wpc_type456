AUTOSAR XML (schema 4-0-3)
package /ECU_EXTRACT
  system EcuExtract: category=ECU_EXTRACT
    system mapping PncMappings
    system mapping DataMappings
    system mapping SwMappings
      sw-mappings:
        swc to ecu mapping SwMapping0: ecu-instance=WPC
          component:
            RootSwCompositionPrototype.SWC_AppMode
            RootSwCompositionPrototype.SWC_DiagnosticService
            RootSwCompositionPrototype.SWC_WdgMTest
            RootSwCompositionPrototype.BswM
            RootSwCompositionPrototype.CanTp
            RootSwCompositionPrototype.ComM
            RootSwCompositionPrototype.Csm
            RootSwCompositionPrototype.Dcm
            RootSwCompositionPrototype.Det
            RootSwCompositionPrototype.EcuM
            RootSwCompositionPrototype.Fota
            RootSwCompositionPrototype.KeyM
            RootSwCompositionPrototype.Os
            RootSwCompositionPrototype.WdgM
    root-software-compositions:
      root sw composition prototype RootSwCompositionPrototype: software-composition=EcuComposition
  ecu instance WPC
    can communication controller WPC_BCAN
    can communication connector Conn_WPC_BCAN: comm-controller=WPC_BCAN
  composition sw component type EcuComposition
    14 x component:
      SWC_AppMode: type=SWC_AppMode
      SWC_DiagnosticService: type=SWC_DiagnosticService
      SWC_WdgMTest: type=SWC_WdgMTest
      BswM: type=BswM
      CanTp: type=CanTp
      ComM: type=ComM
      Csm: type=Csm
      Dcm: type=Dcm
      Det: type=Det
      EcuM: type=EcuM
      Fota: type=Fota
      KeyM: type=KeyM
      Os: type=Os
      WdgM: type=WdgM
    connect SWC_DiagnosticService.CallbackNotification_SignatureVerify -> Csm.SignatureVerify_RSASSA_PKCS1_v1_5_CallbackNotification
    connect Csm.CsmJob_RandomGenerate_L10 -> SWC_DiagnosticService.HaeHsmRandomGenerate_L10_RandomGenerate_L10
    connect Csm.CsmJob_RandomGenerate_L9 -> SWC_DiagnosticService.HaeHsmRandomGenerate_L9_CsmRandomGenerateConfig
    connect Csm.CsmJob_SignatureVerify_RSASSA_PKCS1_v1_5 -> SWC_DiagnosticService.CsmSignatureVerify_RSASSA_PKCS1_v1_5
    connect Csm.CsmKey_CryptoKey_OEUK -> SWC_DiagnosticService.CsmKeyManagement_CryptoKey_OEUK
    connect SWC_DiagnosticService.SecurityAccess_L10 -> Dcm.SecurityAccess_L10
    connect SWC_DiagnosticService.SecurityAccess_L9 -> Dcm.SecurityAccess_L9
    connect SWC_DiagnosticService.ServiceRequestSupplierNotification_DcmDslServiceRequestSupplierNotification0 -> Dcm.ServiceRequestSupplierNotification_DcmDslServiceRequestSupplierNotification0
    connect Fota.Swap_ServiceRequestNotification -> Dcm.ServiceRequestSupplierNotification_DcmDslServiceRequestSupplierNotification1
    connect WdgM.WdgM_API_P -> SWC_WdgMTest.WdgM_API_R
    connect WdgM.alive_SE_Init -> SWC_WdgMTest.SE_Init
    connect WdgM.alive_SE_WdgMTest -> SWC_WdgMTest.SE_WdgMTest
    connect WdgM.globalMode -> SWC_WdgMTest.globalMode
    connect SWC_AppMode.modeRequestPort_ComMMode_BCAN -> BswM.modeRequestPort_ComMMode_BCAN
    connect BswM.modeSwitchPort_CanSMBORState_BCAN -> SWC_AppMode.modeNotificationPort_CanSMBORState_BCAN
    connect BswM.modeSwitchPort_CanSMState_BCAN -> SWC_AppMode.modeNotificationPort_CanSMState_BCAN
    connect BswM.modeSwitchPort_ComMMode_BCAN -> SWC_AppMode.modeNotificationPort_ComMMode_BCAN
    connect BswM.modeSwitchPort_DcmDiagnosticSessionControl -> SWC_DiagnosticService.modeNotificationPort_SessionControl
    connect BswM.modeSwitchPort_EcuMode -> SWC_AppMode.modeNotificationPort_EcuMode
    connect BswM.modeSwitchPort_InitState -> SWC_AppMode.modeNotificationPort_InitState
    connect BswM.modeSwitchPort_WakeupEvent -> SWC_AppMode.modeNotificationPort_WakeupEvent
    connect EcuM.staterequest -> Fota.Fota_StateRequest
    connect EcuM.staterequest -> SWC_AppMode.clientPort_StateRequest
