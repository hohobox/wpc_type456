AUTOSAR XML (schema 00047)
package /DBCImport/CANTP
  can tp config CanTpConfig_BCAN: communication-cluster=BCAN, can-tp-ecu=WPC
    can tp channel CanTpChannel0: channel-id=0, channel-mode=HALF-DUPLEX-MODE
    can tp channel CanTpChannel1: channel-id=1, channel-mode=HALF-DUPLEX-MODE
    tp-connections:
      addressing-format=STANDARD, can-tp-channel=CanTpChannel0, data-pdu=NPdu_BCAN_WPC_GST, flow-control-pdu=NPdu_BCAN_GST_WPC, max-block-size=0, padding-activation=true, ta-type=PHYSICAL-CAN-FD, tp-sdu=DcmIPdu_BCAN_WPC_GST
      addressing-format=STANDARD, can-tp-channel=CanTpChannel0, data-pdu=NPdu_BCAN_GST_WPC, flow-control-pdu=NPdu_BCAN_WPC_GST, max-block-size=0, padding-activation=true, ta-type=PHYSICAL-CAN-FD, tp-sdu=DcmIPdu_BCAN_GST_WPC
      addressing-format=STANDARD, can-tp-channel=CanTpChannel1, data-pdu=NPdu_BCAN_GST_ALL, max-block-size=0, padding-activation=true, ta-type=FUNCTIONAL-CAN-FD, tp-sdu=DcmIPdu_BCAN_GST_ALL
    can tp node WPC: connector=Conn_WPC_BCAN
package /DBCImport/SWCComposition
  composition sw component type DBC_Example_BCAN_WPC
package /DBCImport/CLUSTERS
  can cluster BCAN: baudrate=500000, protocol-name=CAN, speed=500
    can physical channel BCAN: comm-connectors=Conn_WPC_BCAN
      frame CanFrame_BCAN_WPC_GST: id 0x72D, frame-length=8, can-addressing-mode=STANDARD, can-fd-frame-support=true
        dcm i pdu DcmIPdu_BCAN_WPC_GST: length=64, diag-pdu-type=DIAG-RESPONSE
        n pdu NPdu_BCAN_WPC_GST: length=8, meta-data-length=0
      frame CanFrame_BCAN_GST_WPC: id 0x725, frame-length=8, can-addressing-mode=STANDARD, can-fd-frame-support=true
        dcm i pdu DcmIPdu_BCAN_GST_WPC: length=8, diag-pdu-type=DIAG-REQUEST
        n pdu NPdu_BCAN_GST_WPC: length=8, meta-data-length=0
      frame CanFrame_BCAN_GST_ALL: id 0x7DF, frame-length=8, can-addressing-mode=STANDARD, can-fd-frame-support=true
        dcm i pdu DcmIPdu_BCAN_GST_ALL: length=8
        n pdu NPdu_BCAN_GST_ALL: length=8, meta-data-length=0
