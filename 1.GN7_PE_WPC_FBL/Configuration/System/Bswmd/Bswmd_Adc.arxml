AUTOSAR XML (schema 4-0-3)
package /TS_T40D13M1I0R0
  bsw implementation AdcImplementation: sw-version=1.14.0, vendor-id=66, ar-release-version=4.2.2, behavior=AdcBehavior
  17 x bsw module entry, all with sw-service-impl-policy=STANDARD:
    Adc_Init: service-id=0, is-reentrant=false, is-synchronous=true, call-type=REGULAR, execution-context=TASK
    Adc_DeInit: service-id=1, is-reentrant=false, is-synchronous=true, call-type=REGULAR, execution-context=TASK
    Adc_StartGroupConversion: service-id=2, is-reentrant=true, is-synchronous=false, call-type=REGULAR, execution-context=TASK
    Adc_StopGroupConversion: service-id=3, is-reentrant=true, is-synchronous=true, call-type=REGULAR, execution-context=TASK
    Adc_ReadGroup: service-id=4, is-reentrant=true, is-synchronous=true, call-type=REGULAR, execution-context=TASK
    Adc_EnableHardwareTrigger: service-id=5, is-reentrant=true, is-synchronous=true, call-type=REGULAR, execution-context=TASK
    Adc_DisableHardwareTrigger: service-id=6, is-reentrant=true, is-synchronous=true, call-type=REGULAR, execution-context=TASK
    Adc_EnableGroupNotification: service-id=7, is-reentrant=true, is-synchronous=true, call-type=REGULAR, execution-context=TASK
    Adc_DisableGroupNotification: service-id=8, is-reentrant=true, is-synchronous=true, call-type=REGULAR, execution-context=TASK
    Adc_GetGroupStatus: service-id=9, is-reentrant=true, is-synchronous=true, call-type=REGULAR, execution-context=TASK
    Adc_GetVersionInfo: service-id=10, is-reentrant=true, is-synchronous=true, call-type=REGULAR, execution-context=TASK
    Adc_GetStreamLastPointer: service-id=11, is-reentrant=true, is-synchronous=true, call-type=REGULAR, execution-context=TASK
    Adc_SetupResultBuffer: service-id=12, is-reentrant=true, is-synchronous=true, call-type=REGULAR, execution-context=TASK
    Adc_IsrConversionDone_HwUnit0_Cat1: is-reentrant=false, is-synchronous=true, call-type=INTERRUPT, execution-context=INTERRUPT-CAT-1
    Adc_IsrConversionDone_HwUnit0_Cat2: is-reentrant=false, is-synchronous=true, call-type=INTERRUPT, execution-context=INTERRUPT-CAT-2
    Adc_IsrRangeHit_HwUnit0_Cat1: is-reentrant=false, is-synchronous=true, call-type=INTERRUPT, execution-context=INTERRUPT-CAT-1
    Adc_IsrRangeHit_HwUnit0_Cat2: is-reentrant=false, is-synchronous=true, call-type=INTERRUPT, execution-context=INTERRUPT-CAT-2
package /TS_T40D13M1I0R0/BswDescr
  bsw module description Adc: module-id=123
    bsw internal behavior AdcBehavior
      exclusive area ADC_EXCLUSIVE_AREA_0
      13 x bsw called entity:
        Adc_Init: implemented-entry=Adc_Init
        Adc_DeInit: can-enter-exclusive-area=ADC_EXCLUSIVE_AREA_0, implemented-entry=Adc_DeInit
        Adc_StartGroupConversion: can-enter-exclusive-area=ADC_EXCLUSIVE_AREA_0, implemented-entry=Adc_StartGroupConversion
        Adc_StopGroupConversion: can-enter-exclusive-area=ADC_EXCLUSIVE_AREA_0, implemented-entry=Adc_StopGroupConversion
        Adc_ReadGroup: can-enter-exclusive-area=ADC_EXCLUSIVE_AREA_0, implemented-entry=Adc_ReadGroup
        Adc_EnableHardwareTrigger: can-enter-exclusive-area=ADC_EXCLUSIVE_AREA_0, implemented-entry=Adc_EnableHardwareTrigger
        Adc_DisableHardwareTrigger: can-enter-exclusive-area=ADC_EXCLUSIVE_AREA_0, implemented-entry=Adc_DisableHardwareTrigger
        Adc_EnableGroupNotification: implemented-entry=Adc_EnableGroupNotification
        Adc_DisableGroupNotification: implemented-entry=Adc_DisableGroupNotification
        Adc_GetGroupStatus: can-enter-exclusive-area=ADC_EXCLUSIVE_AREA_0, implemented-entry=Adc_GetGroupStatus
        Adc_GetVersionInfo: implemented-entry=Adc_GetVersionInfo
        Adc_GetStreamLastPointer: can-enter-exclusive-area=ADC_EXCLUSIVE_AREA_0, implemented-entry=Adc_GetStreamLastPointer
        Adc_SetupResultBuffer: can-enter-exclusive-area=ADC_EXCLUSIVE_AREA_0, implemented-entry=Adc_SetupResultBuffer
      4 x bsw interrupt entity:
        Adc_IsrConversionDone_HwUnit0_Cat1: implemented-entry=Adc_IsrConversionDone_HwUnit0_Cat1, interrupt-category=CAT-1, interrupt-source=353
        Adc_IsrConversionDone_HwUnit0_Cat2: implemented-entry=Adc_IsrConversionDone_HwUnit0_Cat2, interrupt-category=CAT-2, interrupt-source=353
        Adc_IsrRangeHit_HwUnit0_Cat1: implemented-entry=Adc_IsrRangeHit_HwUnit0_Cat1, interrupt-category=CAT-1, interrupt-source=356
        Adc_IsrRangeHit_HwUnit0_Cat2: implemented-entry=Adc_IsrRangeHit_HwUnit0_Cat2, interrupt-category=CAT-2, interrupt-source=356
      bsw distinguished partition BswDistinguishedPartition_Adc
