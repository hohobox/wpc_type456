AUTOSAR XML (schema 4-0-3)
package /TS_T40D13M1I0R0
  bsw implementation PortImplementation: sw-version=1.18.0, vendor-id=66, ar-release-version=4.2.2, behavior=PortBehavior
  8 x bsw module entry, all with is-synchronous=true, call-type=REGULAR, execution-context=TASK, sw-service-impl-policy=STANDARD:
    Port_Init: service-id=0, is-reentrant=false
    Port_SetPinDirection: service-id=1, is-reentrant=true
    Port_RefreshPortDirection: service-id=2, is-reentrant=false
    Port_GetVersionInfo: service-id=3, is-reentrant=false
    Port_SetPinMode: service-id=4, is-reentrant=true
    Port_SetResourceInputMode: service-id=10, is-reentrant=true
    Port_GetStatus: service-id=254, is-reentrant=true
    Port_GetStatusResourceInput: service-id=255, is-reentrant=true
package /TS_T40D13M1I0R0/BswDescr
  bsw module description Port: module-id=124
    bsw internal behavior PortBehavior
      exclusive area PORT_EXCLUSIVE_AREA_0
      8 x bsw called entity:
        Port_Init: can-enter-exclusive-area=PORT_EXCLUSIVE_AREA_0, implemented-entry=Port_Init
        Port_SetPinDirection: can-enter-exclusive-area=PORT_EXCLUSIVE_AREA_0, implemented-entry=Port_SetPinDirection
        Port_RefreshPortDirection: can-enter-exclusive-area=PORT_EXCLUSIVE_AREA_0, implemented-entry=Port_RefreshPortDirection
        Port_GetVersionInfo: implemented-entry=Port_GetVersionInfo
        Port_SetPinMode: can-enter-exclusive-area=PORT_EXCLUSIVE_AREA_0, implemented-entry=Port_SetPinMode
        Port_SetResourceInputMode: can-enter-exclusive-area=PORT_EXCLUSIVE_AREA_0, implemented-entry=Port_SetResourceInputMode
        Port_GetStatus: can-enter-exclusive-area=PORT_EXCLUSIVE_AREA_0, implemented-entry=Port_GetStatus
        Port_GetStatusResourceInput: can-enter-exclusive-area=PORT_EXCLUSIVE_AREA_0, implemented-entry=Port_GetStatusResourceInput
      bsw distinguished partition BswDistinguishedPartition_Port
