AUTOSAR XML (schema 4-0-3)
package /TS_T40D13M1I0R0
  bsw implementation DioImplementation: sw-version=1.11.0, vendor-id=66, ar-release-version=4.2.2, behavior=DioBehavior
  9 x bsw module entry, all with is-synchronous=true, call-type=REGULAR, execution-context=TASK, sw-service-impl-policy=STANDARD:
    Dio_ReadChannel: service-id=0, is-reentrant=true
    Dio_WriteChannel: service-id=1, is-reentrant=true
    Dio_ReadPort: service-id=2, is-reentrant=true
    Dio_WritePort: service-id=3, is-reentrant=true
    Dio_ReadChannelGroup: service-id=4, is-reentrant=true
    Dio_WriteChannelGroup: service-id=5, is-reentrant=true
    Dio_Init: service-id=16, is-reentrant=false
    Dio_FlipChannel: service-id=17, is-reentrant=true
    Dio_GetVersionInfo: service-id=18, is-reentrant=true
package /TS_T40D13M1I0R0/BswDescr
  bsw module description Dio: module-id=120
    bsw internal behavior DioBehavior
      exclusive area DIO_EXCLUSIVE_AREA_0
      9 x bsw called entity:
        Dio_ReadChannel: can-enter-exclusive-area=DIO_EXCLUSIVE_AREA_0, implemented-entry=Dio_ReadChannel
        Dio_WriteChannel: can-enter-exclusive-area=DIO_EXCLUSIVE_AREA_0, implemented-entry=Dio_WriteChannel
        Dio_ReadPort: can-enter-exclusive-area=DIO_EXCLUSIVE_AREA_0, implemented-entry=Dio_ReadPort
        Dio_WritePort: can-enter-exclusive-area=DIO_EXCLUSIVE_AREA_0, implemented-entry=Dio_WritePort
        Dio_ReadChannelGroup: can-enter-exclusive-area=DIO_EXCLUSIVE_AREA_0, implemented-entry=Dio_ReadChannelGroup
        Dio_WriteChannelGroup: can-enter-exclusive-area=DIO_EXCLUSIVE_AREA_0, implemented-entry=Dio_WriteChannelGroup
        Dio_Init: implemented-entry=Dio_Init
        Dio_FlipChannel: can-enter-exclusive-area=DIO_EXCLUSIVE_AREA_0, implemented-entry=Dio_FlipChannel
        Dio_GetVersionInfo: implemented-entry=Dio_GetVersionInfo
      bsw distinguished partition BswDistinguishedPartition_Dio
