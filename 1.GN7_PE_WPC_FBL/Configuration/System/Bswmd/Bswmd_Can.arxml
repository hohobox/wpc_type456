AUTOSAR XML (schema 4-0-3)
package /TS_T40D13M1I0R0
  bsw implementation CanImplementation: sw-version=1.17.0, vendor-id=66, ar-release-version=4.2.2, behavior=CanBehavior
  17 x bsw module entry, all with sw-service-impl-policy=STANDARD:
    Can_Init: service-id=0, is-reentrant=false, is-synchronous=true, call-type=REGULAR, execution-context=TASK
    Can_MainFunction_Write: service-id=1, is-reentrant=false, is-synchronous=true, call-type=SCHEDULED, execution-context=TASK
    Can_SetControllerMode: service-id=3, is-reentrant=false, is-synchronous=false, call-type=REGULAR, execution-context=TASK
    Can_DisableControllerInterrupts: service-id=4, is-reentrant=true, is-synchronous=true, call-type=REGULAR, execution-context=TASK
    Can_EnableControllerInterrupts: service-id=5, is-reentrant=true, is-synchronous=true, call-type=REGULAR, execution-context=TASK
    Can_GetStatus: service-id=32, is-reentrant=true, is-synchronous=true, call-type=REGULAR, execution-context=TASK
    Can_Write: service-id=6, is-reentrant=true, is-synchronous=true, call-type=REGULAR, execution-context=TASK
    Can_GetVersionInfo: service-id=7, is-reentrant=true, is-synchronous=true, call-type=REGULAR, execution-context=TASK
    Can_MainFunction_Read: service-id=8, is-reentrant=false, is-synchronous=true, call-type=SCHEDULED, execution-context=TASK
    Can_MainFunction_BusOff: service-id=9, is-reentrant=false, is-synchronous=true, call-type=SCHEDULED, execution-context=TASK
    Can_MainFunction_Wakeup: service-id=10, is-reentrant=false, is-synchronous=true, call-type=SCHEDULED, execution-context=TASK
    Can_CheckWakeup: service-id=11, is-reentrant=false, is-synchronous=true, call-type=REGULAR, execution-context=TASK
    Can_MainFunction_Mode: service-id=12, is-reentrant=false, is-synchronous=true, call-type=SCHEDULED, execution-context=TASK
    Can_Interrupt_CAN5_Cat1: is-reentrant=false, is-synchronous=true, call-type=INTERRUPT, execution-context=INTERRUPT-CAT-1
    Can_Interrupt_CAN5_Cat2: is-reentrant=false, is-synchronous=true, call-type=INTERRUPT, execution-context=INTERRUPT-CAT-2
    Can_Interrupt_CAN6_Cat1: is-reentrant=false, is-synchronous=true, call-type=INTERRUPT, execution-context=INTERRUPT-CAT-1
    Can_Interrupt_CAN6_Cat2: is-reentrant=false, is-synchronous=true, call-type=INTERRUPT, execution-context=INTERRUPT-CAT-2
package /TS_T40D13M1I0R0/BswDescr
  bsw module description Can: module-id=80
    bsw internal behavior CanBehavior
      exclusive area CAN_EXCLUSIVE_AREA_0
      7 x bsw called entity, all with can-enter-exclusive-area=CAN_EXCLUSIVE_AREA_0:
        Can_Init: implemented-entry=Can_Init
        Can_SetControllerMode: implemented-entry=Can_SetControllerMode
        Can_DisableControllerInterrupts: implemented-entry=Can_DisableControllerInterrupts
        Can_EnableControllerInterrupts: implemented-entry=Can_EnableControllerInterrupts
        Can_Write: implemented-entry=Can_Write
        Can_GetVersionInfo: implemented-entry=Can_GetVersionInfo
        Can_CheckWakeup: implemented-entry=Can_CheckWakeup
      5 x bsw schedulable entity, all with can-enter-exclusive-area=CAN_EXCLUSIVE_AREA_0:
        Can_MainFunction_Read: implemented-entry=Can_MainFunction_Read
        Can_MainFunction_Write: implemented-entry=Can_MainFunction_Write
        Can_MainFunction_BusOff: implemented-entry=Can_MainFunction_BusOff
        Can_MainFunction_Wakeup: implemented-entry=Can_MainFunction_Wakeup
        Can_MainFunction_Mode: implemented-entry=Can_MainFunction_Mode
      4 x bsw interrupt entity, all with can-enter-exclusive-area=CAN_EXCLUSIVE_AREA_0:
        Can_Interrupt_CAN5_Cat1: implemented-entry=Can_Interrupt_CAN5_Cat1, interrupt-category=CAT-1, interrupt-source=48
        Can_Interrupt_CAN5_Cat2: implemented-entry=Can_Interrupt_CAN5_Cat2, interrupt-category=CAT-2, interrupt-source=48
        Can_Interrupt_CAN6_Cat1: implemented-entry=Can_Interrupt_CAN6_Cat1, interrupt-category=CAT-1, interrupt-source=49
        Can_Interrupt_CAN6_Cat2: implemented-entry=Can_Interrupt_CAN6_Cat2, interrupt-category=CAT-2, interrupt-source=49
      bsw distinguished partition BswDistinguishedPartition_Can
