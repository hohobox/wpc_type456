AUTOSAR XML (schema 4-0-3)
package /Bsw_OsImp
  bsw module description OsImp: module-id=255
    bsw internal behavior BswInternalBehavior_OsImp
  bsw implementation BswImplementation_OsImp: sw-version=2.1.3, vendor-id=76, ar-release-version=4.0.3, behavior=BswInternalBehavior_OsImp
