AUTOSAR XML (schema 4-0-3)
package /Bsw_CanSM
  bsw implementation BswImplementation_CanSM: sw-version=1.12.10, vendor-id=76, ar-release-version=4.0.3, behavior=BswInternalBehavior_CanSM
  bsw module description CanSM: module-id=140
    bsw internal behavior BswInternalBehavior_CanSM
      exclusive area MODE_STATUS_PROTECTION
      exclusive area BUSOFF_STATUS_PROTECTION
      bsw schedulable entity BswSE_CanSM_MainFunction: can-enter-exclusive-area=[MODE_STATUS_PROTECTION, BUSOFF_STATUS_PROTECTION], implemented-entry=CanSM_MainFunction
      bsw timing event BswTE_CanSM_MainFunction: starts-on-event=BswSE_CanSM_MainFunction, period=0.005
      bsw distinguished partition BswDistinguishedPartition_CanSM
  bsw module entry CanSM_MainFunction: service-id=5, is-reentrant=false, is-synchronous=false, call-type=SCHEDULED, execution-context=TASK, sw-service-impl-policy=STANDARD
