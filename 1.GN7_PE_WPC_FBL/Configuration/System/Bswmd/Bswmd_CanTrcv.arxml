AUTOSAR XML (schema 4-0-3)
package /Bsw_CanTrcv
  bsw implementation BswImplementation_CanTrcv: sw-version=2.10.1, vendor-id=76, ar-release-version=4.0.3, behavior=BswInternalBehavior_CanTrcv
  bsw module entry CanTrcv_INIT_MACRO: service-id=0, is-reentrant=false, is-synchronous=false, call-type=REGULAR, execution-context=UNSPECIFIED, sw-service-impl-policy=STANDARD
  bsw module description CanTrcv: module-id=70
    bsw internal behavior BswInternalBehavior_CanTrcv
      exclusive area INTERRUPT_PROTECTION_AREA
      bsw called entity BswCalledEntity_CANTRCV_SETOPMODE_MACRO: can-enter-exclusive-area=INTERRUPT_PROTECTION_AREA, implemented-entry=CanTrcv_INIT_MACRO
      bsw distinguished partition BswDistinguishedPartition_CanTrcv
