AUTOSAR XML (schema 4-0-3)
package /Bsw_ComM
  bsw implementation BswImplementation_ComM: sw-version=1.11.1, swc-bsw-mapping=SwcBswMapping_ComM, vendor-id=76, ar-release-version=4.0.3, behavior=BswIB_ComM
  bsw module description ComM: module-id=12
    bsw internal behavior BswIB_ComM
      8 x exclusive area:
        INHIBIT_CNT_PROTECTION
        REQ_MODECNT_PROTECTION
        CURRENT_MODE_PROTECTION
        DCM_DIAGNOSTIC_PROTECTION
        ECUM_WAKEUP_IND
        NM_INDICATION_PROTECTION
        PNC_PREPARE_TIMER
        PNC_WAKEUP_IND
      bsw schedulable entity BswSE_ComM_MainFunction_0: can-enter-exclusive-area=[INHIBIT_CNT_PROTECTION, REQ_MODECNT_PROTECTION, CURRENT_MODE_PROTECTION, DCM_DIAGNOSTIC_PROTECTION, ECUM_WAKEUP_IND, NM_INDICATION_PROTECTION, PNC_PREPARE_TIMER, PNC_WAKEUP_IND], implemented-entry=ComM_MainFunction_0
      bsw called entity BswCE_ComM_GetCurrentComMode: implemented-entry=ComM_GetCurrentComMode
      bsw called entity BswCE_ComM_GetRequestedComMode: implemented-entry=ComM_GetRequestedComMode
      bsw called entity BswCE_ComM_RequestComMode: implemented-entry=ComM_RequestComMode
      bsw timing event BswTE_ComM_MainFunction0: starts-on-event=BswSE_ComM_MainFunction_0, period=0.005
      bsw distinguished partition BswDistinguishedPartition_ComM
  4 x bsw module entry, all with is-reentrant=false, is-synchronous=false, call-type=SCHEDULED, execution-context=TASK, sw-service-impl-policy=STANDARD:
    ComM_MainFunction_0: service-id=96
    ComM_RequestComMode: service-id=5
      sw service arg User: direction=IN
      sw service arg ComMode: direction=IN
    ComM_GetRequestedComMode: service-id=7
      sw service arg User: direction=IN
      sw service arg ComMode: direction=OUT
    ComM_GetCurrentComMode: service-id=8
      sw service arg User: direction=IN
      sw service arg ComMode: direction=OUT
  swc bsw mapping SwcBswMapping_ComM: bsw-behavior=BswIB_ComM, swc-behavior=SwcIB_ComM
    runnable-mappings:
      bsw-entity=BswCE_ComM_RequestComMode, swc-runnable=RequestComMode
      bsw-entity=BswCE_ComM_GetCurrentComMode, swc-runnable=GetCurrentComMode
      bsw-entity=BswCE_ComM_GetRequestedComMode, swc-runnable=GetRequestedComMode
