AUTOSAR XML (schema 4-0-3)
package /TS_T40D13M1I0R0
  bsw implementation GptImplementation: sw-version=1.13.0, vendor-id=66, ar-release-version=4.2.2, behavior=GptBehavior
  22 x bsw module entry, all with is-synchronous=true, sw-service-impl-policy=STANDARD:
    Gpt_GetVersionInfo: service-id=0, is-reentrant=true, call-type=REGULAR, execution-context=TASK
    Gpt_Init: service-id=1, is-reentrant=false, call-type=REGULAR, execution-context=TASK
    Gpt_DeInit: service-id=2, is-reentrant=false, call-type=REGULAR, execution-context=TASK
    Gpt_GetTimeElapsed: service-id=3, is-reentrant=true, call-type=REGULAR, execution-context=TASK
    Gpt_GetTimeRemaining: service-id=4, is-reentrant=true, call-type=REGULAR, execution-context=TASK
    Gpt_StartTimer: service-id=5, is-reentrant=true, call-type=REGULAR, execution-context=TASK
    Gpt_StopTimer: service-id=6, is-reentrant=true, call-type=REGULAR, execution-context=TASK
    Gpt_EnableNotification: service-id=7, is-reentrant=true, call-type=REGULAR, execution-context=TASK
    Gpt_DisableNotification: service-id=8, is-reentrant=true, call-type=REGULAR, execution-context=TASK
    Gpt_SetMode: service-id=9, is-reentrant=false, call-type=REGULAR, execution-context=TASK
    Gpt_DisableWakeup: service-id=10, is-reentrant=true, call-type=REGULAR, execution-context=TASK
    Gpt_EnableWakeup: service-id=11, is-reentrant=true, call-type=REGULAR, execution-context=TASK
    Gpt_CheckWakeup: service-id=12, is-reentrant=true, call-type=REGULAR, execution-context=TASK
    Gpt_CheckChannelStatus: service-id=254, is-reentrant=true, call-type=REGULAR, execution-context=TASK
    GPT_ISR_Vector_176_CAT1: is-reentrant=false, call-type=INTERRUPT, execution-context=INTERRUPT-CAT-1
    GPT_ISR_Vector_176_CAT2: is-reentrant=false, call-type=INTERRUPT, execution-context=INTERRUPT-CAT-2
    GPT_ISR_Vector_180_CAT1: is-reentrant=false, call-type=INTERRUPT, execution-context=INTERRUPT-CAT-1
    GPT_ISR_Vector_180_CAT2: is-reentrant=false, call-type=INTERRUPT, execution-context=INTERRUPT-CAT-2
    GPT_ISR_Vector_153_CAT1: is-reentrant=false, call-type=INTERRUPT, execution-context=INTERRUPT-CAT-1
    GPT_ISR_Vector_153_CAT2: is-reentrant=false, call-type=INTERRUPT, execution-context=INTERRUPT-CAT-2
    GPT_ISR_Vector_46_CAT1: is-reentrant=false, call-type=INTERRUPT, execution-context=INTERRUPT-CAT-1
    GPT_ISR_Vector_46_CAT2: is-reentrant=false, call-type=INTERRUPT, execution-context=INTERRUPT-CAT-2
package /TS_T40D13M1I0R0/BswDescr
  bsw module description Gpt: module-id=100
    bsw internal behavior GptBehavior
      exclusive area GPT_EXCLUSIVE_AREA_0
      14 x bsw called entity:
        Gpt_GetVersionInfo: implemented-entry=Gpt_GetVersionInfo
        Gpt_Init: implemented-entry=Gpt_Init
        Gpt_DeInit: can-enter-exclusive-area=GPT_EXCLUSIVE_AREA_0, implemented-entry=Gpt_DeInit
        Gpt_GetTimeElapsed: implemented-entry=Gpt_GetTimeElapsed
        Gpt_GetTimeRemaining: implemented-entry=Gpt_GetTimeRemaining
        Gpt_StartTimer: can-enter-exclusive-area=GPT_EXCLUSIVE_AREA_0, implemented-entry=Gpt_StartTimer
        Gpt_StopTimer: can-enter-exclusive-area=GPT_EXCLUSIVE_AREA_0, implemented-entry=Gpt_StopTimer
        Gpt_EnableNotification: can-enter-exclusive-area=GPT_EXCLUSIVE_AREA_0, implemented-entry=Gpt_EnableNotification
        Gpt_DisableNotification: can-enter-exclusive-area=GPT_EXCLUSIVE_AREA_0, implemented-entry=Gpt_DisableNotification
        Gpt_SetMode: can-enter-exclusive-area=GPT_EXCLUSIVE_AREA_0, implemented-entry=Gpt_SetMode
        Gpt_DisableWakeup: can-enter-exclusive-area=GPT_EXCLUSIVE_AREA_0, implemented-entry=Gpt_DisableWakeup
        Gpt_EnableWakeup: can-enter-exclusive-area=GPT_EXCLUSIVE_AREA_0, implemented-entry=Gpt_EnableWakeup
        Gpt_CheckWakeup: can-enter-exclusive-area=GPT_EXCLUSIVE_AREA_0, implemented-entry=Gpt_CheckWakeup
        Gpt_CheckChannelStatus: can-enter-exclusive-area=GPT_EXCLUSIVE_AREA_0, implemented-entry=Gpt_CheckChannelStatus
      8 x bsw interrupt entity, all with can-enter-exclusive-area=GPT_EXCLUSIVE_AREA_0:
        GPT_ISR_Vector_176_CAT1: implemented-entry=GPT_ISR_Vector_176_CAT1, interrupt-category=CAT-1, interrupt-source=176
        GPT_ISR_Vector_176_CAT2: implemented-entry=GPT_ISR_Vector_176_CAT2, interrupt-category=CAT-2, interrupt-source=176
        GPT_ISR_Vector_180_CAT1: implemented-entry=GPT_ISR_Vector_180_CAT1, interrupt-category=CAT-1, interrupt-source=180
        GPT_ISR_Vector_180_CAT2: implemented-entry=GPT_ISR_Vector_180_CAT2, interrupt-category=CAT-2, interrupt-source=180
        GPT_ISR_Vector_153_CAT1: implemented-entry=GPT_ISR_Vector_153_CAT1, interrupt-category=CAT-1, interrupt-source=153
        GPT_ISR_Vector_153_CAT2: implemented-entry=GPT_ISR_Vector_153_CAT2, interrupt-category=CAT-2, interrupt-source=153
        GPT_ISR_Vector_46_CAT1: implemented-entry=GPT_ISR_Vector_46_CAT1, interrupt-category=CAT-1, interrupt-source=46
        GPT_ISR_Vector_46_CAT2: implemented-entry=GPT_ISR_Vector_46_CAT2, interrupt-category=CAT-2, interrupt-source=46
      bsw distinguished partition BswDistinguishedPartition_Gpt
