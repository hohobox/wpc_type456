AUTOSAR XML (schema 4-0-3)
package /Bsw_CanIf
  bsw implementation BswImplementation_CanIf: sw-version=3.2.0, vendor-id=76, ar-release-version=4.0.3, behavior=BswInternalBehavior_CanIf
  bsw module description CanIf: module-id=60
    bsw internal behavior BswInternalBehavior_CanIf
      7 x exclusive area:
        MODE_STATUS_PROTECTION
        TX_QUEUE_PROTECTION
        ExclusiveArea_0
        RX_NOTIFSTATUS_PROTECTION
        RX_DATA_PROTECTION
        TX_DYNCANID_PROTECTION
        TX_NOTIFSTATUS_PROTECTION
      bsw called entity BswCalledEntity_CanIf_SetPduMode: can-enter-exclusive-area=[MODE_STATUS_PROTECTION, TX_QUEUE_PROTECTION, ExclusiveArea_0, RX_NOTIFSTATUS_PROTECTION, RX_DATA_PROTECTION, TX_DYNCANID_PROTECTION, TX_NOTIFSTATUS_PROTECTION], implemented-entry=CanIf_SetPduMode
      bsw distinguished partition BswDistinguishedPartition_CanIf
  bsw module entry CanIf_SetPduMode: service-id=9, is-reentrant=false, is-synchronous=false, call-type=REGULAR, execution-context=UNSPECIFIED, sw-service-impl-policy=STANDARD
