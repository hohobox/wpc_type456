AUTOSAR XML (schema 4-0-3)
package /Bsw_PduR
  bsw implementation BswImplementation_PduR: sw-version=2.9.8, vendor-id=76, ar-release-version=4.0.3, behavior=BswInternalBehavior_PduR
  bsw module description PduR: module-id=51
    bsw module dependency BswModuleDependency0: target-module-id=60, required-entrys=CanIf_SetPduMode
    bsw internal behavior BswInternalBehavior_PduR
      6 x exclusive area:
        TP_TX_PROTECTION_AREA
        GROUP_STATUS_PROTECTION_AREA
        FIFO_STATUS_PROTECTION_AREA
        DATA_BUFFER_PROTECTION_AREA
        MULTICAST_PROTECTION_AREA
        TP_GATEWAY_PROTECTION_AREA
      bsw called entity BswCalledEntity_PduR_LoTpTxConfirmation: can-enter-exclusive-area=[TP_TX_PROTECTION_AREA, GROUP_STATUS_PROTECTION_AREA, FIFO_STATUS_PROTECTION_AREA, DATA_BUFFER_PROTECTION_AREA, MULTICAST_PROTECTION_AREA, TP_GATEWAY_PROTECTION_AREA], implemented-entry=PduR_LoTpTxConfirmation
      bsw distinguished partition BswDistinguishedPartition_PduR
  bsw module entry PduR_LoTpTxConfirmation: service-id=55, is-reentrant=false, is-synchronous=false, call-type=REGULAR, execution-context=UNSPECIFIED, sw-service-impl-policy=STANDARD
