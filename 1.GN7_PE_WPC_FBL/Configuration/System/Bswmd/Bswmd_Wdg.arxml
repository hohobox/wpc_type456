AUTOSAR XML (schema 4-0-3)
package /TS_T40D13M1I0R0
  bsw implementation WdgImplementation: programming-language=C, sw-version=1.16.0, vendor-id=66, ar-release-version=4.2.2, behavior=WdgBehavior, vendor-api-infix=IA, vendor-specific-module-def=Wdg
  8 x bsw module entry, all with is-synchronous=true, sw-service-impl-policy=STANDARD:
    Wdg_Init: service-id=0, is-reentrant=false, call-type=REGULAR, execution-context=TASK
    Wdg_SetMode: service-id=1, is-reentrant=false, call-type=REGULAR, execution-context=TASK
    Wdg_SetTriggerCondition: service-id=3, is-reentrant=false, call-type=REGULAR, execution-context=TASK
    Wdg_GetVersionInfo: service-id=4, is-reentrant=true, call-type=REGULAR, execution-context=TASK
    Wdg_Cbk_GptNotificationTimeout: service-id=5, is-reentrant=false, call-type=CALLBACK, execution-context=TASK
    Wdg_Cbk_GptNotificationTrigger: service-id=6, is-reentrant=false, call-type=CALLBACK, execution-context=TASK
    Wdg_66_IA_PrewarnIrq_Cat1: is-reentrant=false, call-type=INTERRUPT, execution-context=INTERRUPT-CAT-1
    Wdg_66_IA_PrewarnIrq_Cat2: is-reentrant=false, call-type=INTERRUPT, execution-context=INTERRUPT-CAT-2
package /TS_T40D13M1I0R0/BswDescr
  bsw module description Wdg: module-id=102
    bsw internal behavior WdgBehavior
      exclusive area WDG_EXCLUSIVE_AREA_0
      6 x bsw called entity:
        Wdg_Init: can-enter-exclusive-area=WDG_EXCLUSIVE_AREA_0, implemented-entry=Wdg_Init
        Wdg_SetMode: implemented-entry=Wdg_SetMode
        Wdg_SetTriggerCondition: can-enter-exclusive-area=WDG_EXCLUSIVE_AREA_0, implemented-entry=Wdg_SetTriggerCondition
        Wdg_GetVersionInfo: implemented-entry=Wdg_GetVersionInfo
        Wdg_Cbk_GptNotificationTimeout: implemented-entry=Wdg_Cbk_GptNotificationTimeout
        Wdg_Cbk_GptNotificationTrigger: can-enter-exclusive-area=WDG_EXCLUSIVE_AREA_0, implemented-entry=Wdg_Cbk_GptNotificationTrigger
      bsw interrupt entity Wdg_66_IA_PrewarnIrq_Cat1: can-enter-exclusive-area=WDG_EXCLUSIVE_AREA_0, implemented-entry=Wdg_66_IA_PrewarnIrq_Cat1, interrupt-category=CAT-1, interrupt-source=2
      bsw interrupt entity Wdg_66_IA_PrewarnIrq_Cat2: can-enter-exclusive-area=WDG_EXCLUSIVE_AREA_0, implemented-entry=Wdg_66_IA_PrewarnIrq_Cat2, interrupt-category=CAT-2, interrupt-source=2
      bsw distinguished partition BswDistinguishedPartition_Wdg
