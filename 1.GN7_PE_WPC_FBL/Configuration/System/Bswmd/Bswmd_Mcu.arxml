AUTOSAR XML (schema 4-0-3)
package /TS_T40D13M1I0R0
  bsw implementation McuImplementation: sw-version=1.21.0, vendor-id=66, ar-release-version=4.2.2, behavior=McuBehavior
  17 x bsw module entry, all with is-synchronous=true, sw-service-impl-policy=STANDARD:
    Mcu_Init: service-id=0, is-reentrant=false, call-type=REGULAR, execution-context=TASK
    Mcu_InitRamSection: service-id=1, is-reentrant=false, call-type=REGULAR, execution-context=TASK
    Mcu_InitClock: service-id=2, is-reentrant=false, call-type=REGULAR, execution-context=TASK
    Mcu_DistributePllClock: service-id=3, is-reentrant=false, call-type=REGULAR, execution-context=TASK
    Mcu_GetPllStatus: service-id=4, is-reentrant=true, call-type=REGULAR, execution-context=TASK
    Mcu_GetResetReason: service-id=5, is-reentrant=true, call-type=REGULAR, execution-context=TASK
    Mcu_GetResetRawValue: service-id=6, is-reentrant=true, call-type=REGULAR, execution-context=TASK
    Mcu_PerformReset: service-id=7, is-reentrant=false, call-type=REGULAR, execution-context=TASK
    Mcu_SetMode: service-id=8, is-reentrant=false, call-type=REGULAR, execution-context=TASK
    Mcu_GetVersionInfo: service-id=9, is-reentrant=true, call-type=REGULAR, execution-context=TASK
    Mcu_GetClockGearUpStatus: service-id=35, is-reentrant=true, call-type=REGULAR, execution-context=TASK
    Mcu_GetClockGearDownStatus: service-id=36, is-reentrant=true, call-type=REGULAR, execution-context=TASK
    Mcu_StartClockGearDown: service-id=37, is-reentrant=false, call-type=REGULAR, execution-context=TASK
    Mcu_SyscNmiCsv_Cat1: is-reentrant=false, call-type=INTERRUPT, execution-context=INTERRUPT-CAT-1
    Mcu_SyscNmiCsv_Cat2: is-reentrant=false, call-type=INTERRUPT, execution-context=INTERRUPT-CAT-2
    Mcu_SyscNmiLvd_Cat1: is-reentrant=false, call-type=INTERRUPT, execution-context=INTERRUPT-CAT-1
    Mcu_SyscNmiLvd_Cat2: is-reentrant=false, call-type=INTERRUPT, execution-context=INTERRUPT-CAT-2
package /TS_T40D13M1I0R0/BswDescr
  bsw module description Mcu: module-id=101
    bsw internal behavior McuBehavior
      exclusive area MCU_EXCLUSIVE_AREA_0
      13 x bsw called entity:
        Mcu_Init: can-enter-exclusive-area=MCU_EXCLUSIVE_AREA_0, implemented-entry=Mcu_Init
        Mcu_InitRamSection: implemented-entry=Mcu_InitRamSection
        Mcu_InitClock: can-enter-exclusive-area=MCU_EXCLUSIVE_AREA_0, implemented-entry=Mcu_InitClock
        Mcu_DistributePllClock: can-enter-exclusive-area=MCU_EXCLUSIVE_AREA_0, implemented-entry=Mcu_DistributePllClock
        Mcu_GetPllStatus: implemented-entry=Mcu_GetPllStatus
        Mcu_GetResetReason: implemented-entry=Mcu_GetResetReason
        Mcu_GetResetRawValue: implemented-entry=Mcu_GetResetRawValue
        Mcu_PerformReset: can-enter-exclusive-area=MCU_EXCLUSIVE_AREA_0, implemented-entry=Mcu_PerformReset
        Mcu_SetMode: implemented-entry=Mcu_SetMode
        Mcu_GetVersionInfo: implemented-entry=Mcu_GetVersionInfo
        Mcu_GetClockGearUpStatus: implemented-entry=Mcu_GetClockGearUpStatus
        Mcu_GetClockGearDownStatus: implemented-entry=Mcu_GetClockGearDownStatus
        Mcu_StartClockGearDown: can-enter-exclusive-area=MCU_EXCLUSIVE_AREA_0, implemented-entry=Mcu_StartClockGearDown
      4 x bsw interrupt entity:
        Mcu_SyscNmiCsv_Cat1: implemented-entry=Mcu_SyscNmiCsv_Cat1, interrupt-category=CAT-1, interrupt-source=NMI5
        Mcu_SyscNmiCsv_Cat2: implemented-entry=Mcu_SyscNmiCsv_Cat2, interrupt-category=CAT-2, interrupt-source=NMI5
        Mcu_SyscNmiLvd_Cat1: implemented-entry=Mcu_SyscNmiLvd_Cat1, interrupt-category=CAT-1, interrupt-source=NMI4
        Mcu_SyscNmiLvd_Cat2: implemented-entry=Mcu_SyscNmiLvd_Cat2, interrupt-category=CAT-2, interrupt-source=NMI4
      bsw distinguished partition BswDistinguishedPartition_Mcu
