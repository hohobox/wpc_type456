AUTOSAR XML (schema 4-0-3)
package /AUTOSAR
  module config CanSM: implementation-config-variant=VARIANT-PRE-COMPILE, module-description=BswImplementation_CanSM
    CanSMGeneral: CanSMDevErrorDetect=1, CanSMMainFunctionTimePeriod=0.005, CanSMVersionInfoApi=0, CanSmChangeBaudrateApi=0, CanSMPncSupport=0
    CanSMConfiguration: CanSMModeRequestRepetitionMax=3, CanSMModeRequestRepetitionTime=0.03
      CanSMManagerNetwork_BCAN (CanSMManagerNetwork):
        category = TOOL_CONFIGURED
        CanSMBorTimeL1 = 0.96
        CanSMBorCounterL1ToL2 = 125
        CanSMBorTimeTxEnsured = 0.2
        CanSMBorTxConfirmationPolling = 0
        CanSMBorTimeL2 = 0.96
        CanSMTransceiverId = CanIfTrcvCfg_BCAN
        CanSMComMNetworkHandleRef = ComMChannel_BCAN
        CanSMController_WPC_BCAN (CanSMController): category=TOOL_CONFIGURED, CanSMControllerId=CanIfCtrlCfg_WPC_BCAN
