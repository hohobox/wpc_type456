AUTOSAR XML (schema 4-2-1)
package /AUTOSAR
  module config OsImp: implementation-config-variant=VARIANT-PRE-COMPILE, module-description=BswImplementation_OsImp
    OsImpGeneral: OsImpOpfUsed=0, OsImpErrmUsed=0, OsImpDebugStackdepth=1, OsImpCpuLoad=1
    OsImpConfiguration
      SRAM (OsImpRamSector):
        category = TOOL_CONFIGURED
        OsImpRamDefaultValue = 0
        OsImpRamSectionBaseAddress = 0x0800A000
        OsImpRamSectionSize = 0xE000
        OsImpRamInitProperty = PowerOnReset
