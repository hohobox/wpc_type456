AUTOSAR XML (schema 00047)
package /AUTRON
  module config Csm: implementation-config-variant=VARIANT-PRE-COMPILE, module-description=BswImplementation_Csm
    CsmGeneral: CsmDevErrorDetect=1, CsmUseDeprecated=0, CsmMainFunctionPeriod=0.01, CsmVersionInfoApi=1
    CsmKeys
      10 x CsmKey:
        RandomSeed_L9: CsmKeyId=0, CsmKeyUsePort=0, CsmKeyRef=RandomSeed_L9
        Hash_Dummy_Fota: CsmKeyId=1, CsmKeyUsePort=0, CsmKeyRef=Hash_Dummy_Fota
        Pkcs1_Asims_Public_key: CsmKeyId=2, CsmKeyUsePort=0, CsmKeyRef=Pkcs1_Asims_Public_Key
        Fota_Decrypt0Key: CsmKeyId=3, CsmKeyUsePort=0, CsmKeyRef=Fota_Decrypt0Key
        Fota_MacVerify0Key: CsmKeyId=4, CsmKeyUsePort=0, CsmKeyRef=Fota_MacVerify0Key
        PBKDF2_Key: CsmKeyId=5, CsmKeyUsePort=0, CsmKeyRef=PBKDF2_Key
        PBKDF2_TargetKey: CsmKeyId=6, CsmKeyUsePort=0, CsmKeyRef=PBKDF2_TargetKey
        CryptoKey_Dummy: CsmKeyId=7, CsmKeyUsePort=1, CsmKeyRef=CryptoKey_Dummy
        RandomSeed_L10: CsmKeyId=8, CsmKeyUsePort=0, CsmKeyRef=RandomSeed_L10
        CryptoKey_OEUK: CsmKeyId=9, CsmKeyUsePort=1, CsmKeyRef=CryptoKey_OEUK
    CsmQueues
      Crypto_76_HaeHsm (CsmQueue): CsmQueueSize=1, CsmChannelRef=CryIf_76_HaeHsm
      Crypto_HaeCryptoLib (CsmQueue): CsmQueueSize=5, CsmChannelRef=CryIf_HaeCryptoLib
    CsmJobs
      7 x CsmJob:
        RandomGenerate_L9: CsmJobId=0, CsmJobInterfaceUsePort=CRYPTO_USE_PORT, CsmJobPriority=0, CsmProcessingMode=CRYPTO_PROCESSING_SYNC, CsmJobKeyRef=CryptoKey_Dummy, CsmJobPrimitiveRef=CsmRandomGenerate, CsmJobQueueRef=Crypto_76_HaeHsm
        Hash_Sha256_Fota: CsmJobId=1, CsmJobInterfaceUsePort=CRYPTO_USE_FNC, CsmJobPrimitiveCallbackUpdateNotification=0, CsmJobPriority=1, CsmProcessingMode=CRYPTO_PROCESSING_SYNC, CsmJobKeyRef=Hash_Dummy_Fota, CsmJobPrimitiveRef=Crypto_SW/Hash_Sha256_Fota, CsmJobQueueRef=Crypto_HaeCryptoLib
        SignatureVerify_RSASSA_PKCS1_v1_5_Fota: CsmJobId=2, CsmJobInterfaceUsePort=CRYPTO_USE_FNC, CsmJobPrimitiveCallbackUpdateNotification=0, CsmJobPriority=1, CsmProcessingMode=CRYPTO_PROCESSING_SYNC, CsmJobKeyRef=Pkcs1_Asims_Public_key, CsmJobPrimitiveRef=CsmSignatureVerify_RSASSA_PKCS1_v1_5, CsmJobQueueRef=Crypto_HaeCryptoLib
        Fota_Decrypt0: CsmJobId=3, CsmJobInterfaceUsePort=CRYPTO_USE_FNC, CsmJobPriority=1, CsmProcessingMode=CRYPTO_PROCESSING_SYNC, CsmJobKeyRef=Fota_Decrypt0Key, CsmJobPrimitiveRef=CsmDecrypt, CsmJobQueueRef=Crypto_HaeCryptoLib
        Fota_MacVerify0: CsmJobId=4, CsmJobInterfaceUsePort=CRYPTO_USE_FNC, CsmJobPriority=1, CsmProcessingMode=CRYPTO_PROCESSING_SYNC, CsmJobKeyRef=Fota_MacVerify0Key, CsmJobPrimitiveRef=CsmMacVerify, CsmJobQueueRef=Crypto_HaeCryptoLib
        RandomGenerate_L10: CsmJobId=5, CsmJobInterfaceUsePort=CRYPTO_USE_PORT, CsmJobPriority=0, CsmProcessingMode=CRYPTO_PROCESSING_SYNC, CsmJobKeyRef=RandomSeed_L10, CsmJobPrimitiveRef=HaeHsmRandomGenerate_L10, CsmJobQueueRef=Crypto_76_HaeHsm
        SignatureVerify_RSASSA_PKCS1_v1_5: CsmJobId=6, CsmJobInterfaceUsePort=CRYPTO_USE_PORT_OPTIMIZED, CsmJobPrimitiveCallbackUpdateNotification=0, CsmJobPriority=1, CsmProcessingMode=CRYPTO_PROCESSING_ASYNC, CsmJobKeyRef=CryptoKey_OEUK, CsmJobPrimitiveRef=CsmSignatureVerify, CsmJobQueueRef=Crypto_HaeCryptoLib
    3 x CsmPrimitives:
      Crypto_SW
        Hash_Sha256_Fota (CsmHash)
          CsmHashConfig:
            CsmHashAlgorithmMode = CRYPTO_ALGOMODE_NOT_SET
            CsmHashAlgorithmSecondaryFamily = CRYPTO_ALGOFAM_NOT_SET
            CsmHashAlgorithmFamily = CRYPTO_ALGOFAM_SHA2_256
            CsmHashDataMaxLength = 64
            CsmHashResultLength = 32
        CsmSignatureVerify_RSASSA_PKCS1_v1_5 (CsmSignatureVerify)
          CsmSignatureVerifyConfig:
            CsmSignatureVerifyAlgorithmFamily = CRYPTO_ALGOFAM_RSA
            CsmSignatureVerifyAlgorithmMode = CRYPTO_ALGOMODE_RSASSA_PKCS1_v1_5
            CsmSignatureVerifyAlgorithmSecondaryFamily = CRYPTO_ALGOFAM_SHA2_256
            CsmSignatureVerifyCompareLength = 256
            CsmSignatureVerifyDataMaxLength = 4096
            CsmSignatureVerifyKeyLength = 256
        CsmDecrypt
          CsmDecryptConfig:
            CsmDecryptAlgorithmSecondaryFamily = CRYPTO_ALGOFAM_NOT_SET
            CsmDecryptDataMaxLength = 2048
            CsmDecryptResultMaxLength = 2048
            CsmDecryptAlgorithmFamily = CRYPTO_ALGOFAM_AES
            CsmDecryptAlgorithmKeyLength = 16
            CsmDecryptAlgorithmMode = CRYPTO_ALGOMODE_CTR
        CsmMacVerify
          CsmMacVerifyConfig:
            CsmMacVerifyAlgorithmSecondaryFamily = CRYPTO_ALGOFAM_NOT_SET
            CsmMacVerifyAlgorithmFamily = CRYPTO_ALGOFAM_AES
            CsmMacVerifyAlgorithmKeyLength = 16
            CsmMacVerifyAlgorithmMode = CRYPTO_ALGOMODE_CMAC
            CsmMacVerifyCompareLength = 16
      Crypto_HSM
        CsmRandomGenerate
          HaeHsmRandomGenerate_L9 (CsmRandomGenerateConfig):
            CsmRandomGenerateAlgorithmFamily = CRYPTO_ALGOFAM_RNG
            CsmRandomGenerateAlgorithmMode = CRYPTO_ALGOMODE_NOT_SET
            CsmRandomGenerateAlgorithmSecondaryFamily = CRYPTO_ALGOFAM_NOT_SET
            CsmRandomGenerateResultLength = 8
        CsmJobKeyDerive
          CsmJobKeyDeriveConfig:
            CsmJobKeyDeriveAlgorithmSecondaryFamily = CRYPTO_ALGOFAM_CUSTOM
            CsmJobKeyDeriveAlgorithmSecondaryFamilyCustom = CRYPTO_ALGOFAM_SHA2_256
            CsmJobKeyDeriveAlgorithmFamily = CRYPTO_ALGOFAM_PBKDF2
            CsmJobKeyDeriveAlgorithmMode = CRYPTO_ALGOMODE_HMAC
      Crypto_OEUK
        HaeHsmRandomGenerate_L10 (CsmRandomGenerate)
          RandomGenerate_L10 (CsmRandomGenerateConfig):
            CsmRandomGenerateAlgorithmFamily = CRYPTO_ALGOFAM_RNG
            CsmRandomGenerateAlgorithmMode = CRYPTO_ALGOMODE_NOT_SET
            CsmRandomGenerateAlgorithmSecondaryFamily = CRYPTO_ALGOFAM_NOT_SET
            CsmRandomGenerateResultLength = 8
        CsmSignatureVerify
          RSASSA_PKCS1_v1_5 (CsmSignatureVerifyConfig):
            CsmSignatureVerifyAlgorithmFamily = CRYPTO_ALGOFAM_RSA
            CsmSignatureVerifyAlgorithmMode = CRYPTO_ALGOMODE_RSASSA_PKCS1_v1_5
            CsmSignatureVerifyAlgorithmSecondaryFamily = CRYPTO_ALGOFAM_SHA2_256
            CsmSignatureVerifyCompareLength = 8
            CsmSignatureVerifyDataMaxLength = 3
            CsmSignatureVerifyKeyLength = 256
