AUTOSAR XML (schema 4-0-3)
package /AUTOSAR
  module config PduR: implementation-config-variant=VARIANT-PRE-COMPILE, module-description=BswImplementation_PduR
    4 x PduRBswModules, all with PduRChangeParameterRequestApi=0, PduRRetransmission=0, PduRTxConfirmation=1, PduRUseTag=0:
      PduRBswModules_CanIf: PduRCancelReceive=0, PduRCancelTransmit=0, PduRCommunicationInterface=1, PduRLowerModule=1, PduRTransportProtocol=0, PduRTriggertransmit=0, PduRUpperModule=0, PduRBswModuleRef=CanIf
      PduRBswModules_Com: PduRCancelReceive=0, PduRCancelTransmit=0, PduRCommunicationInterface=0, PduRLowerModule=0, PduRTransportProtocol=0, PduRTriggertransmit=1, PduRUpperModule=1, PduRBswModuleRef=Com
      PduRBswModules_CanTp: PduRCancelReceive=1, PduRCancelTransmit=1, PduRCommunicationInterface=0, PduRLowerModule=1, PduRTransportProtocol=1, PduRTriggertransmit=0, PduRUpperModule=0, PduRBswModuleRef=CanTp
      PduRBswModules_Dcm: PduRCancelReceive=1, PduRCancelTransmit=1, PduRCommunicationInterface=0, PduRLowerModule=0, PduRTriggertransmit=0, PduRUpperModule=1, PduRTransportProtocol=1, PduRBswModuleRef=Dcm
    PduRGeneral: PduRVersionInfoApi=0, PduRZeroCostOperation=0, PduRDevErrorDetect=0, PduRRxInterruptBased=0, PduRTxInterruptBased=0
    PduRRoutingTables: PduRConfigurationId=0
      PduRRoutingTable: category=TOOL_CONFIGURED, PduRIsMinimumRouting=0
        3 x PduRRoutingPath, all with category=TOOL_CONFIGURED:
          IN_BCAN_GST_WPC_RoutingPath
            PduR_DcmIPdu_BCAN_GST_WPC_DestPdu (PduRDestPdu): category=TOOL_CONFIGURED, PduRDestPduHandleId=0, PduRTransmissionConfirmation=1, PduRDestPduRef=Pdu_DcmIPdu_BCAN_GST_WPC
            PduR_DcmIPdu_BCAN_GST_WPC_SrcPdu (PduRSrcPdu): category=TOOL_CONFIGURED, PduRSourcePduHandleId=0, PduRSrcPduRef=Pdu_DcmIPdu_BCAN_GST_WPC
          IN_BCAN_GST_ALL_RoutingPath
            PduR_DcmIPdu_BCAN_GST_ALL_DestPdu (PduRDestPdu): category=TOOL_CONFIGURED, PduRDestPduHandleId=1, PduRTransmissionConfirmation=1, PduRDestPduRef=Pdu_DcmIPdu_BCAN_GST_ALL
            PduR_DcmIPdu_BCAN_GST_ALL_SrcPdu (PduRSrcPdu): category=TOOL_CONFIGURED, PduRSourcePduHandleId=1, PduRSrcPduRef=Pdu_DcmIPdu_BCAN_GST_ALL
          OUT_BCAN_WPC_GST_RoutingPath
            PduR_DcmIPdu_BCAN_WPC_GST_DestPdu (PduRDestPdu): category=TOOL_CONFIGURED, PduRDestPduHandleId=0, PduRTransmissionConfirmation=1, PduRDestPduRef=Pdu_DcmIPdu_BCAN_WPC_GST
            PduR_DcmIPdu_BCAN_WPC_GST_SrcPdu (PduRSrcPdu): category=TOOL_CONFIGURED, PduRSourcePduHandleId=0, PduRSrcPduRef=Pdu_DcmIPdu_BCAN_WPC_GST
      PduRRoutingPathGroup0 (PduRRoutingPathGroup): PduRIsEnabledAtInit=1, PduRRoutingPathGroupId=0
