AUTOSAR XML (schema 4-0-3)
package /Can
  module config Can: implementation-config-variant=VARIANT-POST-BUILD, module-description=CanImplementation
    CanConfigSet
      WPC_BCAN (CanController):
        category = TOOL_CONFIGURED
        CanBusoffProcessing = INTERRUPT
        CanControllerActivation = 1
        CanControllerId = 0
        CanTxProcessing = INTERRUPT
        CanRxProcessing = INTERRUPT
        CanWakeupProcessing = POLLING
        CanWakeupSupport = 1
        CanWakeupFunctionalityAPI = 1
        CanControllerBaseAddress = 0x40520400
        CanMessageRamBaseAddress = 0x40530000
        CanControllerPhysicalChannel = CANFD02
        CanMessageRamSize = 32768
        CanControllerInstance = INSTANCE0
        CanCpuClockRef = McuClockReferencePoint_CANFD0_CLOCK_CAN2
        CanWakeupSourceRef = ECUM_WKSOURCE_BCAN_RX
        CanControllerDefaultBaudrate = CanControllerBaudrateConfig
        CanControllerBaudrateConfig:
          category = TOOL_CONFIGURED
          CanControllerBaudRate = 500
          CanControllerBaudRateConfigID = 0
          CanControllerPropSeg = 0
          CanControllerSeg1 = 63
          CanControllerSeg2 = 16
          CanControllerSyncJumpWidth = 16
          CanControllerFdBaudrateConfig:
            CanControllerFdBaudRate = 1000
            CanControllerPropSeg = 0
            CanControllerSeg1 = 14
            CanControllerSeg2 = 5
            CanControllerSyncJumpWidth = 4
            CanControllerTrcvDelayCompensationOffset = 375
            CanControllerTxBitRateSwitch = 1
      3 x CanHardwareObject, all with category=TOOL_CONFIGURED, CanIdType=STANDARD, CanIcomRxMessageDedicated=0, CanTriggerTransmitEnable=0, CanControllerRef=WPC_BCAN:
        IN_HwObj_WPC_BCAN_0x7df_BCAN_GST_ALL: CanIdValue=2015, CanObjectType=RECEIVE, CanHandleType=FULL, CanHwObjectCount=1, CanRxBufferSelection=CAN_RX_DEDICATED, CanObjectId=0
          CanHwFilter0 (CanHwFilter): category=TOOL_CONFIGURED, CanHwFilterMask=2047, CanHwFilterCode=2015
        IN_HwObj_WPC_BCAN_0x725_BCAN_GST_WPC: CanIdValue=1829, CanObjectType=RECEIVE, CanHandleType=BASIC, CanHwObjectCount=10, CanRxBufferSelection=CAN_RX_FIFO1, CanObjectId=1
          CanHwFilter0 (CanHwFilter): category=TOOL_CONFIGURED, CanHwFilterMask=2047, CanHwFilterCode=1829
        OUT_HwObj_WPC_BCAN_0x72d_BCAN_WPC_GST: CanIdValue=1837, CanObjectType=TRANSMIT, CanHandleType=FULL, CanObjectId=2, CanHwObjectCount=1
    CanGeneral:
      CanChangeBaudrateApi = 0
      CanDeInitApi = 0
      CanDevErrorDetection = 1
      CanErrorCalloutFunction = Det_ReportError
      CanGetStatusApi = 1
      CanHardwareCancellation = 1
      CanIdenticalIdCancellation = 1
      CanIncludeFile = Can_Version.h
      CanIncludeFile = Det.h
      CanIndex = 0
      CanMainFunctionModePeriod = 0.005
      CanPublicIcomSupport = 0
      CanRxIndicationCompatibility = CAN_ASR_422_COMPATIBILITY
      CanSetBaudrateInChangedClockApi = 0
      CanTimeoutDuration = 0.005
      CanVersionInfoApi = 1
      CanMultiplexedTransmission = 1
      CanOsCounterRef = OsCounter_0
      CanMainFunctionRWPeriods: category=TOOL_CONFIGURED, CanMainFunctionPeriod=0.005
      CanDemEventParameterRefs
