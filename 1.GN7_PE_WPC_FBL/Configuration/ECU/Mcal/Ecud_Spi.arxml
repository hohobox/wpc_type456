AUTOSAR XML (schema 4-0-3)
package /Spi
  module config Spi: implementation-config-variant=VARIANT-PRE-COMPILE, module-description=SpiImplementation
    SpiDriver
      SpiChannel_0 (SpiChannel): SpiAlignedBuffer=0, SpiChannelId=0, SpiChannelType=IB, SpiDataWidth=8, SpiEbMaxLength=1, SpiIbNBuffers=1, SpiTransferStart=LSB
      SpiExternalDevice_0 (SpiExternalDevice):
        SpiBaudrate = 1000000.0
        SpiCsIdentifier = SPI_SELECT0
        SpiCsPolarity = LOW
        SpiDataShiftEdge = TRAILING
        SpiDeselect = 0.0
        SpiEnableCs = 0
        SpiHoldDelay = 0.75
        SpiHwUnit = SCB0
        SpiSetupDelay = 0.75
        SpiShiftClockIdleLevel = HIGH
        SpiTimeClk2Cs = 0.0
        SpiUseDma = 0
        SpiUseFifo = 1
        SpiClockRef = McuClockReferencePoint_SCB0_CLOCK
      SpiJob_0 (SpiJob): SpiJobId=0, SpiJobPriority=0, SpiDeviceAssignment=SpiExternalDevice_0
        SpiChannelList_0 (SpiChannelList): SpiChannelIndex=0, SpiChannelAssignment=SpiChannel_0
      SpiSequence_0 (SpiSequence): SpiInterruptibleSequence=0, SpiSequenceId=0, SpiJobAssignment=SpiJob_0
    SpiGeneral:
      SpiCancelApi = 1
      SpiChannelBuffersAllowed = 2
      SpiDevErrorDetect = 1
      SpiErrorCalloutFunction = Det_ReportError
      SpiHwStatusApi = 1
      SpiInterruptibleSeqAllowed = 0
      SpiLevelDelivered = 2
      SpiMainFunctionPeriod = 0.01
      SpiSupportConcurrentSyncTransmit = 0
      SpiVersionInfoApi = 1
      SpiIncludeFile = Det.h
    SpiPublishedInformation: SpiMaxHwUnit=32
    SpiDemEventParameterRefs
