AUTOSAR XML (schema 4-0-3)
package /Dio
  module config Dio: implementation-config-variant=VARIANT-PRE-COMPILE, module-description=DioImplementation
    DioConfig_0 (DioConfig)
      15 x DioPort:
        DioPort0: DioPortId=0
          4 x DioChannel:
            DioChannel_P000_{0..3}: DioChannelId={0..3}, DioChannelPin=P000_{0..3}
        DioPort2: DioPortId=2
          4 x DioChannel:
            DioChannel_P002_0: DioChannelId=16, DioChannelPin=P002_0
            DioChannel_P002_1: DioChannelId=17, DioChannelPin=P002_1
            DioChannel_P002_2: DioChannelId=18, DioChannelPin=P002_2
            DioChannel_P002_3: DioChannelId=19, DioChannelPin=P002_3
        DioPort5: DioPortId=5
          4 x DioChannel:
            DioChannel_P005_0: DioChannelId=40, DioChannelPin=P005_0
            DioChannel_P005_1: DioChannelId=41, DioChannelPin=P005_1
            DioChannel_P005_2: DioChannelId=42, DioChannelPin=P005_2
            DioChannel_P005_3: DioChannelId=43, DioChannelPin=P005_3
        DioPort6: DioPortId=6
          6 x DioChannel:
            DioChannel_P006_0: DioChannelId=48, DioChannelPin=P006_0
            DioChannel_P006_1: DioChannelId=49, DioChannelPin=P006_1
            DioChannel_P006_2: DioChannelId=50, DioChannelPin=P006_2
            DioChannel_P006_3: DioChannelId=51, DioChannelPin=P006_3
            DioChannel_P006_4: DioChannelId=52, DioChannelPin=P006_4
            DioChannel_P006_5: DioChannelId=53, DioChannelPin=P006_5
        DioPort7: DioPortId=7
          4 x DioChannel:
            DioChannel_P007_0: DioChannelId=56, DioChannelPin=P007_0
            DioChannel_P007_1: DioChannelId=57, DioChannelPin=P007_1
            DioChannel_P007_2: DioChannelId=58, DioChannelPin=P007_2
            DioChannel_P007_3: DioChannelId=59, DioChannelPin=P007_3
        DioPort8: DioPortId=8
          3 x DioChannel:
            DioChannel_P008_0: DioChannelId=64, DioChannelPin=P008_0
            DioChannel_P008_1: DioChannelId=65, DioChannelPin=P008_1
            DioChannel_P008_2: DioChannelId=66, DioChannelPin=P008_2
        DioPort11: DioPortId=11
          3 x DioChannel:
            DioChannel_P011_0: DioChannelId=88, DioChannelPin=P011_0
            DioChannel_P011_1: DioChannelId=89, DioChannelPin=P011_1
            DioChannel_P011_2: DioChannelId=90, DioChannelPin=P011_2
        DioPort12: DioPortId=12
          4 x DioChannel:
            DioChannel_P012_0: DioChannelId=96, DioChannelPin=P012_0
            DioChannel_P012_1: DioChannelId=97, DioChannelPin=P012_1
            DioChannel_P012_2: DioChannelId=98, DioChannelPin=P012_2
            DioChannel_P012_3: DioChannelId=99, DioChannelPin=P012_3
        DioPort13: DioPortId=13
          8 x DioChannel:
            DioChannel_P013_0: DioChannelId=104, DioChannelPin=P013_0
            DioChannel_P013_1: DioChannelId=105, DioChannelPin=P013_1
            DioChannel_P013_2: DioChannelId=106, DioChannelPin=P013_2
            DioChannel_P013_3: DioChannelId=107, DioChannelPin=P013_3
            DioChannel_P013_4: DioChannelId=108, DioChannelPin=P013_4
            DioChannel_P013_5: DioChannelId=109, DioChannelPin=P013_5
            DioChannel_P013_6: DioChannelId=110, DioChannelPin=P013_6
            DioChannel_P013_7: DioChannelId=111, DioChannelPin=P013_7
        DioPort14: DioPortId=14
          DioChannel_P014_0 (DioChannel): DioChannelId=112, DioChannelPin=P014_0
          DioChannel_P014_1 (DioChannel): DioChannelId=113, DioChannelPin=P014_1
        DioPort18: DioPortId=18
          8 x DioChannel:
            DioChannel_P018_0: DioChannelId=144, DioChannelPin=P018_0
            DioChannel_P018_1: DioChannelId=145, DioChannelPin=P018_1
            DioChannel_P018_2: DioChannelId=146, DioChannelPin=P018_2
            DioChannel_P018_3: DioChannelId=147, DioChannelPin=P018_3
            DioChannel_P018_4: DioChannelId=148, DioChannelPin=P018_4
            DioChannel_P018_5: DioChannelId=149, DioChannelPin=P018_5
            DioChannel_P018_6: DioChannelId=150, DioChannelPin=P018_6
            DioChannel_P018_7: DioChannelId=151, DioChannelPin=P018_7
        DioPort19: DioPortId=19
          DioChannel_P019_0 (DioChannel): DioChannelId=152, DioChannelPin=P019_0
          DioChannel_P019_1 (DioChannel): DioChannelId=153, DioChannelPin=P019_1
        DioPort21: DioPortId=21
          4 x DioChannel:
            DioChannel_P021_0: DioChannelId=168, DioChannelPin=P021_0
            DioChannel_P021_1: DioChannelId=169, DioChannelPin=P021_1
            DioChannel_P021_2: DioChannelId=170, DioChannelPin=P021_2
            DioChannel_P021_3: DioChannelId=171, DioChannelPin=P021_3
        DioPort22: DioPortId=22
          DioChannel_P022_0 (DioChannel): DioChannelId=176, DioChannelPin=P022_0
          DioChannel_P022_1 (DioChannel): DioChannelId=177, DioChannelPin=P022_1
        DioPort23: DioPortId=23
          5 x DioChannel:
            DioChannel_P023_3: DioChannelId=187, DioChannelPin=P023_3
            DioChannel_P023_4: DioChannelId=188, DioChannelPin=P023_4
            DioChannel_P023_5: DioChannelId=189, DioChannelPin=P023_5
            DioChannel_P023_6: DioChannelId=190, DioChannelPin=P023_6
            DioChannel_P023_7: DioChannelId=191, DioChannelPin=P023_7
    DioGeneral: DioDevErrorDetect=1, DioErrorCalloutFunction=Det_ReportError, DioFlipChannelApi=1, DioMaskedWritePortApi=1, DioVersionInfoApi=1, DioIncludeFile=Det.h
