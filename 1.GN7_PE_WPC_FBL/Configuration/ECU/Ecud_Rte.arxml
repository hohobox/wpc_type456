AUTOSAR XML (schema 4-0-3)
package /AUTOSAR
  module config Rte: implementation-config-variant=VARIANT-PRE-COMPILE
    CommonPublishedInformation0 (CommonPublishedInformation): ArReleaseVersion=4.0.3, ModuleId=2, SwVersion=4.11.1, VendorId=76
    RteBswGeneral0 (RteBswGeneral): RteSchMVersionInfoApi=0, RteUseComShadowSignalApi=1
    RteGeneration0 (RteGeneration):
      RteCalibrationSupport = INITIALIZED_RAM
      RteDevErrorDetectUninit = 0
      RteGenerationMode = COMPATIBILITY_MODE
      RteMeasurementSupport = 0
      RteOptimizationMode = RUNTIME
      RteToolChainSignificantCharacters = 100
      RteValueRangeCheckEnabled = 0
      RteVfbTraceEnabled = 0
      RteIocInteractionReturnValue = RTE_IOC
      RteDevErrorDetect = 0
    RteInitializationBehavior0 (RteInitializationBehavior): RteSectionInitializationPolicy=INIT
    RtePostBuildVariantConfiguration
    RteOsInteraction0 (RteOsInteraction): SynchronizedActivateOffset=1, RteSynchronizedOsCounterRef=OsCounter_0
      4 x RteUsedOsActivation, all with AlarmSetMethodIsRelative=1:
        RteUsedOsActivation_BSW_5ms_Com: RteExpectedActivationOffset=0.0025, RteExpectedActivationPosition=1, RteActivationOsAlarmRef=OsAlarm_BSW_5ms_Com
        RteUsedOsActivation_BSW_10ms: RteExpectedActivationOffset=0.005, RteExpectedActivationPosition=2, RteActivationOsAlarmRef=OsAlarm_BSW_10ms
        RteUsedOsActivation_ASW_10ms: RteExpectedActivationOffset=0.00375, RteExpectedActivationPosition=3, RteActivationOsAlarmRef=OsAlarm_ASW_10ms
        RteUsedOsActivation_ASW_100ms: RteExpectedActivationOffset=0.01875, RteExpectedActivationPosition=5, RteActivationOsAlarmRef=OsAlarm_ASW_100ms
    26 x RteBswModuleInstance:
      BswInstance_Com: category=TOOL_CONFIGURED, RteBswImplementationRef=BswImplementation_Com, RteBswModuleConfigurationRef=Com
        21 x RteBswExclusiveAreaImpl, all with category=TOOL_CONFIGURED, RteExclusiveAreaImplMechanism=ALL_INTERRUPT_BLOCKING:
          RX_DM_STS_PROTECTION_AREA: RteBswExclusiveAreaRef=RX_DM_STS_PROTECTION_AREA
          RX_IPDU_STS_PROTECTION_AREA: RteBswExclusiveAreaRef=RX_IPDU_STS_PROTECTION_AREA
          TX_IPDU_STATUS_PROTECTION_AREA: RteBswExclusiveAreaRef=TX_IPDU_STATUS_PROTECTION_AREA
          TX_IPDU_DATA_PROTECTION: RteBswExclusiveAreaRef=TX_IPDU_DATA_PROTECTION
          TX_MDT_PROTECTION_AREA: RteBswExclusiveAreaRef=TX_MDT_PROTECTION_AREA
          RX_IPDU_STATUS_PROTECTION_AREA: RteBswExclusiveAreaRef=RX_IPDU_STATUS_PROTECTION_AREA
          RX_GW_STS_PROTECTION_AREA: RteBswExclusiveAreaRef=RX_GW_STS_PROTECTION_AREA
          SIG_DATA_PROTECTION_AREA: RteBswExclusiveAreaRef=SIG_DATA_PROTECTION_AREA
          RX_SIG_DATA_PROTECTION_AREA: RteBswExclusiveAreaRef=RX_SIG_DATA_PROTECTION_AREA
          RX_IPDU_DATA_PROTECTION_AREA: RteBswExclusiveAreaRef=RX_IPDU_DATA_PROTECTION_AREA
          IPDU_GRP_STS_PROTECTION: RteBswExclusiveAreaRef=IPDU_GRP_STS_PROTECTION
          IPDU_STS_PROTECTION: RteBswExclusiveAreaRef=IPDU_STS_PROTECTION
          RX_EXT_SIG_DATA_PROTECTION_AREA: RteBswExclusiveAreaRef=RX_EXT_SIG_DATA_PROTECTION_AREA
          TX_EXT_SIG_DATA_PROTECTION_AREA: RteBswExclusiveAreaRef=TX_EXT_SIG_DATA_PROTECTION_AREA
          TX_IPDU_BUFFER_PROTECTION_AREA: RteBswExclusiveAreaRef=TX_IPDU_BUFFER_PROTECTION_AREA
          RX_FIFO_PROTECTION_AREA: RteBswExclusiveAreaRef=RX_FIFO_PROTECTION_AREA
          IPDU_GROUP_STATUS_PROTECTION: RteBswExclusiveAreaRef=IPDU_GROUP_STATUS_PROTECTION
          IPDU_COUNTER_PROTECTION: RteBswExclusiveAreaRef=IPDU_COUNTER_PROTECTION
          TX_TMS_STATUS_PROTECTION_AREA: RteBswExclusiveAreaRef=TX_TMS_STATUS_PROTECTION_AREA
          TX_MDT_STS_PROTECTION_AREA: RteBswExclusiveAreaRef=TX_MDT_STS_PROTECTION_AREA
          TX_DM_STS_PROTECTION_AREA: RteBswExclusiveAreaRef=TX_DM_STS_PROTECTION_AREA
        3 x RteBswEventToTaskMapping, all with category=TOOL_CONFIGURED, RteBswImmediateRestart=0, RteBswMappedToTaskRef=OsTask_BSW_FG1_5ms_Com, RteBswUsedOsAlarmRef=OsAlarm_BSW_5ms_Com:
          BswTE_Com_MainFunctionTx: RteBswPositionInTask=37, RteBswEventRef=BswTE_Com_MainFunctionTx
          BswTE_Com_MainFunctionRx: RteBswPositionInTask=35, RteBswEventRef=BswTE_Com_MainFunctionRx
          BswTE_Com_MainFunctionRouteSignals: RteBswPositionInTask=36, RteBswEventRef=BswTE_Com_MainFunctionRouteSignals
      BswInstance_Fota: category=TOOL_CONFIGURED, RteBswImplementationRef=BswImplementation_Fota, RteBswModuleConfigurationRef=Fota
        BswTimingEvent_Fota (RteBswEventToTaskMapping):
          category = TOOL_CONFIGURED
          RteBswImmediateRestart = 0
          RteBswPositionInTask = 0
          RteBswMappedToTaskRef = OsTask_BSW_BG_Fota
          RteBswUsedOsAlarmRef = OsAlarm_BG_Fota
          RteBswUsedOsEventRef = OsEvent_BSW_BG_Fota
          RteBswEventRef = BswTimingEvent_Fota
        CRITICAL_SECTION (RteBswExclusiveAreaImpl): RteExclusiveAreaImplMechanism=ALL_INTERRUPT_BLOCKING, RteBswExclusiveAreaRef=CRITICAL_SECTION
      BswInstance_Crc: category=TOOL_CONFIGURED, RteBswImplementationRef=BswImplementation_Crc, RteBswModuleConfigurationRef=Crc
        CriticalSection (RteBswExclusiveAreaImpl): category=TOOL_CONFIGURED, RteExclusiveAreaImplMechanism=ALL_INTERRUPT_BLOCKING, RteBswExclusiveAreaRef=CriticalSection
      BswInstance_Det: category=TOOL_CONFIGURED, RteBswImplementationRef=BswImplementation_Det, RteBswModuleConfigurationRef=Det
        RAM_DATA_PROTECTION (RteBswExclusiveAreaImpl): category=TOOL_CONFIGURED, RteExclusiveAreaImplMechanism=ALL_INTERRUPT_BLOCKING, RteBswExclusiveAreaRef=RAM_DATA_PROTECTION
      BswInstance_Can: category=TOOL_CONFIGURED, RteBswImplementationRef=CanImplementation, RteBswModuleConfigurationRef=Can
        CAN_EXCLUSIVE_AREA_0 (RteBswExclusiveAreaImpl): category=TOOL_CONFIGURED, RteExclusiveAreaImplMechanism=ALL_INTERRUPT_BLOCKING, RteBswExclusiveAreaRef=CAN_EXCLUSIVE_AREA_0
      BswInstance_Port: category=TOOL_CONFIGURED, RteBswImplementationRef=PortImplementation, RteBswModuleConfigurationRef=Port
        PORT_EXCLUSIVE_AREA_0 (RteBswExclusiveAreaImpl): category=TOOL_CONFIGURED, RteExclusiveAreaImplMechanism=ALL_INTERRUPT_BLOCKING, RteBswExclusiveAreaRef=PORT_EXCLUSIVE_AREA_0
      BswInstance_PduR: category=TOOL_CONFIGURED, RteBswImplementationRef=BswImplementation_PduR, RteBswModuleConfigurationRef=PduR
        6 x RteBswExclusiveAreaImpl, all with category=TOOL_CONFIGURED, RteExclusiveAreaImplMechanism=ALL_INTERRUPT_BLOCKING:
          TP_TX_PROTECTION_AREA: RteBswExclusiveAreaRef=TP_TX_PROTECTION_AREA
          GROUP_STATUS_PROTECTION_AREA: RteBswExclusiveAreaRef=GROUP_STATUS_PROTECTION_AREA
          FIFO_STATUS_PROTECTION_AREA: RteBswExclusiveAreaRef=FIFO_STATUS_PROTECTION_AREA
          DATA_BUFFER_PROTECTION_AREA: RteBswExclusiveAreaRef=DATA_BUFFER_PROTECTION_AREA
          MULTICAST_PROTECTION_AREA: RteBswExclusiveAreaRef=MULTICAST_PROTECTION_AREA
          TP_GATEWAY_PROTECTION_AREA: RteBswExclusiveAreaRef=TP_GATEWAY_PROTECTION_AREA
      BswInstance_Wdg: category=TOOL_CONFIGURED, RteBswImplementationRef=WdgImplementation, RteBswModuleConfigurationRef=Wdg
        WDG_EXCLUSIVE_AREA_0 (RteBswExclusiveAreaImpl): category=TOOL_CONFIGURED, RteExclusiveAreaImplMechanism=ALL_INTERRUPT_BLOCKING, RteBswExclusiveAreaRef=WDG_EXCLUSIVE_AREA_0
      BswInstance_CanIf: category=TOOL_CONFIGURED, RteBswImplementationRef=BswImplementation_CanIf, RteBswModuleConfigurationRef=CanIf
        7 x RteBswExclusiveAreaImpl, all with category=TOOL_CONFIGURED, RteExclusiveAreaImplMechanism=ALL_INTERRUPT_BLOCKING:
          MODE_STATUS_PROTECTION: RteBswExclusiveAreaRef=MODE_STATUS_PROTECTION
          TX_QUEUE_PROTECTION: RteBswExclusiveAreaRef=TX_QUEUE_PROTECTION
          ExclusiveArea_0: RteBswExclusiveAreaRef=ExclusiveArea_0
          RX_NOTIFSTATUS_PROTECTION: RteBswExclusiveAreaRef=RX_NOTIFSTATUS_PROTECTION
          RX_DATA_PROTECTION: RteBswExclusiveAreaRef=RX_DATA_PROTECTION
          TX_DYNCANID_PROTECTION: RteBswExclusiveAreaRef=TX_DYNCANID_PROTECTION
          TX_NOTIFSTATUS_PROTECTION: RteBswExclusiveAreaRef=TX_NOTIFSTATUS_PROTECTION
      BswInstance_Dio: category=TOOL_CONFIGURED, RteBswImplementationRef=DioImplementation, RteBswModuleConfigurationRef=Dio
        DIO_EXCLUSIVE_AREA_0 (RteBswExclusiveAreaImpl): category=TOOL_CONFIGURED, RteExclusiveAreaImplMechanism=ALL_INTERRUPT_BLOCKING, RteBswExclusiveAreaRef=DIO_EXCLUSIVE_AREA_0
      BswInstance_Csm: category=TOOL_CONFIGURED, RteBswImplementationRef=BswImplementation_Csm, RteBswModuleConfigurationRef=Csm
        GLOBALVAR_PROTECTION (RteBswExclusiveAreaImpl): category=TOOL_CONFIGURED, RteExclusiveAreaImplMechanism=ALL_INTERRUPT_BLOCKING, RteBswExclusiveAreaRef=GLOBALVAR_PROTECTION
        BswTE_Csm_MainFunction (RteBswEventToTaskMapping):
          category = TOOL_CONFIGURED
          RteBswImmediateRestart = 0
          RteBswPositionInTask = 6
          RteBswMappedToTaskRef = OsTask_BSW_FG1_10ms
          RteBswUsedOsAlarmRef = OsAlarm_BSW_10ms
          RteBswEventRef = BswTE_Csm_MainFunction
        modeNotificationPort_CsmEcuShutdown (RteBswRequiredModeGroupConnection):
          category = TOOL_CONFIGURED
          RteBswProvidedModeGroupRef = modeSwitchPort_EcuMode
          RteBswRequiredModeGroupRef = modeNotificationPort_CsmEcuShutdown
          RteBswProvidedModeGrpModInstRef = BswInstance_BswM
      BswInstance_Mcu: category=TOOL_CONFIGURED, RteBswImplementationRef=McuImplementation, RteBswModuleConfigurationRef=Mcu
        MCU_EXCLUSIVE_AREA_0 (RteBswExclusiveAreaImpl): category=TOOL_CONFIGURED, RteExclusiveAreaImplMechanism=ALL_INTERRUPT_BLOCKING, RteBswExclusiveAreaRef=MCU_EXCLUSIVE_AREA_0
      BswInstance_Mem: category=TOOL_CONFIGURED, RteBswImplementationRef=BswImplementation_Mem, RteBswModuleConfigurationRef=Mem
        CRITICAL_SECTION (RteBswExclusiveAreaImpl): category=TOOL_CONFIGURED, RteExclusiveAreaImplMechanism=ALL_INTERRUPT_BLOCKING, RteBswExclusiveAreaRef=CRITICAL_SECTION
        BswTE_Mem_76_Pfls_MainFunction (RteBswEventToTaskMapping):
          category = TOOL_CONFIGURED
          RteBswImmediateRestart = 0
          RteBswPositionInTask = 0
          RteBswMappedToTaskRef = OsTask_BSW_BG_Mem_76_Pfls_Main
          RteBswUsedOsAlarmRef = OsAlarm_BSW_BG_Mem_76_Pfls_Main
          RteBswUsedOsEventRef = OsEvent_BSW_Mem_76_Pfls_Main
          RteBswEventRef = BswTE_Mem_76_Pfls_MainFunction
      BswInstance_CanSM: category=TOOL_CONFIGURED, RteBswImplementationRef=BswImplementation_CanSM, RteBswModuleConfigurationRef=CanSM
        MODE_STATUS_PROTECTION (RteBswExclusiveAreaImpl): category=TOOL_CONFIGURED, RteExclusiveAreaImplMechanism=ALL_INTERRUPT_BLOCKING, RteBswExclusiveAreaRef=MODE_STATUS_PROTECTION
        BUSOFF_STATUS_PROTECTION (RteBswExclusiveAreaImpl): category=TOOL_CONFIGURED, RteExclusiveAreaImplMechanism=ALL_INTERRUPT_BLOCKING, RteBswExclusiveAreaRef=BUSOFF_STATUS_PROTECTION
        BswTE_CanSM_MainFunction (RteBswEventToTaskMapping):
          category = TOOL_CONFIGURED
          RteBswImmediateRestart = 0
          RteBswPositionInTask = 40
          RteBswMappedToTaskRef = OsTask_BSW_FG1_5ms_Com
          RteBswUsedOsAlarmRef = OsAlarm_BSW_5ms_Com
          RteBswEventRef = BswTE_CanSM_MainFunction
      BswInstance_EcuM: category=TOOL_CONFIGURED, RteBswImplementationRef=BswImplementation_EcuM, RteBswModuleConfigurationRef=EcuM
        7 x RteBswExclusiveAreaImpl, all with category=TOOL_CONFIGURED, RteExclusiveAreaImplMechanism=ALL_INTERRUPT_BLOCKING:
          ALARM_TIME_PROTECTION: RteBswExclusiveAreaRef=ALARM_TIME_PROTECTION
          BOOT_TARGET_PROTECTION: RteBswExclusiveAreaRef=BOOT_TARGET_PROTECTION
          SHUTDOWN_CAUSE: RteBswExclusiveAreaRef=SHUTDOWN_CAUSE
          SHUTDOWN_OR_SLEEP_FLAG_PROTECTION: RteBswExclusiveAreaRef=SHUTDOWN_OR_SLEEP_FLAG_PROTECTION
          SHUTDOWN_TARGET_PROTECTION: RteBswExclusiveAreaRef=SHUTDOWN_TARGET_PROTECTION
          STATE_PROTECTION: RteBswExclusiveAreaRef=STATE_PROTECTION
          WAKEUP_STATUS_PROTECTION: RteBswExclusiveAreaRef=WAKEUP_STATUS_PROTECTION
        BswTE_EcuM_MainFunction (RteBswEventToTaskMapping):
          category = TOOL_CONFIGURED
          RteBswImmediateRestart = 0
          RteBswPositionInTask = 2
          RteBswMappedToTaskRef = OsTask_BSW_FG1_10ms
          RteBswUsedOsAlarmRef = OsAlarm_BSW_10ms
          RteBswEventRef = BswTE_EcuM_MainFunction
      BswInstance_WdgM: category=TOOL_CONFIGURED, RteBswImplementationRef=BswImplementation_WdgM, RteBswModuleConfigurationRef=WdgM
        GLOBALSUPVSNSTATUS_PROTECTION (RteBswExclusiveAreaImpl): category=TOOL_CONFIGURED, RteExclusiveAreaImplMechanism=ALL_INTERRUPT_BLOCKING, RteBswExclusiveAreaRef=GLOBALSUPVSNSTATUS_PROTECTION
        BswTE_WdgM_MainFunction (RteBswEventToTaskMapping):
          category = TOOL_CONFIGURED
          RteBswImmediateRestart = 0
          RteBswPositionInTask = 1
          RteBswMappedToTaskRef = OsTask_BSW_FG1_10ms
          RteBswUsedOsAlarmRef = OsAlarm_BSW_10ms
          RteBswEventRef = BswTE_WdgM_MainFunction
        modeNotificationPort_EcuMode (RteBswRequiredModeGroupConnection):
          category = TOOL_CONFIGURED
          RteBswProvidedModeGroupRef = modeSwitchPort_EcuMode
          RteBswRequiredModeGroupRef = modeNotificationPort_EcuMode
          RteBswProvidedModeGrpModInstRef = BswInstance_BswM
      BswInstance_Adc: category=TOOL_CONFIGURED, RteBswImplementationRef=AdcImplementation, RteBswModuleConfigurationRef=Adc
        ADC_EXCLUSIVE_AREA_0 (RteBswExclusiveAreaImpl): category=TOOL_CONFIGURED, RteExclusiveAreaImplMechanism=ALL_INTERRUPT_BLOCKING, RteBswExclusiveAreaRef=ADC_EXCLUSIVE_AREA_0
      BswInstance_Dcm: category=TOOL_CONFIGURED, RteBswImplementationRef=BswImplementation_Dcm, RteBswModuleConfigurationRef=Dcm
        6 x RteBswExclusiveAreaImpl, all with category=TOOL_CONFIGURED, RteExclusiveAreaImplMechanism=ALL_INTERRUPT_BLOCKING:
          SIGNAL_DATA_PROTECTION_AREA: RteBswExclusiveAreaRef=SIGNAL_DATA_PROTECTION_AREA
          ProtclProtection: RteBswExclusiveAreaRef=ProtclProtection
          RxPduIdProtection: RteBswExclusiveAreaRef=RxPduIdProtection
          RxLengthProtection: RteBswExclusiveAreaRef=RxLengthProtection
          TimerProtection: RteBswExclusiveAreaRef=TimerProtection
          DATA_UPDATE: RteBswExclusiveAreaRef=DATA_UPDATE
        BswTE_Dcm_MainFunction (RteBswEventToTaskMapping):
          category = TOOL_CONFIGURED
          RteBswImmediateRestart = 0
          RteBswPositionInTask = 50
          RteBswMappedToTaskRef = OsTask_BSW_FG1_10ms
          RteBswUsedOsAlarmRef = OsAlarm_BSW_10ms
          RteBswEventRef = BswTE_Dcm_MainFunction
        Dcm_EM_R (RteBswRequiredModeGroupConnection): RteBswProvidedModeGroupRef=modeSwitchPort_EcuMode, RteBswRequiredModeGroupRef=Dcm_EM_R, RteBswProvidedModeGrpModInstRef=BswInstance_BswM
      BswInstance_KeyM: category=TOOL_CONFIGURED, RteBswImplementationRef=BswImplementation_KeyM, RteBswModuleConfigurationRef=KeyM
        GLOBALVAR_PROTECTION (RteBswExclusiveAreaImpl): category=TOOL_CONFIGURED, RteExclusiveAreaImplMechanism=ALL_INTERRUPT_BLOCKING, RteBswExclusiveAreaRef=GLOBALVAR_PROTECTION
        BswTE_KeyM_MainBackgroundFunction (RteBswEventToTaskMapping):
          category = TOOL_CONFIGURED
          RteBswImmediateRestart = 0
          RteBswPositionInTask = 0
          RteBswMappedToTaskRef = OsTask_BSW_BG_KeyM
          RteBswUsedOsAlarmRef = OsAlarm_BG_KeyM
          RteBswUsedOsEventRef = OsEvent_BSW_KeyM
          RteBswEventRef = BswTE_KeyM_MainBackgroundFunction
        BswTE_KeyM_MainFunction (RteBswEventToTaskMapping):
          category = TOOL_CONFIGURED
          RteBswImmediateRestart = 0
          RteBswPositionInTask = 20
          RteBswMappedToTaskRef = OsTask_BSW_FG1_10ms
          RteBswUsedOsAlarmRef = OsAlarm_BSW_10ms
          RteBswEventRef = BswTE_KeyM_MainFunction
        modeNotificationPort_KeyMEcuShutdown (RteBswRequiredModeGroupConnection):
          category = TOOL_CONFIGURED
          RteBswProvidedModeGroupRef = modeSwitchPort_EcuMode
          RteBswRequiredModeGroupRef = modeNotificationPort_KeyMEcuShutdown
          RteBswProvidedModeGrpModInstRef = BswInstance_BswM
      BswInstance_CanTp: category=TOOL_CONFIGURED, RteBswImplementationRef=BswImplementation_CanTp, RteBswModuleConfigurationRef=CanTp
        TIMER_PROTECTION (RteBswExclusiveAreaImpl): category=TOOL_CONFIGURED, RteExclusiveAreaImplMechanism=ALL_INTERRUPT_BLOCKING, RteBswExclusiveAreaRef=TIMER_PROTECTION
        BswTE_CanTp_MainFunction (RteBswEventToTaskMapping):
          category = TOOL_CONFIGURED
          RteBswImmediateRestart = 0
          RteBswPositionInTask = 55
          RteBswMappedToTaskRef = OsTask_BSW_FG1_5ms_Com
          RteBswUsedOsAlarmRef = OsAlarm_BSW_5ms_Com
          RteBswEventRef = BswTE_CanTp_MainFunction
      BswInstance_ComM: category=TOOL_CONFIGURED, RteBswImplementationRef=BswImplementation_ComM, RteBswModuleConfigurationRef=ComM
        8 x RteBswExclusiveAreaImpl, all with category=TOOL_CONFIGURED, RteExclusiveAreaImplMechanism=ALL_INTERRUPT_BLOCKING:
          INHIBIT_CNT_PROTECTION: RteBswExclusiveAreaRef=INHIBIT_CNT_PROTECTION
          REQ_MODECNT_PROTECTION: RteBswExclusiveAreaRef=REQ_MODECNT_PROTECTION
          CURRENT_MODE_PROTECTION: RteBswExclusiveAreaRef=CURRENT_MODE_PROTECTION
          DCM_DIAGNOSTIC_PROTECTION: RteBswExclusiveAreaRef=DCM_DIAGNOSTIC_PROTECTION
          ECUM_WAKEUP_IND: RteBswExclusiveAreaRef=ECUM_WAKEUP_IND
          NM_INDICATION_PROTECTION: RteBswExclusiveAreaRef=NM_INDICATION_PROTECTION
          PNC_PREPARE_TIMER: RteBswExclusiveAreaRef=PNC_PREPARE_TIMER
          PNC_WAKEUP_IND: RteBswExclusiveAreaRef=PNC_WAKEUP_IND
        BswTE_ComM_MainFunction0 (RteBswEventToTaskMapping):
          category = TOOL_CONFIGURED
          RteBswImmediateRestart = 0
          RteBswPositionInTask = 1
          RteBswMappedToTaskRef = OsTask_BSW_FG1_5ms_Com
          RteBswUsedOsAlarmRef = OsAlarm_BSW_5ms_Com
          RteBswEventRef = BswTE_ComM_MainFunction0
      BswInstance_Gpt: category=TOOL_CONFIGURED, RteBswImplementationRef=GptImplementation, RteBswModuleConfigurationRef=Gpt
        GPT_EXCLUSIVE_AREA_0 (RteBswExclusiveAreaImpl): category=TOOL_CONFIGURED, RteExclusiveAreaImplMechanism=ALL_INTERRUPT_BLOCKING, RteBswExclusiveAreaRef=GPT_EXCLUSIVE_AREA_0
      BswInstance_BswM: category=TOOL_CONFIGURED, RteBswImplementationRef=BswImplementation_BswM, RteBswModuleConfigurationRef=BswM
        3 x RteBswExclusiveAreaImpl, all with category=TOOL_CONFIGURED, RteExclusiveAreaImplMechanism=ALL_INTERRUPT_BLOCKING:
          DATA_PROTECTION: RteBswExclusiveAreaRef=DATA_PROTECTION
          RULEPREVRESULT_PROTECTION: RteBswExclusiveAreaRef=RULEPREVRESULT_PROTECTION
          RULESTATUS_PROTECTION: RteBswExclusiveAreaRef=RULESTATUS_PROTECTION
        32 x RteBswEventToTaskMapping, all with category=TOOL_CONFIGURED, RteBswImmediateRestart=0:
          BMSE_Entry_BswM_Immediate_DcmCommunicationControl_0_modeNotificationPort_DcmCommunicationControl_0_DCM_DISABLE_RX_DISABLE_TX_NM: RteBswPositionInTask=0, RteBswEventRef=BMSE_Entry_BswM_Immediate_DcmCommunicationControl_0_modeNotificationPort_DcmCommunicationControl_0_DCM_DISABLE_RX_DISABLE_TX_NM
          BMSE_Entry_BswM_Immediate_DcmCommunicationControl_0_modeNotificationPort_DcmCommunicationControl_0_DCM_DISABLE_RX_ENABLE_TX_NORM: RteBswPositionInTask=0, RteBswEventRef=BMSE_Entry_BswM_Immediate_DcmCommunicationControl_0_modeNotificationPort_DcmCommunicationControl_0_DCM_DISABLE_RX_ENABLE_TX_NORM
          BMSE_Entry_BswM_Immediate_DcmCommunicationControl_0_modeNotificationPort_DcmCommunicationControl_0_DCM_DISABLE_RX_ENABLE_TX_NORM_NM: RteBswPositionInTask=0, RteBswEventRef=BMSE_Entry_BswM_Immediate_DcmCommunicationControl_0_modeNotificationPort_DcmCommunicationControl_0_DCM_DISABLE_RX_ENABLE_TX_NORM_NM
          BMSE_Entry_BswM_Immediate_DcmCommunicationControl_0_modeNotificationPort_DcmCommunicationControl_0_DCM_DISABLE_RX_TX_NM: RteBswPositionInTask=0, RteBswEventRef=BMSE_Entry_BswM_Immediate_DcmCommunicationControl_0_modeNotificationPort_DcmCommunicationControl_0_DCM_DISABLE_RX_TX_NM
          BMSE_Entry_BswM_Immediate_DcmCommunicationControl_0_modeNotificationPort_DcmCommunicationControl_0_DCM_DISABLE_RX_TX_NORMAL: RteBswPositionInTask=0, RteBswEventRef=BMSE_Entry_BswM_Immediate_DcmCommunicationControl_0_modeNotificationPort_DcmCommunicationControl_0_DCM_DISABLE_RX_TX_NORMAL
          BMSE_Entry_BswM_Immediate_DcmCommunicationControl_0_modeNotificationPort_DcmCommunicationControl_0_DCM_DISABLE_RX_TX_NORM_NM: RteBswPositionInTask=0, RteBswEventRef=BMSE_Entry_BswM_Immediate_DcmCommunicationControl_0_modeNotificationPort_DcmCommunicationControl_0_DCM_DISABLE_RX_TX_NORM_NM
          BMSE_Entry_BswM_Immediate_DcmCommunicationControl_0_modeNotificationPort_DcmCommunicationControl_0_DCM_ENABLE_RX_DISABLE_TX_NM: RteBswPositionInTask=0, RteBswEventRef=BMSE_Entry_BswM_Immediate_DcmCommunicationControl_0_modeNotificationPort_DcmCommunicationControl_0_DCM_ENABLE_RX_DISABLE_TX_NM
          BMSE_Entry_BswM_Immediate_DcmCommunicationControl_0_modeNotificationPort_DcmCommunicationControl_0_DCM_ENABLE_RX_DISABLE_TX_NORM: RteBswPositionInTask=0, RteBswEventRef=BMSE_Entry_BswM_Immediate_DcmCommunicationControl_0_modeNotificationPort_DcmCommunicationControl_0_DCM_ENABLE_RX_DISABLE_TX_NORM
          BMSE_Entry_BswM_Immediate_DcmCommunicationControl_0_modeNotificationPort_DcmCommunicationControl_0_DCM_ENABLE_RX_DISABLE_TX_NORM_NM: RteBswPositionInTask=0, RteBswEventRef=BMSE_Entry_BswM_Immediate_DcmCommunicationControl_0_modeNotificationPort_DcmCommunicationControl_0_DCM_ENABLE_RX_DISABLE_TX_NORM_NM
          BMSE_Entry_BswM_Immediate_DcmCommunicationControl_0_modeNotificationPort_DcmCommunicationControl_0_DCM_ENABLE_RX_TX_NM: RteBswPositionInTask=0, RteBswEventRef=BMSE_Entry_BswM_Immediate_DcmCommunicationControl_0_modeNotificationPort_DcmCommunicationControl_0_DCM_ENABLE_RX_TX_NM
          BMSE_Entry_BswM_Immediate_DcmCommunicationControl_0_modeNotificationPort_DcmCommunicationControl_0_DCM_ENABLE_RX_TX_NORM: RteBswPositionInTask=0, RteBswEventRef=BMSE_Entry_BswM_Immediate_DcmCommunicationControl_0_modeNotificationPort_DcmCommunicationControl_0_DCM_ENABLE_RX_TX_NORM
          BMSE_Entry_BswM_Immediate_DcmCommunicationControl_0_modeNotificationPort_DcmCommunicationControl_0_DCM_ENABLE_RX_TX_NORM_NM: RteBswPositionInTask=0, RteBswEventRef=BMSE_Entry_BswM_Immediate_DcmCommunicationControl_0_modeNotificationPort_DcmCommunicationControl_0_DCM_ENABLE_RX_TX_NORM_NM
          BMSE_Entry_BswM_Immediate_DcmControlDTCSetting_modeNotificationPort_DcmControlDTCSetting_DISABLEDTCSETTING: RteBswPositionInTask=1, RteBswEventRef=BMSE_Entry_BswM_Immediate_DcmControlDTCSetting_modeNotificationPort_DcmControlDTCSetting_DISABLEDTCSETTING
          BMSE_Entry_BswM_Immediate_DcmControlDTCSetting_modeNotificationPort_DcmControlDTCSetting_ENABLEDTCSETTING: RteBswPositionInTask=2, RteBswEventRef=BMSE_Entry_BswM_Immediate_DcmControlDTCSetting_modeNotificationPort_DcmControlDTCSetting_ENABLEDTCSETTING
          BMSE_Entry_BswM_Immediate_DcmDiagnosticSessionControl_modeNotificationPort_DcmDiagnosticSessionControl_DCM_DEFAULT_SESSION: RteBswPositionInTask=3, RteBswEventRef=BMSE_Entry_BswM_Immediate_DcmDiagnosticSessionControl_modeNotificationPort_DcmDiagnosticSessionControl_DCM_DEFAULT_SESSION
          BMSE_Entry_BswM_Immediate_DcmDiagnosticSessionControl_modeNotificationPort_DcmDiagnosticSessionControl_DCM_ECU_PROGRAMMING_MODE: RteBswPositionInTask=4, RteBswEventRef=BMSE_Entry_BswM_Immediate_DcmDiagnosticSessionControl_modeNotificationPort_DcmDiagnosticSessionControl_DCM_ECU_PROGRAMMING_MODE
          BMSE_Entry_BswM_Immediate_DcmDiagnosticSessionControl_modeNotificationPort_DcmDiagnosticSessionControl_DCM_EXTENDED_DIAGNOSTIC_MODE: RteBswPositionInTask=5, RteBswEventRef=BMSE_Entry_BswM_Immediate_DcmDiagnosticSessionControl_modeNotificationPort_DcmDiagnosticSessionControl_DCM_EXTENDED_DIAGNOSTIC_MODE
          BMSE_Entry_BswM_Immediate_DcmDiagnosticSessionControl_modeNotificationPort_DcmDiagnosticSessionControl_DCM_EXTENDED_DIAGNOSTIC_SESSION: RteBswPositionInTask=6, RteBswEventRef=BMSE_Entry_BswM_Immediate_DcmDiagnosticSessionControl_modeNotificationPort_DcmDiagnosticSessionControl_DCM_EXTENDED_DIAGNOSTIC_SESSION
          BMSE_Entry_BswM_Immediate_DcmDiagnosticSessionControl_modeNotificationPort_DcmDiagnosticSessionControl_DCM_PROGRAMMING_SESSION: RteBswPositionInTask=7, RteBswEventRef=BMSE_Entry_BswM_Immediate_DcmDiagnosticSessionControl_modeNotificationPort_DcmDiagnosticSessionControl_DCM_PROGRAMMING_SESSION
          BMSE_Entry_BswM_Immediate_DcmDiagnosticSessionControl_modeNotificationPort_DcmDiagnosticSessionControl_DCM_QUIESCENT_CURRENT_DIAGNOSTIC_MODE_START: RteBswPositionInTask=8, RteBswEventRef=BMSE_Entry_BswM_Immediate_DcmDiagnosticSessionControl_modeNotificationPort_DcmDiagnosticSessionControl_DCM_QUIESCENT_CURRENT_DIAGNOSTIC_MODE_START
          BMSE_Entry_BswM_Immediate_DcmDiagnosticSessionControl_modeNotificationPort_DcmDiagnosticSessionControl_DCM_SAFETY_SYSTEM_DIAGNOSTIC_SESSION: RteBswPositionInTask=9, RteBswEventRef=BMSE_Entry_BswM_Immediate_DcmDiagnosticSessionControl_modeNotificationPort_DcmDiagnosticSessionControl_DCM_SAFETY_SYSTEM_DIAGNOSTIC_SESSION
          BMSE_Entry_BswM_Immediate_DcmDiagnosticSessionControl_modeNotificationPort_DcmDiagnosticSessionControl_DCM_SLEEP_MODE_START_REQUEST: RteBswPositionInTask=10, RteBswEventRef=BMSE_Entry_BswM_Immediate_DcmDiagnosticSessionControl_modeNotificationPort_DcmDiagnosticSessionControl_DCM_SLEEP_MODE_START_REQUEST
          BMSE_Entry_BswM_Immediate_DcmEcuReset_modeNotificationPort_DcmEcuReset_EXECUTE: RteBswPositionInTask=11, RteBswEventRef=BMSE_Entry_BswM_Immediate_DcmEcuReset_modeNotificationPort_DcmEcuReset_EXECUTE
          BMSE_Entry_BswM_Immediate_DcmEcuReset_modeNotificationPort_DcmEcuReset_HARD: RteBswPositionInTask=12, RteBswEventRef=BMSE_Entry_BswM_Immediate_DcmEcuReset_modeNotificationPort_DcmEcuReset_HARD
          BMSE_Entry_BswM_Immediate_DcmEcuReset_modeNotificationPort_DcmEcuReset_JUMPTOBOOTLOADER: RteBswPositionInTask=13, RteBswEventRef=BMSE_Entry_BswM_Immediate_DcmEcuReset_modeNotificationPort_DcmEcuReset_JUMPTOBOOTLOADER
          BMSE_Entry_BswM_Immediate_DcmEcuReset_modeNotificationPort_DcmEcuReset_JUMPTOSYSSUPPLIERBOOTLOADER: RteBswPositionInTask=14, RteBswEventRef=BMSE_Entry_BswM_Immediate_DcmEcuReset_modeNotificationPort_DcmEcuReset_JUMPTOSYSSUPPLIERBOOTLOADER
          BMSE_Entry_BswM_Immediate_DcmEcuReset_modeNotificationPort_DcmEcuReset_KEYONOFF: RteBswPositionInTask=15, RteBswEventRef=BMSE_Entry_BswM_Immediate_DcmEcuReset_modeNotificationPort_DcmEcuReset_KEYONOFF
          BMSE_Entry_BswM_Immediate_DcmEcuReset_modeNotificationPort_DcmEcuReset_NONE: RteBswPositionInTask=16, RteBswEventRef=BMSE_Entry_BswM_Immediate_DcmEcuReset_modeNotificationPort_DcmEcuReset_NONE
          BMSE_Entry_BswM_Immediate_DcmEcuReset_modeNotificationPort_DcmEcuReset_SOFT: RteBswPositionInTask=17, RteBswEventRef=BMSE_Entry_BswM_Immediate_DcmEcuReset_modeNotificationPort_DcmEcuReset_SOFT
          BMSE_Entry_BswM_Immediate_DcmModeRapidPowerShutDown_modeNotificationPort_DcmModeRapidPowerShutDown_DISABLE_RAPIDPOWERSHUTDOWN: RteBswPositionInTask=18, RteBswEventRef=BMSE_Entry_BswM_Immediate_DcmModeRapidPowerShutDown_modeNotificationPort_DcmModeRapidPowerShutDown_DISABLE_RAPIDPOWERSHUTDOWN
          BMSE_Entry_BswM_Immediate_DcmModeRapidPowerShutDown_modeNotificationPort_DcmModeRapidPowerShutDown_ENABLE_RAPIDPOWERSHUTDOWN: RteBswPositionInTask=19, RteBswEventRef=BMSE_Entry_BswM_Immediate_DcmModeRapidPowerShutDown_modeNotificationPort_DcmModeRapidPowerShutDown_ENABLE_RAPIDPOWERSHUTDOWN
          BswTE_BswM_MainFunction: RteBswPositionInTask=4, RteBswMappedToTaskRef=OsTask_BSW_FG1_10ms, RteBswUsedOsAlarmRef=OsAlarm_BSW_10ms, RteBswEventRef=BswTE_BswM_MainFunction
        5 x RteBswRequiredModeGroupConnection, all with category=TOOL_CONFIGURED, RteBswProvidedModeGrpModInstRef=BswInstance_Dcm:
          modeNotificationPort_DcmCommunicationControl_0: RteBswProvidedModeGroupRef=DcmCommunicationControl_0, RteBswRequiredModeGroupRef=modeNotificationPort_DcmCommunicationControl_0
          modeNotificationPort_DcmControlDTCSetting: RteBswProvidedModeGroupRef=DcmControlDTCSetting, RteBswRequiredModeGroupRef=modeNotificationPort_DcmControlDTCSetting
          modeNotificationPort_DcmDiagnosticSessionControl: RteBswProvidedModeGroupRef=DcmDiagnosticSessionControl, RteBswRequiredModeGroupRef=modeNotificationPort_DcmDiagnosticSessionControl
          modeNotificationPort_DcmEcuReset: RteBswProvidedModeGroupRef=DcmEcuReset, RteBswRequiredModeGroupRef=modeNotificationPort_DcmEcuReset
          modeNotificationPort_DcmModeRapidPowerShutDown: RteBswProvidedModeGroupRef=DcmModeRapidPowerShutDown, RteBswRequiredModeGroupRef=modeNotificationPort_DcmModeRapidPowerShutDown
      BswInstance_CanTrcv: RteBswImplementationRef=BswImplementation_CanTrcv, RteBswModuleConfigurationRef=CanTrcv
        INTERRUPT_PROTECTION_AREA (RteBswExclusiveAreaImpl): RteExclusiveAreaImplMechanism=ALL_INTERRUPT_BLOCKING, RteBswExclusiveAreaRef=INTERRUPT_PROTECTION_AREA
      BswInstance_Spi: category=TOOL_CONFIGURED, RteBswImplementationRef=SpiImplementation, RteBswModuleConfigurationRef=Spi
        SPI_EXCLUSIVE_AREA_0 (RteBswExclusiveAreaImpl): category=TOOL_CONFIGURED, RteExclusiveAreaImplMechanism=ALL_INTERRUPT_BLOCKING, RteBswExclusiveAreaRef=SPI_EXCLUSIVE_AREA_0
      BswInstance_Crypto_76_HaeModule: RteBswImplementationRef=BswImplementation_Crypto_76_HaeModule, RteBswModuleConfigurationRef=Crypto, RteBswImplementationRef=BswImplementation_Crypto_76_HaeModule, RteBswImplementationRef=BswImplementation_Crypto_76_HaeModule
        BswTE_Crypto_HaeHsm_MainFunction (RteBswEventToTaskMapping):
          RteBswImmediateRestart = 0
          RteBswPositionInTask = 0
          RteBswEventRef = BswTE_Crypto_HaeHsm_MainFunction
          RteBswMappedToTaskRef = OsTask_BSW_Crypto_Main
          RteBswUsedOsAlarmRef = OsAlarm_BSW_Crypto_Main
          RteBswUsedOsEventRef = OsEvent_BSW_Crypto_Main
          RteBswEventRef = BswTE_Crypto_HaeHsm_MainFunction
          RteBswEventRef = BswTE_Crypto_HaeHsm_MainFunction
        BswTE_Crypto_HaeCryptoLib_MainFunction (RteBswEventToTaskMapping):
          RteBswImmediateRestart = 0
          RteBswPositionInTask = 1
          RteBswEventRef = BswTE_Crypto_HaeCryptoLib_MainFunction
          RteBswMappedToTaskRef = OsTask_BSW_Crypto_Main
          RteBswUsedOsAlarmRef = OsAlarm_BSW_Crypto_Main
          RteBswUsedOsEventRef = OsEvent_BSW_Crypto_Main
          RteBswEventRef = BswTE_Crypto_HaeCryptoLib_MainFunction
          RteBswEventRef = BswTE_Crypto_HaeCryptoLib_MainFunction
        GLOBALVAR_PROTECTION (RteBswExclusiveAreaImpl): RteExclusiveAreaImplMechanism=ALL_INTERRUPT_BLOCKING, RteBswExclusiveAreaRef=GLOBALVAR_PROTECTION
    SwcInstance_Os (RteSwComponentInstance): category=TOOL_CONFIGURED, RteSoftwareComponentInstanceRef=Os
      RteEventToTaskMapping_Os_TE_100ms_Master (RteEventToTaskMapping):
        category = TOOL_CONFIGURED
        RteImmediateRestart = 0
        RtePositionInTask = 4
        RteMappedToTaskRef = OsTask_ASW_FG1_100ms
        RteUsedOsAlarmRef = OsAlarm_ASW_100ms
        RteEventRef = Os_TE_100ms_Master
    SwcInstance_SWC_AppMode (RteSwComponentInstance): category=TOOL_CONFIGURED, RteSoftwareComponentInstanceRef=SWC_AppMode
      13 x RteEventToTaskMapping, all with category=TOOL_CONFIGURED, RteImmediateRestart=0:
        RteEventToTaskMapping_TE_AppMode_Test: RtePositionInTask=0, RteMappedToTaskRef=OsTask_ASW_FG1_100ms, RteUsedOsAlarmRef=OsAlarm_ASW_100ms, RteEventRef=TE_AppMode_Test
        RteEventToTaskMapping_SMSE_Entry_InitCompleted_modeNotificationPort_InitState_InitState_COMPLETE: RteEventRef=SMSE_Entry_InitCompleted_modeNotificationPort_InitState_InitState_COMPLETE
        RteEventToTaskMapping_SMSE_Entry_BusOffStateSwitched_modeNotificationPort_CanSMBORState_BCAN_CanSMBORState_BCAN_COMPLETE: RteEventRef=SMSE_Entry_BusOffStateSwitched_modeNotificationPort_CanSMBORState_BCAN_CanSMBORState_BCAN_COMPLETE
        RteEventToTaskMapping_SMSE_Entry_BusOffStateSwitched_modeNotificationPort_CanSMBORState_BCAN_CanSMBORState_BCAN_START: RteEventRef=SMSE_Entry_BusOffStateSwitched_modeNotificationPort_CanSMBORState_BCAN_CanSMBORState_BCAN_START
        RteEventToTaskMapping_SMSE_Entry_ComMModeSwitched_BCAN_modeNotificationPort_ComMMode_BCAN_ComMMode_BCAN_NO_COM: RteEventRef=SMSE_Entry_ComMModeSwitched_BCAN_modeNotificationPort_ComMMode_BCAN_ComMMode_BCAN_NO_COM
        RteEventToTaskMapping_SMSE_Entry_ComMModeSwitched_BCAN_modeNotificationPort_ComMMode_BCAN_ComMMode_BCAN_SILENT_COM: RteEventRef=SMSE_Entry_ComMModeSwitched_BCAN_modeNotificationPort_ComMMode_BCAN_ComMMode_BCAN_SILENT_COM
        RteEventToTaskMapping_SMSE_Entry_ComMModeSwitched_BCAN_modeNotificationPort_ComMMode_BCAN_ComMMode_BCAN_FULL_COM: RteEventRef=SMSE_Entry_ComMModeSwitched_BCAN_modeNotificationPort_ComMMode_BCAN_ComMMode_BCAN_FULL_COM
        RteEventToTaskMapping_SMSE_Entry_EcuModeSwitched_modeNotificationPort_EcuMode_EcuMode_ECUM_STATE_RUN: RteEventRef=SMSE_Entry_EcuModeSwitched_modeNotificationPort_EcuMode_EcuMode_ECUM_STATE_RUN
        RteEventToTaskMapping_SMSE_Entry_EcuModeSwitched_modeNotificationPort_EcuMode_EcuMode_ECUM_STATE_SHUTDOWN: RteEventRef=SMSE_Entry_EcuModeSwitched_modeNotificationPort_EcuMode_EcuMode_ECUM_STATE_SHUTDOWN
        RteEventToTaskMapping_SMSE_Entry_EcuModeSwitched_modeNotificationPort_EcuMode_EcuMode_ECUM_STATE_PREP_SHUTDOWN: RteEventRef=SMSE_Entry_EcuModeSwitched_modeNotificationPort_EcuMode_EcuMode_ECUM_STATE_PREP_SHUTDOWN
        RteEventToTaskMapping_SMSE_Entry_EcuModeSwitched_modeNotificationPort_EcuMode_EcuMode_ECUM_STATE_SLEEP: RteEventRef=SMSE_Entry_EcuModeSwitched_modeNotificationPort_EcuMode_EcuMode_ECUM_STATE_SLEEP
        RteEventToTaskMapping_SMSE_Entry_EcuModeSwitched_modeNotificationPort_EcuMode_EcuMode_ECUM_STATE_OFF: RteEventRef=SMSE_Entry_EcuModeSwitched_modeNotificationPort_EcuMode_EcuMode_ECUM_STATE_OFF
        RteEventToTaskMapping_SMSE_Entry_EcuModeSwitched_modeNotificationPort_EcuMode_EcuMode_ECUM_STATE_RESET: RteEventRef=SMSE_Entry_EcuModeSwitched_modeNotificationPort_EcuMode_EcuMode_ECUM_STATE_RESET
    RteSwComponentType_SWC_AppMode (RteSwComponentType): RteComponentTypeRef=SWC_AppMode
      RteComponentTypeCalibration: category=TOOL_CONFIGURED, RteCalibrationSupportEnabled=0
    SwcInstance_Det (RteSwComponentInstance): category=TOOL_CONFIGURED, RteSoftwareComponentInstanceRef=Det
      RteEventToTaskMapping_OperationInvokedEvent_Det (RteEventToTaskMapping): category=TOOL_CONFIGURED, RteImmediateRestart=0, RteEventRef=OperationInvokedEvent_Det
    RteSwComponentType_Det (RteSwComponentType): RteComponentTypeRef=Det
      RteComponentTypeCalibration: category=TOOL_CONFIGURED, RteCalibrationSupportEnabled=0
    SwcInstance_SWC_DiagnosticService (RteSwComponentInstance): category=TOOL_CONFIGURED, RteSoftwareComponentInstanceRef=SWC_DiagnosticService
      13 x RteEventToTaskMapping, all with category=TOOL_CONFIGURED, RteImmediateRestart=0:
        RteEventToTaskMapping_OIE_CallbackDCMRequestServices_StopProtocol: RteEventRef=OIE_CallbackDCMRequestServices_StopProtocol
        RteEventToTaskMapping_OIE_CallbackDCMRequestServices_StartProtocol: RteEventRef=OIE_CallbackDCMRequestServices_StartProtocol
        RteEventToTaskMapping_OIE_ServiceRequestSupplierNotification_Indication: RteEventRef=OIE_ServiceRequestSupplierNotification_Indication
        RteEventToTaskMapping_OIE_ServiceRequestSupplierNotification_Confirmation: RteEventRef=OIE_ServiceRequestSupplierNotification_Confirmation
        RteEventToTaskMapping_SMSE_Entry_DiagnosticSessionControlNotification_modeNotificationPort_SessionControl_DcmDiagnosticSessionControl_DCM_DEFAULT_SESSION: RteEventRef=SMSE_Entry_DiagnosticSessionControlNotification_modeNotificationPort_SessionControl_DcmDiagnosticSessionControl_DCM_DEFAULT_SESSION
        RteEventToTaskMapping_SMSE_Entry_DiagnosticSessionControlNotification_modeNotificationPort_SessionControl_DcmDiagnosticSessionControl_DCM_EXTENDED_DIAGNOSTIC_SESSION: RteEventRef=SMSE_Entry_DiagnosticSessionControlNotification_modeNotificationPort_SessionControl_DcmDiagnosticSessionControl_DCM_EXTENDED_DIAGNOSTIC_SESSION
        RteEventToTaskMapping_SMSE_ApplicationUpdatedIndication_modeNotificationPort_ApplicationUpdated_DcmApplicationUpdated_APP_UPDATED: RteEventRef=SMSE_ApplicationUpdatedIndication_modeNotificationPort_ApplicationUpdated_DcmApplicationUpdated_APP_UPDATED
        RteEventToTaskMapping_SMSE_ApplicationUpdatedIndication_modeNotificationPort_ApplicationUpdated_DcmApplicationUpdated_APP_NOT_UPDATED: RteEventRef=SMSE_ApplicationUpdatedIndication_modeNotificationPort_ApplicationUpdated_DcmApplicationUpdated_APP_NOT_UPDATED
        RteEventToTaskMapping_OIE_L9_GetSeed_SecurityAccess_L9_GetSeed: RteEventRef=OIE_L9_GetSeed
        RteEventToTaskMapping_OIE_L9_CompareKey_SecurityAccess_L9_CompareKey: RteEventRef=OIE_L9_CompareKey
        RteEventToTaskMapping_OIE_OEUK_AsyncVerifyFinished_CallbackNotification_SignatureVerify_CallbackNotification: RteEventRef=OIE_OEUK_AsyncVerifyFinished_CallbackNotification_SignatureVerify_CallbackNotification
        RteEventToTaskMapping_OIE_L10_CompareKey_SecurityAccess_L10_CompareKey: RteEventRef=OIE_L10_CompareKey_SecurityAccess_L10_CompareKey
        RteEventToTaskMapping_OIE_L10_GetSeed_SecurityAccess_L10_GetSeed: RteEventRef=OIE_L10_GetSeed_SecurityAccess_L10_GetSeed
    RteSwComponentType_SWC_DiagnosticService (RteSwComponentType): RteComponentTypeRef=SWC_DiagnosticService
      RteComponentTypeCalibration: category=TOOL_CONFIGURED, RteCalibrationSupportEnabled=0
    SwcInstance_SWC_WdgMTest (RteSwComponentInstance): category=TOOL_CONFIGURED, RteSoftwareComponentInstanceRef=SWC_WdgMTest
      5 x RteEventToTaskMapping, all with category=TOOL_CONFIGURED, RteImmediateRestart=0:
        RteEventToTaskMapping_TE_WdgMTest: RtePositionInTask=2, RteMappedToTaskRef=OsTask_ASW_FG1_10ms, RteUsedOsAlarmRef=OsAlarm_ASW_10ms, RteEventRef=TE_WdgMTest
        RteEventToTaskMapping_SwcModeSwitchEvent_globalMode_OK: RtePositionInTask=0, RteMappedToTaskRef=OsTask_ASW_FG2_WdgMTestMode, RteEventRef=SwcModeSwitchEvent_globalMode_OK
        RteEventToTaskMapping_SwcModeSwitchEvent_globalMode_FAILED: RtePositionInTask=1, RteMappedToTaskRef=OsTask_ASW_FG2_WdgMTestMode, RteEventRef=SwcModeSwitchEvent_globalMode_FAILED
        RteEventToTaskMapping_SwcModeSwitchEvent_globalMode_EXPIRED: RtePositionInTask=2, RteMappedToTaskRef=OsTask_ASW_FG2_WdgMTestMode, RteEventRef=SwcModeSwitchEvent_globalMode_EXPIRED
        RteEventToTaskMapping_SwcModeSwitchEvent_globalMode_STOPPED: RtePositionInTask=3, RteMappedToTaskRef=OsTask_ASW_FG2_WdgMTestMode, RteEventRef=SwcModeSwitchEvent_globalMode_STOPPED
    RteSwComponentType_SWC_WdgMTest (RteSwComponentType): RteComponentTypeRef=SWC_WdgMTest
      RteComponentTypeCalibration: category=TOOL_CONFIGURED, RteCalibrationSupportEnabled=0
    SwcInstance_CanTp (RteSwComponentInstance): category=TOOL_CONFIGURED, RteSoftwareComponentInstanceRef=CanTp
      RteEventToTaskMapping_OIE_ChangeParameter (RteEventToTaskMapping): category=TOOL_CONFIGURED, RteImmediateRestart=0, RteEventRef=OIE_ChangeParameter
      RteEventToTaskMapping_OIE_ReadParameter (RteEventToTaskMapping): category=TOOL_CONFIGURED, RteImmediateRestart=0, RteEventRef=OIE_ReadParameter
    RteSwComponentType_CanTp (RteSwComponentType): RteComponentTypeRef=CanTp
      RteComponentTypeCalibration: category=TOOL_CONFIGURED, RteCalibrationSupportEnabled=0
    SwcInstance_BswM (RteSwComponentInstance): category=TOOL_CONFIGURED, RteSoftwareComponentInstanceRef=BswM
      RteEventToTaskMapping_DRE_BswM_Immediate_SwcModeRequest_ComMMode_BCAN_modeRequestPort_ComMMode_BCAN_ComMMode_BCAN (RteEventToTaskMapping):
        category = TOOL_CONFIGURED
        RteImmediateRestart = 0
        RtePositionInTask = 0
        RteMappedToTaskRef = OsTask_BSW_ComMModeRequest
        RteEventRef = DRE_BswM_Immediate_SwcModeRequest_ComMMode_BCAN_modeRequestPort_ComMMode_BCAN_ComMMode_BCAN
    RteSwComponentType_BswM (RteSwComponentType): RteComponentTypeRef=BswM
      RteComponentTypeCalibration: category=TOOL_CONFIGURED, RteCalibrationSupportEnabled=0
    SwcInstance_ComM (RteSwComponentInstance): category=TOOL_CONFIGURED, RteSoftwareComponentInstanceRef=ComM
      29 x RteEventToTaskMapping, all with category=TOOL_CONFIGURED, RteImmediateRestart=0:
        RteEventToTaskMapping_OIE_GetStatus_ML: RteEventRef=OIE_GetStatus_ML
        RteEventToTaskMapping_OIE_LimitECUToNoComMode_ML: RteEventRef=OIE_LimitECUToNoComMode_ML
        RteEventToTaskMapping_OIE_ReadInhibitCounter_ML: RteEventRef=OIE_ReadInhibitCounter_ML
        RteEventToTaskMapping_OIE_ResetInhibitCounter_ML: RteEventRef=OIE_ResetInhibitCounter_ML
        RteEventToTaskMapping_OIE_SetECUGroupClassification_ML: RteEventRef=OIE_SetECUGroupClassification_ML
        RteEventToTaskMapping_OIE_LimitChannelToNoComMode_CL000: RteEventRef=OIE_LimitChannelToNoComMode_CL000
        RteEventToTaskMapping_OIE_PreventWakeUp_CL000: RteEventRef=OIE_PreventWakeUp_CL000
        RteEventToTaskMapping_OIE_GetState_CL000: RteEventRef=OIE_GetState_CL000
        RteEventToTaskMapping_OIE_GetInhibitionStatus_CL000: RteEventRef=OIE_GetInhibitionStatus_CL000
        RteEventToTaskMapping_OIE_LimitChannelToNoComMode_CL001: RteEventRef=OIE_LimitChannelToNoComMode_CL001
        RteEventToTaskMapping_OIE_PreventWakeUp_CL001: RteEventRef=OIE_PreventWakeUp_CL001
        RteEventToTaskMapping_OIE_GetState_CL001: RteEventRef=OIE_GetState_CL001
        RteEventToTaskMapping_OIE_GetInhibitionStatus_CL001: RteEventRef=OIE_GetInhibitionStatus_CL001
        RteEventToTaskMapping_OIE_LimitChannelToNoComMode_CL002: RteEventRef=OIE_LimitChannelToNoComMode_CL002
        RteEventToTaskMapping_OIE_PreventWakeUp_CL002: RteEventRef=OIE_PreventWakeUp_CL002
        RteEventToTaskMapping_OIE_GetState_CL002: RteEventRef=OIE_GetState_CL002
        RteEventToTaskMapping_OIE_GetInhibitionStatus_CL002: RteEventRef=OIE_GetInhibitionStatus_CL002
        RteEventToTaskMapping_OIE_RequestComMode_UR000: RteEventRef=OIE_RequestComMode_UR000
        RteEventToTaskMapping_OIE_GetCurrentComMode_UR000: RteEventRef=OIE_GetCurrentComMode_UR000
        RteEventToTaskMapping_OIE_GetRequestedComMode_UR000: RteEventRef=OIE_GetRequestedComMode_UR000
        RteEventToTaskMapping_OIE_RequestComMode_UR001: RteEventRef=OIE_RequestComMode_UR001
        RteEventToTaskMapping_OIE_GetCurrentComMode_UR001: RteEventRef=OIE_GetCurrentComMode_UR001
        RteEventToTaskMapping_OIE_GetRequestedComMode_UR001: RteEventRef=OIE_GetRequestedComMode_UR001
        RteEventToTaskMapping_OIE_RequestComMode_UR002: RteEventRef=OIE_RequestComMode_UR002
        RteEventToTaskMapping_OIE_GetCurrentComMode_UR002: RteEventRef=OIE_GetCurrentComMode_UR002
        RteEventToTaskMapping_OIE_GetRequestedComMode_UR002: RteEventRef=OIE_GetRequestedComMode_UR002
        RteEventToTaskMapping_OperationInvokedEvent_RequestComMode_ComMUser_BCAN: RteEventRef=OperationInvokedEvent_RequestComMode_ComMUser_BCAN
        RteEventToTaskMapping_OperationInvokedEvent_GetCurrentComMode_ComMUser_BCAN: RteEventRef=OperationInvokedEvent_GetCurrentComMode_ComMUser_BCAN
        RteEventToTaskMapping_OperationInvokedEvent_GetRequestedComMode_ComMUser_BCAN: RteEventRef=OperationInvokedEvent_GetRequestedComMode_ComMUser_BCAN
    RteSwComponentType_ComM (RteSwComponentType): RteComponentTypeRef=ComM
      RteComponentTypeCalibration: category=TOOL_CONFIGURED, RteCalibrationSupportEnabled=0
    SwcInstance_Fota (RteSwComponentInstance): category=TOOL_CONFIGURED, RteSoftwareComponentInstanceRef=Fota
      RteEventToTaskMapping_OIE_Fota_ServiceRequest_SupplierNotification_Confirmation_Swap_ServiceRequestNotification_Confirmation (RteEventToTaskMapping):
        category = TOOL_CONFIGURED
        RteImmediateRestart = 0
        RteEventRef = OIE_Fota_ServiceRequest_SupplierNotification_Confirmation_Swap_ServiceRequestNotification_Confirmation
      RteEventToTaskMapping_OIE_Fota_SupplierNotification_ServiceRequest_Indication_Swap_ServiceRequestNotification_Indication (RteEventToTaskMapping):
        category = TOOL_CONFIGURED
        RteImmediateRestart = 0
        RteEventRef = OIE_Fota_SupplierNotification_ServiceRequest_Indication_Swap_ServiceRequestNotification_Indication
    RteSwComponentType_Fota (RteSwComponentType): RteComponentTypeRef=Fota
      RteComponentTypeCalibration: category=TOOL_CONFIGURED, RteCalibrationSupportEnabled=0
    SwcInstance_Csm (RteSwComponentInstance): category=TOOL_CONFIGURED, RteSoftwareComponentInstanceRef=Csm
      26 x RteEventToTaskMapping, all with category=TOOL_CONFIGURED, RteImmediateRestart=0:
        RteEventToTaskMapping_OperationInvokedEvent_CsmJob_RandomGenerate_L9_RandomGenerate: RteEventRef=OperationInvokedEvent_CsmJob_RandomGenerate_L9_RandomGenerate
        RteEventToTaskMapping_OperationInvokedEvent_CsmKey_CryptoKey_Dummy_KeyCopy: RteEventRef=OperationInvokedEvent_CsmKey_CryptoKey_Dummy_KeyCopy
        RteEventToTaskMapping_OperationInvokedEvent_CsmKey_CryptoKey_Dummy_KeyDerive: RteEventRef=OperationInvokedEvent_CsmKey_CryptoKey_Dummy_KeyDerive
        RteEventToTaskMapping_OperationInvokedEvent_CsmKey_CryptoKey_Dummy_KeyElementCopy: RteEventRef=OperationInvokedEvent_CsmKey_CryptoKey_Dummy_KeyElementCopy
        RteEventToTaskMapping_OperationInvokedEvent_CsmKey_CryptoKey_Dummy_KeyElementCopyPartial: RteEventRef=OperationInvokedEvent_CsmKey_CryptoKey_Dummy_KeyElementCopyPartial
        RteEventToTaskMapping_OperationInvokedEvent_CsmKey_CryptoKey_Dummy_KeyElementGet: RteEventRef=OperationInvokedEvent_CsmKey_CryptoKey_Dummy_KeyElementGet
        RteEventToTaskMapping_OperationInvokedEvent_CsmKey_CryptoKey_Dummy_KeyElementSet: RteEventRef=OperationInvokedEvent_CsmKey_CryptoKey_Dummy_KeyElementSet
        RteEventToTaskMapping_OperationInvokedEvent_CsmKey_CryptoKey_Dummy_KeyExchangeCalcPubVal: RteEventRef=OperationInvokedEvent_CsmKey_CryptoKey_Dummy_KeyExchangeCalcPubVal
        RteEventToTaskMapping_OperationInvokedEvent_CsmKey_CryptoKey_Dummy_KeyExchangeCalcSecret: RteEventRef=OperationInvokedEvent_CsmKey_CryptoKey_Dummy_KeyExchangeCalcSecret
        RteEventToTaskMapping_OperationInvokedEvent_CsmKey_CryptoKey_Dummy_KeyGenerate: RteEventRef=OperationInvokedEvent_CsmKey_CryptoKey_Dummy_KeyGenerate
        RteEventToTaskMapping_OperationInvokedEvent_CsmKey_CryptoKey_Dummy_KeySetValid: RteEventRef=OperationInvokedEvent_CsmKey_CryptoKey_Dummy_KeySetValid
        RteEventToTaskMapping_OperationInvokedEvent_CsmKey_CryptoKey_Dummy_RandomSeed: RteEventRef=OperationInvokedEvent_CsmKey_CryptoKey_Dummy_RandomSeed
        RteEventToTaskMapping_OperationInvokedEvent_CsmJob_RandomGenerate_L10_RandomGenerate: RteEventRef=OperationInvokedEvent_CsmJob_RandomGenerate_L10_RandomGenerate
        RteEventToTaskMapping_OperationInvokedEvent_CsmJob_SignatureVerify_RSASSA_PKCS1_v1_5_CancelJob: RteEventRef=OperationInvokedEvent_CsmJob_SignatureVerify_RSASSA_PKCS1_v1_5_CancelJob
        RteEventToTaskMapping_OperationInvokedEvent_CsmJob_SignatureVerify_RSASSA_PKCS1_v1_5_SignatureVerify: RteEventRef=OperationInvokedEvent_CsmJob_SignatureVerify_RSASSA_PKCS1_v1_5_SignatureVerify
        RteEventToTaskMapping_OperationInvokedEvent_CsmKey_CryptoKey_OEUK_KeyCopy: RteEventRef=OperationInvokedEvent_CsmKey_CryptoKey_OEUK_KeyCopy
        RteEventToTaskMapping_OperationInvokedEvent_CsmKey_CryptoKey_OEUK_KeyDerive: RteEventRef=OperationInvokedEvent_CsmKey_CryptoKey_OEUK_KeyDerive
        RteEventToTaskMapping_OperationInvokedEvent_CsmKey_CryptoKey_OEUK_KeyElementCopy: RteEventRef=OperationInvokedEvent_CsmKey_CryptoKey_OEUK_KeyElementCopy
        RteEventToTaskMapping_OperationInvokedEvent_CsmKey_CryptoKey_OEUK_KeyElementCopyPartial: RteEventRef=OperationInvokedEvent_CsmKey_CryptoKey_OEUK_KeyElementCopyPartial
        RteEventToTaskMapping_OperationInvokedEvent_CsmKey_CryptoKey_OEUK_KeyElementGet: RteEventRef=OperationInvokedEvent_CsmKey_CryptoKey_OEUK_KeyElementGet
        RteEventToTaskMapping_OperationInvokedEvent_CsmKey_CryptoKey_OEUK_KeyElementSet: RteEventRef=OperationInvokedEvent_CsmKey_CryptoKey_OEUK_KeyElementSet
        RteEventToTaskMapping_OperationInvokedEvent_CsmKey_CryptoKey_OEUK_KeyExchangeCalcPubVal: RteEventRef=OperationInvokedEvent_CsmKey_CryptoKey_OEUK_KeyExchangeCalcPubVal
        RteEventToTaskMapping_OperationInvokedEvent_CsmKey_CryptoKey_OEUK_KeyExchangeCalcSecret: RteEventRef=OperationInvokedEvent_CsmKey_CryptoKey_OEUK_KeyExchangeCalcSecret
        RteEventToTaskMapping_OperationInvokedEvent_CsmKey_CryptoKey_OEUK_KeyGenerate: RteEventRef=OperationInvokedEvent_CsmKey_CryptoKey_OEUK_KeyGenerate
        RteEventToTaskMapping_OperationInvokedEvent_CsmKey_CryptoKey_OEUK_KeySetValid: RteEventRef=OperationInvokedEvent_CsmKey_CryptoKey_OEUK_KeySetValid
        RteEventToTaskMapping_OperationInvokedEvent_CsmKey_CryptoKey_OEUK_RandomSeed: RteEventRef=OperationInvokedEvent_CsmKey_CryptoKey_OEUK_RandomSeed
    RteSwComponentType_Csm (RteSwComponentType): RteComponentTypeRef=Csm
      RteComponentTypeCalibration: category=TOOL_CONFIGURED, RteCalibrationSupportEnabled=0
    SwcInstance_WdgM (RteSwComponentInstance): category=TOOL_CONFIGURED, RteSoftwareComponentInstanceRef=WdgM
      10 x RteEventToTaskMapping, all with category=TOOL_CONFIGURED, RteImmediateRestart=0:
        RteEventToTaskMapping_OperationInvokedEvent_alive_SE_Init_CheckpointReached: RteEventRef=OperationInvokedEvent_alive_SE_Init_CheckpointReached
        RteEventToTaskMapping_OperationInvokedEvent_alive_SE_Init_UpdateAliveCounter: RteEventRef=OperationInvokedEvent_alive_SE_Init_UpdateAliveCounter
        RteEventToTaskMapping_OperationInvokedEvent_alive_SE_WdgMTest_CheckpointReached: RteEventRef=OperationInvokedEvent_alive_SE_WdgMTest_CheckpointReached
        RteEventToTaskMapping_OperationInvokedEvent_alive_SE_WdgMTest_UpdateAliveCounter: RteEventRef=OperationInvokedEvent_alive_SE_WdgMTest_UpdateAliveCounter
        RteEventToTaskMapping_OperationInvokedEvent_SetMode: RtePositionInTask=0, RteMappedToTaskRef=OsTask_BSW_FG2_WdgMAPI, RteEventRef=OperationInvokedEvent_SetMode
        RteEventToTaskMapping_OperationInvokedEvent_GetMode: RteEventRef=OperationInvokedEvent_GetMode
        RteEventToTaskMapping_OperationInvokedEvent_GetLocalStatus: RteEventRef=OperationInvokedEvent_GetLocalStatus
        RteEventToTaskMapping_OperationInvokedEvent_GetGlobalStatus: RteEventRef=OperationInvokedEvent_GetGlobalStatus
        RteEventToTaskMapping_OperationInvokedEvent_PerformReset: RtePositionInTask=1, RteMappedToTaskRef=OsTask_BSW_FG2_WdgMAPI, RteEventRef=OperationInvokedEvent_PerformReset
        RteEventToTaskMapping_OperationInvokedEvent_GetFirstExpiredSEID: RteEventRef=OperationInvokedEvent_GetFirstExpiredSEID
    RteSwComponentType_WdgM (RteSwComponentType): RteComponentTypeRef=WdgM
      RteComponentTypeCalibration: category=TOOL_CONFIGURED, RteCalibrationSupportEnabled=0
    SwcInstance_EcuM (RteSwComponentInstance): category=TOOL_CONFIGURED, RteSoftwareComponentInstanceRef=EcuM
      21 x RteEventToTaskMapping, all with category=TOOL_CONFIGURED, RteImmediateRestart=0:
        RteEventToTaskMapping_OIE_GetBootTarget: RteEventRef=OIE_GetBootTarget
        RteEventToTaskMapping_OIE_SelectBootTarget: RteEventRef=OIE_SelectBootTarget
        RteEventToTaskMapping_OIE_GetLastShutdownTarget: RteEventRef=OIE_GetLastShutdownTarget
        RteEventToTaskMapping_OIE_GetMostRecentShutdown: RteEventRef=OIE_GetMostRecentShutdown
        RteEventToTaskMapping_OIE_GetNextRecentShutdown: RteEventRef=OIE_GetNextRecentShutdown
        RteEventToTaskMapping_OIE_GetShutdownCause: RteEventRef=OIE_GetShutdownCause
        RteEventToTaskMapping_OIE_GetShutdownTarget: RteEventRef=OIE_GetShutdownTarget
        RteEventToTaskMapping_OIE_GoDown: RteEventRef=OIE_GoDown
        RteEventToTaskMapping_OIE_GoHalt: RteEventRef=OIE_GoHalt
        RteEventToTaskMapping_OIE_GoPoll: RteEventRef=OIE_GoPoll
        RteEventToTaskMapping_OIE_SelectShutdownCause: RteEventRef=OIE_SelectShutdownCause
        RteEventToTaskMapping_OIE_SelectShutdownTarget: RteEventRef=OIE_SelectShutdownTarget
        RteEventToTaskMapping_OIE_ReleaseRUN: RteEventRef=OIE_ReleaseRUN
        RteEventToTaskMapping_OIE_RequestOff: RteEventRef=OIE_RequestOff
        RteEventToTaskMapping_OIE_RequestRUN: RteEventRef=OIE_RequestRUN
        RteEventToTaskMapping_OIE_RequestReset: RteEventRef=OIE_RequestReset
        RteEventToTaskMapping_OIE_RequestSleep: RteEventRef=OIE_RequestSleep
        RteEventToTaskMapping_OIE_SetRunState: RteEventRef=OIE_SetRunState
        RteEventToTaskMapping_OIE_ClearWakeupEvent: RteEventRef=OIE_ClearWakeupEvent
        RteEventToTaskMapping_OIE_DisableWakeupSources: RteEventRef=OIE_DisableWakeupSources
        RteEventToTaskMapping_OIE_EnableWakeupSources: RteEventRef=OIE_EnableWakeupSources
    RteSwComponentType_EcuM (RteSwComponentType): RteComponentTypeRef=EcuM
      RteComponentTypeCalibration: category=TOOL_CONFIGURED, RteCalibrationSupportEnabled=0
    SwcInstance_KeyM (RteSwComponentInstance): category=TOOL_CONFIGURED, RteSoftwareComponentInstanceRef=KeyM
      RteEventToTaskMapping_OperationInvokedEvent_KeyMCryptoKey_Update (RteEventToTaskMapping): category=TOOL_CONFIGURED, RteImmediateRestart=0, RteEventRef=OperationInvokedEvent_KeyMCryptoKey_Update
    RteSwComponentType_KeyM (RteSwComponentType): RteComponentTypeRef=KeyM
      RteComponentTypeCalibration: category=TOOL_CONFIGURED, RteCalibrationSupportEnabled=0
    SwcInstance_Dcm (RteSwComponentInstance): category=TOOL_CONFIGURED, RteSoftwareComponentInstanceRef=Dcm
      6 x RteEventToTaskMapping, all with category=TOOL_CONFIGURED, RteImmediateRestart=0:
        RteEventToTaskMapping_OIE_DCMServices_GetSesCtrlType: RteEventRef=OIE_DCMServices_GetSesCtrlType
        RteEventToTaskMapping_OIE_DCMServices_GetCertificationInfo: RteEventRef=OIE_DCMServices_GetCertificationInfo
        RteEventToTaskMapping_OIE_DCMServices_GetActiveProtocol: RteEventRef=OIE_DCMServices_GetActiveProtocol
        RteEventToTaskMapping_OIE_DCMServices_GetSecurityLevel: RteEventRef=OIE_DCMServices_GetSecurityLevel
        RteEventToTaskMapping_OIE_DCMServices_ResetToDefaultSession: RteEventRef=OIE_DCMServices_ResetToDefaultSession
        RteEventToTaskMapping_OIE_DCMServices_GetCertHolderReference: RteEventRef=OIE_DCMServices_GetCertHolderReference
    RteSwComponentType_Dcm (RteSwComponentType): RteComponentTypeRef=Dcm
      RteComponentTypeCalibration: category=TOOL_CONFIGURED, RteCalibrationSupportEnabled=0
