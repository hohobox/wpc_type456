AUTOSAR XML (schema 4-0-3)
package /AUTOSAR
  module config EcuM: implementation-config-variant=VARIANT-PRE-COMPILE, module-description=BswImplementation_EcuM
    EcuMConfiguration
      EcuMCommonConfiguration: category=TOOL_CONFIGURED, EcuMConfigConsistencyHash=123456789, EcuMDefaultAppMode=OsAppMode0
        EcuMDefaultShutdownTarget: EcuMDefaultState=EcuMStateSleep, EcuMDefaultResetModeRef=ECUM_RESET_UNDEFINED, EcuMDefaultSleepModeRef=ECUM_SLEEP_MODE
        ECUM_SLEEP_MODE (EcuMSleepMode): EcuMSleepModeId=0, EcuMSleepModeSuspend=1, EcuMWakeupSourceMask=ECUM_WKSOURCE_GPT, EcuMSleepModeMcuModeRef=McuModeSettingConf_DEEPSLEEP
        EcuMDriverInitListZero
          Det_Init (EcuMDriverInitItem): EcuMModuleID=Det, EcuMModuleParameter=VOID, EcuMModuleService=Init, EcuMDriverInitItemIndex=0, EcuMModuleUsed=1, EcuMModuleRef=Det
          Fota_Init (EcuMDriverInitItem): EcuMModuleUsed=1, EcuMModuleID=Fota, EcuMModuleParameter=VOID, EcuMModuleService=Init, EcuMDriverInitItemIndex=1, EcuMModuleRef=Fota
        EcuMDriverInitListOne
          17 x EcuMDriverInitItem, all with EcuMModuleService=Init, EcuMModuleUsed=1:
            Mcu_Init: EcuMModuleID=Mcu, EcuMModuleParameter=POSTBUILD_PTR, EcuMDriverInitItemIndex=1, EcuMModulePostBuildPtr=&Mcu_Config[0], EcuMModuleRef=Mcu
            Port_Init: EcuMModuleID=Port, EcuMModuleParameter=POSTBUILD_PTR, EcuMDriverInitItemIndex=2, EcuMModulePostBuildPtr=&Port_Config[0], EcuMModuleRef=Port
            Gpt_Init: EcuMModuleID=Gpt, EcuMDriverInitItemIndex=3, EcuMModuleParameter=POSTBUILD_PTR, EcuMModulePostBuildPtr=&Gpt_Config[0], EcuMModuleRef=Gpt
            Spi_Init: EcuMModuleID=Spi, EcuMModuleParameter=NULL_PTR, EcuMDriverInitItemIndex=4, EcuMModuleRef=Spi
            CanTrcv_Init: EcuMModuleID=CanTrcv, EcuMModuleParameter=NULL_PTR, EcuMDriverInitItemIndex=5, EcuMModuleRef=CanTrcv
            Can_Init: EcuMModuleID=Can, EcuMModuleParameter=POSTBUILD_PTR, EcuMDriverInitItemIndex=6, EcuMModulePostBuildPtr=&CanConfigSet, EcuMModuleRef=Can
            CanIf_Init: EcuMModuleID=CanIf, EcuMDriverInitItemIndex=7, EcuMModuleParameter=NULL_PTR, EcuMModuleRef=CanIf
            CanSM_Init: EcuMModuleID=CanSM, EcuMDriverInitItemIndex=8, EcuMModuleParameter=NULL_PTR, EcuMModuleRef=CanSM
            CanTp_Init: EcuMModuleID=CanTp, EcuMDriverInitItemIndex=9, EcuMModuleParameter=NULL_PTR, EcuMModuleRef=CanTp
            PduR_Init: EcuMModuleID=PduR, EcuMDriverInitItemIndex=10, EcuMModuleParameter=NULL_PTR, EcuMModuleRef=PduR
            Com_Init: EcuMModuleID=Com, EcuMDriverInitItemIndex=11, EcuMModuleParameter=NULL_PTR, EcuMModuleRef=Com
            Csm_Init: EcuMModuleID=Csm, EcuMModuleParameter=NULL_PTR, EcuMDriverInitItemIndex=12, EcuMModuleRef=Csm
            ComM_Init: EcuMModuleID=ComM, EcuMDriverInitItemIndex=13, EcuMModuleParameter=VOID, EcuMModuleRef=ComM
            CryIf_Init: EcuMModuleID=CryIf, EcuMModuleParameter=NULL_PTR, EcuMDriverInitItemIndex=14, EcuMModuleRef=CryIf
            Mem_76_Pfls_Init: EcuMModuleID=Mem_76_Pfls, EcuMModuleParameter=NULL_PTR, EcuMDriverInitItemIndex=15, EcuMModuleRef=Mem_76_Pfls
            Wdg_66_IA_Init: EcuMModuleID=Wdg_66_IA, EcuMModuleParameter=POSTBUILD_PTR, EcuMDriverInitItemIndex=16, EcuMModulePostBuildPtr=&Wdg_66_IA_Config, EcuMModuleRef=Wdg
            WdgM_Init: EcuMModuleID=WdgM, EcuMModuleParameter=NULL_PTR, EcuMDriverInitItemIndex=17, EcuMModuleRef=WdgM
        EcuMCalloutUserIncludeFiles: EcuMCalloutUserIncludeFile=Fota.h, EcuMCalloutUserIncludeFile=Mem_76_Pfls.h, EcuMCalloutUserIncludeFile=Spi.h
        6 x EcuMWakeupSource, all with category=TOOL_CONFIGURED, EcuMWakeupSourcePolling=0, EcuMResetReasonRef=MCU_RESET_UNDEFINED:
          ECUM_WKSOURCE_POWER: EcuMWakeupSourceId=0
          ECUM_WKSOURCE_RESET: EcuMWakeupSourceId=1
          ECUM_WKSOURCE_INTERNAL_RESET: EcuMWakeupSourceId=2
          ECUM_WKSOURCE_INTERNAL_WDG: EcuMWakeupSourceId=3
          ECUM_WKSOURCE_EXTERNAL_WDG: EcuMWakeupSourceId=4
          ECUM_WKSOURCE_GPT: EcuMWakeupSourceId=5
      EcuMFlexConfiguration: category=TOOL_CONFIGURED, EcuMNormalMcuClockRef=McuClockSettingConfig_0
        EcuMGoDownAllowedUsers: EcuMGoDownAllowedUserRef=ECUM_USER_BSWM
        EcuMSetClockAllowedUsers: EcuMSetClockAllowedUserRef=ECUM_USER_APP
        ECUM_USER_APP (EcuMFlexUserConfig): EcuMFlexUser=0
        ECUM_USER_BSWM (EcuMFlexUserConfig): EcuMFlexUser=42
        7 x EcuMResetMode:
          ECUM_RESET_MCU: category=TOOL_CONFIGURED, EcuMResetModeId=0
          ECUM_RESET_WDG: category=TOOL_CONFIGURED, EcuMResetModeId=1
          ECUM_RESET_IO: category=TOOL_CONFIGURED, EcuMResetModeId=2
          ECUM_RESET_APP: EcuMResetModeId=3
          ECUM_RESET_DCM: EcuMResetModeId=4
          ECUM_RESET_UNDEFINED: EcuMResetModeId=5
          ECUM_RESET_XCP: EcuMResetModeId=6
        4 x EcuMShutdownCause, all with category=TOOL_CONFIGURED:
          ECUM_CAUSE_UNKNOWN: EcuMShutdownCauseId=0
          ECUM_CAUSE_ECU_STATE: EcuMShutdownCauseId=1
          ECUM_CAUSE_WDGM: EcuMShutdownCauseId=2
          ECUM_CAUSE_DCM: EcuMShutdownCauseId=3
    EcuMGeneral: EcuMMainFunctionPeriod=0.01, EcuMVersionInfoApi=0, EcuMIncludeDet=1, EcuMDevErrorDetect=1
    EcuMFlexGeneral:
      EcuMEnableDefBehaviour = 0
      EcuMPmEnabled = 0
      EcuMAlarmClockPresent = 0
      EcuMLpTransitionCalloutEnabled = 0
      EcuMLoopCountMax = 2000000
      EcuMResetLoopDetection = 0
      EcuMAlarmWakeupSource = ECUM_WKSOURCE_GPT
