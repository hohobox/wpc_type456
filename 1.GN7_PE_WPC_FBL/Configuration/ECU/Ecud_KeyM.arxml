AUTOSAR XML (schema 00047)
package /AUTRON
  module config KeyM: implementation-config-variant=VARIANT-PRE-COMPILE, module-description=BswImplementation_KeyM
    KeyMGeneral:
      KeyMCertificateChainMaxDepth = 3
      KeyMCertificateManagerEnabled = 0
      KeyMCryptoKeyHandlerPrepareEnabled = 0
      KeyMCryptoKeyHandlerServiceCertificateEnabled = 0
      KeyMCryptoKeyHandlerStartFinalizeEnabled = 0
      KeyMCryptoKeyHandlerUpdateEnabled = 0
      KeyMCryptoKeyHandlerVerifyEnabled = 0
      KeyMCryptoKeyManagerEnabled = 1
      KeyMDevErrorDetect = 1
      KeyMKeyCertNameMaxLength = 255
      KeyMCryptoKeyVerifyFunctionEnabled = 0
      KeyMServiceCertificateFunctionEnabled = 0
      KeyMMainFunctionPeriod = 0.01
      KeyMCryptoKeyStartFinalizeFunctionEnabled = 0
      KeyMCryptoKeyPrepareFunctionEnabled = 0
      KeyMCryptoKeyVerifyAsyncMode = 0
      KeyMUserGetCurrentTimeFunc = KeyM_User_GetCurrentTime
    KeyMCryptoKey_DummyKey (KeyMCryptoKey):
      KeyMCryptoKeyGenerationType = KEYM_STORED_KEY
      KeyMCryptoKeyStorage = KEYM_STORAGE_IN_RAM
      KeyMCryptoKeyId = 0
      KeyMCryptoKeyMaxLength = 300
      KeyMCryptoKeyName = key0
      KeyMCryptoKeyCsmKeyTargetRef = RandomSeed_L9
