AUTOSAR XML (schema 4-0-3)
package /AUTOSAR
  module config Dcm: implementation-config-variant=VARIANT-PRE-COMPILE, module-description=BswImplementation_Dcm
    DcmConfigSet
      DcmDsd
        ES95486_SERVICE (DcmDsdServiceTable): DcmDsdSidTabId=0
          11 x DcmDsdService:
            SID10_DiagnosticSessionControl: DcmDsdSidTabServiceId=0x10, DcmDsdSidTabSubfuncAvail=1, DcmDsdSidTabSessionLevelRef=DCM_ALL_SESSION_LEVEL
              5 x DcmDsdSubService:
                defaultSession: DcmDsdSubServiceId=0x01
                programmingSession: DcmDsdSubServiceId=0x02, DcmDsdSubServiceSessionLevelRef=DCM_DEFAULT_SESSION, DcmDsdSubServiceSessionLevelRef=DCM_PROGRAMMING_SESSION, DcmDsdSubServiceSessionLevelRef=DCM_EXTENDED_DIAGNOSTIC_SESSION
                extendedDiagnosticSession: DcmDsdSubServiceId=0x03, DcmDsdSubServiceSessionLevelRef=DCM_DEFAULT_SESSION, DcmDsdSubServiceSessionLevelRef=DCM_EXTENDED_DIAGNOSTIC_SESSION, DcmDsdSubServiceSessionLevelRef=DCM_SAFETY_SYSTEM_DIAGNOSTIC_SESSION
                quiescent_current_diagnostic_mode: DcmDsdSubServiceId=0x50, DcmDsdSubServiceSessionLevelRef=DCM_DEFAULT_SESSION, DcmDsdSubServiceSessionLevelRef=DCM_QUIESCENT_CURRENT_DIAGNOSTIC_MODE
                sleep_mode_start_request: DcmDsdSubServiceId=0x51
            SID11_ECUReset: DcmDsdSidTabServiceId=0x11, DcmDsdSidTabSubfuncAvail=1, DcmDsdSidTabSessionLevelRef=DCM_DEFAULT_SESSION, DcmDsdSidTabSessionLevelRef=DCM_PROGRAMMING_SESSION, DcmDsdSidTabSessionLevelRef=DCM_EXTENDED_DIAGNOSTIC_SESSION, DcmDsdSidTabSessionLevelRef=DCM_SAFETY_SYSTEM_DIAGNOSTIC_SESSION
              hardReset (DcmDsdSubService): DcmDsdSubServiceId=0x01
            SID27_SecurityAccess: DcmDsdSidTabServiceId=0x27, DcmDsdSidTabSubfuncAvail=1, DcmDsdSidTabSessionLevelRef=DCM_PROGRAMMING_SESSION, DcmDsdSidTabSessionLevelRef=DCM_EXTENDED_DIAGNOSTIC_SESSION, DcmDsdSidTabSessionLevelRef=DCM_SAFETY_SYSTEM_DIAGNOSTIC_SESSION
              4 x DcmDsdSubService:
                GetSeed: DcmDsdSubServiceId=0x11
                CompareKey: DcmDsdSubServiceId=0x12
                GetSeed_OEUK: DcmDsdSubServiceId=0x13
                CompareKey_OEUK: DcmDsdSubServiceId=0x14
            SID28_CommunicationControl: DcmDsdSidTabServiceId=0x28, DcmDsdSidTabSubfuncAvail=1, DcmDsdSidTabSessionLevelRef=DCM_PROGRAMMING_SESSION, DcmDsdSidTabSessionLevelRef=DCM_EXTENDED_DIAGNOSTIC_SESSION
              4 x DcmDsdSubService:
                enableRxAndTx: DcmDsdSubServiceId=0
                disableNormalMessageTransmission: DcmDsdSubServiceId=1
                disableRxAndEnableTx: DcmDsdSubServiceId=2
                disableRxAndTx: DcmDsdSubServiceId=3
            SID3E_TesterPresent: DcmDsdSidTabServiceId=0x3E, DcmDsdSidTabSubfuncAvail=1, DcmDsdSidTabSessionLevelRef=DCM_DEFAULT_SESSION, DcmDsdSidTabSessionLevelRef=DCM_PROGRAMMING_SESSION, DcmDsdSidTabSessionLevelRef=DCM_EXTENDED_DIAGNOSTIC_SESSION, DcmDsdSidTabSessionLevelRef=DCM_SAFETY_SYSTEM_DIAGNOSTIC_SESSION
              zeroSubFunction (DcmDsdSubService): DcmDsdSubServiceId=0x0
            SID85_ControlDTCSetting: DcmDsdSidTabServiceId=0x85, DcmDsdSidTabSubfuncAvail=1, DcmDsdSidTabSessionLevelRef=DCM_PROGRAMMING_SESSION, DcmDsdSidTabSessionLevelRef=DCM_EXTENDED_DIAGNOSTIC_SESSION
              On (DcmDsdSubService): DcmDsdSubServiceId=0x01
              Off (DcmDsdSubService): DcmDsdSubServiceId=0x02
            SID20_StopDiagnosticSession: DcmDsdSidTabServiceId=0x20, DcmDsdSidTabSubfuncAvail=0, DcmDsdSidTabSessionLevelRef=DCM_DEFAULT_SESSION, DcmDsdSidTabSessionLevelRef=DCM_PROGRAMMING_SESSION, DcmDsdSidTabSessionLevelRef=DCM_EXTENDED_DIAGNOSTIC_SESSION
            SID31_RoutineControl: DcmDsdSidTabServiceId=0x31, DcmDsdSidTabSubfuncAvail=1, DcmDsdSidTabSessionLevelRef=DCM_DEFAULT_SESSION, DcmDsdSidTabSessionLevelRef=DCM_PROGRAMMING_SESSION, DcmDsdSidTabSessionLevelRef=DCM_EXTENDED_DIAGNOSTIC_SESSION, DcmDsdSidTabSessionLevelRef=DCM_SAFETY_SYSTEM_DIAGNOSTIC_SESSION
              3 x DcmDsdSubService:
                startRoutine: DcmDsdSubServiceId=0x01
                stopRoutine: DcmDsdSubServiceId=0x02
                requestRoutineResults: DcmDsdSubServiceId=0x03
            SID34_RequestDownload: DcmDsdSidTabServiceId=0x34, DcmDsdSidTabSubfuncAvail=0, DcmDsdSidTabSessionLevelRef=DCM_EXTENDED_DIAGNOSTIC_SESSION, DcmDsdSidTabSessionLevelRef=DCM_PROGRAMMING_SESSION, DcmDsdSidTabSecurityLevelRef=L9, DcmDsdSidTabSecurityLevelRef=L10
            SID36_TransferData: DcmDsdSidTabSubfuncAvail=0, DcmDsdSidTabServiceId=0x36, DcmDsdSidTabSessionLevelRef=DCM_EXTENDED_DIAGNOSTIC_SESSION, DcmDsdSidTabSessionLevelRef=DCM_PROGRAMMING_SESSION, DcmDsdSidTabSecurityLevelRef=L9, DcmDsdSidTabSecurityLevelRef=L10
            SID37_RequestTransferExit: DcmDsdSidTabSubfuncAvail=0, DcmDsdSidTabServiceId=0x37, DcmDsdSidTabSessionLevelRef=DCM_EXTENDED_DIAGNOSTIC_SESSION, DcmDsdSidTabSessionLevelRef=DCM_PROGRAMMING_SESSION, DcmDsdSidTabSecurityLevelRef=L9, DcmDsdSidTabSecurityLevelRef=L10
      DcmDsl: category=TOOL_CONFIGURED
        UDS_RX (DcmDslBuffer): DcmDslBufferSize=2050
        UDS_TX (DcmDslBuffer): DcmDslBufferSize=512
        ECU1 (DcmDslCallbackDCMRequestService)
        DcmDslDiagResp: DcmDslDiagRespMaxNumRespPend=80, DcmDslDiagRespOnSecondDeclinedRequest=0
        Dcm_DiagCom_Protocol (DcmDslProtocol): category=TOOL_CONFIGURED
          UDS_ON_CAN (DcmDslProtocolRow):
            category = TOOL_CONFIGURED
            DcmDslProtocolEndiannessConvEnabled = 0
            DcmDslProtocolID = DCM_UDS_ON_CAN
            DcmDslProtocolIsParallelExecutab = 1
            DcmDslProtocolPreemptTimeout = 0.01
            DcmDslProtocolPriority = 1
            DcmDslProtocolTransType = TYPE2
            DcmSendRespPendOnTransToBoot = 0
            DcmTimStrP2ServerAdjust = 0.02
            DcmTimStrP2StarServerAdjust = 2.5
            DcmDslProtocolSIDTable = ES95486_SERVICE
            DcmDslProtocolSessionRef = ES95486_SESSION
            DcmDslProtocolRxBufferRef = UDS_RX
            DcmDslProtocolTxBufferRef = UDS_TX
            UDS_ON_CAN (DcmDslConnection): category=TOOL_CONFIGURED
              DcmDslMainConnection: category=TOOL_CONFIGURED, DcmDslProtocolRxTesterSourceAddr=0xf0, DcmDslProtocolRxConnectionId=1829
                PhysicalRequest (DcmDslProtocolRx):
                  category = TOOL_CONFIGURED
                  DcmDslProtocolRxAddrType = DCM_PHYSICAL_TYPE
                  DcmDslProtocolRxPduId = 0
                  DcmDslProtocolRxChannelId = 0
                  DcmDslProtocolRxComMChannelRef = ComMChannel_BCAN
                  DcmDslProtocolRxPduRef = Pdu_DcmIPdu_BCAN_GST_WPC
                FunctionalRequest (DcmDslProtocolRx):
                  category = TOOL_CONFIGURED
                  DcmDslProtocolRxAddrType = DCM_FUNCTIONAL_TYPE
                  DcmDslProtocolRxPduId = 1
                  DcmDslProtocolRxChannelId = 0
                  DcmDslProtocolRxComMChannelRef = ComMChannel_BCAN
                  DcmDslProtocolRxPduRef = Pdu_DcmIPdu_BCAN_GST_ALL
                Response (DcmDslProtocolTx): category=TOOL_CONFIGURED, DcmDslTxConfirmationPduId=0, DcmDslProtocolTxPduRef=Pdu_DcmIPdu_BCAN_WPC_GST
        DcmDslServiceRequestSupplierNotification0 (DcmDslServiceRequestSupplierNotification)
        DcmDslServiceRequestSupplierNotification1 (DcmDslServiceRequestSupplierNotification)
      DcmDsp: DcmDspMaxDidToRead=32, DcmDspPowerDownTime=10, DcmDspMaxPeriodicDidScheduler=2, DcmDspMaxPeriodicDidToRead=2, DcmDspDDDIDcheckPerSourceDID=0
        9 x DcmDspData, all with DcmDspDataType=UINT8, DcmDspDataUsePort=USE_DATA_SYNCH_CLIENT_SERVER:
          VehicleManufacturerECUSoftwareVersionNumber: DcmDspDataSize=136, DcmDspDataInfoRef=NoScalingInfomation_FixedData
          SystemSupplierECUHardwareVersionNumber: DcmDspDataSize=32, DcmDspDataInfoRef=NoScalingInfomation_FixedData
          SystemSupplierECUSoftwareNumber: DcmDspDataSize=32, DcmDspDataInfoRef=NoScalingInfomation_FixedData
          VehicleSpeed: DcmDspDataSize=8, DcmDspDataInfoRef=VehicleSpeed_FixedData
          ActuatorControl: DcmDspDataSize=8, DcmDspDataInfoRef=NoScalingInfomation_FixedData
          VINDataIdentifier: DcmDspDataSize=136, DcmDspDataInfoRef=VIN_DataIdentifier
          BatVolt: DcmDspDataSize=8, DcmDspDataInfoRef=NoScalingInfomation_FixedData
          RPM: DcmDspDataSize=16, DcmDspDataInfoRef=NoScalingInfomation_FixedData
          ECT: DcmDspDataSize=8, DcmDspDataInfoRef=NoScalingInfomation_FixedData
        4 x DcmDspDataInfo:
          VehicleSpeed_FixedData: DcmDspDataFixedLength=1, DcmDspDataScalingInfoSize=9
          NoScalingInfomation_FixedData: DcmDspDataFixedLength=1
          NoScalingInfomation_VariableData: DcmDspDataFixedLength=0
          VIN_DataIdentifier: DcmDspDataFixedLength=1, DcmDspDataScalingInfoSize=2
        14 x DcmDspDid, all with DcmDspDidUsed=1:
          DID_0201h_VehicleSpeed: DcmDspDidIdentifier=0x0201, DcmDspDidInfoRef=DIDInfo_0201h_VehicleSpeed
            VehicleSpeed (DcmDspDidSignal): DcmDspDidDataPos=0, DcmDspDidDataRef=DcmDsp/VehicleSpeed
          DID_F189h_VehicleManufacturerECUSoftwareVersionNumber: DcmDspDidIdentifier=0xF189, DcmDspDidInfoRef=DcmDsp/DID_F189h_VehicleManufacturerECUSoftwareVersionNumber
            VehicleManufacturerECUSoftwareVersionNumber (DcmDspDidSignal): DcmDspDidDataPos=0, DcmDspDidDataRef=DcmDsp/VehicleManufacturerECUSoftwareVersionNumber
          DID_F193h_SystemSupplierECUHardwareVersionNumber: DcmDspDidIdentifier=0xF193, DcmDspDidInfoRef=DcmDsp/DID_F193h_SystemSupplierECUHardwareVersionNumber
            SystemSupplierECUHardwareVersionNumber (DcmDspDidSignal): DcmDspDidDataPos=0, DcmDspDidDataRef=DcmDsp/SystemSupplierECUHardwareVersionNumber
          DID_F194h_SystemSupplierECUSoftwareNumber: DcmDspDidIdentifier=0xF194, DcmDspDidInfoRef=DcmDsp/DID_F194h_SystemSupplierECUSoftwareNumber
            SystemSupplierECUSoftwareNumber (DcmDspDidSignal): DcmDspDidDataPos=0, DcmDspDidDataRef=DcmDsp/SystemSupplierECUSoftwareNumber
          DID_F190h_VINDataIdentifier: DcmDspDidIdentifier=0xF190, DcmDspDidInfoRef=DcmDsp/DID_F190h_VINDataIdentifier
            DcmDspDidSignal: DcmDspDidDataPos=0, DcmDspDidDataRef=VINDataIdentifier
          DID_010A: DcmDspDidIdentifier=0x010A, DcmDspDidInfoRef=DID_010Ah
            3 x DcmDspDidSignal:
              BatVolt: DcmDspDidDataPos=0, DcmDspDidDataRef=DcmDsp/BatVolt
              RPM: DcmDspDidDataPos=8, DcmDspDidDataRef=DcmDsp/RPM
              ECT: DcmDspDidDataPos=24, DcmDspDidDataRef=DcmDsp/ECT
          DDID_F301h: DcmDspDidIdentifier=0xF301, DcmDspDidInfoRef=DDID_F301
          DDID_F302: DcmDspDidIdentifier=0xF302, DcmDspDidInfoRef=DDID_F302h
          DDID_F303: DcmDspDidIdentifier=0xF303, DcmDspDidInfoRef=DDID_F303h
          IO_F010h_ActuatorControl: DcmDspDidIdentifier=0xF010, DcmDspDidInfoRef=DcmDsp/IO_F010h_ActuatorControl
            ActuatorControl (DcmDspDidSignal): DcmDspDidDataPos=0, DcmDspDidDataRef=DcmDsp/ActuatorControl
          IO_F012h_MultipleActuatorControl: DcmDspDidIdentifier=0xF012, DcmDspDidInfoRef=IO_F010h_MultiActuatorControl
            ActuatorControl (DcmDspDidSignal): DcmDspDidDataPos=0, DcmDspDidDataRef=DcmDsp/ActuatorControl
            RPM (DcmDspDidSignal): DcmDspDidDataPos=8, DcmDspDidDataRef=DcmDsp/RPM
          PDID_F2E3: DcmDspDidIdentifier=0xF2E3, DcmDspDidInfoRef=pDID_F2E3h
            AC (DcmDspDidSignal): DcmDspDidDataPos=0, DcmDspDidDataRef=DcmDsp/ActuatorControl
            BatVolt (DcmDspDidSignal): DcmDspDidDataPos=8, DcmDspDidDataRef=DcmDsp/BatVolt
          PDID_F224: DcmDspDidIdentifier=0xF224, DcmDspDidInfoRef=pDID_F2E3h
            RPM (DcmDspDidSignal): DcmDspDidDataPos=0, DcmDspDidDataRef=DcmDsp/RPM
            ECT (DcmDspDidSignal): DcmDspDidDataPos=16, DcmDspDidDataRef=DcmDsp/ECT
          PDID_F232: DcmDspDidIdentifier=0xF232, DcmDspDidInfoRef=PDID_F232h
            3 x DcmDspDidSignal:
              BatVolt: DcmDspDidDataPos=0, DcmDspDidDataRef=DcmDsp/BatVolt
              RPM: DcmDspDidDataPos=8, DcmDspDidDataRef=DcmDsp/RPM
              ECT: DcmDspDidDataPos=32, DcmDspDidDataRef=DcmDsp/ECT
        15 x DcmDspDidInfo:
          DIDs_0100h_0110h: DcmDspDidDynamicallyDefined=0
            DcmDspDidAccess
              DcmDspDidRead
              DcmDspDidWrite: DcmDspDidWriteSessionRef=DCM_ALL_SESSION_LEVEL
          DIDInfo_0201h_VehicleSpeed: DcmDspDidDynamicallyDefined=0
            DcmDspDidAccess
              DcmDspDidRead
          DID_F189h_VehicleManufacturerECUSoftwareVersionNumber: DcmDspDidDynamicallyDefined=0
            DcmDspDidAccess
              DcmDspDidRead
          DID_F193h_SystemSupplierECUHardwareVersionNumber: DcmDspDidDynamicallyDefined=0
            DcmDspDidAccess
              DcmDspDidRead
          DID_F194h_SystemSupplierECUSoftwareNumber: DcmDspDidDynamicallyDefined=0
            DcmDspDidAccess
              DcmDspDidRead
          DID_F190h_VINDataIdentifier: DcmDspDidDynamicallyDefined=0
            DcmDspDidAccess
              DcmDspDidRead
              DcmDspDidWrite
          DDID_F301: DcmDspDidDynamicallyDefined=1
            DcmDspDidAccess
              DcmDspDidRead: DcmDspDDDIDMaxElements=3
          DID_010Ah: DcmDspDidDynamicallyDefined=0
            DcmDspDidAccess
              DcmDspDidRead: DcmDspDDDIDMaxElements=2
          DDID_F302h: DcmDspDidDynamicallyDefined=1
            DcmDspDidAccess
              DcmDspDidRead: DcmDspDDDIDMaxElements=3
          DDID_F303h: DcmDspDidDynamicallyDefined=1
            DcmDspDidAccess
              DcmDspDidRead: DcmDspDDDIDMaxElements=4
          IO_F010h_ActuatorControl: DcmDspDidDynamicallyDefined=0
            DcmDspDidAccess
              DcmDspDidControl:
                DcmDspDidFreezeCurrentState = 1
                DcmDspDidResetToDefault = 1
                DcmDspDidReturnControlToEcu = 1
                DcmDspDidShortTermAdjustment = 1
                DcmDspDidControlSessionRef = DCM_EXTENDED_DIAGNOSTIC_SESSION
              DcmDspDidRead: DcmDspDidReadSessionRef=DCM_EXTENDED_DIAGNOSTIC_SESSION
              DcmDspDidWrite: DcmDspDidWriteSessionRef=DCM_EXTENDED_DIAGNOSTIC_SESSION
          IO_F010h_MultiActuatorControl: DcmDspDidDynamicallyDefined=0
            DcmDspDidAccess
              DcmDspDidControl:
                DcmDspDidFreezeCurrentState = 1
                DcmDspDidResetToDefault = 0
                DcmDspDidReturnControlToEcu = 1
                DcmDspDidShortTermAdjustment = 1
                DcmDspDidControlSessionRef = DCM_EXTENDED_DIAGNOSTIC_SESSION
              DcmDspDidRead: DcmDspDidReadSessionRef=DCM_EXTENDED_DIAGNOSTIC_SESSION
          pDID_F2E3h: DcmDspDidDynamicallyDefined=0
            DcmDspDidAccess
              DcmDspDidRead: DcmDspDidReadSessionRef=DCM_EXTENDED_DIAGNOSTIC_SESSION
              DcmDspDidWrite: DcmDspDidWriteSessionRef=DCM_EXTENDED_DIAGNOSTIC_SESSION
          PDID_F232h: DcmDspDidDynamicallyDefined=0
            DcmDspDidAccess
              DcmDspDidRead
          pDID_F224h: DcmDspDidDynamicallyDefined=0
            DcmDspDidAccess
              DcmDspDidRead: DcmDspDidReadSessionRef=DCM_EXTENDED_DIAGNOSTIC_SESSION
              DcmDspDidWrite: DcmDspDidWriteSessionRef=DCM_EXTENDED_DIAGNOSTIC_SESSION
        5 x DcmDspRoutineInfo:
          RID_Info_FF01h_CheckProgrammingDependency
            DcmDspRoutineAuthorization:
              DcmDspRoutineSessionRef = DCM_EXTENDED_DIAGNOSTIC_SESSION
              DcmDspRoutineSecurityLevelRef = L9
              DcmDspRoutineSessionRef = DCM_PROGRAMMING_SESSION
              DcmDspRoutineSecurityLevelRef = L10
            DcmDspStartRoutineIn
              In_MemoryArea (DcmDspStartRoutineInSignal): DcmDspRoutineStartInEndianness=0, DcmDspRoutineSignalLength=24, DcmDspRoutineSignalPos=0, DcmDspRoutineSignalType=VARIABLE_LENGTH
            DcmDspStartRoutineOut
              Out_MemoryArea (DcmDspStartRoutineOutSignal): DcmDspRoutineStartOutEndianness=0, DcmDspRoutineSignalLength=8, DcmDspRoutineSignalPos=0, DcmDspRoutineSignalType=VARIABLE_LENGTH
          RID_Info_0210h_ReadActiveArea
            DcmDspRoutineAuthorization: DcmDspRoutineSessionRef=DCM_EXTENDED_DIAGNOSTIC_SESSION, DcmDspRoutineSecurityLevelRef=L9, DcmDspRoutineSecurityLevelRef=L10
            DcmDspStartRoutineIn
              In_SWUnitMemoryArea (DcmDspStartRoutineInSignal): DcmDspRoutineStartInEndianness=0, DcmDspRoutineSignalLength=16, DcmDspRoutineSignalPos=0, DcmDspRoutineSignalType=VARIABLE_LENGTH
            DcmDspStartRoutineOut
              StartOutSignal (DcmDspStartRoutineOutSignal): DcmDspRoutineStartOutEndianness=0, DcmDspRoutineSignalLength=8, DcmDspRoutineSignalPos=0, DcmDspRoutineSignalType=VARIABLE_LENGTH
          RID_Info_0212h_EraseTargetArea
            DcmDspRoutineAuthorization:
              DcmDspRoutineSessionRef = DCM_EXTENDED_DIAGNOSTIC_SESSION
              DcmDspRoutineSecurityLevelRef = L9
              DcmDspRoutineSessionRef = DCM_PROGRAMMING_SESSION
              DcmDspRoutineSecurityLevelRef = L10
            DcmDspStartRoutineIn
              In_MemoryArea (DcmDspStartRoutineInSignal): DcmDspRoutineStartInEndianness=0, DcmDspRoutineSignalLength=24, DcmDspRoutineSignalPos=0, DcmDspRoutineSignalType=VARIABLE_LENGTH
            DcmDspStartRoutineOut
              Out_MemoryArea (DcmDspStartRoutineOutSignal): DcmDspRoutineStartOutEndianness=0, DcmDspRoutineSignalLength=8, DcmDspRoutineSignalPos=0, DcmDspRoutineSignalType=VARIABLE_LENGTH
          RID_Info_0213h_SwapActiveArea
            DcmDspRoutineAuthorization: DcmDspRoutineSessionRef=DCM_EXTENDED_DIAGNOSTIC_SESSION, DcmDspRoutineSecurityLevelRef=L9, DcmDspRoutineSecurityLevelRef=L10
            DcmDspStartRoutineIn
              In_MemoryArea (DcmDspStartRoutineInSignal): DcmDspRoutineStartInEndianness=0, DcmDspRoutineSignalLength=24, DcmDspRoutineSignalPos=0, DcmDspRoutineSignalType=VARIABLE_LENGTH
            DcmDspStartRoutineOut
              Out_MemoryArea (DcmDspStartRoutineOutSignal): DcmDspRoutineStartOutEndianness=0, DcmDspRoutineSignalLength=40, DcmDspRoutineSignalType=VARIABLE_LENGTH, DcmDspRoutineSignalPos=0
          RID_Info_FF00h_EraseMemory
            DcmDspRoutineAuthorization:
              DcmDspRoutineSessionRef = DCM_EXTENDED_DIAGNOSTIC_SESSION
              DcmDspRoutineSecurityLevelRef = L9
              DcmDspRoutineSessionRef = DCM_PROGRAMMING_SESSION
              DcmDspRoutineSecurityLevelRef = L10
            DcmDspStartRoutineIn
              pRoutineDataIn (DcmDspStartRoutineInSignal): DcmDspRoutineStartInEndianness=0, DcmDspRoutineSignalLength=16, DcmDspRoutineSignalPos=0, DcmDspRoutineSignalType=VARIABLE_LENGTH
            DcmDspStartRoutineOut
              Out_RoutineStatus (DcmDspStartRoutineOutSignal): DcmDspRoutineStartOutEndianness=0, DcmDspRoutineSignalLength=24, DcmDspRoutineSignalPos=0, DcmDspRoutineSignalType=VARIABLE_LENGTH
        4 x DcmDspRoutine, all with DcmDspRequestResultsRoutineSupported=0, DcmDspRoutineFixedLength=0, DcmDspRoutineUsePort=0, DcmDspRoutineUsed=1, DcmDspStopRoutineSupported=0:
          RID_FF01h_CheckProgrammingDependency: DcmDspRoutineIdentifier=0xFF01, DcmDspStartRoutineFnc=Fota_Start_CheckProgrammingDependency, DcmDspRoutineInfoRef=RID_Info_FF01h_CheckProgrammingDependency
          RID_0210h_ReadActiveArea: DcmDspRoutineIdentifier=0x0210, DcmDspStartRoutineFnc=Fota_Start_ReadActiveArea, DcmDspRoutineInfoRef=RID_Info_0210h_ReadActiveArea
          RID_0212h_EraseTargetArea: DcmDspRoutineIdentifier=0x0212, DcmDspStartRoutineFnc=Fota_Start_EraseTargetArea, DcmDspRoutineInfoRef=RID_Info_0212h_EraseTargetArea
          RID_0213h_SwapActiveArea: DcmDspRoutineIdentifier=0x0213, DcmDspStartRoutineFnc=Fota_Start_SwapActiveArea, DcmDspRoutineInfoRef=RID_Info_0213h_SwapActiveArea
        DcmDspMemory: DcmDspUseMemoryId=0
          3 x DcmDspAddressAndLengthFormatIdentifier:
            ALF_0x14h: DcmDspSupportedAddressAndLengthFormatIdentifier=0x14
            ALF_0x34h: DcmDspSupportedAddressAndLengthFormatIdentifier=0x34
            ALF_0x44h: DcmDspSupportedAddressAndLengthFormatIdentifier=0x44
          MemoryIdInfo (DcmDspMemoryIdInfo)
            RMA_21091968h (DcmDspReadMemoryRangeInfo): DcmDspReadMemoryRangeHigh=0x2109196C, DcmDspReadMemoryRangeLow=0x21091968
            WMA_20481309h (DcmDspWriteMemoryRangeInfo): DcmDspWriteMemoryRangeHigh=0x2048130E, DcmDspWriteMemoryRangeLow=0x20481309
        3 x DcmDspRoutine, all with DcmDspRequestResultsRoutineSupported=0, DcmDspRoutineFixedLength=0, DcmDspRoutineUsePort=0, DcmDspRoutineUsed=1, DcmDspStopRoutineSupported=0:
          RID_FF00h_EraseMemory: DcmDspRoutineIdentifier=0xFF00, DcmDspStartRoutineFnc=Fota_Start_EraseMemory, DcmDspRoutineInfoRef=RID_Info_FF00h_EraseMemory
          RID_0200h_CheckMemory: DcmDspRoutineIdentifier=0x0200, DcmDspStartRoutineFnc=Fota_Start_CheckMemory, DcmDspRoutineInfoRef=RID_Info_0200h_CheckMemory
          RID_0211h_FinishUpdate: DcmDspStartRoutineFnc=Fota_Start_FinishUpdate, DcmDspRoutineIdentifier=0x0211, DcmDspRoutineInfoRef=RID_Info_0211h_FinishUpdate
        3 x DcmDspRoutineInfo:
          RID_0200h_CalibrationActuator
            DcmDspRoutineAuthorization0 (DcmDspRoutineAuthorization): DcmDspRoutineSecurityLevelRef=L9, DcmDspRoutineSessionRef=DCM_EXTENDED_DIAGNOSTIC_SESSION
            routineStatus_ResOutSignal (DcmDspRoutineRequestResOut)
              routineStatus_ResOutSignal (DcmDspRoutineRequestResOutSignal): DcmDspRoutineSignalLength=8, DcmDspRoutineSignalPos=0, DcmDspRoutineSignalType=UINT8, DcmDspRoutineRequestEndianness=0
            DcmDspRoutineStopIn
              DcmDspRoutineStopInSignal0 (DcmDspRoutineStopInSignal): DcmDspRoutineSignalLength=8, DcmDspRoutineSignalPos=0, DcmDspRoutineSignalType=UINT8, DcmDspRoutineStopInEndianness=0
            DcmDspRoutineStopOut
              DcmDspRoutineStopOutSignal0 (DcmDspRoutineStopOutSignal): DcmDspRoutineSignalLength=8, DcmDspRoutineSignalPos=0, DcmDspRoutineSignalType=UINT8, DcmDspRoutineStopOutEndianness=0
            routineControlOption_StartIn (DcmDspStartRoutineIn)
              routineControlOption_StartInSignal (DcmDspStartRoutineInSignal): DcmDspRoutineSignalLength=7, DcmDspRoutineSignalPos=0, DcmDspRoutineSignalType=UINT8, DcmDspRoutineStartInEndianness=0
            routineStatus_StartOutSignal (DcmDspStartRoutineOut)
              routineStatus_StartOutSignal (DcmDspStartRoutineOutSignal): DcmDspRoutineSignalLength=8, DcmDspRoutineSignalPos=0, DcmDspRoutineSignalType=UINT8, DcmDspRoutineStartOutEndianness=0
          RID_Info_0211h_FinishUpdate
            DcmDspRoutineAuthorization
          RID_Info_0200h_CheckMemory
            DcmDspRoutineAuthorization: DcmDspRoutineSecurityLevelRef=L9, DcmDspRoutineSecurityLevelRef=L10
        ES95486_SECURITY (DcmDspSecurity): DcmDspSecurityMaxAttemptCounterReadoutTime=0.01
          L9 (DcmDspSecurityRow):
            DcmDspSecurityDelayTime = 180.0
            DcmDspSecurityDelayTimeOnBoot = 0.0
            DcmDspSecurityKeySize = 8
            DcmDspSecurityLevel = 0x9
            DcmDspSecurityNumAttDelay = 3
            DcmDspSecuritySeedSize = 8
            DcmDspSecurityUsePort = USE_ASYNCH_CLIENT_SERVER
            DcmDspSecurityAttemptCounterEnabled = 0
          L10 (DcmDspSecurityRow):
            DcmDspSecurityDelayTime = 180.0
            DcmDspSecurityDelayTimeOnBoot = 0.0
            DcmDspSecurityKeySize = 256
            DcmDspSecurityLevel = 10
            DcmDspSecurityNumAttDelay = 3
            DcmDspSecuritySeedSize = 8
            DcmDspSecurityUsePort = USE_ASYNCH_CLIENT_SERVER
            DcmDspSecurityAttemptCounterEnabled = 0
        ES95486_SESSION (DcmDspSession)
          7 x DcmDspSessionRow, all with DcmDspSessionP2ServerMax=0.05, DcmDspSessionP2StarServerMax=5.0:
            DCM_DEFAULT_SESSION: DcmDspSessionForBoot=DCM_OEM_BOOT, DcmDspSessionLevel=0x01
            DCM_PROGRAMMING_SESSION: DcmDspSessionForBoot=DCM_NO_BOOT, DcmDspSessionLevel=0x02
            DCM_EXTENDED_DIAGNOSTIC_SESSION: DcmDspSessionForBoot=DCM_NO_BOOT, DcmDspSessionLevel=0x03
            DCM_SAFETY_SYSTEM_DIAGNOSTIC_SESSION: DcmDspSessionForBoot=DCM_NO_BOOT, DcmDspSessionLevel=0x04
            DCM_QUIESCENT_CURRENT_DIAGNOSTIC_MODE: DcmDspSessionForBoot=DCM_NO_BOOT, DcmDspSessionLevel=0x50
            DCM_SLEEP_MODE_START_REQUEST: DcmDspSessionForBoot=DCM_NO_BOOT, DcmDspSessionLevel=0x51
            DCM_ALL_SESSION_LEVEL: DcmDspSessionForBoot=DCM_NO_BOOT, DcmDspSessionLevel=0xFF
        DcmDspComControl
          CommChannel_BCAN (DcmDspComControlAllChannel): DcmDspAllComMChannelRef=ComMChannel_BCAN
          SpecificCommChannel_BCAN (DcmDspComControlSpecificChannel): DcmDspSubnetNumber=1, DcmDspSpecificComMChannelRef=ComMChannel_BCAN
      DcmGeneral:
        DcmDevErrorDetect = 1
        DcmRequestManufacturerNotificationEnabled = 0
        DcmRequestSupplierNotificationEnabled = 1
        DcmRespondAllRequest = 1
        DcmTaskTime = 0.01
        DcmVersionInfoApi = 0
        DcmStandardSupport = DCM_ES95486_02_SUPPORT
        DcmHeaderFileInclusion = Fota_Diag.h
        DcmForcedEcuReset = 1
        DemIntegrated = 0
        DcmFblUsedType = DCM_AUTOEVER_FBL_USED_RXCONNECTION_ID_UNUSED
        DcmNvmIntegrated = 0
        DcmHeaderFileInclusion = Dcm_Callout_SecureService.h
      DcmPageBufferCfg: DcmPagedBufferEnabled=0
