AUTOSAR XML (schema 4-0-3)
package /AUTOSAR
  module config Com: implementation-config-variant=VARIANT-PRE-COMPILE, module-description=BswImplementation_Com
    ComConfig: ComConfigurationId=0
      ComTimeBase: category=TOOL_CONFIGURED, ComGwTimeBase=0.005, ComRxTimeBase=0.005, ComTxTimeBase=0.005
    ComGeneral:
      ComSupportedIPduGroups = 1
      ComVersionInfoApi = 0
      ComRetryFailedTransmitRequests = 0
      ComEnableMDTForCyclicTransmission = 1
      ComConfigurationUseDet = 1
      ComMainFunctionBasedTransmit = 1
      ComEnableSignalGroupArrayApi = 0
      ComRxInterruptBased = 0
      ComTxInterruptBased = 0
