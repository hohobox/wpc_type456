AUTOSAR XML (schema 4-0-3)
package /AUTOSAR
  module config CanTp: implementation-config-variant=VARIANT-PRE-COMPILE, module-description=BswImplementation_CanTp
    CanTpGeneral:
      CanTpDevErrorDetect = 1
      CanTpPaddingByte = 0xAA
      CanTpReadParameterApi = 0
      CanTpVersionInfoApi = 0
      CanTpChangeParameterApi = 0
      CanTpFlexibleDataRateSupport = 1
    CanTpConfig: CanTpMainFunctionPeriod=0.005
      CanTpChannel_0_Pdu_DcmIPdu_BCAN_GST_WPC (CanTpChannel): category=TOOL_CONFIGURED, CanTpChannelMode=CANTP_MODE_HALF_DUPLEX
        CanTpTxNSdu_0_Pdu_DcmIPdu_BCAN_WPC_GST (CanTpTxNSdu):
          category = TOOL_CONFIGURED
          CanTpTxAddressingFormat = CANTP_STANDARD
          CanTpTxPaddingActivation = CANTP_ON
          CanTpTxDl = 1
          CanTpTxNSduId = 0
          CanTpTc = 1
          CanTpTxTaType = CANTP_CANFD_PHYSICAL
          CanTpNas = 1
          CanTpNcs = 0
          CanTpNbs = 1
          CanTpTxNSduRef = Pdu_DcmIPdu_BCAN_WPC_GST
          CanTpTxNPdu_0 (CanTpTxNPdu): category=TOOL_CONFIGURED, CanTpTxNPduConfirmationPduId=0, CanTpTxNPduRef=Pdu_NPdu_BCAN_WPC_GST
          CanTpRxFcNPdu_0 (CanTpRxFcNPdu): category=TOOL_CONFIGURED, CanTpRxFcNPduId=0, CanTpRxFcNPduRef=Pdu_NPdu_BCAN_GST_WPC
          CanTpNSa_0 (CanTpNSa): category=TOOL_CONFIGURED, CanTpNSa=8
          CanTpNTa_0 (CanTpNTa): category=TOOL_CONFIGURED, CanTpNTa=240
        CanTpRxNSdu_0_Pdu_DcmIPdu_BCAN_GST_WPC (CanTpRxNSdu):
          category = TOOL_CONFIGURED
          CanTpRxPaddingActivation = CANTP_ON
          CanTpRxAddressingFormat = CANTP_STANDARD
          CanTpRxTaType = CANTP_CANFD_PHYSICAL
          CanTpRxNSduId = 0
          CanTpRxDl = 1
          CanTpBs = 0
          CanTpNcr = 1
          CanTpRxWftMax = 0
          CanTpNbr = 0
          CanTpSTmin = 0.005
          CanTpNar = 1
          CanTpRxNSduRef = Pdu_DcmIPdu_BCAN_GST_WPC
          CanTpTxFcNPdu_0 (CanTpTxFcNPdu): category=TOOL_CONFIGURED, CanTpTxFcNPduConfirmationPduId=0, CanTpTxFcNPduRef=Pdu_NPdu_BCAN_WPC_GST
          CanTpRxNPdu_0 (CanTpRxNPdu): category=TOOL_CONFIGURED, CanTpRxNPduId=0, CanTpRxNPduRef=Pdu_NPdu_BCAN_GST_WPC
          CanTpNSa_0 (CanTpNSa): category=TOOL_CONFIGURED, CanTpNSa=8
          CanTpNTa_0 (CanTpNTa): category=TOOL_CONFIGURED, CanTpNTa=240
      CanTpChannel_1_RxOnly_Pdu_DcmIPdu_BCAN_GST_ALL (CanTpChannel): category=TOOL_CONFIGURED, CanTpChannelMode=CANTP_MODE_HALF_DUPLEX
        CanTpRxNSdu_1_Pdu_DcmIPdu_BCAN_GST_ALL (CanTpRxNSdu):
          category = TOOL_CONFIGURED
          CanTpRxPaddingActivation = CANTP_ON
          CanTpRxAddressingFormat = CANTP_STANDARD
          CanTpRxTaType = CANTP_CANFD_FUNCTIONAL
          CanTpRxNSduId = 1
          CanTpRxDl = 1
          CanTpSTmin = 0.005
          CanTpBs = 0
          CanTpNbr = 0
          CanTpNar = 1
          CanTpRxWftMax = 0
          CanTpNcr = 1
          CanTpRxNSduRef = Pdu_DcmIPdu_BCAN_GST_ALL
          CanTpRxNPdu_1 (CanTpRxNPdu): category=TOOL_CONFIGURED, CanTpRxNPduId=1, CanTpRxNPduRef=Pdu_NPdu_BCAN_GST_ALL
          CanTpNSa_1 (CanTpNSa): category=TOOL_CONFIGURED, CanTpNSa=8
          CanTpNTa_1 (CanTpNTa): category=TOOL_CONFIGURED, CanTpNTa=240
