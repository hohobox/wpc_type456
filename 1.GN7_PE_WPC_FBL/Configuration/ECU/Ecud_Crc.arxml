AUTOSAR XML (schema 4-0-3)
package /AUTOSAR
  module config Crc: implementation-config-variant=VARIANT-PRE-COMPILE, module-description=BswImplementation_Crc
    CrcGeneral: Crc16Mode=CRC_16_RUNTIME
