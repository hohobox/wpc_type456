AUTOSAR XML (schema 4-0-3)
package /AUTOSAR
  module config Os: implementation-config-variant=VARIANT-PRE-COMPILE, module-description=BswImplementation_Os
    4 x OsAlarm, all with OsAlarmCounterRef=OsCounter_0:
      OsAlarm_BSW_5ms_Com
        OsAlarmAction: category=TOOL_CONFIGURED
          OsAlarmActivateTask: category=TOOL_CONFIGURED, OsAlarmActivateTaskRef=OsTask_BSW_FG1_5ms_Com
      OsAlarm_BSW_10ms
        OsAlarmAction: category=TOOL_CONFIGURED
          OsAlarmActivateTask: category=TOOL_CONFIGURED, OsAlarmActivateTaskRef=OsTask_BSW_FG1_10ms
      OsAlarm_ASW_10ms
        OsAlarmAction: category=TOOL_CONFIGURED
          OsAlarmActivateTask: category=TOOL_CONFIGURED, OsAlarmActivateTaskRef=OsTask_ASW_FG1_10ms
      OsAlarm_ASW_100ms
        OsAlarmAction: category=TOOL_CONFIGURED
          OsAlarmActivateTask: category=TOOL_CONFIGURED, OsAlarmActivateTaskRef=OsTask_ASW_FG1_100ms
    OsAppMode0 (OsAppMode)
    OsApplication0 (OsApplication):
      OsApplicationCoreAssignment = 0
      OsTrusted = 1
      OsApplicationStackSize = 1024
      OsAppCounterRef = OsCounter_0
      OsAppResourceRef = OsResource_FG1
      OsAppResourceRef = OsResource_FG2
      OsAppTaskRef = OsTask_ASW_FG1_100ms
      OsAppTaskRef = OsTask_ASW_FG1_10ms
      OsAppTaskRef = OsTask_ASW_FG2_WdgMTestMode
      OsAppTaskRef = OsTask_BSW_ComMModeRequest
      OsAppTaskRef = OsTask_BSW_FG1_10ms
      OsAppTaskRef = OsTask_BSW_FG1_5ms_Com
      OsAppTaskRef = OsTask_BSW_FG2_WdgMAPI
      OsAppTaskRef = OsTask_BSW_Init
      OsAppAlarmRef = OsAlarm_BSW_5ms_Com
      OsAppAlarmRef = OsAlarm_BSW_10ms
      OsAppAlarmRef = OsAlarm_ASW_10ms
      OsAppAlarmRef = OsAlarm_ASW_100ms
      OsAppAlarmRef = OsAlarm_BSW_Crypto_Main
      OsAppAlarmRef = OsAlarm_BG_KeyM
      OsAppAlarmRef = OsAlarm_BG_Fota
      OsAppAlarmRef = OsAlarm_BSW_BG_Mem_76_Pfls_Main
      OsAppTaskRef = OsTask_BSW_BG_KeyM
      OsAppTaskRef = OsTask_BSW_BG_Fota
      OsAppTaskRef = OsTask_BSW_BG_Mem_76_Pfls_Main
      OsAppTaskRef = OsTask_BSW_Crypto_Main
      OsAppResourceRef = OsResource_BG
      OsAppIsrRef = Can_Interrupt_CANFD02_Cat2
      OsAppIsrRef = GPT_Isr_Vector_307_Cat2
      OsAppIsrRef = GPT_Isr_Vector_303_Cat2
      OsAppIsrRef = Hsm_Isr_Vector_4_Cat2
      OsApplicationHooks0 (OsApplicationHooks): OsAppErrorHook=0, OsAppShutdownHook=0, OsAppStartupHook=0
    OsCounter_0 (OsCounter):
      OsCounterMaxAllowedValue = 0xFFFFFFFF
      OsCounterMinCycle = 1
      OsCounterTicksPerBase = 1
      OsCounterType = HARDWARE
      OsDrivingInterrupt = SYSTICK
      OsSecondsPerTick = 0.00125
    OsOS:
      OsNumberOfCores = 1
      OsScalabilityClass = SC1
      OsStackMonitoring = 1
      OsStatus = EXTENDED
      OsUseGetServiceId = 1
      OsUseResScheduler = 1
      OsProcessor = CYT2BL4CAS
      OsProcessorSeries = CYT2BL
      OsUseParameterAccess = 1
      OsUserStackSize = 4096
      OsStackFrame = StackFrame8
      OsSystemTimerClock = 160
      OsFpuSupport = 1
      OsHooks0 (OsHooks): OsErrorHook=1, OsPostTaskHook=0, OsPreTaskHook=0, OsProtectionHook=0, OsStartupHook=1, OsShutdownHook=1, OsProfilingHook=1
    8 x OsTask, all with OsTaskActivation=1, OsTaskSchedule=FULL:
      OsTask_ASW_FG1_100ms: OsTaskPriority=116, OsTaskResourceRef=OsResource_FG1
      OsTask_ASW_FG1_10ms: OsTaskPriority=140, OsTaskResourceRef=OsResource_FG1
      OsTask_ASW_FG2_WdgMTestMode: OsTaskPriority=205, OsTaskResourceRef=OsResource_FG2
      OsTask_BSW_ComMModeRequest: OsTaskPriority=253
      OsTask_BSW_FG1_10ms: OsTaskPriority=180, OsTaskResourceRef=OsResource_FG1
      OsTask_BSW_FG1_5ms_Com: OsTaskPriority=197, OsTaskResourceRef=OsResource_FG1
      OsTask_BSW_FG2_WdgMAPI: OsTaskPriority=210, OsTaskResourceRef=OsResource_FG2
      OsTask_BSW_Init: OsTaskPriority=99
        OsTaskAutostart: OsTaskAppModeRef=OsAppMode0
    OsResource_FG1 (OsResource): OsResourceProperty=INTERNAL
    OsResource_FG2 (OsResource): OsResourceProperty=INTERNAL
    4 x OsEvent:
      OsEvent_BSW_Crypto_Main: OsEventMask=32768
      OsEvent_BSW_KeyM: OsEventMask=16384
      OsEvent_BSW_BG_Fota: OsEventMask=4096
      OsEvent_BSW_Mem_76_Pfls_Main: OsEventMask=8192
    OsResource_BG (OsResource): OsResourceProperty=INTERNAL
    4 x OsTask, all with OsTaskActivation=1, OsTaskSchedule=FULL, OsTaskStackSize=4096, OsTaskResourceRef=OsResource_BG:
      OsTask_BSW_BG_KeyM: OsTaskPriority=6, OsTaskEventRef=OsEvent_BSW_KeyM
      OsTask_BSW_BG_Fota: OsTaskPriority=4, OsTaskEventRef=OsEvent_BSW_BG_Fota
      OsTask_BSW_BG_Mem_76_Pfls_Main: OsTaskPriority=2, OsTaskEventRef=OsEvent_BSW_Mem_76_Pfls_Main
      OsTask_BSW_Crypto_Main: OsTaskPriority=3, OsTaskEventRef=OsEvent_BSW_Crypto_Main
    4 x OsAlarm, all with OsAlarmCounterRef=OsCounter_0:
      OsAlarm_BSW_Crypto_Main
        OsAlarmAction
          OsAlarmSetEvent: OsAlarmSetEventRef=OsEvent_BSW_Crypto_Main, OsAlarmSetEventTaskRef=OsTask_BSW_Crypto_Main
      OsAlarm_BG_KeyM
        OsAlarmAction
          OsAlarmSetEvent: OsAlarmSetEventRef=OsEvent_BSW_KeyM, OsAlarmSetEventTaskRef=OsTask_BSW_BG_KeyM
      OsAlarm_BG_Fota
        OsAlarmAction
          OsAlarmSetEvent: OsAlarmSetEventRef=OsEvent_BSW_BG_Fota, OsAlarmSetEventTaskRef=OsTask_BSW_BG_Fota
      OsAlarm_BSW_BG_Mem_76_Pfls_Main
        OsAlarmAction
          OsAlarmSetEvent: OsAlarmSetEventRef=OsEvent_BSW_Mem_76_Pfls_Main, OsAlarmSetEventTaskRef=OsTask_BSW_BG_Mem_76_Pfls_Main
    4 x OsIsr, all with OsIsrCategory=CATEGORY_2, OsIsrHardwarePriority=6:
      Can_Interrupt_CANFD02_Cat2: OsIsrName=CAN0, Interrupt #0, Channel #2(59)
      GPT_Isr_Vector_307_Cat2: OsIsrName=TCPWM0 Group #0, Counter #7 Interrupt(307)
      GPT_Isr_Vector_303_Cat2: OsIsrName=TCPWM0 Group #0, Counter #3 Interrupt(303)
      Hsm_Isr_Vector_4_Cat2: OsIsrName=CPUSS Inter Process Communication Interrupt #4(4)
