AUTOSAR XML (schema 4-0-3)
package /AUTOSAR
  module config CanIf: implementation-config-variant=VARIANT-PRE-COMPILE, module-description=BswImplementation_CanIf
    CanIfDispatchCfg:
      CanIfDispatchUserCtrlBusOffUL = CAN_SM
      CanIfDispatchUserCtrlModeIndicationUL = CAN_SM
      CanIfDispatchUserValidateWakeupEventUL = ECUM
      CanIfDispatchUserCheckTrcvWakeFlagIndicationUL = CAN_SM
      CanIfDispatchUserClearTrcvWufFlagIndicationUL = CAN_SM
      CanIfDispatchUserTrcvModeIndicationUL = CAN_SM
    CanIfPrivateCfg: CanIfPrivateDlcCheck=1, CanIfPrivateSoftwareFilterType=BINARY, CanIfSupportTTCAN=0, CanIfSupportCanCM=0, CanIfSupportCANFD=1
    CanIfPublicCfg:
      CanIfPublicChangeBaudrateSupport = 0
      CanIfPublicDevErrorDetect = 0
      CanIfPublicMultipleDrvSupport = 0
      CanIfPublicNumberOfCanHwUnits = 1
      CanIfPublicPnSupport = 0
      CanIfPublicReadRxPduDataApi = 0
      CanIfPublicReadRxPduNotifyStatusApi = 0
      CanIfPublicReadTxPduNotifyStatusApi = 0
      CanIfPublicSetDynamicTxIdApi = 0
      CanIfPublicTxBuffering = 1
      CanIfPublicTxConfirmPollingSupport = 1
      CanIfPublicVersionInfoApi = 1
      CanIfPublicWakeupCheckValidSupport = 0
      CanIfPublicWakeupCheckValidByNM = 0
      CanIfPublicCancelTransmitSupport = 0
      CanIfMetaDataSupport = 0
      CanIfPublicHandleTypeEnum = UINT16
      CanIfCANFDID16BitSupport = 0
      CanIfCANFDDiscreteDlcSupport = 0
      CanIfExternalTrcvDrvSupport = 0
      CanIfBusloadDetectingSupport = 0
      CanIfPublicCanDrvVersion = AR_403
      CanIfTxRxMonitoringSupport = 0
    CanIfTrcvDrvCfg0 (CanIfTrcvDrvCfg)
      CanIfTrcvCfg_BCAN (CanIfTrcvCfg): CanIfTrcvWakeupSupport=0, CanIfTrcvId=0, CanIfTrcvCanTrcvRef=CanTrcvChannel_BCAN
    CanIfInitCfg
      CanIfInitHohCfg0 (CanIfInitHohCfg): category=TOOL_CONFIGURED, CanIfInitRefCfgSet=CanConfigSet
        CanIfHrhCfg_IN_WPC_BCAN_0x7df_BCAN_GST_ALL (CanIfHrhCfg):
          category = TOOL_CONFIGURED
          CanIfHrhSoftwareFilter = 1
          CanIfHrhCanCtrlIdRef = CanIfCtrlCfg_WPC_BCAN
          CanIfHrhCanHandleTypeRef = IN_HwObj_WPC_BCAN_0x7df_BCAN_GST_ALL
          CanIfHrhIdSymRef = IN_HwObj_WPC_BCAN_0x7df_BCAN_GST_ALL
        CanIfHrhCfg_IN_WPC_BCAN_0x725_BCAN_GST_WPC (CanIfHrhCfg):
          category = TOOL_CONFIGURED
          CanIfHrhSoftwareFilter = 1
          CanIfHrhCanCtrlIdRef = CanIfCtrlCfg_WPC_BCAN
          CanIfHrhCanHandleTypeRef = IN_HwObj_WPC_BCAN_0x725_BCAN_GST_WPC
          CanIfHrhIdSymRef = IN_HwObj_WPC_BCAN_0x725_BCAN_GST_WPC
        CanIfHthCfg_OUT_WPC_BCAN_0x72d_BCAN_WPC_GST (CanIfHthCfg):
          category = TOOL_CONFIGURED
          CanIfHthCanCtrlIdRef = CanIfCtrlCfg_WPC_BCAN
          CanIfHthCanHandleTypeRef = OUT_HwObj_WPC_BCAN_0x72d_BCAN_WPC_GST
          CanIfHthIdSymRef = OUT_HwObj_WPC_BCAN_0x72d_BCAN_WPC_GST
      CanIfRxPduCfg_IN_WPC_BCAN_0x7df_BCAN_GST_ALL (CanIfRxPduCfg):
        category = TOOL_CONFIGURED
        CanIfRxPduCanId = 2015
        CanIfRxPduCanIdType = STANDARD_CAN
        CanIfRxPduCanIdMask = 2015
        CanIfRxPduId = 0
        CanIfRxPduDlc = 8
        CanIfPduReportIdsMEnable = 0
        CanIfRxPduUserRxIndicationUL = CAN_TP
        CanIfRxPduReadNotifyStatus = 0
        CanIfRxPduReadData = 0
        CanIfRxPduHrhIdRef = CanIfHrhCfg_IN_WPC_BCAN_0x7df_BCAN_GST_ALL
        CanIfRxPduRef = Pdu_NPdu_BCAN_GST_ALL
      CanIfRxPduCfg_IN_WPC_BCAN_0x725_BCAN_GST_WPC (CanIfRxPduCfg):
        category = TOOL_CONFIGURED
        CanIfRxPduCanId = 1829
        CanIfRxPduCanIdType = STANDARD_CAN
        CanIfRxPduCanIdMask = 2015
        CanIfRxPduId = 1
        CanIfRxPduDlc = 8
        CanIfPduReportIdsMEnable = 0
        CanIfRxPduUserRxIndicationUL = CAN_TP
        CanIfRxPduReadData = 0
        CanIfRxPduReadNotifyStatus = 0
        CanIfRxPduHrhIdRef = CanIfHrhCfg_IN_WPC_BCAN_0x725_BCAN_GST_WPC
        CanIfRxPduRef = Pdu_NPdu_BCAN_GST_WPC
      CanIfBufferCfg_OUT_WPC_BCAN_0x72d_BCAN_WPC_GST (CanIfBufferCfg): category=TOOL_CONFIGURED, CanIfBufferSize=0, CanIfBufferHthRef=CanIfHthCfg_OUT_WPC_BCAN_0x72d_BCAN_WPC_GST
      CanIfTxPduCfg_OUT_WPC_BCAN_0x72d_BCAN_WPC_GST (CanIfTxPduCfg):
        category = TOOL_CONFIGURED
        CanIfTxPduCanId = 1837
        CanIfTxPduCanIdType = STANDARD_FD_CAN
        CanIfTxPduCanIdMask = 2015
        CanIfTxPduId = 0
        CanIfTxPduDlc = 8
        CanIfTxPduPnFilterPdu = 0
        CanIfTxPduUserTxConfirmationUL = CAN_TP
        CanIfTxPduReadNotifyStatus = 0
        CanIfTxPduType = STATIC
        CanIfTxPduBufferRef = CanIfBufferCfg_OUT_WPC_BCAN_0x72d_BCAN_WPC_GST
        CanIfTxPduRef = Pdu_NPdu_BCAN_WPC_GST
    CanIfCtrlDrvCfg0 (CanIfCtrlDrvCfg): CanIfCtrlDrvTxCancellation=1, CanIfCtrlDrvInitHohConfigRef=CanIfInitHohCfg0, CanIfCtrlDrvNameRef=CanGeneral
      CanIfCtrlCfg_WPC_BCAN (CanIfCtrlCfg): category=TOOL_CONFIGURED, CanIfCtrlId=0, CanIfCtrlWakeupSupport=0, CanIfCtrlCanCtrlRef=WPC_BCAN
