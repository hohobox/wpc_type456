AUTOSAR XML (schema 4-0-3)
package /AUTOSAR
  module config EcuC: implementation-config-variant=VARIANT-POST-BUILD
    EcucPduCollection: PduIdTypeEnum=UINT8, PduLengthTypeEnum=UINT8
      6 x Pdu, all with category=TOOL_CONFIGURED:
        Pdu_DcmIPdu_BCAN_GST_ALL: PduLength=8, SysTPduToFrameMappingRef=PduToFrame_BCAN_GST_ALL
        Pdu_NPdu_BCAN_GST_ALL: PduLength=8, SysTPduToFrameMappingRef=MapNPdu_BCAN_GST_ALL
        Pdu_DcmIPdu_BCAN_GST_WPC: PduLength=8, SysTPduToFrameMappingRef=PduToFrame_BCAN_GST_WPC
        Pdu_NPdu_BCAN_GST_WPC: PduLength=8, SysTPduToFrameMappingRef=MapNPdu_BCAN_GST_WPC
        Pdu_DcmIPdu_BCAN_WPC_GST: PduLength=64, SysTPduToFrameMappingRef=PduToFrame_BCAN_WPC_GST
        Pdu_NPdu_BCAN_WPC_GST: PduLength=8, SysTPduToFrameMappingRef=MapNPdu_BCAN_WPC_GST
