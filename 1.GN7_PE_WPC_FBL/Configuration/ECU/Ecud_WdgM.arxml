AUTOSAR XML (schema 4-0-3)
package /AUTOSAR
  module config WdgM: implementation-config-variant=VARIANT-PRE-COMPILE, module-description=BswImplementation_WdgM
    WdgMConfigSet: WdgMDeInitTimeout=4000, WdgMInitialMode=WdgMMode0
      3 x WdgMMode, all with WdgMSupervisionCycle=0.010:
        WdgMMode0: WdgMExpiredSupervisionCycleTol=0, WdgMModeId=0
          WdgMAliveSupervision0 (WdgMAliveSupervision): WdgMExpectedAliveIndications=1, WdgMMaxMargin=0, WdgMMinMargin=0, WdgMSupervisionReferenceCycle=1000, WdgMAliveSupervisionCheckpointRef=CP_Init_AS0
          WdgMLocalStatusParams0 (WdgMLocalStatusParams): WdgMFailedAliveSupervisionRefCycleTol=0, WdgMLocalStatusSupervisedEntityRef=SE_Init
          WdgMTrigger_Int (WdgMTrigger): WdgMTriggerConditionValue=2000, WdgMWatchdogMode=WDGIF_SLOW_MODE, WdgMTriggerWatchdogRef=WdgMWatchdog_Int
        WdgMMode1: WdgMExpiredSupervisionCycleTol=2, WdgMModeId=1
          WdgMAliveSupervision0 (WdgMAliveSupervision):
            WdgMExpectedAliveIndications = 10
            WdgMMaxMargin = 3
            WdgMMinMargin = 5
            WdgMSupervisionReferenceCycle = 10
            WdgMAliveSupervisionCheckpointRef = CP_WdgMTest_AS0
          WdgMLocalStatusParams0 (WdgMLocalStatusParams): WdgMFailedAliveSupervisionRefCycleTol=1, WdgMLocalStatusSupervisedEntityRef=SE_WdgMTest
          WdgMTrigger_Int (WdgMTrigger): WdgMTriggerConditionValue=2000, WdgMWatchdogMode=WDGIF_SLOW_MODE, WdgMTriggerWatchdogRef=WdgMWatchdog_Int
        WdgMMode2: WdgMExpiredSupervisionCycleTol=2, WdgMModeId=2
          WdgMAliveSupervision0 (WdgMAliveSupervision):
            WdgMExpectedAliveIndications = 10
            WdgMMaxMargin = 3
            WdgMMinMargin = 5
            WdgMSupervisionReferenceCycle = 10
            WdgMAliveSupervisionCheckpointRef = CP_WdgMTest_AS0
          WdgMLocalStatusParams0 (WdgMLocalStatusParams): WdgMFailedAliveSupervisionRefCycleTol=1, WdgMLocalStatusSupervisedEntityRef=SE_WdgMTest
          WdgMTrigger0 (WdgMTrigger): WdgMTriggerConditionValue=2000, WdgMWatchdogMode=WDGIF_OFF_MODE, WdgMTriggerWatchdogRef=WdgMWatchdog_Int
    WdgMGeneral:
      WdgMDemStoppedSupervisionReport = 0
      WdgMDevErrorDetect = 1
      WdgMVersionInfoApi = 0
      WdgMOsVendor = AUTRON_OS
      WdgMOffModeEnabled = 1
      WdgMDefensiveBehavior = 0
      WdgMErrorInfoApi = 0
      WdgMImmediateReset = 0
      WdgMCallerIds: WdgMCallerId=300
      SE_Init (WdgMSupervisedEntity): WdgMSupervisedEntityId=300, WdgMInternalCheckpointInitialRef=CP_Init_ILS_0, WdgMInternalCheckpointFinalRef=CP_Init_ILS_1
        3 x WdgMCheckpoint:
          CP_Init_AS0: WdgMCheckpointId=0
          CP_Init_ILS_0: WdgMCheckpointId=1
          CP_Init_ILS_1: WdgMCheckpointId=2
      SE_WdgMTest (WdgMSupervisedEntity): WdgMSupervisedEntityId=400, WdgMInternalCheckpointInitialRef=CP_WdgMTest_ILS_0, WdgMInternalCheckpointFinalRef=CP_WdgMTest_ILS_1
        3 x WdgMCheckpoint:
          CP_WdgMTest_AS0: WdgMCheckpointId=0
          CP_WdgMTest_ILS_0: WdgMCheckpointId=1
          CP_WdgMTest_ILS_1: WdgMCheckpointId=2
      WdgMWatchdog_Int (WdgMWatchdog): WdgMWatchdogName=Watchdog_Int, WdgMWatchdogDeviceRef=WdgIfDevice_Int
