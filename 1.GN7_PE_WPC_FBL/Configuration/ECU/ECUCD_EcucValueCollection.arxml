AUTOSAR XML (schema 4-0-3)
package /EcucValueCollection
  ecuc value collection EcucValueCollection: category=MANAGED_ECUC_MODULES, ecu-extract=EcuExtract
    ecuc-values:
      Com
      EcuC
      Det
      Crc
      Dio
      WdgIf
      Adc
      Fota
      Mcu
      Os
      WdgM
      EcuM
      KeyM
      CanTp
      ComM
      HwResource
      BswM
      Wdg
      Dcm
      Gpt
      Crypto_76_HaeModule
      Csm
      Port
      Can
      CryIf
      CanTrcv
      Spi
      Mem_76_Pfls
      CanSM
      Resource
      PduR
      Rte
      OsImp
      CanIf
