AUTOSAR XML (schema 4-0-3)
package /AUTOSAR
  module config ComM: implementation-config-variant=VARIANT-PRE-COMPILE, module-description=BswImplementation_ComM
    ComMGeneral:
      ComMDevErrorDetect = 0
      ComMEcuGroupClassification = 3
      ComMModeLimitationEnabled = 0
      ComMPncSupport = 0
      ComMSynchronousWakeUp = 0
      ComMTMinFullComModeDuration = 0.005
      ComMVersionInfoApi = 0
      ComMWakeupInhibitionEnabled = 0
      ComMDirectUserMapping = 0
      ComMPncGatewayEnabled = 0
      ComMCanCMSupport = 0
      ComMBusloadDetectingApi = 0
    ComMConfigSet
      ComMUser_BCAN (ComMUser): category=TOOL_CONFIGURED, ComMUserIdentifier=0
      ComMChannel_BCAN (ComMChannel):
        category = TOOL_CONFIGURED
        ComMBusType = COMM_BUS_TYPE_CAN
        ComMChannelId = 0
        ComMMainFunctionPeriod = 0.005
        ComMFullCommRequestNotificationEnabled = 0
        ComMNoWakeup = 0
        ComMGlobalNvmBlockDescriptor = 0
        ComMNoCom = 0
        ComMNetworkManagement_BCAN (ComMNetworkManagement): category=TOOL_CONFIGURED, ComMNmLightTimeout=0, ComMNmVariant=LIGHT, ComMPncNmRequest=0
        ComMUserPerChannel_BCAN (ComMUserPerChannel): category=TOOL_CONFIGURED, ComMUserChannel=ComMUser_BCAN
