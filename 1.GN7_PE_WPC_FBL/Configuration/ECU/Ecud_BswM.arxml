AUTOSAR XML (schema 4-0-3)
package /AUTOSAR
  module config BswM: implementation-config-variant=VARIANT-PRE-COMPILE, module-description=BswImplementation_BswM
    BswMGeneral:
      BswMMainFunctionPeriod = 0.01
      BswMComMEnabled = 1
      BswMCanSMEnabled = 1
      BswMDcmEnabled = 1
      BswMLinSMEnabled = 0
      BswMEcuMEnabled = 1
      BswMNvMEnabled = 0
      BswMWdgMEnabled = 1
      BswMSchMEnabled = 1
      BswMGenericRequestEnabled = 1
      BswMJ1939NmEnabled = 0
      BswMDevErrorDetect = 1
      BswMEthSMEnabled = 0
      BswMFrSMEnabled = 0
      BswMLinTPEnabled = 0
      BswMJ1939DcmEnabled = 0
      BswMVersionInfoApi = 0
      BswMUserIncludeFiles:
        category = TOOL_CONFIGURED
        BswMUserIncludeFile = ComM.h
        BswMUserIncludeFile = EcuM.h
        BswMUserIncludeFile = KeyM.h
        BswMUserIncludeFile = Rte_Main.h
        BswMUserIncludeFile = WdgM.h
        BswMUserIncludeFile = Dummy.h
        BswMUserIncludeFile = Crypto_76_HaeModule.h
        BswMUserIncludeFile = App_Hsm_Hae.h
    BswMConfig
      BswMArbitration: category=TOOL_CONFIGURED
        14 x BswMModeRequestPort, all with category=TOOL_CONFIGURED, BswMRequestProcessing=BSWM_IMMEDIATE:
          MRP_IMM_BswModeNotification_modeNotificationPort_DcmCommunicationControl_0
            BswMModeRequestSource: category=TOOL_CONFIGURED
              BswMBswModeNotification: category=TOOL_CONFIGURED, BswMBswModeDeclarationGroupPrototypeRef=modeNotificationPort_DcmCommunicationControl_0
            BswMModeInitValue: category=TOOL_CONFIGURED
              BswMSwcModeInitValue: category=TOOL_CONFIGURED, BswMSwcModeInitValueRef=DCM_ENABLE_RX_TX_NORM_NM
          MRP_IMM_BswModeNotification_modeNotificationPort_DcmControlDTCSetting
            BswMModeRequestSource: category=TOOL_CONFIGURED
              BswMBswModeNotification: category=TOOL_CONFIGURED, BswMBswModeDeclarationGroupPrototypeRef=modeNotificationPort_DcmControlDTCSetting
            BswMModeInitValue: category=TOOL_CONFIGURED
              BswMSwcModeInitValue: category=TOOL_CONFIGURED, BswMSwcModeInitValueRef=ENABLEDTCSETTING
          MRP_IMM_BswModeNotification_modeNotificationPort_DcmDiagnosticSessionControl
            BswMModeRequestSource: category=TOOL_CONFIGURED
              BswMBswModeNotification: category=TOOL_CONFIGURED, BswMBswModeDeclarationGroupPrototypeRef=modeNotificationPort_DcmDiagnosticSessionControl
            BswMModeInitValue: category=TOOL_CONFIGURED
              BswMSwcModeInitValue: category=TOOL_CONFIGURED, BswMSwcModeInitValueRef=DCM_DEFAULT_SESSION
          MRP_IMM_BswModeNotification_modeNotificationPort_DcmEcuReset
            BswMModeRequestSource: category=TOOL_CONFIGURED
              BswMBswModeNotification: category=TOOL_CONFIGURED, BswMBswModeDeclarationGroupPrototypeRef=modeNotificationPort_DcmEcuReset
            BswMModeInitValue: category=TOOL_CONFIGURED
              BswMSwcModeInitValue: category=TOOL_CONFIGURED, BswMSwcModeInitValueRef=NONE
          MRP_IMM_BswModeNotification_modeNotificationPort_DcmModeRapidPowerShutDown
            BswMModeRequestSource: category=TOOL_CONFIGURED
              BswMBswModeNotification: category=TOOL_CONFIGURED, BswMBswModeDeclarationGroupPrototypeRef=modeNotificationPort_DcmModeRapidPowerShutDown
            BswMModeInitValue: category=TOOL_CONFIGURED
              BswMSwcModeInitValue: category=TOOL_CONFIGURED, BswMSwcModeInitValueRef=ENABLE_RAPIDPOWERSHUTDOWN
          MRP_IMM_CanSMIndication_BCAN
            BswMModeRequestSource: category=TOOL_CONFIGURED
              BswMCanSMIndication: category=TOOL_CONFIGURED, BswMCanSMChannelRef=ComMChannel_BCAN
            BswMModeInitValue: category=TOOL_CONFIGURED
              BswMBswModeInitValue: category=TOOL_CONFIGURED, BswMBswModeInitValueMode=CANSM_BSWM_NO_COMMUNICATION
          MRP_IMM_ComMIndication_BCAN
            BswMModeRequestSource: category=TOOL_CONFIGURED
              BswMComMIndication: category=TOOL_CONFIGURED, BswMComMChannelRef=ComMChannel_BCAN
            BswMModeInitValue: category=TOOL_CONFIGURED
              BswMBswModeInitValue: category=TOOL_CONFIGURED, BswMBswModeInitValueMode=COMM_NO_COMMUNICATION
          MRP_IMM_DcmApplicationUpdatedIndication
            BswMModeRequestSource: category=TOOL_CONFIGURED
              BswMDcmApplicationUpdatedIndication: category=TOOL_CONFIGURED
            BswMModeInitValue: category=TOOL_CONFIGURED
              BswMSwcModeInitValue: category=TOOL_CONFIGURED, BswMSwcModeInitValueRef=APP_NOT_UPDATED
          MRP_IMM_DcmComModeRequest_BCAN
            BswMModeRequestSource: category=TOOL_CONFIGURED
              BswMDcmComModeRequest: category=TOOL_CONFIGURED, BswMDcmComMChannelRef=ComMChannel_BCAN
            BswMModeInitValue: category=TOOL_CONFIGURED
              BswMBswModeInitValue: category=TOOL_CONFIGURED, BswMBswModeInitValueMode=DCM_ENABLE_RX_TX_NORM_NM
          MRP_IMM_EcuMIndication
            BswMModeRequestSource: category=TOOL_CONFIGURED
              BswMEcuMIndication: category=TOOL_CONFIGURED
            BswMModeInitValue: category=TOOL_CONFIGURED
              BswMBswModeInitValue: category=TOOL_CONFIGURED, BswMBswModeInitValueMode=ECUM_STATE_STARTUP_ONE
          MRP_IMM_GenericRequest_CanSMBOR_BCAN
            BswMModeRequestSource: category=TOOL_CONFIGURED
              BswMGenericRequest: category=TOOL_CONFIGURED, BswMModeRequesterId=140, BswMRequestedModeMax=1
            BswMModeInitValue: category=TOOL_CONFIGURED
              BswMBswModeInitValue: category=TOOL_CONFIGURED, BswMBswModeInitValueMode=CANSM_BSWM_BOR_COMPLETE
          MRP_IMM_GenericRequest_EcuState
            BswMModeRequestSource: category=TOOL_CONFIGURED
              BswMGenericRequest: category=TOOL_CONFIGURED, BswMModeRequesterId=42, BswMRequestedModeMax=400
            BswMModeInitValue: category=TOOL_CONFIGURED
              BswMBswModeInitValue: category=TOOL_CONFIGURED, BswMBswModeInitValueMode=BSWM_ECUSTATE_READY
          MRP_IMM_GenericRequest_ShutdownTarget
            BswMModeRequestSource: category=TOOL_CONFIGURED
              BswMGenericRequest: category=TOOL_CONFIGURED, BswMModeRequesterId=298, BswMRequestedModeMax=3
            BswMModeInitValue: category=TOOL_CONFIGURED
              BswMBswModeInitValue: category=TOOL_CONFIGURED, BswMBswModeInitValueMode=BSWM_SHUTDOWNTARGET_RUN
          MRP_IMM_SwcModeRequest_ComMMode_BCAN
            BswMModeRequestSource: category=TOOL_CONFIGURED
              BswMSwcModeRequest: category=TOOL_CONFIGURED, BswMSwcModeRequestVariableDataPrototypeRef=ComMMode_BCAN
        63 x BswMModeCondition, all with category=TOOL_CONFIGURED:
          MC_IMM_BswModeNotification_modeNotificationPort_DcmCommunicationControl_0_EQ_DCM_DISABLE_RX_DISABLE_TX_NM: BswMConditionType=BSWM_EQUALS, BswMConditionMode=MRP_IMM_BswModeNotification_modeNotificationPort_DcmCommunicationControl_0
            BswMConditionValue: category=TOOL_CONFIGURED
              BswMModeDeclaration: category=TOOL_CONFIGURED, BswMModeValueRef=DCM_DISABLE_RX_DISABLE_TX_NM
          MC_IMM_BswModeNotification_modeNotificationPort_DcmCommunicationControl_0_EQ_DCM_DISABLE_RX_ENABLE_TX_NORM: BswMConditionType=BSWM_EQUALS, BswMConditionMode=MRP_IMM_BswModeNotification_modeNotificationPort_DcmCommunicationControl_0
            BswMConditionValue: category=TOOL_CONFIGURED
              BswMModeDeclaration: category=TOOL_CONFIGURED, BswMModeValueRef=DCM_DISABLE_RX_ENABLE_TX_NORM
          MC_IMM_BswModeNotification_modeNotificationPort_DcmCommunicationControl_0_EQ_DCM_DISABLE_RX_ENABLE_TX_NORM_NM: BswMConditionType=BSWM_EQUALS, BswMConditionMode=MRP_IMM_BswModeNotification_modeNotificationPort_DcmCommunicationControl_0
            BswMConditionValue: category=TOOL_CONFIGURED
              BswMModeDeclaration: category=TOOL_CONFIGURED, BswMModeValueRef=DCM_DISABLE_RX_ENABLE_TX_NORM_NM
          MC_IMM_BswModeNotification_modeNotificationPort_DcmCommunicationControl_0_EQ_DCM_DISABLE_RX_TX_NM: BswMConditionType=BSWM_EQUALS, BswMConditionMode=MRP_IMM_BswModeNotification_modeNotificationPort_DcmCommunicationControl_0
            BswMConditionValue: category=TOOL_CONFIGURED
              BswMModeDeclaration: category=TOOL_CONFIGURED, BswMModeValueRef=DCM_DISABLE_RX_TX_NM
          MC_IMM_BswModeNotification_modeNotificationPort_DcmCommunicationControl_0_EQ_DCM_DISABLE_RX_TX_NORMAL: BswMConditionType=BSWM_EQUALS, BswMConditionMode=MRP_IMM_BswModeNotification_modeNotificationPort_DcmCommunicationControl_0
            BswMConditionValue: category=TOOL_CONFIGURED
              BswMModeDeclaration: category=TOOL_CONFIGURED, BswMModeValueRef=DCM_DISABLE_RX_TX_NORMAL
          MC_IMM_BswModeNotification_modeNotificationPort_DcmCommunicationControl_0_EQ_DCM_DISABLE_RX_TX_NORM_NM: BswMConditionType=BSWM_EQUALS, BswMConditionMode=MRP_IMM_BswModeNotification_modeNotificationPort_DcmCommunicationControl_0
            BswMConditionValue: category=TOOL_CONFIGURED
              BswMModeDeclaration: category=TOOL_CONFIGURED, BswMModeValueRef=DCM_DISABLE_RX_TX_NORM_NM
          MC_IMM_BswModeNotification_modeNotificationPort_DcmCommunicationControl_0_EQ_DCM_ENABLE_RX_DISABLE_TX_NM: BswMConditionType=BSWM_EQUALS, BswMConditionMode=MRP_IMM_BswModeNotification_modeNotificationPort_DcmCommunicationControl_0
            BswMConditionValue: category=TOOL_CONFIGURED
              BswMModeDeclaration: category=TOOL_CONFIGURED, BswMModeValueRef=DCM_ENABLE_RX_DISABLE_TX_NM
          MC_IMM_BswModeNotification_modeNotificationPort_DcmCommunicationControl_0_EQ_DCM_ENABLE_RX_DISABLE_TX_NORM: BswMConditionType=BSWM_EQUALS, BswMConditionMode=MRP_IMM_BswModeNotification_modeNotificationPort_DcmCommunicationControl_0
            BswMConditionValue: category=TOOL_CONFIGURED
              BswMModeDeclaration: category=TOOL_CONFIGURED, BswMModeValueRef=DCM_ENABLE_RX_DISABLE_TX_NORM
          MC_IMM_BswModeNotification_modeNotificationPort_DcmCommunicationControl_0_EQ_DCM_ENABLE_RX_DISABLE_TX_NORM_NM: BswMConditionType=BSWM_EQUALS, BswMConditionMode=MRP_IMM_BswModeNotification_modeNotificationPort_DcmCommunicationControl_0
            BswMConditionValue: category=TOOL_CONFIGURED
              BswMModeDeclaration: category=TOOL_CONFIGURED, BswMModeValueRef=DCM_ENABLE_RX_DISABLE_TX_NORM_NM
          MC_IMM_BswModeNotification_modeNotificationPort_DcmCommunicationControl_0_EQ_DCM_ENABLE_RX_TX_NM: BswMConditionType=BSWM_EQUALS, BswMConditionMode=MRP_IMM_BswModeNotification_modeNotificationPort_DcmCommunicationControl_0
            BswMConditionValue: category=TOOL_CONFIGURED
              BswMModeDeclaration: category=TOOL_CONFIGURED, BswMModeValueRef=DCM_ENABLE_RX_TX_NM
          MC_IMM_BswModeNotification_modeNotificationPort_DcmCommunicationControl_0_EQ_DCM_ENABLE_RX_TX_NORM: BswMConditionType=BSWM_EQUALS, BswMConditionMode=MRP_IMM_BswModeNotification_modeNotificationPort_DcmCommunicationControl_0
            BswMConditionValue: category=TOOL_CONFIGURED
              BswMModeDeclaration: category=TOOL_CONFIGURED, BswMModeValueRef=DCM_ENABLE_RX_TX_NORM
          MC_IMM_BswModeNotification_modeNotificationPort_DcmCommunicationControl_0_EQ_DCM_ENABLE_RX_TX_NORM_NM: BswMConditionType=BSWM_EQUALS, BswMConditionMode=MRP_IMM_BswModeNotification_modeNotificationPort_DcmCommunicationControl_0
            BswMConditionValue: category=TOOL_CONFIGURED
              BswMModeDeclaration: category=TOOL_CONFIGURED, BswMModeValueRef=DCM_ENABLE_RX_TX_NORM_NM
          MC_IMM_BswModeNotification_modeNotificationPort_DcmControlDTCSetting_EQ_DISABLEDTCSETTING: BswMConditionType=BSWM_EQUALS, BswMConditionMode=MRP_IMM_BswModeNotification_modeNotificationPort_DcmControlDTCSetting
            BswMConditionValue: category=TOOL_CONFIGURED
              BswMModeDeclaration: category=TOOL_CONFIGURED, BswMModeValueRef=DISABLEDTCSETTING
          MC_IMM_BswModeNotification_modeNotificationPort_DcmControlDTCSetting_EQ_ENABLEDTCSETTING: BswMConditionType=BSWM_EQUALS, BswMConditionMode=MRP_IMM_BswModeNotification_modeNotificationPort_DcmControlDTCSetting
            BswMConditionValue: category=TOOL_CONFIGURED
              BswMModeDeclaration: category=TOOL_CONFIGURED, BswMModeValueRef=ENABLEDTCSETTING
          MC_IMM_BswModeNotification_modeNotificationPort_DcmDiagnosticSessionControl_EQ_DCM_DEFAULT_SESSION: BswMConditionType=BSWM_EQUALS, BswMConditionMode=MRP_IMM_BswModeNotification_modeNotificationPort_DcmDiagnosticSessionControl
            BswMConditionValue: category=TOOL_CONFIGURED
              BswMModeDeclaration: category=TOOL_CONFIGURED, BswMModeValueRef=DCM_DEFAULT_SESSION
          MC_IMM_BswModeNotification_modeNotificationPort_DcmDiagnosticSessionControl_EQ_DCM_ECU_PROGRAMMING_MODE: BswMConditionType=BSWM_EQUALS, BswMConditionMode=MRP_IMM_BswModeNotification_modeNotificationPort_DcmDiagnosticSessionControl
            BswMConditionValue: category=TOOL_CONFIGURED
              BswMModeDeclaration: category=TOOL_CONFIGURED, BswMModeValueRef=DCM_ECU_PROGRAMMING_MODE
          MC_IMM_BswModeNotification_modeNotificationPort_DcmDiagnosticSessionControl_EQ_DCM_EXTENDED_DIAGNOSTIC_MODE: BswMConditionType=BSWM_EQUALS, BswMConditionMode=MRP_IMM_BswModeNotification_modeNotificationPort_DcmDiagnosticSessionControl
            BswMConditionValue: category=TOOL_CONFIGURED
              BswMModeDeclaration: category=TOOL_CONFIGURED, BswMModeValueRef=DCM_EXTENDED_DIAGNOSTIC_MODE
          MC_IMM_BswModeNotification_modeNotificationPort_DcmDiagnosticSessionControl_EQ_DCM_EXTENDED_DIAGNOSTIC_SESSION: BswMConditionType=BSWM_EQUALS, BswMConditionMode=MRP_IMM_BswModeNotification_modeNotificationPort_DcmDiagnosticSessionControl
            BswMConditionValue: category=TOOL_CONFIGURED
              BswMModeDeclaration: category=TOOL_CONFIGURED, BswMModeValueRef=DCM_EXTENDED_DIAGNOSTIC_SESSION
          MC_IMM_BswModeNotification_modeNotificationPort_DcmDiagnosticSessionControl_EQ_DCM_PROGRAMMING_SESSION: BswMConditionType=BSWM_EQUALS, BswMConditionMode=MRP_IMM_BswModeNotification_modeNotificationPort_DcmDiagnosticSessionControl
            BswMConditionValue: category=TOOL_CONFIGURED
              BswMModeDeclaration: category=TOOL_CONFIGURED, BswMModeValueRef=DCM_PROGRAMMING_SESSION
          MC_IMM_BswModeNotification_modeNotificationPort_DcmDiagnosticSessionControl_EQ_DCM_QUIESCENT_CURRENT_DIAGNOSTIC_MODE_START: BswMConditionType=BSWM_EQUALS, BswMConditionMode=MRP_IMM_BswModeNotification_modeNotificationPort_DcmDiagnosticSessionControl
            BswMConditionValue: category=TOOL_CONFIGURED
              BswMModeDeclaration: category=TOOL_CONFIGURED, BswMModeValueRef=DCM_QUIESCENT_CURRENT_DIAGNOSTIC_MODE_START
          MC_IMM_BswModeNotification_modeNotificationPort_DcmDiagnosticSessionControl_EQ_DCM_SAFETY_SYSTEM_DIAGNOSTIC_SESSION: BswMConditionType=BSWM_EQUALS, BswMConditionMode=MRP_IMM_BswModeNotification_modeNotificationPort_DcmDiagnosticSessionControl
            BswMConditionValue: category=TOOL_CONFIGURED
              BswMModeDeclaration: category=TOOL_CONFIGURED, BswMModeValueRef=DCM_SAFETY_SYSTEM_DIAGNOSTIC_SESSION
          MC_IMM_BswModeNotification_modeNotificationPort_DcmDiagnosticSessionControl_EQ_DCM_SLEEP_MODE_START_REQUEST: BswMConditionType=BSWM_EQUALS, BswMConditionMode=MRP_IMM_BswModeNotification_modeNotificationPort_DcmDiagnosticSessionControl
            BswMConditionValue: category=TOOL_CONFIGURED
              BswMModeDeclaration: category=TOOL_CONFIGURED, BswMModeValueRef=DCM_SLEEP_MODE_START_REQUEST
          MC_IMM_BswModeNotification_modeNotificationPort_DcmEcuReset_EQ_EXECUTE: BswMConditionType=BSWM_EQUALS, BswMConditionMode=MRP_IMM_BswModeNotification_modeNotificationPort_DcmEcuReset
            BswMConditionValue: category=TOOL_CONFIGURED
              BswMModeDeclaration: category=TOOL_CONFIGURED, BswMModeValueRef=EXECUTE
          MC_IMM_BswModeNotification_modeNotificationPort_DcmModeRapidPowerShutDown_EQ_DISABLE_RAPIDPOWERSHUTDOWN: BswMConditionType=BSWM_EQUALS, BswMConditionMode=MRP_IMM_BswModeNotification_modeNotificationPort_DcmModeRapidPowerShutDown
            BswMConditionValue: category=TOOL_CONFIGURED
              BswMModeDeclaration: category=TOOL_CONFIGURED, BswMModeValueRef=DISABLE_RAPIDPOWERSHUTDOWN
          MC_IMM_BswModeNotification_modeNotificationPort_DcmModeRapidPowerShutDown_EQ_ENABLE_RAPIDPOWERSHUTDOWN: BswMConditionType=BSWM_EQUALS, BswMConditionMode=MRP_IMM_BswModeNotification_modeNotificationPort_DcmModeRapidPowerShutDown
            BswMConditionValue: category=TOOL_CONFIGURED
              BswMModeDeclaration: category=TOOL_CONFIGURED, BswMModeValueRef=ENABLE_RAPIDPOWERSHUTDOWN
          MC_IMM_CanSMIndication_BCAN_EQ_BUS_OFF: BswMConditionType=BSWM_EQUALS, BswMConditionMode=MRP_IMM_CanSMIndication_BCAN
            BswMConditionValue: category=TOOL_CONFIGURED
              BswMBswMode: category=TOOL_CONFIGURED, BswMBswRequestedMode=CANSM_BSWM_BUS_OFF
          MC_IMM_CanSMIndication_BCAN_EQ_CHANGE_BAUDRATE: BswMConditionType=BSWM_EQUALS, BswMConditionMode=MRP_IMM_CanSMIndication_BCAN
            BswMConditionValue: category=TOOL_CONFIGURED
              BswMBswMode: category=TOOL_CONFIGURED, BswMBswRequestedMode=CANSM_BSWM_CHANGE_BAUDRATE
          MC_IMM_CanSMIndication_BCAN_EQ_FULL_COM: BswMConditionType=BSWM_EQUALS, BswMConditionMode=MRP_IMM_CanSMIndication_BCAN
            BswMConditionValue: category=TOOL_CONFIGURED
              BswMBswMode: category=TOOL_CONFIGURED, BswMBswRequestedMode=CANSM_BSWM_FULL_COMMUNICATION
          MC_IMM_CanSMIndication_BCAN_EQ_NO_COM: BswMConditionType=BSWM_EQUALS, BswMConditionMode=MRP_IMM_CanSMIndication_BCAN
            BswMConditionValue: category=TOOL_CONFIGURED
              BswMBswMode: category=TOOL_CONFIGURED, BswMBswRequestedMode=CANSM_BSWM_NO_COMMUNICATION
          MC_IMM_CanSMIndication_BCAN_EQ_SILENT_COM: BswMConditionType=BSWM_EQUALS, BswMConditionMode=MRP_IMM_CanSMIndication_BCAN
            BswMConditionValue: category=TOOL_CONFIGURED
              BswMBswMode: category=TOOL_CONFIGURED, BswMBswRequestedMode=CANSM_BSWM_SILENT_COMMUNICATION
          MC_IMM_ComMIndication_BCAN_EN_FULL_COM: BswMConditionType=BSWM_EQUALS_NOT, BswMConditionMode=MRP_IMM_ComMIndication_BCAN
            BswMConditionValue: category=TOOL_CONFIGURED
              BswMBswMode: category=TOOL_CONFIGURED, BswMBswRequestedMode=COMM_FULL_COMMUNICATION
          MC_IMM_ComMIndication_BCAN_EQ_FULL_COM: BswMConditionType=BSWM_EQUALS, BswMConditionMode=MRP_IMM_ComMIndication_BCAN
            BswMConditionValue: category=TOOL_CONFIGURED
              BswMBswMode: category=TOOL_CONFIGURED, BswMBswRequestedMode=COMM_FULL_COMMUNICATION
          MC_IMM_ComMIndication_BCAN_EQ_NO_COM: BswMConditionType=BSWM_EQUALS, BswMConditionMode=MRP_IMM_ComMIndication_BCAN
            BswMConditionValue: category=TOOL_CONFIGURED
              BswMBswMode: category=TOOL_CONFIGURED, BswMBswRequestedMode=COMM_NO_COMMUNICATION
          MC_IMM_ComMIndication_BCAN_EQ_SILENT_COM: BswMConditionType=BSWM_EQUALS, BswMConditionMode=MRP_IMM_ComMIndication_BCAN
            BswMConditionValue: category=TOOL_CONFIGURED
              BswMBswMode: category=TOOL_CONFIGURED, BswMBswRequestedMode=COMM_SILENT_COMMUNICATION
          MC_IMM_DcmApplicationUpdatedIndication_EQ_APP_NOT_UPDATED: BswMConditionType=BSWM_EQUALS, BswMConditionMode=MRP_IMM_DcmApplicationUpdatedIndication
            BswMConditionValue: category=TOOL_CONFIGURED
              BswMModeDeclaration: category=TOOL_CONFIGURED, BswMModeValueRef=APP_NOT_UPDATED
          MC_IMM_DcmApplicationUpdatedIndication_EQ_APP_UPDATED: BswMConditionType=BSWM_EQUALS, BswMConditionMode=MRP_IMM_DcmApplicationUpdatedIndication
            BswMConditionValue: category=TOOL_CONFIGURED
              BswMModeDeclaration: category=TOOL_CONFIGURED, BswMModeValueRef=APP_UPDATED
          MC_IMM_DcmComModeRequest_BCAN_EQ_DISABLE_RX_ENABLE_TX_NORM: BswMConditionType=BSWM_EQUALS, BswMConditionMode=MRP_IMM_DcmComModeRequest_BCAN
            BswMConditionValue: category=TOOL_CONFIGURED
              BswMBswMode: category=TOOL_CONFIGURED, BswMBswRequestedMode=DCM_DISABLE_RX_ENABLE_TX_NORM
          MC_IMM_DcmComModeRequest_BCAN_EQ_DISABLE_RX_ENABLE_TX_NORM_NM: BswMConditionType=BSWM_EQUALS, BswMConditionMode=MRP_IMM_DcmComModeRequest_BCAN
            BswMConditionValue: category=TOOL_CONFIGURED
              BswMBswMode: category=TOOL_CONFIGURED, BswMBswRequestedMode=DCM_DISABLE_RX_ENABLE_TX_NORM_NM
          MC_IMM_DcmComModeRequest_BCAN_EQ_DISABLE_RX_TX_NORM: BswMConditionType=BSWM_EQUALS, BswMConditionMode=MRP_IMM_DcmComModeRequest_BCAN
            BswMConditionValue: category=TOOL_CONFIGURED
              BswMBswMode: category=TOOL_CONFIGURED, BswMBswRequestedMode=DCM_DISABLE_RX_TX_NORM
          MC_IMM_DcmComModeRequest_BCAN_EQ_DISABLE_RX_TX_NORM_NM: BswMConditionType=BSWM_EQUALS, BswMConditionMode=MRP_IMM_DcmComModeRequest_BCAN
            BswMConditionValue: category=TOOL_CONFIGURED
              BswMBswMode: category=TOOL_CONFIGURED, BswMBswRequestedMode=DCM_DISABLE_RX_TX_NORM_NM
          MC_IMM_DcmComModeRequest_BCAN_EQ_ENABLE_RX_DISABLE_TX_NORM: BswMConditionType=BSWM_EQUALS, BswMConditionMode=MRP_IMM_DcmComModeRequest_BCAN
            BswMConditionValue: category=TOOL_CONFIGURED
              BswMBswMode: category=TOOL_CONFIGURED, BswMBswRequestedMode=DCM_ENABLE_RX_DISABLE_TX_NORM
          MC_IMM_DcmComModeRequest_BCAN_EQ_ENABLE_RX_DISABLE_TX_NORM_NM: BswMConditionType=BSWM_EQUALS, BswMConditionMode=MRP_IMM_DcmComModeRequest_BCAN
            BswMConditionValue: category=TOOL_CONFIGURED
              BswMBswMode: category=TOOL_CONFIGURED, BswMBswRequestedMode=DCM_ENABLE_RX_DISABLE_TX_NORM_NM
          MC_IMM_DcmComModeRequest_BCAN_EQ_ENABLE_RX_TX_NORM: BswMConditionType=BSWM_EQUALS, BswMConditionMode=MRP_IMM_DcmComModeRequest_BCAN
            BswMConditionValue: category=TOOL_CONFIGURED
              BswMBswMode: category=TOOL_CONFIGURED, BswMBswRequestedMode=DCM_ENABLE_RX_TX_NORM
          MC_IMM_DcmComModeRequest_BCAN_EQ_ENABLE_RX_TX_NORM_NM: BswMConditionType=BSWM_EQUALS, BswMConditionMode=MRP_IMM_DcmComModeRequest_BCAN
            BswMConditionValue: category=TOOL_CONFIGURED
              BswMBswMode: category=TOOL_CONFIGURED, BswMBswRequestedMode=DCM_ENABLE_RX_TX_NORM_NM
          MC_IMM_EcuMIndication_EQ_STARTUP_TWO: BswMConditionType=BSWM_EQUALS, BswMConditionMode=MRP_IMM_EcuMIndication
            BswMConditionValue: category=TOOL_CONFIGURED
              BswMBswMode: category=TOOL_CONFIGURED, BswMBswRequestedMode=ECUM_STATE_STARTUP_TWO
          MC_IMM_GenericRequest_CanSMBOR_BCAN_EQ_COMPLETE: BswMConditionType=BSWM_EQUALS, BswMConditionMode=MRP_IMM_GenericRequest_CanSMBOR_BCAN
            BswMConditionValue: category=TOOL_CONFIGURED
              BswMBswMode: category=TOOL_CONFIGURED, BswMBswRequestedMode=CANSM_BSWM_BOR_COMPLETE
          MC_IMM_GenericRequest_CanSMBOR_BCAN_EQ_START: BswMConditionType=BSWM_EQUALS, BswMConditionMode=MRP_IMM_GenericRequest_CanSMBOR_BCAN
            BswMConditionValue: category=TOOL_CONFIGURED
              BswMBswMode: category=TOOL_CONFIGURED, BswMBswRequestedMode=CANSM_BSWM_BOR_START
          MC_IMM_GenericRequest_EcuState_EQ_ENTRY_OFF: BswMConditionType=BSWM_EQUALS, BswMConditionMode=MRP_IMM_GenericRequest_EcuState
            BswMConditionValue: category=TOOL_CONFIGURED
              BswMBswMode: category=TOOL_CONFIGURED, BswMBswRequestedMode=BSWM_ECUSTATE_ENTRY_OFF
          MC_IMM_GenericRequest_EcuState_EQ_ENTRY_RESET: BswMConditionType=BSWM_EQUALS, BswMConditionMode=MRP_IMM_GenericRequest_EcuState
            BswMConditionValue: category=TOOL_CONFIGURED
              BswMBswMode: category=TOOL_CONFIGURED, BswMBswRequestedMode=BSWM_ECUSTATE_ENTRY_RESET
          MC_IMM_GenericRequest_EcuState_EQ_ENTRY_RUN: BswMConditionType=BSWM_EQUALS, BswMConditionMode=MRP_IMM_GenericRequest_EcuState
            BswMConditionValue: category=TOOL_CONFIGURED
              BswMBswMode: category=TOOL_CONFIGURED, BswMBswRequestedMode=BSWM_ECUSTATE_ENTRY_RUN
          MC_IMM_GenericRequest_EcuState_EQ_ENTRY_SHUTDOWN: BswMConditionType=BSWM_EQUALS, BswMConditionMode=MRP_IMM_GenericRequest_EcuState
            BswMConditionValue: category=TOOL_CONFIGURED
              BswMBswMode: category=TOOL_CONFIGURED, BswMBswRequestedMode=BSWM_ECUSTATE_ENTRY_SHUTDOWN
          MC_IMM_GenericRequest_EcuState_EQ_ENTRY_SLEEP: BswMConditionType=BSWM_EQUALS, BswMConditionMode=MRP_IMM_GenericRequest_EcuState
            BswMConditionValue: category=TOOL_CONFIGURED
              BswMBswMode: category=TOOL_CONFIGURED, BswMBswRequestedMode=BSWM_ECUSTATE_ENTRY_SLEEP
          MC_IMM_GenericRequest_EcuState_EQ_ENTRY_STARTUP_TWO: BswMConditionType=BSWM_EQUALS, BswMConditionMode=MRP_IMM_GenericRequest_EcuState
            BswMConditionValue: category=TOOL_CONFIGURED
              BswMBswMode: category=TOOL_CONFIGURED, BswMBswRequestedMode=BSWM_ECUSTATE_ENTRY_STARTUP_TWO
          MC_IMM_GenericRequest_EcuState_EQ_EXIT_RUN: BswMConditionType=BSWM_EQUALS, BswMConditionMode=MRP_IMM_GenericRequest_EcuState
            BswMConditionValue: category=TOOL_CONFIGURED
              BswMBswMode: category=TOOL_CONFIGURED, BswMBswRequestedMode=BSWM_ECUSTATE_EXIT_RUN
          MC_IMM_GenericRequest_EcuState_EQ_EXIT_SHUTDOWN: BswMConditionType=BSWM_EQUALS, BswMConditionMode=MRP_IMM_GenericRequest_EcuState
            BswMConditionValue: category=TOOL_CONFIGURED
              BswMBswMode: category=TOOL_CONFIGURED, BswMBswRequestedMode=BSWM_ECUSTATE_EXIT_SHUTDOWN
          MC_IMM_GenericRequest_EcuState_EQ_EXIT_SLEEP: BswMConditionType=BSWM_EQUALS, BswMConditionMode=MRP_IMM_GenericRequest_EcuState
            BswMConditionValue: category=TOOL_CONFIGURED
              BswMBswMode: category=TOOL_CONFIGURED, BswMBswRequestedMode=BSWM_ECUSTATE_EXIT_SLEEP
          MC_IMM_GenericRequest_EcuState_EQ_EXIT_STARTUP_TWO: BswMConditionType=BSWM_EQUALS, BswMConditionMode=MRP_IMM_GenericRequest_EcuState
            BswMConditionValue: category=TOOL_CONFIGURED
              BswMBswMode: category=TOOL_CONFIGURED, BswMBswRequestedMode=BSWM_ECUSTATE_EXIT_STARTUP_TWO
          MC_IMM_GenericRequest_ShutdownTarget_EQ_OFF: BswMConditionType=BSWM_EQUALS, BswMConditionMode=MRP_IMM_GenericRequest_ShutdownTarget
            BswMConditionValue: category=TOOL_CONFIGURED
              BswMBswMode: category=TOOL_CONFIGURED, BswMBswRequestedMode=BSWM_SHUTDOWNTARGET_OFF
          MC_IMM_GenericRequest_ShutdownTarget_EQ_RESET: BswMConditionType=BSWM_EQUALS, BswMConditionMode=MRP_IMM_GenericRequest_ShutdownTarget
            BswMConditionValue: category=TOOL_CONFIGURED
              BswMBswMode: category=TOOL_CONFIGURED, BswMBswRequestedMode=BSWM_SHUTDOWNTARGET_RESET
          MC_IMM_GenericRequest_ShutdownTarget_EQ_RUN: BswMConditionType=BSWM_EQUALS, BswMConditionMode=MRP_IMM_GenericRequest_ShutdownTarget
            BswMConditionValue: category=TOOL_CONFIGURED
              BswMBswMode: category=TOOL_CONFIGURED, BswMBswRequestedMode=BSWM_SHUTDOWNTARGET_RUN
          MC_IMM_GenericRequest_ShutdownTarget_EQ_SLEEP: BswMConditionType=BSWM_EQUALS, BswMConditionMode=MRP_IMM_GenericRequest_ShutdownTarget
            BswMConditionValue: category=TOOL_CONFIGURED
              BswMBswMode: category=TOOL_CONFIGURED, BswMBswRequestedMode=BSWM_SHUTDOWNTARGET_SLEEP
          MC_IMM_SwcModeRequest_ComMMode_BCAN_EQ_COMM_MODE_FULL_COM: BswMConditionType=BSWM_EQUALS, BswMConditionMode=MRP_IMM_SwcModeRequest_ComMMode_BCAN
            BswMConditionValue: category=TOOL_CONFIGURED
              BswMBswMode: category=TOOL_CONFIGURED, BswMBswRequestedMode=COMM_MODE_FULL_COM
          MC_IMM_SwcModeRequest_ComMMode_BCAN_EQ_COMM_MODE_NO_COM: BswMConditionType=BSWM_EQUALS, BswMConditionMode=MRP_IMM_SwcModeRequest_ComMMode_BCAN
            BswMConditionValue: category=TOOL_CONFIGURED
              BswMBswMode: category=TOOL_CONFIGURED, BswMBswRequestedMode=COMM_MODE_NO_COM
        76 x BswMLogicalExpression, all with category=TOOL_CONFIGURED:
          LE_BCAN_COMM_DISABLE_DM: BswMArgumentRef=MC_IMM_ComMIndication_BCAN_EN_FULL_COM
          LE_BCAN_COMM_DISABLE_RX: BswMArgumentRef=MC_IMM_ComMIndication_BCAN_EQ_NO_COM
          LE_BCAN_COMM_DISABLE_TX: BswMLogicalOperator=BSWM_OR, BswMArgumentRef=MC_IMM_ComMIndication_BCAN_EQ_NO_COM, BswMArgumentRef=MC_IMM_ComMIndication_BCAN_EQ_SILENT_COM
          LE_BCAN_COMM_ENABLE_DM: BswMArgumentRef=MC_IMM_ComMIndication_BCAN_EQ_FULL_COM
          LE_BCAN_COMM_ENABLE_RX: BswMLogicalOperator=BSWM_OR, BswMArgumentRef=MC_IMM_ComMIndication_BCAN_EQ_FULL_COM, BswMArgumentRef=MC_IMM_ComMIndication_BCAN_EQ_SILENT_COM
          LE_BCAN_COMM_ENABLE_TX: BswMArgumentRef=MC_IMM_ComMIndication_BCAN_EQ_FULL_COM
          LE_BCAN_DCM_DISABLE_RX: BswMLogicalOperator=BSWM_OR, BswMArgumentRef=MC_IMM_DcmComModeRequest_BCAN_EQ_DISABLE_RX_ENABLE_TX_NORM, BswMArgumentRef=MC_IMM_DcmComModeRequest_BCAN_EQ_DISABLE_RX_ENABLE_TX_NORM_NM, BswMArgumentRef=MC_IMM_DcmComModeRequest_BCAN_EQ_DISABLE_RX_TX_NORM, BswMArgumentRef=MC_IMM_DcmComModeRequest_BCAN_EQ_DISABLE_RX_TX_NORM_NM
          LE_BCAN_DCM_DISABLE_TX: BswMLogicalOperator=BSWM_OR, BswMArgumentRef=MC_IMM_DcmComModeRequest_BCAN_EQ_DISABLE_RX_TX_NORM, BswMArgumentRef=MC_IMM_DcmComModeRequest_BCAN_EQ_DISABLE_RX_TX_NORM_NM, BswMArgumentRef=MC_IMM_DcmComModeRequest_BCAN_EQ_ENABLE_RX_DISABLE_TX_NORM, BswMArgumentRef=MC_IMM_DcmComModeRequest_BCAN_EQ_ENABLE_RX_DISABLE_TX_NORM_NM
          LE_BCAN_DCM_ENABLE_RX: BswMLogicalOperator=BSWM_OR, BswMArgumentRef=MC_IMM_DcmComModeRequest_BCAN_EQ_ENABLE_RX_DISABLE_TX_NORM, BswMArgumentRef=MC_IMM_DcmComModeRequest_BCAN_EQ_ENABLE_RX_DISABLE_TX_NORM_NM, BswMArgumentRef=MC_IMM_DcmComModeRequest_BCAN_EQ_ENABLE_RX_TX_NORM, BswMArgumentRef=MC_IMM_DcmComModeRequest_BCAN_EQ_ENABLE_RX_TX_NORM_NM
          LE_BCAN_DCM_ENABLE_TX: BswMLogicalOperator=BSWM_OR, BswMArgumentRef=MC_IMM_DcmComModeRequest_BCAN_EQ_DISABLE_RX_ENABLE_TX_NORM, BswMArgumentRef=MC_IMM_DcmComModeRequest_BCAN_EQ_DISABLE_RX_ENABLE_TX_NORM_NM, BswMArgumentRef=MC_IMM_DcmComModeRequest_BCAN_EQ_ENABLE_RX_TX_NORM, BswMArgumentRef=MC_IMM_DcmComModeRequest_BCAN_EQ_ENABLE_RX_TX_NORM_NM
          LE_ComMIndication_ALL_FULL_COM: BswMArgumentRef=MC_IMM_ComMIndication_BCAN_EQ_FULL_COM
          LE_ComMIndication_ALL_NO_COM: BswMArgumentRef=MC_IMM_ComMIndication_BCAN_EQ_NO_COM
          LE_EcuGoDownTypes: BswMLogicalOperator=BSWM_OR, BswMArgumentRef=MC_IMM_GenericRequest_ShutdownTarget_EQ_OFF, BswMArgumentRef=MC_IMM_GenericRequest_ShutdownTarget_EQ_RESET
          LE_EcuResetTypes: BswMArgumentRef=MC_IMM_BswModeNotification_modeNotificationPort_DcmEcuReset_EQ_EXECUTE
          LE_EcuSleepAllowed: BswMArgumentRef=LE_ComMIndication_ALL_NO_COM
          RuleLE_CanBorNotification_BCAN_COMPLETE: BswMArgumentRef=MC_IMM_GenericRequest_CanSMBOR_BCAN_EQ_COMPLETE
          RuleLE_CanBorNotification_BCAN_START: BswMArgumentRef=MC_IMM_GenericRequest_CanSMBOR_BCAN_EQ_START
          RuleLE_CanStateNotification_BCAN_BUS_OFF: BswMArgumentRef=MC_IMM_CanSMIndication_BCAN_EQ_BUS_OFF
          RuleLE_CanStateNotification_BCAN_CHANGE_BAUDRATE: BswMArgumentRef=MC_IMM_CanSMIndication_BCAN_EQ_CHANGE_BAUDRATE
          RuleLE_CanStateNotification_BCAN_FULL_COM: BswMArgumentRef=MC_IMM_CanSMIndication_BCAN_EQ_FULL_COM
          RuleLE_CanStateNotification_BCAN_NO_COM: BswMArgumentRef=MC_IMM_CanSMIndication_BCAN_EQ_NO_COM
          RuleLE_CanStateNotification_BCAN_SILENT_COM: BswMArgumentRef=MC_IMM_CanSMIndication_BCAN_EQ_SILENT_COM
          RuleLE_ComControl_BCAN_DISABLE_DM: BswMArgumentRef=LE_BCAN_COMM_DISABLE_DM
          RuleLE_ComControl_BCAN_DISABLE_RX: BswMLogicalOperator=BSWM_OR, BswMArgumentRef=LE_BCAN_COMM_DISABLE_RX, BswMArgumentRef=LE_BCAN_DCM_DISABLE_RX
          RuleLE_ComControl_BCAN_DISABLE_TX: BswMLogicalOperator=BSWM_OR, BswMArgumentRef=LE_BCAN_COMM_DISABLE_TX, BswMArgumentRef=LE_BCAN_DCM_DISABLE_TX
          RuleLE_ComControl_BCAN_ENABLE_DM: BswMArgumentRef=LE_BCAN_COMM_ENABLE_DM
          RuleLE_ComControl_BCAN_ENABLE_RX: BswMLogicalOperator=BSWM_AND, BswMArgumentRef=LE_BCAN_COMM_ENABLE_RX, BswMArgumentRef=LE_BCAN_DCM_ENABLE_RX
          RuleLE_ComControl_BCAN_ENABLE_TX: BswMLogicalOperator=BSWM_AND, BswMArgumentRef=LE_BCAN_COMM_ENABLE_TX, BswMArgumentRef=LE_BCAN_DCM_ENABLE_TX
          RuleLE_ComModeNotification_BCAN_FULL_COM: BswMArgumentRef=MC_IMM_ComMIndication_BCAN_EQ_FULL_COM
          RuleLE_ComModeNotification_BCAN_NO_COM: BswMArgumentRef=MC_IMM_ComMIndication_BCAN_EQ_NO_COM
          RuleLE_ComModeNotification_BCAN_SILENT_COM: BswMArgumentRef=MC_IMM_ComMIndication_BCAN_EQ_SILENT_COM
          RuleLE_ComModeRequest_BCAN_FULL_COM: BswMArgumentRef=MC_IMM_SwcModeRequest_ComMMode_BCAN_EQ_COMM_MODE_FULL_COM
          RuleLE_ComModeRequest_BCAN_NO_COM: BswMArgumentRef=MC_IMM_SwcModeRequest_ComMMode_BCAN_EQ_COMM_MODE_NO_COM
          RuleLE_DcmApplicationUpdatedNotification_APP_NOT_UPDATED: BswMArgumentRef=MC_IMM_DcmApplicationUpdatedIndication_EQ_APP_NOT_UPDATED
          RuleLE_DcmApplicationUpdatedNotification_APP_UPDATED: BswMArgumentRef=MC_IMM_DcmApplicationUpdatedIndication_EQ_APP_UPDATED
          RuleLE_DcmCommunicationControl_0_DCM_DISABLE_RX_DISABLE_TX_NM: BswMArgumentRef=MC_IMM_BswModeNotification_modeNotificationPort_DcmCommunicationControl_0_EQ_DCM_DISABLE_RX_DISABLE_TX_NM
          RuleLE_DcmCommunicationControl_0_DCM_DISABLE_RX_ENABLE_TX_NORM: BswMArgumentRef=MC_IMM_BswModeNotification_modeNotificationPort_DcmCommunicationControl_0_EQ_DCM_DISABLE_RX_ENABLE_TX_NORM
          RuleLE_DcmCommunicationControl_0_DCM_DISABLE_RX_ENABLE_TX_NORM_NM: BswMArgumentRef=MC_IMM_BswModeNotification_modeNotificationPort_DcmCommunicationControl_0_EQ_DCM_DISABLE_RX_ENABLE_TX_NORM_NM
          RuleLE_DcmCommunicationControl_0_DCM_DISABLE_RX_TX_NM: BswMArgumentRef=MC_IMM_BswModeNotification_modeNotificationPort_DcmCommunicationControl_0_EQ_DCM_DISABLE_RX_TX_NM
          RuleLE_DcmCommunicationControl_0_DCM_DISABLE_RX_TX_NORMAL: BswMArgumentRef=MC_IMM_BswModeNotification_modeNotificationPort_DcmCommunicationControl_0_EQ_DCM_DISABLE_RX_TX_NORMAL
          RuleLE_DcmCommunicationControl_0_DCM_DISABLE_RX_TX_NORM_NM: BswMArgumentRef=MC_IMM_BswModeNotification_modeNotificationPort_DcmCommunicationControl_0_EQ_DCM_DISABLE_RX_TX_NORM_NM
          RuleLE_DcmCommunicationControl_0_DCM_ENABLE_RX_DISABLE_TX_NM: BswMArgumentRef=MC_IMM_BswModeNotification_modeNotificationPort_DcmCommunicationControl_0_EQ_DCM_ENABLE_RX_DISABLE_TX_NM
          RuleLE_DcmCommunicationControl_0_DCM_ENABLE_RX_DISABLE_TX_NORM: BswMArgumentRef=MC_IMM_BswModeNotification_modeNotificationPort_DcmCommunicationControl_0_EQ_DCM_ENABLE_RX_DISABLE_TX_NORM
          RuleLE_DcmCommunicationControl_0_DCM_ENABLE_RX_DISABLE_TX_NORM_NM: BswMArgumentRef=MC_IMM_BswModeNotification_modeNotificationPort_DcmCommunicationControl_0_EQ_DCM_ENABLE_RX_DISABLE_TX_NORM_NM
          RuleLE_DcmCommunicationControl_0_DCM_ENABLE_RX_TX_NM: BswMArgumentRef=MC_IMM_BswModeNotification_modeNotificationPort_DcmCommunicationControl_0_EQ_DCM_ENABLE_RX_TX_NM
          RuleLE_DcmCommunicationControl_0_DCM_ENABLE_RX_TX_NORM: BswMArgumentRef=MC_IMM_BswModeNotification_modeNotificationPort_DcmCommunicationControl_0_EQ_DCM_ENABLE_RX_TX_NORM
          RuleLE_DcmCommunicationControl_0_DCM_ENABLE_RX_TX_NORM_NM: BswMArgumentRef=MC_IMM_BswModeNotification_modeNotificationPort_DcmCommunicationControl_0_EQ_DCM_ENABLE_RX_TX_NORM_NM
          RuleLE_DcmControlDTCSetting_DISABLEDTCSETTING: BswMArgumentRef=MC_IMM_BswModeNotification_modeNotificationPort_DcmControlDTCSetting_EQ_DISABLEDTCSETTING
          RuleLE_DcmControlDTCSetting_ENABLEDTCSETTING: BswMArgumentRef=MC_IMM_BswModeNotification_modeNotificationPort_DcmControlDTCSetting_EQ_ENABLEDTCSETTING
          RuleLE_DcmModeRapidPowerShutDown_DISABLE_RAPIDPOWERSHUTDOWN: BswMArgumentRef=MC_IMM_BswModeNotification_modeNotificationPort_DcmModeRapidPowerShutDown_EQ_DISABLE_RAPIDPOWERSHUTDOWN
          RuleLE_DcmModeRapidPowerShutDown_ENABLE_RAPIDPOWERSHUTDOWN: BswMArgumentRef=MC_IMM_BswModeNotification_modeNotificationPort_DcmModeRapidPowerShutDown_EQ_ENABLE_RAPIDPOWERSHUTDOWN
          RuleLE_DiagnosticSessionNotification_DEFAULT_SESSION: BswMArgumentRef=MC_IMM_BswModeNotification_modeNotificationPort_DcmDiagnosticSessionControl_EQ_DCM_DEFAULT_SESSION
          RuleLE_DiagnosticSessionNotification_ECU_PROGRAMMING_MODE: BswMArgumentRef=MC_IMM_BswModeNotification_modeNotificationPort_DcmDiagnosticSessionControl_EQ_DCM_ECU_PROGRAMMING_MODE
          RuleLE_DiagnosticSessionNotification_EXTENDED_DIAGNOSTIC_MODE: BswMArgumentRef=MC_IMM_BswModeNotification_modeNotificationPort_DcmDiagnosticSessionControl_EQ_DCM_EXTENDED_DIAGNOSTIC_MODE
          RuleLE_DiagnosticSessionNotification_EXTENDED_DIAGNOSTIC_SESSION: BswMArgumentRef=MC_IMM_BswModeNotification_modeNotificationPort_DcmDiagnosticSessionControl_EQ_DCM_EXTENDED_DIAGNOSTIC_SESSION
          RuleLE_DiagnosticSessionNotification_PROGRAMMING_SESSION: BswMArgumentRef=MC_IMM_BswModeNotification_modeNotificationPort_DcmDiagnosticSessionControl_EQ_DCM_PROGRAMMING_SESSION
          RuleLE_DiagnosticSessionNotification_QUIESCENT_CURRENT_DIAGNOSTIC_MODE_START: BswMArgumentRef=MC_IMM_BswModeNotification_modeNotificationPort_DcmDiagnosticSessionControl_EQ_DCM_QUIESCENT_CURRENT_DIAGNOSTIC_MODE_START
          RuleLE_DiagnosticSessionNotification_SAFETY_SYSTEM_DIAGNOSTIC_SESSION: BswMArgumentRef=MC_IMM_BswModeNotification_modeNotificationPort_DcmDiagnosticSessionControl_EQ_DCM_SAFETY_SYSTEM_DIAGNOSTIC_SESSION
          RuleLE_DiagnosticSessionNotification_SLEEP_MODE_START_REQUEST: BswMArgumentRef=MC_IMM_BswModeNotification_modeNotificationPort_DcmDiagnosticSessionControl_EQ_DCM_SLEEP_MODE_START_REQUEST
          RuleLE_EcuStateTo_OFF: BswMLogicalOperator=BSWM_AND, BswMArgumentRef=MC_IMM_GenericRequest_EcuState_EQ_EXIT_SHUTDOWN, BswMArgumentRef=MC_IMM_GenericRequest_ShutdownTarget_EQ_OFF
          RuleLE_EcuStateTo_RESET: BswMLogicalOperator=BSWM_AND, BswMArgumentRef=MC_IMM_GenericRequest_EcuState_EQ_EXIT_SHUTDOWN, BswMArgumentRef=MC_IMM_GenericRequest_ShutdownTarget_EQ_RESET
          RuleLE_EcuStateTo_RUN_From_SLEEP: BswMLogicalOperator=BSWM_AND, BswMArgumentRef=MC_IMM_GenericRequest_EcuState_EQ_EXIT_SLEEP, BswMArgumentRef=MC_IMM_GenericRequest_ShutdownTarget_EQ_RUN
          RuleLE_EcuStateTo_RUN_From_STARTUP: BswMLogicalOperator=BSWM_AND, BswMArgumentRef=MC_IMM_GenericRequest_EcuState_EQ_EXIT_STARTUP_TWO, BswMArgumentRef=MC_IMM_GenericRequest_ShutdownTarget_EQ_RUN
          RuleLE_EcuStateTo_SHUTDOWN: BswMLogicalOperator=BSWM_AND, BswMArgumentRef=LE_EcuGoDownTypes, BswMArgumentRef=MC_IMM_GenericRequest_EcuState_EQ_EXIT_RUN
          RuleLE_EcuStateTo_SLEEP: BswMLogicalOperator=BSWM_AND, BswMArgumentRef=LE_EcuSleepAllowed, BswMArgumentRef=MC_IMM_GenericRequest_EcuState_EQ_EXIT_RUN, BswMArgumentRef=MC_IMM_GenericRequest_ShutdownTarget_EQ_SLEEP
          RuleLE_EcuStateTo_STARTUP_TWO: BswMArgumentRef=MC_IMM_EcuMIndication_EQ_STARTUP_TWO
          RuleLE_EcuState_OFF: BswMArgumentRef=MC_IMM_GenericRequest_EcuState_EQ_ENTRY_OFF
          RuleLE_EcuState_RESET: BswMArgumentRef=MC_IMM_GenericRequest_EcuState_EQ_ENTRY_RESET
          RuleLE_EcuState_RUN: BswMArgumentRef=MC_IMM_GenericRequest_EcuState_EQ_ENTRY_RUN
          RuleLE_EcuState_SHUTDOWN: BswMArgumentRef=MC_IMM_GenericRequest_EcuState_EQ_ENTRY_SHUTDOWN
          RuleLE_EcuState_SLEEP: BswMArgumentRef=MC_IMM_GenericRequest_EcuState_EQ_ENTRY_SLEEP
          RuleLE_EcuState_STARTUP_TWO: BswMArgumentRef=MC_IMM_GenericRequest_EcuState_EQ_ENTRY_STARTUP_TWO
          RuleLE_ShutdownTargetTo_OFF: BswMArgumentRef=MC_IMM_GenericRequest_ShutdownTarget_EQ_RUN
          RuleLE_ShutdownTargetTo_RESET: BswMLogicalOperator=BSWM_AND, BswMArgumentRef=LE_EcuResetTypes, BswMArgumentRef=MC_IMM_GenericRequest_ShutdownTarget_EQ_RUN
          RuleLE_ShutdownTargetTo_RUN: BswMArgumentRef=MC_IMM_GenericRequest_ShutdownTarget_EQ_SLEEP
          RuleLE_ShutdownTargetTo_SLEEP: BswMArgumentRef=MC_IMM_GenericRequest_ShutdownTarget_EQ_RUN
        55 x BswMRule, all with category=TOOL_CONFIGURED, BswMNestedExecutionOnly=0:
          Rule_CanBorNotification_BCAN_COMPLETE: BswMRuleInitState=BSWM_TRUE, BswMRuleExpressionRef=RuleLE_CanBorNotification_BCAN_COMPLETE, BswMRuleTrueActionList=TrueAL_CanBorNotification_BCAN_COMPLETE
          Rule_CanBorNotification_BCAN_START: BswMRuleInitState=BSWM_FALSE, BswMRuleExpressionRef=RuleLE_CanBorNotification_BCAN_START, BswMRuleTrueActionList=TrueAL_CanBorNotification_BCAN_START
          Rule_CanStateNotification_BCAN_BUS_OFF: BswMRuleInitState=BSWM_FALSE, BswMRuleExpressionRef=RuleLE_CanStateNotification_BCAN_BUS_OFF, BswMRuleTrueActionList=TrueAL_CanStateNotification_BCAN_BUS_OFF
          Rule_CanStateNotification_BCAN_CHANGE_BAUDRATE: BswMRuleInitState=BSWM_FALSE, BswMRuleExpressionRef=RuleLE_CanStateNotification_BCAN_CHANGE_BAUDRATE, BswMRuleTrueActionList=TrueAL_CanStateNotification_BCAN_CHANGE_BAUDRATE
          Rule_CanStateNotification_BCAN_FULL_COM: BswMRuleInitState=BSWM_FALSE, BswMRuleExpressionRef=RuleLE_CanStateNotification_BCAN_FULL_COM, BswMRuleTrueActionList=TrueAL_CanStateNotification_BCAN_FULL_COM
          Rule_CanStateNotification_BCAN_NO_COM: BswMRuleInitState=BSWM_FALSE, BswMRuleExpressionRef=RuleLE_CanStateNotification_BCAN_NO_COM, BswMRuleTrueActionList=TrueAL_CanStateNotification_BCAN_NO_COM
          Rule_CanStateNotification_BCAN_SILENT_COM: BswMRuleInitState=BSWM_FALSE, BswMRuleExpressionRef=RuleLE_CanStateNotification_BCAN_SILENT_COM, BswMRuleTrueActionList=TrueAL_CanStateNotification_BCAN_SILENT_COM
          Rule_ComModeNotification_BCAN_FULL_COM: BswMRuleInitState=BSWM_FALSE, BswMRuleExpressionRef=RuleLE_ComModeNotification_BCAN_FULL_COM, BswMRuleTrueActionList=TrueAL_ComModeNotification_BCAN_FULL_COM
          Rule_ComModeNotification_BCAN_NO_COM: BswMRuleInitState=BSWM_FALSE, BswMRuleExpressionRef=RuleLE_ComModeNotification_BCAN_NO_COM, BswMRuleTrueActionList=TrueAL_ComModeNotification_BCAN_NO_COM
          Rule_ComModeNotification_BCAN_SILENT_COM: BswMRuleInitState=BSWM_FALSE, BswMRuleExpressionRef=RuleLE_ComModeNotification_BCAN_SILENT_COM, BswMRuleTrueActionList=TrueAL_ComModeNotification_BCAN_SILENT_COM
          Rule_ComModeRequest_BCAN_FULL_COM: BswMRuleInitState=BSWM_FALSE, BswMRuleExpressionRef=RuleLE_ComModeRequest_BCAN_FULL_COM, BswMRuleTrueActionList=TrueAL_ComModeRequest_BCAN_FULL_COM
          Rule_ComModeRequest_BCAN_NO_COM: BswMRuleInitState=BSWM_FALSE, BswMRuleExpressionRef=RuleLE_ComModeRequest_BCAN_NO_COM, BswMRuleTrueActionList=TrueAL_ComModeRequest_BCAN_NO_COM
          Rule_DcmApplicationUpdatedNotification_APP_NOT_UPDATED: BswMRuleInitState=BSWM_FALSE, BswMRuleExpressionRef=RuleLE_DcmApplicationUpdatedNotification_APP_NOT_UPDATED, BswMRuleTrueActionList=TrueAL_DcmApplicationUpdatedNotification_APP_NOT_UPDATED
          Rule_DcmApplicationUpdatedNotification_APP_UPDATED: BswMRuleInitState=BSWM_FALSE, BswMRuleExpressionRef=RuleLE_DcmApplicationUpdatedNotification_APP_UPDATED, BswMRuleTrueActionList=TrueAL_DcmApplicationUpdatedNotification_APP_UPDATED
          Rule_DcmCommunicationControl_0_DCM_DISABLE_RX_DISABLE_TX_NM: BswMRuleInitState=BSWM_FALSE, BswMRuleExpressionRef=RuleLE_DcmCommunicationControl_0_DCM_DISABLE_RX_DISABLE_TX_NM, BswMRuleTrueActionList=TrueAL_DcmCommunicationControl_0_DCM_DISABLE_RX_DISABLE_TX_NM
          Rule_DcmCommunicationControl_0_DCM_DISABLE_RX_ENABLE_TX_NORM: BswMRuleInitState=BSWM_FALSE, BswMRuleExpressionRef=RuleLE_DcmCommunicationControl_0_DCM_DISABLE_RX_ENABLE_TX_NORM, BswMRuleTrueActionList=TrueAL_DcmCommunicationControl_0_DCM_DISABLE_RX_ENABLE_TX_NORM
          Rule_DcmCommunicationControl_0_DCM_DISABLE_RX_ENABLE_TX_NORM_NM: BswMRuleInitState=BSWM_FALSE, BswMRuleExpressionRef=RuleLE_DcmCommunicationControl_0_DCM_DISABLE_RX_ENABLE_TX_NORM_NM, BswMRuleTrueActionList=TrueAL_DcmCommunicationControl_0_DCM_DISABLE_RX_ENABLE_TX_NORM_NM
          Rule_DcmCommunicationControl_0_DCM_DISABLE_RX_TX_NM: BswMRuleInitState=BSWM_FALSE, BswMRuleExpressionRef=RuleLE_DcmCommunicationControl_0_DCM_DISABLE_RX_TX_NM, BswMRuleTrueActionList=TrueAL_DcmCommunicationControl_0_DCM_DISABLE_RX_TX_NM
          Rule_DcmCommunicationControl_0_DCM_DISABLE_RX_TX_NORMAL: BswMRuleInitState=BSWM_FALSE, BswMRuleExpressionRef=RuleLE_DcmCommunicationControl_0_DCM_DISABLE_RX_TX_NORMAL, BswMRuleTrueActionList=TrueAL_DcmCommunicationControl_0_DCM_DISABLE_RX_TX_NORMAL
          Rule_DcmCommunicationControl_0_DCM_DISABLE_RX_TX_NORM_NM: BswMRuleInitState=BSWM_FALSE, BswMRuleExpressionRef=RuleLE_DcmCommunicationControl_0_DCM_DISABLE_RX_TX_NORM_NM, BswMRuleTrueActionList=TrueAL_DcmCommunicationControl_0_DCM_DISABLE_RX_TX_NORM_NM
          Rule_DcmCommunicationControl_0_DCM_ENABLE_RX_DISABLE_TX_NM: BswMRuleInitState=BSWM_FALSE, BswMRuleExpressionRef=RuleLE_DcmCommunicationControl_0_DCM_ENABLE_RX_DISABLE_TX_NM, BswMRuleTrueActionList=TrueAL_DcmCommunicationControl_0_DCM_ENABLE_RX_DISABLE_TX_NM
          Rule_DcmCommunicationControl_0_DCM_ENABLE_RX_DISABLE_TX_NORM: BswMRuleInitState=BSWM_FALSE, BswMRuleExpressionRef=RuleLE_DcmCommunicationControl_0_DCM_ENABLE_RX_DISABLE_TX_NORM, BswMRuleTrueActionList=TrueAL_DcmCommunicationControl_0_DCM_ENABLE_RX_DISABLE_TX_NORM
          Rule_DcmCommunicationControl_0_DCM_ENABLE_RX_DISABLE_TX_NORM_NM: BswMRuleInitState=BSWM_FALSE, BswMRuleExpressionRef=RuleLE_DcmCommunicationControl_0_DCM_ENABLE_RX_DISABLE_TX_NORM_NM, BswMRuleTrueActionList=TrueAL_DcmCommunicationControl_0_DCM_ENABLE_RX_DISABLE_TX_NORM_NM
          Rule_DcmCommunicationControl_0_DCM_ENABLE_RX_TX_NM: BswMRuleInitState=BSWM_FALSE, BswMRuleExpressionRef=RuleLE_DcmCommunicationControl_0_DCM_ENABLE_RX_TX_NM, BswMRuleTrueActionList=TrueAL_DcmCommunicationControl_0_DCM_ENABLE_RX_TX_NM
          Rule_DcmCommunicationControl_0_DCM_ENABLE_RX_TX_NORM: BswMRuleInitState=BSWM_FALSE, BswMRuleExpressionRef=RuleLE_DcmCommunicationControl_0_DCM_ENABLE_RX_TX_NORM, BswMRuleTrueActionList=TrueAL_DcmCommunicationControl_0_DCM_ENABLE_RX_TX_NORM
          Rule_DcmCommunicationControl_0_DCM_ENABLE_RX_TX_NORM_NM: BswMRuleInitState=BSWM_FALSE, BswMRuleExpressionRef=RuleLE_DcmCommunicationControl_0_DCM_ENABLE_RX_TX_NORM_NM, BswMRuleTrueActionList=TrueAL_DcmCommunicationControl_0_DCM_ENABLE_RX_TX_NORM_NM
          Rule_DcmControlDTCSetting_DISABLEDTCSETTING: BswMRuleInitState=BSWM_FALSE, BswMRuleExpressionRef=RuleLE_DcmControlDTCSetting_DISABLEDTCSETTING, BswMRuleTrueActionList=TrueAL_DcmControlDTCSetting_DISABLEDTCSETTING
          Rule_DcmControlDTCSetting_ENABLEDTCSETTING: BswMRuleInitState=BSWM_FALSE, BswMRuleExpressionRef=RuleLE_DcmControlDTCSetting_ENABLEDTCSETTING, BswMRuleTrueActionList=TrueAL_DcmControlDTCSetting_ENABLEDTCSETTING
          Rule_DcmModeRapidPowerShutDown_DISABLE_RAPIDPOWERSHUTDOWN: BswMRuleInitState=BSWM_FALSE, BswMRuleExpressionRef=RuleLE_DcmModeRapidPowerShutDown_DISABLE_RAPIDPOWERSHUTDOWN, BswMRuleTrueActionList=TrueAL_DcmModeRapidPowerShutDown_DISABLE_RAPIDPOWERSHUTDOWN
          Rule_DcmModeRapidPowerShutDown_ENABLE_RAPIDPOWERSHUTDOWN: BswMRuleInitState=BSWM_FALSE, BswMRuleExpressionRef=RuleLE_DcmModeRapidPowerShutDown_ENABLE_RAPIDPOWERSHUTDOWN, BswMRuleTrueActionList=TrueAL_DcmModeRapidPowerShutDown_ENABLE_RAPIDPOWERSHUTDOWN
          Rule_DiagnosticSessionNotification_DEFAULT_SESSION: BswMRuleInitState=BSWM_FALSE, BswMRuleExpressionRef=RuleLE_DiagnosticSessionNotification_DEFAULT_SESSION, BswMRuleTrueActionList=TrueAL_DiagnosticSessionNotification_DEFAULT_SESSION
          Rule_DiagnosticSessionNotification_ECU_PROGRAMMING_MODE: BswMRuleInitState=BSWM_FALSE, BswMRuleExpressionRef=RuleLE_DiagnosticSessionNotification_ECU_PROGRAMMING_MODE, BswMRuleTrueActionList=TrueAL_DiagnosticSessionNotification_ECU_PROGRAMMING_MODE
          Rule_DiagnosticSessionNotification_EXTENDED_DIAGNOSTIC_MODE: BswMRuleInitState=BSWM_FALSE, BswMRuleExpressionRef=RuleLE_DiagnosticSessionNotification_EXTENDED_DIAGNOSTIC_MODE, BswMRuleTrueActionList=TrueAL_DiagnosticSessionNotification_EXTENDED_DIAGNOSTIC_MODE
          Rule_DiagnosticSessionNotification_EXTENDED_DIAGNOSTIC_SESSION: BswMRuleInitState=BSWM_FALSE, BswMRuleExpressionRef=RuleLE_DiagnosticSessionNotification_EXTENDED_DIAGNOSTIC_SESSION, BswMRuleTrueActionList=TrueAL_DiagnosticSessionNotification_EXTENDED_DIAGNOSTIC_SESSION
          Rule_DiagnosticSessionNotification_PROGRAMMING_SESSION: BswMRuleInitState=BSWM_FALSE, BswMRuleExpressionRef=RuleLE_DiagnosticSessionNotification_PROGRAMMING_SESSION, BswMRuleTrueActionList=TrueAL_DiagnosticSessionNotification_PROGRAMMING_SESSION
          Rule_DiagnosticSessionNotification_QUIESCENT_CURRENT_DIAGNOSTIC_MODE_START: BswMRuleInitState=BSWM_FALSE, BswMRuleExpressionRef=RuleLE_DiagnosticSessionNotification_QUIESCENT_CURRENT_DIAGNOSTIC_MODE_START, BswMRuleTrueActionList=TrueAL_DiagnosticSessionNotification_QUIESCENT_CURRENT_DIAGNOSTIC_MODE_START
          Rule_DiagnosticSessionNotification_SAFETY_SYSTEM_DIAGNOSTIC_SESSION: BswMRuleInitState=BSWM_FALSE, BswMRuleExpressionRef=RuleLE_DiagnosticSessionNotification_SAFETY_SYSTEM_DIAGNOSTIC_SESSION, BswMRuleTrueActionList=TrueAL_DiagnosticSessionNotification_SAFETY_SYSTEM_DIAGNOSTIC_SESSION
          Rule_DiagnosticSessionNotification_SLEEP_MODE_START_REQUEST: BswMRuleInitState=BSWM_FALSE, BswMRuleExpressionRef=RuleLE_DiagnosticSessionNotification_SLEEP_MODE_START_REQUEST, BswMRuleTrueActionList=TrueAL_DiagnosticSessionNotification_SLEEP_MODE_START_REQUEST
          Rule_EcuStateTo_OFF: BswMRuleInitState=BSWM_FALSE, BswMRuleExpressionRef=RuleLE_EcuStateTo_OFF, BswMRuleTrueActionList=TrueAL_EcuStateTo_OFF
          Rule_EcuStateTo_RESET: BswMRuleInitState=BSWM_FALSE, BswMRuleExpressionRef=RuleLE_EcuStateTo_RESET, BswMRuleTrueActionList=TrueAL_EcuStateTo_RESET
          Rule_EcuStateTo_RUN_From_SLEEP: BswMRuleInitState=BSWM_FALSE, BswMRuleExpressionRef=RuleLE_EcuStateTo_RUN_From_SLEEP, BswMRuleTrueActionList=TrueAL_EcuStateTo_RUN_From_SLEEP
          Rule_EcuStateTo_RUN_From_STARTUP: BswMRuleInitState=BSWM_FALSE, BswMRuleExpressionRef=RuleLE_EcuStateTo_RUN_From_STARTUP, BswMRuleTrueActionList=TrueAL_EcuStateTo_RUN_From_STARTUP
          Rule_EcuStateTo_SHUTDOWN: BswMRuleInitState=BSWM_FALSE, BswMRuleExpressionRef=RuleLE_EcuStateTo_SHUTDOWN, BswMRuleTrueActionList=TrueAL_EcuStateTo_SHUTDOWN
          Rule_EcuStateTo_SLEEP: BswMRuleInitState=BSWM_FALSE, BswMRuleExpressionRef=RuleLE_EcuStateTo_SLEEP, BswMRuleTrueActionList=TrueAL_EcuStateTo_SLEEP
          Rule_EcuStateTo_STARTUP_TWO: BswMRuleInitState=BSWM_FALSE, BswMRuleExpressionRef=RuleLE_EcuStateTo_STARTUP_TWO, BswMRuleTrueActionList=TrueAL_EcuStateTo_STARTUP_TWO
          Rule_EcuState_OFF: BswMRuleInitState=BSWM_FALSE, BswMRuleExpressionRef=RuleLE_EcuState_OFF, BswMRuleTrueActionList=TrueAL_EcuState_OFF
          Rule_EcuState_RESET: BswMRuleInitState=BSWM_FALSE, BswMRuleExpressionRef=RuleLE_EcuState_RESET, BswMRuleTrueActionList=TrueAL_EcuState_RESET
          Rule_EcuState_RUN: BswMRuleInitState=BSWM_FALSE, BswMRuleExpressionRef=RuleLE_EcuState_RUN, BswMRuleTrueActionList=TrueAL_EcuState_RUN
          Rule_EcuState_SHUTDOWN: BswMRuleInitState=BSWM_FALSE, BswMRuleExpressionRef=RuleLE_EcuState_SHUTDOWN, BswMRuleTrueActionList=TrueAL_EcuState_SHUTDOWN
          Rule_EcuState_SLEEP: BswMRuleInitState=BSWM_FALSE, BswMRuleExpressionRef=RuleLE_EcuState_SLEEP, BswMRuleTrueActionList=TrueAL_EcuState_SLEEP
          Rule_EcuState_STARTUP_TWO: BswMRuleInitState=BSWM_FALSE, BswMRuleExpressionRef=RuleLE_EcuState_STARTUP_TWO, BswMRuleTrueActionList=TrueAL_EcuState_STARTUP_TWO
          Rule_ShutdownTargetTo_OFF: BswMRuleInitState=BSWM_FALSE, BswMRuleExpressionRef=RuleLE_ShutdownTargetTo_OFF, BswMRuleTrueActionList=TrueAL_ShutdownTargetTo_OFF
          Rule_ShutdownTargetTo_RESET: BswMRuleInitState=BSWM_FALSE, BswMRuleExpressionRef=RuleLE_ShutdownTargetTo_RESET, BswMRuleTrueActionList=TrueAL_ShutdownTargetTo_RESET
          Rule_ShutdownTargetTo_RUN: BswMRuleInitState=BSWM_FALSE, BswMRuleExpressionRef=RuleLE_ShutdownTargetTo_RUN, BswMRuleTrueActionList=TrueAL_ShutdownTargetTo_RUN
          Rule_ShutdownTargetTo_SLEEP: BswMRuleInitState=BSWM_FALSE, BswMRuleExpressionRef=RuleLE_ShutdownTargetTo_SLEEP, BswMRuleTrueActionList=TrueAL_ShutdownTargetTo_SLEEP
      BswMModeControl: category=TOOL_CONFIGURED
        74 x BswMAction, all with category=TOOL_CONFIGURED:
          AC_ComMAllowCom_BCAN_FALSE
            BswMAvailableActions: category=TOOL_CONFIGURED
              BswMComMAllowCom: category=TOOL_CONFIGURED, BswMComAllowed=0, BswMComMAllowChannelRef=ComMChannel_BCAN
          AC_ComMAllowCom_BCAN_TRUE
            BswMAvailableActions: category=TOOL_CONFIGURED
              BswMComMAllowCom: category=TOOL_CONFIGURED, BswMComAllowed=1, BswMComMAllowChannelRef=ComMChannel_BCAN
          AC_ComMModeSwitch_BCAN_FULL_COM
            BswMAvailableActions: category=TOOL_CONFIGURED
              BswMComMModeSwitch: category=TOOL_CONFIGURED, BswMComMRequestedMode=BSWM_FULL_COM, BswMComMUserRef=ComMUser_BCAN
          AC_ComMModeSwitch_BCAN_NO_COM
            BswMAvailableActions: category=TOOL_CONFIGURED
              BswMComMModeSwitch: category=TOOL_CONFIGURED, BswMComMRequestedMode=BSWM_NO_COM, BswMComMUserRef=ComMUser_BCAN
          AC_EcuMGoDown_BSWM
            BswMAvailableActions: category=TOOL_CONFIGURED
              BswMEcuMGoDown: category=TOOL_CONFIGURED, BswMEcuMUserIdRef=ECUM_USER_BSWM
          AC_EcuMSelectShutdownTarget_OFF
            BswMAvailableActions: category=TOOL_CONFIGURED
              BswMEcuMSelectShutdownTarget: category=TOOL_CONFIGURED, BswMEcuMShutdownTarget=ECUM_STATE_OFF
          AC_EcuMSelectShutdownTarget_RESET_MCU
            BswMAvailableActions: category=TOOL_CONFIGURED
              BswMEcuMSelectShutdownTarget: category=TOOL_CONFIGURED, BswMEcuMShutdownTarget=ECUM_STATE_RESET, BswMEcuMResetModeRef=ECUM_RESET_MCU
          AC_RteSwitch_CanSMBORState_BCAN_COMPLETE
            BswMAvailableActions: category=TOOL_CONFIGURED
              BswMRteSwitch: category=TOOL_CONFIGURED, BswMRteSwitchPortRef=CanSMBORState_BCAN, BswMSwitchedMode=COMPLETE
          AC_RteSwitch_CanSMBORState_BCAN_START
            BswMAvailableActions: category=TOOL_CONFIGURED
              BswMRteSwitch: category=TOOL_CONFIGURED, BswMRteSwitchPortRef=CanSMBORState_BCAN, BswMSwitchedMode=START
          AC_RteSwitch_CanSMState_BCAN_BUS_OFF
            BswMAvailableActions: category=TOOL_CONFIGURED
              BswMRteSwitch: category=TOOL_CONFIGURED, BswMRteSwitchPortRef=CanSMState_BCAN, BswMSwitchedMode=BUS_OFF
          AC_RteSwitch_CanSMState_BCAN_CHANGE_BAUDRATE
            BswMAvailableActions: category=TOOL_CONFIGURED
              BswMRteSwitch: category=TOOL_CONFIGURED, BswMRteSwitchPortRef=CanSMState_BCAN, BswMSwitchedMode=CHANGE_BAUDRATE
          AC_RteSwitch_CanSMState_BCAN_FULL_COM
            BswMAvailableActions: category=TOOL_CONFIGURED
              BswMRteSwitch: category=TOOL_CONFIGURED, BswMRteSwitchPortRef=CanSMState_BCAN, BswMSwitchedMode=FULL_COM
          AC_RteSwitch_CanSMState_BCAN_NO_COM
            BswMAvailableActions: category=TOOL_CONFIGURED
              BswMRteSwitch: category=TOOL_CONFIGURED, BswMRteSwitchPortRef=CanSMState_BCAN, BswMSwitchedMode=NO_COM
          AC_RteSwitch_CanSMState_BCAN_SILENT_COM
            BswMAvailableActions: category=TOOL_CONFIGURED
              BswMRteSwitch: category=TOOL_CONFIGURED, BswMRteSwitchPortRef=CanSMState_BCAN, BswMSwitchedMode=SILENT_COM
          AC_RteSwitch_ComMMode_BCAN_FULL_COM
            BswMAvailableActions: category=TOOL_CONFIGURED
              BswMRteSwitch: category=TOOL_CONFIGURED, BswMRteSwitchPortRef=ComMMode_BCAN, BswMSwitchedMode=FULL_COM
          AC_RteSwitch_ComMMode_BCAN_NO_COM
            BswMAvailableActions: category=TOOL_CONFIGURED
              BswMRteSwitch: category=TOOL_CONFIGURED, BswMRteSwitchPortRef=ComMMode_BCAN, BswMSwitchedMode=NO_COM
          AC_RteSwitch_ComMMode_BCAN_SILENT_COM
            BswMAvailableActions: category=TOOL_CONFIGURED
              BswMRteSwitch: category=TOOL_CONFIGURED, BswMRteSwitchPortRef=ComMMode_BCAN, BswMSwitchedMode=SILENT_COM
          AC_RteSwitch_DcmApplicationUpdated_APP_NOT_UPDATED
            BswMAvailableActions: category=TOOL_CONFIGURED
              BswMRteSwitch: category=TOOL_CONFIGURED, BswMRteSwitchPortRef=DcmApplicationUpdated, BswMSwitchedMode=APP_NOT_UPDATED
          AC_RteSwitch_DcmApplicationUpdated_APP_UPDATED
            BswMAvailableActions: category=TOOL_CONFIGURED
              BswMRteSwitch: category=TOOL_CONFIGURED, BswMRteSwitchPortRef=DcmApplicationUpdated, BswMSwitchedMode=APP_UPDATED
          AC_RteSwitch_DcmCommunicationControl_0_DCM_DISABLE_RX_DISABLE_TX_NM
            BswMAvailableActions: category=TOOL_CONFIGURED
              BswMRteSwitch: category=TOOL_CONFIGURED, BswMRteSwitchPortRef=DcmCommunicationControl_0, BswMSwitchedMode=DCM_DISABLE_RX_DISABLE_TX_NM
          AC_RteSwitch_DcmCommunicationControl_0_DCM_DISABLE_RX_ENABLE_TX_NORM
            BswMAvailableActions: category=TOOL_CONFIGURED
              BswMRteSwitch: category=TOOL_CONFIGURED, BswMRteSwitchPortRef=DcmCommunicationControl_0, BswMSwitchedMode=DCM_DISABLE_RX_ENABLE_TX_NORM
          AC_RteSwitch_DcmCommunicationControl_0_DCM_DISABLE_RX_ENABLE_TX_NORM_NM
            BswMAvailableActions: category=TOOL_CONFIGURED
              BswMRteSwitch: category=TOOL_CONFIGURED, BswMRteSwitchPortRef=DcmCommunicationControl_0, BswMSwitchedMode=DCM_DISABLE_RX_ENABLE_TX_NORM_NM
          AC_RteSwitch_DcmCommunicationControl_0_DCM_DISABLE_RX_TX_NM
            BswMAvailableActions: category=TOOL_CONFIGURED
              BswMRteSwitch: category=TOOL_CONFIGURED, BswMRteSwitchPortRef=DcmCommunicationControl_0, BswMSwitchedMode=DCM_DISABLE_RX_TX_NM
          AC_RteSwitch_DcmCommunicationControl_0_DCM_DISABLE_RX_TX_NORMAL
            BswMAvailableActions: category=TOOL_CONFIGURED
              BswMRteSwitch: category=TOOL_CONFIGURED, BswMRteSwitchPortRef=DcmCommunicationControl_0, BswMSwitchedMode=DCM_DISABLE_RX_TX_NORMAL
          AC_RteSwitch_DcmCommunicationControl_0_DCM_DISABLE_RX_TX_NORM_NM
            BswMAvailableActions: category=TOOL_CONFIGURED
              BswMRteSwitch: category=TOOL_CONFIGURED, BswMRteSwitchPortRef=DcmCommunicationControl_0, BswMSwitchedMode=DCM_DISABLE_RX_TX_NORM_NM
          AC_RteSwitch_DcmCommunicationControl_0_DCM_ENABLE_RX_DISABLE_TX_NM
            BswMAvailableActions: category=TOOL_CONFIGURED
              BswMRteSwitch: category=TOOL_CONFIGURED, BswMRteSwitchPortRef=DcmCommunicationControl_0, BswMSwitchedMode=DCM_ENABLE_RX_DISABLE_TX_NM
          AC_RteSwitch_DcmCommunicationControl_0_DCM_ENABLE_RX_DISABLE_TX_NORM
            BswMAvailableActions: category=TOOL_CONFIGURED
              BswMRteSwitch: category=TOOL_CONFIGURED, BswMRteSwitchPortRef=DcmCommunicationControl_0, BswMSwitchedMode=DCM_ENABLE_RX_DISABLE_TX_NORM
          AC_RteSwitch_DcmCommunicationControl_0_DCM_ENABLE_RX_DISABLE_TX_NORM_NM
            BswMAvailableActions: category=TOOL_CONFIGURED
              BswMRteSwitch: category=TOOL_CONFIGURED, BswMRteSwitchPortRef=DcmCommunicationControl_0, BswMSwitchedMode=DCM_ENABLE_RX_DISABLE_TX_NORM_NM
          AC_RteSwitch_DcmCommunicationControl_0_DCM_ENABLE_RX_TX_NM
            BswMAvailableActions: category=TOOL_CONFIGURED
              BswMRteSwitch: category=TOOL_CONFIGURED, BswMRteSwitchPortRef=DcmCommunicationControl_0, BswMSwitchedMode=DCM_ENABLE_RX_TX_NM
          AC_RteSwitch_DcmCommunicationControl_0_DCM_ENABLE_RX_TX_NORM
            BswMAvailableActions: category=TOOL_CONFIGURED
              BswMRteSwitch: category=TOOL_CONFIGURED, BswMRteSwitchPortRef=DcmCommunicationControl_0, BswMSwitchedMode=DCM_ENABLE_RX_TX_NORM
          AC_RteSwitch_DcmCommunicationControl_0_DCM_ENABLE_RX_TX_NORM_NM
            BswMAvailableActions: category=TOOL_CONFIGURED
              BswMRteSwitch: category=TOOL_CONFIGURED, BswMRteSwitchPortRef=DcmCommunicationControl_0, BswMSwitchedMode=DCM_ENABLE_RX_TX_NORM_NM
          AC_RteSwitch_DcmControlDTCSetting_DISABLEDTCSETTING
            BswMAvailableActions: category=TOOL_CONFIGURED
              BswMRteSwitch: category=TOOL_CONFIGURED, BswMRteSwitchPortRef=DcmControlDTCSetting, BswMSwitchedMode=DISABLEDTCSETTING
          AC_RteSwitch_DcmControlDTCSetting_ENABLEDTCSETTING
            BswMAvailableActions: category=TOOL_CONFIGURED
              BswMRteSwitch: category=TOOL_CONFIGURED, BswMRteSwitchPortRef=DcmControlDTCSetting, BswMSwitchedMode=ENABLEDTCSETTING
          AC_RteSwitch_DcmDiagnosticSessionControl_DCM_DEFAULT_SESSION
            BswMAvailableActions: category=TOOL_CONFIGURED
              BswMRteSwitch: category=TOOL_CONFIGURED, BswMRteSwitchPortRef=DcmDiagnosticSessionControl, BswMSwitchedMode=DCM_DEFAULT_SESSION
          AC_RteSwitch_DcmDiagnosticSessionControl_DCM_ECU_PROGRAMMING_MODE
            BswMAvailableActions: category=TOOL_CONFIGURED
              BswMRteSwitch: category=TOOL_CONFIGURED, BswMRteSwitchPortRef=DcmDiagnosticSessionControl, BswMSwitchedMode=DCM_ECU_PROGRAMMING_MODE
          AC_RteSwitch_DcmDiagnosticSessionControl_DCM_EXTENDED_DIAGNOSTIC_MODE
            BswMAvailableActions: category=TOOL_CONFIGURED
              BswMRteSwitch: category=TOOL_CONFIGURED, BswMRteSwitchPortRef=DcmDiagnosticSessionControl, BswMSwitchedMode=DCM_EXTENDED_DIAGNOSTIC_MODE
          AC_RteSwitch_DcmDiagnosticSessionControl_DCM_EXTENDED_DIAGNOSTIC_SESSION
            BswMAvailableActions: category=TOOL_CONFIGURED
              BswMRteSwitch: category=TOOL_CONFIGURED, BswMRteSwitchPortRef=DcmDiagnosticSessionControl, BswMSwitchedMode=DCM_EXTENDED_DIAGNOSTIC_SESSION
          AC_RteSwitch_DcmDiagnosticSessionControl_DCM_PROGRAMMING_SESSION
            BswMAvailableActions: category=TOOL_CONFIGURED
              BswMRteSwitch: category=TOOL_CONFIGURED, BswMRteSwitchPortRef=DcmDiagnosticSessionControl, BswMSwitchedMode=DCM_PROGRAMMING_SESSION
          AC_RteSwitch_DcmDiagnosticSessionControl_DCM_QUIESCENT_CURRENT_DIAGNOSTIC_MODE_START
            BswMAvailableActions: category=TOOL_CONFIGURED
              BswMRteSwitch: category=TOOL_CONFIGURED, BswMRteSwitchPortRef=DcmDiagnosticSessionControl, BswMSwitchedMode=DCM_QUIESCENT_CURRENT_DIAGNOSTIC_MODE_START
          AC_RteSwitch_DcmDiagnosticSessionControl_DCM_SAFETY_SYSTEM_DIAGNOSTIC_SESSION
            BswMAvailableActions: category=TOOL_CONFIGURED
              BswMRteSwitch: category=TOOL_CONFIGURED, BswMRteSwitchPortRef=DcmDiagnosticSessionControl, BswMSwitchedMode=DCM_SAFETY_SYSTEM_DIAGNOSTIC_SESSION
          AC_RteSwitch_DcmDiagnosticSessionControl_DCM_SLEEP_MODE_START_REQUEST
            BswMAvailableActions: category=TOOL_CONFIGURED
              BswMRteSwitch: category=TOOL_CONFIGURED, BswMRteSwitchPortRef=DcmDiagnosticSessionControl, BswMSwitchedMode=DCM_SLEEP_MODE_START_REQUEST
          AC_RteSwitch_DcmModeRapidPowerShutDown_DISABLE_RAPIDPOWERSHUTDOWN
            BswMAvailableActions: category=TOOL_CONFIGURED
              BswMRteSwitch: category=TOOL_CONFIGURED, BswMRteSwitchPortRef=DcmModeRapidPowerShutDown, BswMSwitchedMode=DISABLE_RAPIDPOWERSHUTDOWN
          AC_RteSwitch_DcmModeRapidPowerShutDown_ENABLE_RAPIDPOWERSHUTDOWN
            BswMAvailableActions: category=TOOL_CONFIGURED
              BswMRteSwitch: category=TOOL_CONFIGURED, BswMRteSwitchPortRef=DcmModeRapidPowerShutDown, BswMSwitchedMode=ENABLE_RAPIDPOWERSHUTDOWN
          AC_RteSwitch_EcuMode_ECUM_STATE_RUN
            BswMAvailableActions: category=TOOL_CONFIGURED
              BswMRteSwitch: category=TOOL_CONFIGURED, BswMRteSwitchPortRef=EcuMode, BswMSwitchedMode=ECUM_STATE_RUN
          AC_RteSwitch_EcuMode_ECUM_STATE_SHUTDOWN
            BswMAvailableActions: category=TOOL_CONFIGURED
              BswMRteSwitch: category=TOOL_CONFIGURED, BswMRteSwitchPortRef=EcuMode, BswMSwitchedMode=ECUM_STATE_SHUTDOWN
          AC_RteSwitch_EcuMode_ECUM_STATE_SLEEP
            BswMAvailableActions: category=TOOL_CONFIGURED
              BswMRteSwitch: category=TOOL_CONFIGURED, BswMRteSwitchPortRef=EcuMode, BswMSwitchedMode=ECUM_STATE_SLEEP
          AC_RteSwitch_InitState_COMPLETE
            BswMAvailableActions: category=TOOL_CONFIGURED
              BswMRteSwitch: category=TOOL_CONFIGURED, BswMRteSwitchPortRef=InitState, BswMSwitchedMode=COMPLETE
          AC_SchMSwitch_EcuMode_ECUM_STATE_OFF
            BswMAvailableActions: category=TOOL_CONFIGURED
              BswMSchMSwitch: category=TOOL_CONFIGURED, BswMSchMModeDeclarationGroupRef=EcuMode, BswMSchMSwitchedMode=ECUM_STATE_OFF
          AC_SchMSwitch_EcuMode_ECUM_STATE_RESET
            BswMAvailableActions: category=TOOL_CONFIGURED
              BswMSchMSwitch: category=TOOL_CONFIGURED, BswMSchMModeDeclarationGroupRef=EcuMode, BswMSchMSwitchedMode=ECUM_STATE_RESET
          AC_SchMSwitch_EcuMode_ECUM_STATE_RUN
            BswMAvailableActions: category=TOOL_CONFIGURED
              BswMSchMSwitch: category=TOOL_CONFIGURED, BswMSchMModeDeclarationGroupRef=EcuMode, BswMSchMSwitchedMode=ECUM_STATE_RUN
          AC_SchMSwitch_EcuMode_ECUM_STATE_SHUTDOWN
            BswMAvailableActions: category=TOOL_CONFIGURED
              BswMSchMSwitch: category=TOOL_CONFIGURED, BswMSchMModeDeclarationGroupRef=EcuMode, BswMSchMSwitchedMode=ECUM_STATE_SHUTDOWN
          AC_SchMSwitch_EcuMode_ECUM_STATE_SLEEP
            BswMAvailableActions: category=TOOL_CONFIGURED
              BswMSchMSwitch: category=TOOL_CONFIGURED, BswMSchMModeDeclarationGroupRef=EcuMode, BswMSchMSwitchedMode=ECUM_STATE_SLEEP
          AC_SchMSwitch_EcuMode_ECUM_STATE_STARTUP_TWO
            BswMAvailableActions: category=TOOL_CONFIGURED
              BswMSchMSwitch: category=TOOL_CONFIGURED, BswMSchMModeDeclarationGroupRef=EcuMode, BswMSchMSwitchedMode=ECUM_STATE_STARTUP_TWO
          AC_UserCallout_ComM_DeInit
            BswMAvailableActions: category=TOOL_CONFIGURED
              ComM_DeInit (BswMUserCallout): category=TOOL_CONFIGURED, BswMUserCalloutFunction=ComM_DeInit()
          AC_UserCallout_Dcm_Init
            BswMAvailableActions: category=TOOL_CONFIGURED
              Dcm_Init (BswMUserCallout): category=TOOL_CONFIGURED, BswMUserCalloutFunction=Dcm_Init(NULL_PTR)
          AC_UserCallout_EcuM_GoHalt
            BswMAvailableActions: category=TOOL_CONFIGURED
              EcuM_GoHalt (BswMUserCallout): category=TOOL_CONFIGURED, BswMUserCalloutFunction=EcuM_GoHalt()
          AC_UserCallout_EcuState_ENTRY_OFF
            BswMAvailableActions: category=TOOL_CONFIGURED
              EcuState_ENTRY_OFF (BswMUserCallout): category=TOOL_CONFIGURED, BswMUserCalloutFunction=BswM_RequestMode((BswM_UserType)0x2A, (BswM_ModeType)BSWM_ECUSTATE_ENTRY_OFF)
          AC_UserCallout_EcuState_ENTRY_RESET
            BswMAvailableActions: category=TOOL_CONFIGURED
              EcuState_ENTRY_RESET (BswMUserCallout): category=TOOL_CONFIGURED, BswMUserCalloutFunction=BswM_RequestMode((BswM_UserType)0x2A, (BswM_ModeType)BSWM_ECUSTATE_ENTRY_RESET)
          AC_UserCallout_EcuState_ENTRY_RUN
            BswMAvailableActions: category=TOOL_CONFIGURED
              EcuState_ENTRY_RUN (BswMUserCallout): category=TOOL_CONFIGURED, BswMUserCalloutFunction=BswM_RequestMode((BswM_UserType)0x2A, (BswM_ModeType)BSWM_ECUSTATE_ENTRY_RUN)
          AC_UserCallout_EcuState_ENTRY_SHUTDOWN
            BswMAvailableActions: category=TOOL_CONFIGURED
              EcuState_ENTRY_SHUTDOWN (BswMUserCallout): category=TOOL_CONFIGURED, BswMUserCalloutFunction=BswM_RequestMode((BswM_UserType)0x2A, (BswM_ModeType)BSWM_ECUSTATE_ENTRY_SHUTDOWN)
          AC_UserCallout_EcuState_ENTRY_SLEEP
            BswMAvailableActions: category=TOOL_CONFIGURED
              EcuState_ENTRY_SLEEP (BswMUserCallout): category=TOOL_CONFIGURED, BswMUserCalloutFunction=BswM_RequestMode((BswM_UserType)0x2A, (BswM_ModeType)BSWM_ECUSTATE_ENTRY_SLEEP)
          AC_UserCallout_EcuState_ENTRY_STARTUP_TWO
            BswMAvailableActions: category=TOOL_CONFIGURED
              EcuState_ENTRY_STARTUP_TWO (BswMUserCallout): category=TOOL_CONFIGURED, BswMUserCalloutFunction=BswM_RequestMode((BswM_UserType)0x2A, (BswM_ModeType)BSWM_ECUSTATE_ENTRY_STARTUP_TWO)
          AC_UserCallout_EcuState_EXIT_RUN
            BswMAvailableActions: category=TOOL_CONFIGURED
              EcuState_EXIT_RUN (BswMUserCallout): category=TOOL_CONFIGURED, BswMUserCalloutFunction=BswM_RequestMode((BswM_UserType)0x2A, (BswM_ModeType)BSWM_ECUSTATE_EXIT_RUN)
          AC_UserCallout_EcuState_EXIT_SHUTDOWN
            BswMAvailableActions: category=TOOL_CONFIGURED
              EcuState_EXIT_SHUTDOWN (BswMUserCallout): category=TOOL_CONFIGURED, BswMUserCalloutFunction=BswM_RequestMode((BswM_UserType)0x2A, (BswM_ModeType)BSWM_ECUSTATE_EXIT_SHUTDOWN)
          AC_UserCallout_EcuState_EXIT_SLEEP
            BswMAvailableActions: category=TOOL_CONFIGURED
              EcuState_EXIT_SLEEP (BswMUserCallout): category=TOOL_CONFIGURED, BswMUserCalloutFunction=BswM_RequestMode((BswM_UserType)0x2A, (BswM_ModeType)BSWM_ECUSTATE_EXIT_SLEEP)
          AC_UserCallout_EcuState_EXIT_STARTUP_TWO
            BswMAvailableActions: category=TOOL_CONFIGURED
              EcuState_EXIT_STARTUP_TWO (BswMUserCallout): category=TOOL_CONFIGURED, BswMUserCalloutFunction=BswM_RequestMode((BswM_UserType)0x2A, (BswM_ModeType)BSWM_ECUSTATE_EXIT_STARTUP_TWO)
          AC_UserCallout_KeyM_Init
            BswMAvailableActions: category=TOOL_CONFIGURED
              KeyM_Init (BswMUserCallout): category=TOOL_CONFIGURED, BswMUserCalloutFunction=KeyM_Init(NULL_PTR)
          AC_UserCallout_Rte_Start_Main
            BswMAvailableActions: category=TOOL_CONFIGURED
              Rte_Start_Main (BswMUserCallout): category=TOOL_CONFIGURED, BswMUserCalloutFunction=(void)Rte_Start()
          AC_UserCallout_Rte_Stop_Main
            BswMAvailableActions: category=TOOL_CONFIGURED
              Rte_Stop_Main (BswMUserCallout): category=TOOL_CONFIGURED, BswMUserCalloutFunction=(void)Rte_Stop()
          AC_UserCallout_ShutdownTargetTo_OFF
            BswMAvailableActions: category=TOOL_CONFIGURED
              ShutdownTargetTo_OFF (BswMUserCallout): category=TOOL_CONFIGURED, BswMUserCalloutFunction=BswM_RequestMode((BswM_UserType)0x12A, (BswM_ModeType)BSWM_SHUTDOWNTARGET_OFF)
          AC_UserCallout_ShutdownTargetTo_RESET
            BswMAvailableActions: category=TOOL_CONFIGURED
              ShutdownTargetTo_RESET (BswMUserCallout): category=TOOL_CONFIGURED, BswMUserCalloutFunction=BswM_RequestMode((BswM_UserType)0x12A, (BswM_ModeType)BSWM_SHUTDOWNTARGET_RESET)
          AC_UserCallout_ShutdownTargetTo_RUN
            BswMAvailableActions: category=TOOL_CONFIGURED
              ShutdownTargetTo_RUN (BswMUserCallout): category=TOOL_CONFIGURED, BswMUserCalloutFunction=BswM_RequestMode((BswM_UserType)0x12A, (BswM_ModeType)BSWM_SHUTDOWNTARGET_RUN)
          AC_UserCallout_ShutdownTargetTo_SLEEP
            BswMAvailableActions: category=TOOL_CONFIGURED
              ShutdownTargetTo_SLEEP (BswMUserCallout): category=TOOL_CONFIGURED, BswMUserCalloutFunction=BswM_RequestMode((BswM_UserType)0x12A, (BswM_ModeType)BSWM_SHUTDOWNTARGET_SLEEP)
          AC_UserCallout_WdgM_DeInit
            BswMAvailableActions: category=TOOL_CONFIGURED
              WdgM_DeInit (BswMUserCallout): category=TOOL_CONFIGURED, BswMUserCalloutFunction=WdgM_DeInit()
        63 x BswMActionList, all with category=TOOL_CONFIGURED, BswMActionListExecution=BSWM_TRIGGER:
          AL_ComModeAllow_ALL_FALSE
            AC_ComMAllowCom_BCAN_FALSE (BswMActionListItem): category=TOOL_CONFIGURED, BswMAbortOnFail=0, BswMActionListItemIndex=10, BswMActionListItemRef=BswMModeControl/AC_ComMAllowCom_BCAN_FALSE
          AL_ComModeAllow_ALL_TRUE
            AC_ComMAllowCom_BCAN_TRUE (BswMActionListItem): category=TOOL_CONFIGURED, BswMAbortOnFail=0, BswMActionListItemIndex=10, BswMActionListItemRef=BswMModeControl/AC_ComMAllowCom_BCAN_TRUE
          AL_ComModeRequest_ALL_FULL_COM
            AC_ComMModeSwitch_BCAN_FULL_COM (BswMActionListItem): category=TOOL_CONFIGURED, BswMAbortOnFail=0, BswMActionListItemIndex=10, BswMActionListItemRef=BswMModeControl/AC_ComMModeSwitch_BCAN_FULL_COM
          AL_ComModeRequest_ALL_NO_COM
            AC_ComMModeSwitch_BCAN_NO_COM (BswMActionListItem): category=TOOL_CONFIGURED, BswMAbortOnFail=0, BswMActionListItemIndex=10, BswMActionListItemRef=BswMModeControl/AC_ComMModeSwitch_BCAN_NO_COM
          AL_DriverDeinit
            AC_UserCallout_WdgM_DeInit (BswMActionListItem): category=TOOL_CONFIGURED, BswMAbortOnFail=0, BswMActionListItemIndex=10, BswMActionListItemRef=BswMModeControl/AC_UserCallout_WdgM_DeInit
            AC_UserCallout_ComM_DeInit (BswMActionListItem): category=TOOL_CONFIGURED, BswMAbortOnFail=0, BswMActionListItemIndex=20, BswMActionListItemRef=BswMModeControl/AC_UserCallout_ComM_DeInit
          AL_DriverInitTwo
            4 x BswMActionListItem, all with BswMAbortOnFail=0:
              AC_UserCallout_Dcm_Init: category=TOOL_CONFIGURED, BswMActionListItemIndex=10, BswMActionListItemRef=BswMModeControl/AC_UserCallout_Dcm_Init
              AC_UserCallout_KeyM_Init: category=TOOL_CONFIGURED, BswMActionListItemIndex=20, BswMActionListItemRef=BswMModeControl/AC_UserCallout_KeyM_Init
              Al_UserCallout_HaeHsmDriver_StartUp: BswMActionListItemIndex=30, BswMActionListItemRef=AC_UserCallout_haeHsmDriver_Init
              Al_UserCallout_Crypto_76_HaeModule_Init: BswMActionListItemIndex=40, BswMActionListItemRef=AC_UserCallout_Crypto_76_HaeModule_Init
          AL_RteStart
            AC_UserCallout_Rte_Start_Main (BswMActionListItem): category=TOOL_CONFIGURED, BswMAbortOnFail=0, BswMActionListItemIndex=10, BswMActionListItemRef=BswMModeControl/AC_UserCallout_Rte_Start_Main
          AL_RteStop
            AC_UserCallout_Rte_Stop_Main (BswMActionListItem): category=TOOL_CONFIGURED, BswMAbortOnFail=0, BswMActionListItemIndex=10, BswMActionListItemRef=BswMModeControl/AC_UserCallout_Rte_Stop_Main
          TrueAL_CanBorNotification_BCAN_COMPLETE
            AC_RteSwitch_CanSMBORState_BCAN_COMPLETE (BswMActionListItem):
              category = TOOL_CONFIGURED
              BswMAbortOnFail = 0
              BswMActionListItemIndex = 10
              BswMActionListItemRef = BswMModeControl/AC_RteSwitch_CanSMBORState_BCAN_COMPLETE
          TrueAL_CanBorNotification_BCAN_START
            AC_RteSwitch_CanSMBORState_BCAN_START (BswMActionListItem):
              category = TOOL_CONFIGURED
              BswMAbortOnFail = 0
              BswMActionListItemIndex = 10
              BswMActionListItemRef = BswMModeControl/AC_RteSwitch_CanSMBORState_BCAN_START
          TrueAL_CanStateNotification_BCAN_BUS_OFF
            AC_RteSwitch_CanSMState_BCAN_BUS_OFF (BswMActionListItem):
              category = TOOL_CONFIGURED
              BswMAbortOnFail = 0
              BswMActionListItemIndex = 10
              BswMActionListItemRef = BswMModeControl/AC_RteSwitch_CanSMState_BCAN_BUS_OFF
          TrueAL_CanStateNotification_BCAN_CHANGE_BAUDRATE
            AC_RteSwitch_CanSMState_BCAN_CHANGE_BAUDRATE (BswMActionListItem):
              category = TOOL_CONFIGURED
              BswMAbortOnFail = 0
              BswMActionListItemIndex = 10
              BswMActionListItemRef = BswMModeControl/AC_RteSwitch_CanSMState_BCAN_CHANGE_BAUDRATE
          TrueAL_CanStateNotification_BCAN_FULL_COM
            AC_RteSwitch_CanSMState_BCAN_FULL_COM (BswMActionListItem):
              category = TOOL_CONFIGURED
              BswMAbortOnFail = 0
              BswMActionListItemIndex = 10
              BswMActionListItemRef = BswMModeControl/AC_RteSwitch_CanSMState_BCAN_FULL_COM
          TrueAL_CanStateNotification_BCAN_NO_COM
            AC_RteSwitch_CanSMState_BCAN_NO_COM (BswMActionListItem): category=TOOL_CONFIGURED, BswMAbortOnFail=0, BswMActionListItemIndex=10, BswMActionListItemRef=BswMModeControl/AC_RteSwitch_CanSMState_BCAN_NO_COM
          TrueAL_CanStateNotification_BCAN_SILENT_COM
            AC_RteSwitch_CanSMState_BCAN_SILENT_COM (BswMActionListItem):
              category = TOOL_CONFIGURED
              BswMAbortOnFail = 0
              BswMActionListItemIndex = 10
              BswMActionListItemRef = BswMModeControl/AC_RteSwitch_CanSMState_BCAN_SILENT_COM
          TrueAL_ComModeNotification_BCAN_FULL_COM
            AC_RteSwitch_ComMMode_BCAN_FULL_COM (BswMActionListItem): category=TOOL_CONFIGURED, BswMAbortOnFail=0, BswMActionListItemIndex=10, BswMActionListItemRef=BswMModeControl/AC_RteSwitch_ComMMode_BCAN_FULL_COM
          TrueAL_ComModeNotification_BCAN_NO_COM
            AC_RteSwitch_ComMMode_BCAN_NO_COM (BswMActionListItem): category=TOOL_CONFIGURED, BswMAbortOnFail=0, BswMActionListItemIndex=10, BswMActionListItemRef=BswMModeControl/AC_RteSwitch_ComMMode_BCAN_NO_COM
          TrueAL_ComModeNotification_BCAN_SILENT_COM
            AC_RteSwitch_ComMMode_BCAN_SILENT_COM (BswMActionListItem):
              category = TOOL_CONFIGURED
              BswMAbortOnFail = 0
              BswMActionListItemIndex = 10
              BswMActionListItemRef = BswMModeControl/AC_RteSwitch_ComMMode_BCAN_SILENT_COM
          TrueAL_ComModeRequest_BCAN_FULL_COM
            AC_ComMModeSwitch_BCAN_FULL_COM (BswMActionListItem): category=TOOL_CONFIGURED, BswMAbortOnFail=0, BswMActionListItemIndex=10, BswMActionListItemRef=BswMModeControl/AC_ComMModeSwitch_BCAN_FULL_COM
          TrueAL_ComModeRequest_BCAN_NO_COM
            AC_ComMModeSwitch_BCAN_NO_COM (BswMActionListItem): category=TOOL_CONFIGURED, BswMAbortOnFail=0, BswMActionListItemIndex=10, BswMActionListItemRef=BswMModeControl/AC_ComMModeSwitch_BCAN_NO_COM
          TrueAL_DcmApplicationUpdatedNotification_APP_NOT_UPDATED
            AC_RteSwitch_DcmApplicationUpdated_APP_NOT_UPDATED (BswMActionListItem):
              category = TOOL_CONFIGURED
              BswMAbortOnFail = 0
              BswMActionListItemIndex = 10
              BswMActionListItemRef = BswMModeControl/AC_RteSwitch_DcmApplicationUpdated_APP_NOT_UPDATED
          TrueAL_DcmApplicationUpdatedNotification_APP_UPDATED
            AC_RteSwitch_DcmApplicationUpdated_APP_UPDATED (BswMActionListItem):
              category = TOOL_CONFIGURED
              BswMAbortOnFail = 0
              BswMActionListItemIndex = 10
              BswMActionListItemRef = BswMModeControl/AC_RteSwitch_DcmApplicationUpdated_APP_UPDATED
          TrueAL_DcmCommunicationControl_0_DCM_DISABLE_RX_DISABLE_TX_NM
            AC_RteSwitch_DcmCommunicationControl_0_DCM_DISABLE_RX_DISABLE_TX_NM (BswMActionListItem):
              category = TOOL_CONFIGURED
              BswMAbortOnFail = 0
              BswMActionListItemIndex = 10
              BswMActionListItemRef = BswMModeControl/AC_RteSwitch_DcmCommunicationControl_0_DCM_DISABLE_RX_DISABLE_TX_NM
          TrueAL_DcmCommunicationControl_0_DCM_DISABLE_RX_ENABLE_TX_NORM
            AC_RteSwitch_DcmCommunicationControl_0_DCM_DISABLE_RX_ENABLE_TX_NORM (BswMActionListItem):
              category = TOOL_CONFIGURED
              BswMAbortOnFail = 0
              BswMActionListItemIndex = 10
              BswMActionListItemRef = BswMModeControl/AC_RteSwitch_DcmCommunicationControl_0_DCM_DISABLE_RX_ENABLE_TX_NORM
            AC_RteSwitch_DcmCommunicationControl_0_DCM_DISABLE_RX_ENABLE_TX_NORM_NM (BswMActionListItem):
              category = TOOL_CONFIGURED
              BswMAbortOnFail = 0
              BswMActionListItemIndex = 20
              BswMActionListItemRef = BswMModeControl/AC_RteSwitch_DcmCommunicationControl_0_DCM_DISABLE_RX_ENABLE_TX_NORM_NM
          TrueAL_DcmCommunicationControl_0_DCM_DISABLE_RX_ENABLE_TX_NORM_NM
            AC_RteSwitch_DcmCommunicationControl_0_DCM_DISABLE_RX_ENABLE_TX_NORM_NM (BswMActionListItem):
              category = TOOL_CONFIGURED
              BswMAbortOnFail = 0
              BswMActionListItemIndex = 10
              BswMActionListItemRef = BswMModeControl/AC_RteSwitch_DcmCommunicationControl_0_DCM_DISABLE_RX_ENABLE_TX_NORM_NM
          TrueAL_DcmCommunicationControl_0_DCM_DISABLE_RX_TX_NM
            AC_RteSwitch_DcmCommunicationControl_0_DCM_DISABLE_RX_TX_NM (BswMActionListItem):
              category = TOOL_CONFIGURED
              BswMAbortOnFail = 0
              BswMActionListItemIndex = 10
              BswMActionListItemRef = BswMModeControl/AC_RteSwitch_DcmCommunicationControl_0_DCM_DISABLE_RX_TX_NM
          TrueAL_DcmCommunicationControl_0_DCM_DISABLE_RX_TX_NORMAL
            AC_RteSwitch_DcmCommunicationControl_0_DCM_DISABLE_RX_TX_NORMAL (BswMActionListItem):
              category = TOOL_CONFIGURED
              BswMAbortOnFail = 0
              BswMActionListItemIndex = 10
              BswMActionListItemRef = BswMModeControl/AC_RteSwitch_DcmCommunicationControl_0_DCM_DISABLE_RX_TX_NORMAL
          TrueAL_DcmCommunicationControl_0_DCM_DISABLE_RX_TX_NORM_NM
            AC_RteSwitch_DcmCommunicationControl_0_DCM_DISABLE_RX_TX_NORM_NM (BswMActionListItem):
              category = TOOL_CONFIGURED
              BswMAbortOnFail = 0
              BswMActionListItemIndex = 10
              BswMActionListItemRef = BswMModeControl/AC_RteSwitch_DcmCommunicationControl_0_DCM_DISABLE_RX_TX_NORM_NM
          TrueAL_DcmCommunicationControl_0_DCM_ENABLE_RX_DISABLE_TX_NM
            AC_RteSwitch_DcmCommunicationControl_0_DCM_ENABLE_RX_DISABLE_TX_NM (BswMActionListItem):
              category = TOOL_CONFIGURED
              BswMAbortOnFail = 0
              BswMActionListItemIndex = 10
              BswMActionListItemRef = BswMModeControl/AC_RteSwitch_DcmCommunicationControl_0_DCM_ENABLE_RX_DISABLE_TX_NM
          TrueAL_DcmCommunicationControl_0_DCM_ENABLE_RX_DISABLE_TX_NORM
            AC_RteSwitch_DcmCommunicationControl_0_DCM_ENABLE_RX_DISABLE_TX_NORM (BswMActionListItem):
              category = TOOL_CONFIGURED
              BswMAbortOnFail = 0
              BswMActionListItemIndex = 10
              BswMActionListItemRef = BswMModeControl/AC_RteSwitch_DcmCommunicationControl_0_DCM_ENABLE_RX_DISABLE_TX_NORM
            AC_RteSwitch_DcmCommunicationControl_0_DCM_ENABLE_RX_DISABLE_TX_NORM_NM (BswMActionListItem):
              category = TOOL_CONFIGURED
              BswMAbortOnFail = 0
              BswMActionListItemIndex = 20
              BswMActionListItemRef = BswMModeControl/AC_RteSwitch_DcmCommunicationControl_0_DCM_ENABLE_RX_DISABLE_TX_NORM_NM
          TrueAL_DcmCommunicationControl_0_DCM_ENABLE_RX_DISABLE_TX_NORM_NM
            AC_RteSwitch_DcmCommunicationControl_0_DCM_ENABLE_RX_DISABLE_TX_NORM_NM (BswMActionListItem):
              category = TOOL_CONFIGURED
              BswMAbortOnFail = 0
              BswMActionListItemIndex = 10
              BswMActionListItemRef = BswMModeControl/AC_RteSwitch_DcmCommunicationControl_0_DCM_ENABLE_RX_DISABLE_TX_NORM_NM
          TrueAL_DcmCommunicationControl_0_DCM_ENABLE_RX_TX_NM
            AC_RteSwitch_DcmCommunicationControl_0_DCM_ENABLE_RX_TX_NM (BswMActionListItem):
              category = TOOL_CONFIGURED
              BswMAbortOnFail = 0
              BswMActionListItemIndex = 10
              BswMActionListItemRef = BswMModeControl/AC_RteSwitch_DcmCommunicationControl_0_DCM_ENABLE_RX_TX_NM
          TrueAL_DcmCommunicationControl_0_DCM_ENABLE_RX_TX_NORM
            AC_RteSwitch_DcmCommunicationControl_0_DCM_ENABLE_RX_TX_NORM (BswMActionListItem):
              category = TOOL_CONFIGURED
              BswMAbortOnFail = 0
              BswMActionListItemIndex = 10
              BswMActionListItemRef = BswMModeControl/AC_RteSwitch_DcmCommunicationControl_0_DCM_ENABLE_RX_TX_NORM
            AC_RteSwitch_DcmCommunicationControl_0_DCM_ENABLE_RX_TX_NORM_NM (BswMActionListItem):
              category = TOOL_CONFIGURED
              BswMAbortOnFail = 0
              BswMActionListItemIndex = 20
              BswMActionListItemRef = BswMModeControl/AC_RteSwitch_DcmCommunicationControl_0_DCM_ENABLE_RX_TX_NORM_NM
          TrueAL_DcmCommunicationControl_0_DCM_ENABLE_RX_TX_NORM_NM
            AC_RteSwitch_DcmCommunicationControl_0_DCM_ENABLE_RX_TX_NORM_NM (BswMActionListItem):
              category = TOOL_CONFIGURED
              BswMAbortOnFail = 0
              BswMActionListItemIndex = 10
              BswMActionListItemRef = BswMModeControl/AC_RteSwitch_DcmCommunicationControl_0_DCM_ENABLE_RX_TX_NORM_NM
          TrueAL_DcmControlDTCSetting_DISABLEDTCSETTING
            AC_RteSwitch_DcmControlDTCSetting_DISABLEDTCSETTING (BswMActionListItem):
              category = TOOL_CONFIGURED
              BswMAbortOnFail = 0
              BswMActionListItemIndex = 10
              BswMActionListItemRef = BswMModeControl/AC_RteSwitch_DcmControlDTCSetting_DISABLEDTCSETTING
          TrueAL_DcmControlDTCSetting_ENABLEDTCSETTING
            AC_RteSwitch_DcmControlDTCSetting_ENABLEDTCSETTING (BswMActionListItem):
              category = TOOL_CONFIGURED
              BswMAbortOnFail = 0
              BswMActionListItemIndex = 10
              BswMActionListItemRef = BswMModeControl/AC_RteSwitch_DcmControlDTCSetting_ENABLEDTCSETTING
          TrueAL_DcmModeRapidPowerShutDown_DISABLE_RAPIDPOWERSHUTDOWN
            AC_RteSwitch_DcmModeRapidPowerShutDown_DISABLE_RAPIDPOWERSHUTDOWN (BswMActionListItem):
              category = TOOL_CONFIGURED
              BswMAbortOnFail = 0
              BswMActionListItemIndex = 10
              BswMActionListItemRef = BswMModeControl/AC_RteSwitch_DcmModeRapidPowerShutDown_DISABLE_RAPIDPOWERSHUTDOWN
          TrueAL_DcmModeRapidPowerShutDown_ENABLE_RAPIDPOWERSHUTDOWN
            AC_RteSwitch_DcmModeRapidPowerShutDown_ENABLE_RAPIDPOWERSHUTDOWN (BswMActionListItem):
              category = TOOL_CONFIGURED
              BswMAbortOnFail = 0
              BswMActionListItemIndex = 10
              BswMActionListItemRef = BswMModeControl/AC_RteSwitch_DcmModeRapidPowerShutDown_ENABLE_RAPIDPOWERSHUTDOWN
          TrueAL_DiagnosticSessionNotification_DEFAULT_SESSION
            AC_RteSwitch_DcmDiagnosticSessionControl_DCM_DEFAULT_SESSION (BswMActionListItem):
              category = TOOL_CONFIGURED
              BswMAbortOnFail = 0
              BswMActionListItemIndex = 10
              BswMActionListItemRef = BswMModeControl/AC_RteSwitch_DcmDiagnosticSessionControl_DCM_DEFAULT_SESSION
          TrueAL_DiagnosticSessionNotification_ECU_PROGRAMMING_MODE
            AC_RteSwitch_DcmDiagnosticSessionControl_DCM_ECU_PROGRAMMING_MODE (BswMActionListItem):
              category = TOOL_CONFIGURED
              BswMAbortOnFail = 0
              BswMActionListItemIndex = 10
              BswMActionListItemRef = BswMModeControl/AC_RteSwitch_DcmDiagnosticSessionControl_DCM_ECU_PROGRAMMING_MODE
          TrueAL_DiagnosticSessionNotification_EXTENDED_DIAGNOSTIC_MODE
            AC_RteSwitch_DcmDiagnosticSessionControl_DCM_EXTENDED_DIAGNOSTIC_MODE (BswMActionListItem):
              category = TOOL_CONFIGURED
              BswMAbortOnFail = 0
              BswMActionListItemIndex = 10
              BswMActionListItemRef = BswMModeControl/AC_RteSwitch_DcmDiagnosticSessionControl_DCM_EXTENDED_DIAGNOSTIC_MODE
          TrueAL_DiagnosticSessionNotification_EXTENDED_DIAGNOSTIC_SESSION
            AC_RteSwitch_DcmDiagnosticSessionControl_DCM_EXTENDED_DIAGNOSTIC_SESSION (BswMActionListItem):
              category = TOOL_CONFIGURED
              BswMAbortOnFail = 0
              BswMActionListItemIndex = 10
              BswMActionListItemRef = BswMModeControl/AC_RteSwitch_DcmDiagnosticSessionControl_DCM_EXTENDED_DIAGNOSTIC_SESSION
          TrueAL_DiagnosticSessionNotification_PROGRAMMING_SESSION
            AC_RteSwitch_DcmDiagnosticSessionControl_DCM_PROGRAMMING_SESSION (BswMActionListItem):
              category = TOOL_CONFIGURED
              BswMAbortOnFail = 0
              BswMActionListItemIndex = 10
              BswMActionListItemRef = BswMModeControl/AC_RteSwitch_DcmDiagnosticSessionControl_DCM_PROGRAMMING_SESSION
          TrueAL_DiagnosticSessionNotification_QUIESCENT_CURRENT_DIAGNOSTIC_MODE_START
            AC_RteSwitch_DcmDiagnosticSessionControl_DCM_QUIESCENT_CURRENT_DIAGNOSTIC_MODE_START (BswMActionListItem):
              category = TOOL_CONFIGURED
              BswMAbortOnFail = 0
              BswMActionListItemIndex = 10
              BswMActionListItemRef = BswMModeControl/AC_RteSwitch_DcmDiagnosticSessionControl_DCM_QUIESCENT_CURRENT_DIAGNOSTIC_MODE_START
          TrueAL_DiagnosticSessionNotification_SAFETY_SYSTEM_DIAGNOSTIC_SESSION
            AC_RteSwitch_DcmDiagnosticSessionControl_DCM_SAFETY_SYSTEM_DIAGNOSTIC_SESSION (BswMActionListItem):
              category = TOOL_CONFIGURED
              BswMAbortOnFail = 0
              BswMActionListItemIndex = 10
              BswMActionListItemRef = BswMModeControl/AC_RteSwitch_DcmDiagnosticSessionControl_DCM_SAFETY_SYSTEM_DIAGNOSTIC_SESSION
          TrueAL_DiagnosticSessionNotification_SLEEP_MODE_START_REQUEST
            AC_RteSwitch_DcmDiagnosticSessionControl_DCM_SLEEP_MODE_START_REQUEST (BswMActionListItem):
              category = TOOL_CONFIGURED
              BswMAbortOnFail = 0
              BswMActionListItemIndex = 10
              BswMActionListItemRef = BswMModeControl/AC_RteSwitch_DcmDiagnosticSessionControl_DCM_SLEEP_MODE_START_REQUEST
          TrueAL_EcuStateTo_OFF
            AC_SchMSwitch_EcuMode_ECUM_STATE_OFF (BswMActionListItem):
              category = TOOL_CONFIGURED
              BswMAbortOnFail = 0
              BswMActionListItemIndex = 10
              BswMActionListItemRef = BswMModeControl/AC_SchMSwitch_EcuMode_ECUM_STATE_OFF
            AC_UserCallout_EcuState_ENTRY_OFF (BswMActionListItem): category=TOOL_CONFIGURED, BswMAbortOnFail=0, BswMActionListItemIndex=20, BswMActionListItemRef=BswMModeControl/AC_UserCallout_EcuState_ENTRY_OFF
          TrueAL_EcuStateTo_RESET
            AC_SchMSwitch_EcuMode_ECUM_STATE_RESET (BswMActionListItem):
              category = TOOL_CONFIGURED
              BswMAbortOnFail = 0
              BswMActionListItemIndex = 10
              BswMActionListItemRef = BswMModeControl/AC_SchMSwitch_EcuMode_ECUM_STATE_RESET
            AC_UserCallout_EcuState_ENTRY_RESET (BswMActionListItem): category=TOOL_CONFIGURED, BswMAbortOnFail=0, BswMActionListItemIndex=20, BswMActionListItemRef=BswMModeControl/AC_UserCallout_EcuState_ENTRY_RESET
          TrueAL_EcuStateTo_RUN_From_SLEEP
            3 x BswMActionListItem, all with category=TOOL_CONFIGURED, BswMAbortOnFail=0:
              AC_SchMSwitch_EcuMode_ECUM_STATE_RUN: BswMActionListItemIndex=10, BswMActionListItemRef=BswMModeControl/AC_SchMSwitch_EcuMode_ECUM_STATE_RUN
              AC_RteSwitch_EcuMode_ECUM_STATE_RUN: BswMActionListItemIndex=20, BswMActionListItemRef=BswMModeControl/AC_RteSwitch_EcuMode_ECUM_STATE_RUN
              AC_UserCallout_EcuState_ENTRY_RUN: BswMActionListItemIndex=30, BswMActionListItemRef=BswMModeControl/AC_UserCallout_EcuState_ENTRY_RUN
          TrueAL_EcuStateTo_RUN_From_STARTUP
            3 x BswMActionListItem, all with category=TOOL_CONFIGURED, BswMAbortOnFail=0:
              AC_SchMSwitch_EcuMode_ECUM_STATE_RUN: BswMActionListItemIndex=10, BswMActionListItemRef=BswMModeControl/AC_SchMSwitch_EcuMode_ECUM_STATE_RUN
              AC_RteSwitch_EcuMode_ECUM_STATE_RUN: BswMActionListItemIndex=20, BswMActionListItemRef=BswMModeControl/AC_RteSwitch_EcuMode_ECUM_STATE_RUN
              AC_UserCallout_EcuState_ENTRY_RUN: BswMActionListItemIndex=30, BswMActionListItemRef=BswMModeControl/AC_UserCallout_EcuState_ENTRY_RUN
          TrueAL_EcuStateTo_SHUTDOWN
            3 x BswMActionListItem, all with category=TOOL_CONFIGURED, BswMAbortOnFail=0:
              AC_SchMSwitch_EcuMode_ECUM_STATE_SHUTDOWN: BswMActionListItemIndex=10, BswMActionListItemRef=BswMModeControl/AC_SchMSwitch_EcuMode_ECUM_STATE_SHUTDOWN
              AC_RteSwitch_EcuMode_ECUM_STATE_SHUTDOWN: BswMActionListItemIndex=20, BswMActionListItemRef=BswMModeControl/AC_RteSwitch_EcuMode_ECUM_STATE_SHUTDOWN
              AC_UserCallout_EcuState_ENTRY_SHUTDOWN: BswMActionListItemIndex=30, BswMActionListItemRef=BswMModeControl/AC_UserCallout_EcuState_ENTRY_SHUTDOWN
          TrueAL_EcuStateTo_SLEEP
            3 x BswMActionListItem, all with category=TOOL_CONFIGURED, BswMAbortOnFail=0:
              AC_SchMSwitch_EcuMode_ECUM_STATE_SLEEP: BswMActionListItemIndex=10, BswMActionListItemRef=BswMModeControl/AC_SchMSwitch_EcuMode_ECUM_STATE_SLEEP
              AC_RteSwitch_EcuMode_ECUM_STATE_SLEEP: BswMActionListItemIndex=20, BswMActionListItemRef=BswMModeControl/AC_RteSwitch_EcuMode_ECUM_STATE_SLEEP
              AC_UserCallout_EcuState_ENTRY_SLEEP: BswMActionListItemIndex=30, BswMActionListItemRef=BswMModeControl/AC_UserCallout_EcuState_ENTRY_SLEEP
          TrueAL_EcuStateTo_STARTUP_TWO
            AC_SchMSwitch_EcuMode_ECUM_STATE_STARTUP_TWO (BswMActionListItem):
              category = TOOL_CONFIGURED
              BswMAbortOnFail = 0
              BswMActionListItemIndex = 10
              BswMActionListItemRef = BswMModeControl/AC_SchMSwitch_EcuMode_ECUM_STATE_STARTUP_TWO
            AC_UserCallout_EcuState_ENTRY_STARTUP_TWO (BswMActionListItem):
              category = TOOL_CONFIGURED
              BswMAbortOnFail = 0
              BswMActionListItemIndex = 20
              BswMActionListItemRef = BswMModeControl/AC_UserCallout_EcuState_ENTRY_STARTUP_TWO
          TrueAL_EcuState_OFF
            AC_EcuMGoDown_BSWM (BswMActionListItem): category=TOOL_CONFIGURED, BswMAbortOnFail=0, BswMActionListItemIndex=10, BswMActionListItemRef=BswMModeControl/AC_EcuMGoDown_BSWM
          TrueAL_EcuState_RESET
            AC_EcuMGoDown_BSWM (BswMActionListItem): category=TOOL_CONFIGURED, BswMAbortOnFail=0, BswMActionListItemIndex=10, BswMActionListItemRef=BswMModeControl/AC_EcuMGoDown_BSWM
          TrueAL_EcuState_RUN
            AC_UserCallout_EcuState_EXIT_RUN (BswMActionListItem): category=TOOL_CONFIGURED, BswMAbortOnFail=0, BswMActionListItemIndex=10, BswMActionListItemRef=BswMModeControl/AC_UserCallout_EcuState_EXIT_RUN
          TrueAL_EcuState_SHUTDOWN
            4 x BswMActionListItem, all with category=TOOL_CONFIGURED, BswMAbortOnFail=0:
              AL_ComModeAllow_ALL_FALSE: BswMActionListItemIndex=10, BswMActionListItemRef=BswMModeControl/AL_ComModeAllow_ALL_FALSE
              AL_RteStop: BswMActionListItemIndex=20, BswMActionListItemRef=BswMModeControl/AL_RteStop
              AL_DriverDeinit: BswMActionListItemIndex=30, BswMActionListItemRef=BswMModeControl/AL_DriverDeinit
              AC_UserCallout_EcuState_EXIT_SHUTDOWN: BswMActionListItemIndex=40, BswMActionListItemRef=BswMModeControl/AC_UserCallout_EcuState_EXIT_SHUTDOWN
          TrueAL_EcuState_SLEEP
            AC_UserCallout_EcuM_GoHalt (BswMActionListItem): category=TOOL_CONFIGURED, BswMAbortOnFail=0, BswMActionListItemIndex=10, BswMActionListItemRef=BswMModeControl/AC_UserCallout_EcuM_GoHalt
            AC_UserCallout_EcuState_EXIT_SLEEP (BswMActionListItem): category=TOOL_CONFIGURED, BswMAbortOnFail=0, BswMActionListItemIndex=20, BswMActionListItemRef=BswMModeControl/AC_UserCallout_EcuState_EXIT_SLEEP
          TrueAL_EcuState_STARTUP_TWO
            5 x BswMActionListItem, all with category=TOOL_CONFIGURED, BswMAbortOnFail=0:
              AL_DriverInitTwo: BswMActionListItemIndex=10, BswMActionListItemRef=BswMModeControl/AL_DriverInitTwo
              AL_ComModeAllow_ALL_TRUE: BswMActionListItemIndex=20, BswMActionListItemRef=BswMModeControl/AL_ComModeAllow_ALL_TRUE
              AL_RteStart: BswMActionListItemIndex=30, BswMActionListItemRef=BswMModeControl/AL_RteStart
              AC_RteSwitch_InitState_COMPLETE: BswMActionListItemIndex=40, BswMActionListItemRef=BswMModeControl/AC_RteSwitch_InitState_COMPLETE
              AC_UserCallout_EcuState_EXIT_STARTUP_TWO: BswMActionListItemIndex=50, BswMActionListItemRef=BswMModeControl/AC_UserCallout_EcuState_EXIT_STARTUP_TWO
          TrueAL_ShutdownTargetTo_OFF
            AC_EcuMSelectShutdownTarget_OFF (BswMActionListItem): category=TOOL_CONFIGURED, BswMAbortOnFail=0, BswMActionListItemIndex=10, BswMActionListItemRef=BswMModeControl/AC_EcuMSelectShutdownTarget_OFF
            AC_UserCallout_ShutdownTargetTo_OFF (BswMActionListItem): category=TOOL_CONFIGURED, BswMAbortOnFail=0, BswMActionListItemIndex=20, BswMActionListItemRef=BswMModeControl/AC_UserCallout_ShutdownTargetTo_OFF
          TrueAL_ShutdownTargetTo_RESET
            AC_EcuMSelectShutdownTarget_RESET_MCU (BswMActionListItem):
              category = TOOL_CONFIGURED
              BswMAbortOnFail = 0
              BswMActionListItemIndex = 10
              BswMActionListItemRef = BswMModeControl/AC_EcuMSelectShutdownTarget_RESET_MCU
            AC_UserCallout_ShutdownTargetTo_RESET (BswMActionListItem):
              category = TOOL_CONFIGURED
              BswMAbortOnFail = 0
              BswMActionListItemIndex = 20
              BswMActionListItemRef = BswMModeControl/AC_UserCallout_ShutdownTargetTo_RESET
          TrueAL_ShutdownTargetTo_RUN
            AC_UserCallout_ShutdownTargetTo_RUN (BswMActionListItem): category=TOOL_CONFIGURED, BswMAbortOnFail=0, BswMActionListItemIndex=10, BswMActionListItemRef=BswMModeControl/AC_UserCallout_ShutdownTargetTo_RUN
          TrueAL_ShutdownTargetTo_SLEEP
            AC_UserCallout_ShutdownTargetTo_SLEEP (BswMActionListItem):
              category = TOOL_CONFIGURED
              BswMAbortOnFail = 0
              BswMActionListItemIndex = 10
              BswMActionListItemRef = BswMModeControl/AC_UserCallout_ShutdownTargetTo_SLEEP
        11 x BswMSwitchPort, all with category=TOOL_CONFIGURED:
          CanSMBORState_BCAN: BswMModeSwitchInterfaceRef=CanSMBORStateInterface_BCAN
          CanSMState_BCAN: BswMModeSwitchInterfaceRef=CanSMStateInterface_BCAN
          ComMMode_BCAN: BswMModeSwitchInterfaceRef=ComMModeInterface_BCAN
          DcmApplicationUpdated: BswMModeSwitchInterfaceRef=DcmApplicationUpdated
          DcmCommunicationControl_0: BswMModeSwitchInterfaceRef=DcmCommunicationControl_0
          DcmControlDTCSetting: BswMModeSwitchInterfaceRef=DcmControlDTCSetting
          DcmDiagnosticSessionControl: BswMModeSwitchInterfaceRef=DcmDiagnosticSessionControl
          DcmModeRapidPowerShutDown: BswMModeSwitchInterfaceRef=DcmModeRapidPowerShutDown
          EcuMode: BswMModeSwitchInterfaceRef=EcuModeInterface
          InitState: BswMModeSwitchInterfaceRef=InitStateInterface
          WakeupEvent: BswMModeSwitchInterfaceRef=WakeupEventInterface
        AC_UserCallout_haeHsmDriver_Init (BswMAction)
          BswMAvailableActions
            BswMUserCallout: BswMUserCalloutFunction=UserCallout_HsmDriverInit
        AC_UserCallout_Crypto_76_HaeModule_Init (BswMAction)
          BswMAvailableActions
            BswMUserCallout: BswMUserCalloutFunction=Crypto_76_HaeModule_Init(NULL)
